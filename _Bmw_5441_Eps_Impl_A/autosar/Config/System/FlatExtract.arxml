[part 2 of 4: package /COM/VECTOR/CFG/WORKFLOW/SYSDESC/SYNC]
AUTOSAR XML (schema 4-3-0)
package /COM/VECTOR/CFG/WORKFLOW/SYSDESC/SYNC  (continued)
  composition sw component type COMPOSITIONTYPE  (continued)
    connect CalRegn01Cmn.LoaMgrCurrMeasMtgtnSca -> LoaMgr.LoaMgrCurrMeasMtgtnSca  # UB:Derived from original system description
    connect CalRegn01Cmn.LoaMgrCurrMeasMtgtnScaZeroEna -> LoaMgr.LoaMgrCurrMeasMtgtnScaZeroEna  # UB:Derived from original system description
    connect CalRegn01Cmn.LoaMgrFadeOutStRate -> LoaMgr.LoaMgrFadeOutStRate  # UB:Derived from original system description
    connect CalRegn01Cmn.LoaMgrHwTqIdptSig0NoTqLoaResp -> LoaMgr.LoaMgrHwTqIdptSig0NoTqLoaResp  # UB:Derived from original system description
    connect CalRegn01Cmn.LoaMgrHwTqIdptSig1NoTqLoaResp -> LoaMgr.LoaMgrHwTqIdptSig1NoTqLoaResp  # UB:Derived from original system description
    connect CalRegn01Cmn.LoaMgrHwTqIdptSig{2..4}Resp -> LoaMgr.LoaMgrHwTqIdptSig{2..4}Resp  # UB:Derived from original system description
    connect CalRegn01Cmn.LoaMgrHwTqIdptSigFltThd -> LoaMgr.LoaMgrHwTqIdptSigFltThd  # UB:Derived from original system description
    connect CalRegn01Cmn.LoaMgrHwTqLoaAvlResp -> LoaMgr.LoaMgrHwTqLoaAvlResp  # UB:Derived from original system description
    connect CalRegn01Cmn.LoaMgrIvtrIdptSig{0..2}Resp -> LoaMgr.LoaMgrIvtrIdptSig{0..2}Resp  # UB:Derived from original system description
    connect CalRegn01Cmn.LoaMgrIvtrIdptSigFltThd -> LoaMgr.LoaMgrIvtrIdptSigFltThd  # UB:Derived from original system description
    connect CalRegn01Cmn.LoaMgrIvtrMtgtnRate -> LoaMgr.LoaMgrIvtrMtgtnRate  # UB:Derived from original system description
    connect CalRegn01Cmn.LoaMgrIvtrMtgtnSca -> LoaMgr.LoaMgrIvtrMtgtnSca  # UB:Derived from original system description
    connect CalRegn01Cmn.LoaMgrIvtrMtgtnScaZeroEna -> LoaMgr.LoaMgrIvtrMtgtnScaZeroEna  # UB:Derived from original system description
    connect CalRegn01Cmn.LoaMgrLimdStRate -> LoaMgr.LoaMgrLimdStRate  # UB:Derived from original system description
    connect CalRegn01Cmn.LoaMgrLimdStSca -> LoaMgr.LoaMgrLimdStSca  # UB:Derived from original system description
    connect CalRegn01Cmn.LoaMgrMotAgAvlSnsrlsResp -> LoaMgr.LoaMgrMotAgAvlSnsrlsResp  # UB:Derived from original system description
    connect CalRegn01Cmn.LoaMgrMotAgIdptSig0NoSnsrlsResp -> LoaMgr.LoaMgrMotAgIdptSig0NoSnsrlsResp  # UB:Derived from original system description
    connect CalRegn01Cmn.LoaMgrMotAgIdptSig1NoSnsrlsResp -> LoaMgr.LoaMgrMotAgIdptSig1NoSnsrlsResp  # UB:Derived from original system description
    connect CalRegn01Cmn.LoaMgrMotAgIdptSig2Resp -> LoaMgr.LoaMgrMotAgIdptSig2Resp  # UB:Derived from original system description
    connect CalRegn01Cmn.LoaMgrMotAgIdptSig3Resp -> LoaMgr.LoaMgrMotAgIdptSig3Resp  # UB:Derived from original system description
    connect CalRegn01Cmn.LoaMgrMotAgIdptSigFltThd -> LoaMgr.LoaMgrMotAgIdptSigFltThd  # UB:Derived from original system description
    connect CalRegn01Cmn.LoaMgrMotAgMtgtnRate -> LoaMgr.LoaMgrMotAgMtgtnRate  # UB:Derived from original system description
    connect CalRegn01Cmn.LoaMgrMotAgMtgtnSca -> LoaMgr.LoaMgrMotAgMtgtnSca  # UB:Derived from original system description
    connect CalRegn01Cmn.LoaMgrMotAgMtgtnScaZeroEna -> LoaMgr.LoaMgrMotAgMtgtnScaZeroEna  # UB:Derived from original system description
    connect CalRegn01Cmn.LrndRackCentrAllwManIniLrng -> LrndRackCentr.LrndRackCentrAllwManIniLrng  # UB:Derived from original system description
    connect CalRegn01Cmn.LrndRackCentrConfTrvlThd -> LrndRackCentr.LrndRackCentrConfTrvlThd  # UB:Derived from original system description
    connect CalRegn01Cmn.LrndRackCentrHwAgFilFrq -> LrndRackCentr.LrndRackCentrHwAgFilFrq  # UB:Derived from original system description
    connect CalRegn01Cmn.LrndRackCentrMinMaxAdjmtFac -> LrndRackCentr.LrndRackCentrMinMaxAdjmtFac  # UB:Derived from original system description
    connect CalRegn01Cmn.LrndRackCentrRackCentrPosnChgAllwd -> LrndRackCentr.LrndRackCentrRackCentrPosnChgAllwd  # UB:Derived from original system description
    connect CalRegn01Cmn.LrndRackCentrTiThd -> LrndRackCentr.LrndRackCentrTiThd  # UB:Derived from original system description
    connect CalRegn01Cmn.LrnPinionCentrDampgCtrlGain -> LrnPinionCentr.LrnPinionCentrDampgCtrlGain  # UB:Derived from original system description
    connect CalRegn01Cmn.LrnPinionCentrHldTq -> LrnPinionCentr.LrnPinionCentrHldTq  # UB:Derived from original system description
    connect CalRegn01Cmn.LrnPinionCentrHldTqErrThd -> LrnPinionCentr.LrnPinionCentrHldTqErrThd  # UB:Derived from original system description
    connect CalRegn01Cmn.LrnPinionCentrHldTqRateLim -> LrnPinionCentr.LrnPinionCentrHldTqRateLim  # UB:Derived from original system description
    connect CalRegn01Cmn.LrnPinionCentrHwPosnErrThd -> LrnPinionCentr.LrnPinionCentrHwPosnErrThd  # UB:Derived from original system description
    connect CalRegn01Cmn.LrnPinionCentrIntglCtrlGain -> LrnPinionCentr.LrnPinionCentrIntglCtrlGain  # UB:Derived from original system description
    connect CalRegn01Cmn.LrnPinionCentrMaxTqCmd -> LrnPinionCentr.LrnPinionCentrMaxTqCmd  # UB:Derived from original system description
    connect CalRegn01Cmn.LrnPinionCentrMinMotTq -> LrnPinionCentr.LrnPinionCentrMinMotTq  # UB:Derived from original system description
    connect CalRegn01Cmn.LrnPinionCentrMotVelThd -> LrnPinionCentr.LrnPinionCentrMotVelThd  # UB:Derived from original system description
    connect CalRegn01Cmn.LrnPinionCentrPropCtrlGain -> LrnPinionCentr.LrnPinionCentrPropCtrlGain  # UB:Derived from original system description
    connect CalRegn01Cmn.LrnPinionCentrTiOutThd -> LrnPinionCentr.LrnPinionCentrTiOutThd  # UB:Derived from original system description
    connect CalRegn01Cmn.LrnPinionCentrTiThd -> LrnPinionCentr.LrnPinionCentrTiThd  # UB:Derived from original system description
    connect CalRegn01Cmn.SysGlbPrmMotPoleCnt -> MotAgCorrln.SysGlbPrmMotPoleCnt  # UB:Derived from original system description
    connect CalRegn01Cmn.MotCtrlPrmEstimnFetThermCoeff -> MotCtrlPrmEstimn.MotCtrlPrmEstimnFetThermCoeff  # UB:Derived from original system description
    connect CalRegn01Cmn.MotCtrlPrmEstimnMagThermCoeff -> MotCtrlPrmEstimn.MotCtrlPrmEstimnMagThermCoeff  # UB:Derived from original system description
    connect CalRegn01Cmn.MotCurrRegCfgCtrlrDynGainVehSpdCutOff -> MotCurrRegCfg.MotCurrRegCfgCtrlrDynGainVehSpdCutOff  # UB:Derived from original system description
    connect CalRegn01Cmn.MotCurrRegCfgCurrLoopSecOrderTrfFctEna -> MotCurrRegCfg.MotCurrRegCfgCurrLoopSecOrderTrfFctEna  # UB:Derived from original system description
    connect CalRegn01Cmn.MotCurrRegCfgIntglGainSampleTi -> MotCurrRegCfg.MotCurrRegCfgIntglGainSampleTi  # UB:Derived from original system description
    connect CalRegn01Cmn.MotCurrRegCfgMotAgCompuDly -> MotCurrRegCfg.MotCurrRegCfgMotAgCompuDly  # UB:Derived from original system description
    connect CalRegn01Cmn.MotCurrRegCfgMotCtrlPrmSelnX -> MotCurrRegCfg.MotCurrRegCfgMotCtrlPrmSelnX  # UB:Derived from original system description
    connect CalRegn01Cmn.MotRefMdlFbCtrlDi -> MotCurrRegCfg.MotRefMdlFbCtrlDi  # UB:Derived from original system description
    connect CalRegn01Cmn.SysGlbPrmMotPoleCnt -> MotCurrRegCfg.SysGlbPrmMotPoleCnt  # UB:Derived from original system description
    connect CalRegn01Cmn.MotQuadDetnMotDirHysInsts -> MotQuadDetn.MotQuadDetnMotDirHysInsts  # UB:Derived from original system description
    connect CalRegn01Cmn.MotRefMdlFbCtrlDi -> MotRefMdl.MotRefMdlFbCtrlDi  # UB:Derived from original system description
    connect CalRegn01Cmn.MotRefMdlIvtrDeadTiBrdgVltgSca -> MotRefMdl.MotRefMdlIvtrDeadTiBrdgVltgSca  # UB:Derived from original system description
    connect CalRegn01Cmn.MotRefMdlMinCurrItrnLim -> MotRefMdl.MotRefMdlMinCurrItrnLim  # UB:Derived from original system description
    connect CalRegn01Cmn.MotRefMdlMotVelLpFilFrq -> MotRefMdl.MotRefMdlMotVelLpFilFrq  # UB:Derived from original system description
    connect CalRegn01Cmn.MotRefMdlMotVltgDerivtvTiCon -> MotRefMdl.MotRefMdlMotVltgDerivtvTiCon  # UB:Derived from original system description
    connect CalRegn01Cmn.MotRefMdlRefLocnItrnLim -> MotRefMdl.MotRefMdlRefLocnItrnLim  # UB:Derived from original system description
    connect CalRegn01Cmn.MotRefMdlTqItrnLim -> MotRefMdl.MotRefMdlTqItrnLim  # UB:Derived from original system description
    connect CalRegn01Cmn.MotRefMdlTqItrnTolr -> MotRefMdl.MotRefMdlTqItrnTolr  # UB:Derived from original system description
    connect CalRegn01Cmn.MotRefMdlVltgModDynCmpEna -> MotRefMdl.MotRefMdlVltgModDynCmpEna  # UB:Derived from original system description
    connect CalRegn01Cmn.SysGlbPrmMotPoleCnt -> MotRefMdl.SysGlbPrmMotPoleCnt  # UB:Derived from original system description
    connect CalRegn01Cmn.SysGlbPrmMotPoleCnt -> MotTqCalcd.SysGlbPrmMotPoleCnt  # UB:Derived from original system description
    connect CalRegn01Cmn.MotTqCmdScaMax -> MotTqCmdSca.MotTqCmdScaMax  # UB:Derived from original system description
    connect CalRegn01Cmn.MotTqCmdScaMin -> MotTqCmdSca.MotTqCmdScaMin  # UB:Derived from original system description
    connect CalRegn01Cmn.MotTqTranlDampgDampgCoeff -> MotTqTranlDampg.MotTqTranlDampgDampgCoeff  # UB:Derived from original system description
    connect CalRegn01Cmn.MotTqTranlDampgRampEnd -> MotTqTranlDampg.MotTqTranlDampgRampEnd  # UB:Derived from original system description
    connect CalRegn01Cmn.MotTqTranlDampgTmrPt1 -> MotTqTranlDampg.MotTqTranlDampgTmrPt1  # UB:Derived from original system description
    connect CalRegn01Cmn.MotTqTranlDampgTmrPt2 -> MotTqTranlDampg.MotTqTranlDampgTmrPt2  # UB:Derived from original system description
    connect CalRegn01Cmn.MotTqTranlDampgVehSpdBlndX -> MotTqTranlDampg.MotTqTranlDampgVehSpdBlndX  # UB:Derived from original system description
    connect CalRegn01Cmn.MotTqTranlDampgVehSpdBlndY -> MotTqTranlDampg.MotTqTranlDampgVehSpdBlndY  # UB:Derived from original system description
    connect CalRegn01Cmn.PhaDiscnctClsDlyTi -> PhaDiscnct.PhaDiscnctClsDlyTi  # UB:Derived from original system description
    connect CalRegn01Cmn.PhaDiscnctFixdPhaOnTi -> PhaDiscnct.PhaDiscnctFixdPhaOnTi  # UB:Derived from original system description
    connect CalRegn01Cmn.PhaDiscnctFixdPwmPerd -> PhaDiscnct.PhaDiscnctFixdPwmPerd  # UB:Derived from original system description
    connect CalRegn01Cmn.PhaDiscnctOpenDlyTi -> PhaDiscnct.PhaDiscnctOpenDlyTi  # UB:Derived from original system description
    connect CalRegn01Cmn.PhaDiscnctTestCurrTestVal -> PhaDiscnct.PhaDiscnctTestCurrTestVal  # UB:Derived from original system description
    connect CalRegn01Cmn.PhaDiscnctTestFailScanMax -> PhaDiscnct.PhaDiscnctTestFailScanMax  # UB:Derived from original system description
    connect CalRegn01Cmn.PhaDiscnctTestIninScan -> PhaDiscnct.PhaDiscnctTestIninScan  # UB:Derived from original system description
    connect CalRegn01Cmn.PhaDiscnctTestScanCnt -> PhaDiscnct.PhaDiscnctTestScanCnt  # UB:Derived from original system description
    connect CalRegn01Cmn.PosnTrakgServoHwAgTarRateLimTblY -> PosnTrakgServo.PosnTrakgServoHwAgTarRateLimTblY  # UB:Derived from original system description
    connect CalRegn01Cmn.PosnTrakgServoHwVelTarRateLimTblY -> PosnTrakgServo.PosnTrakgServoHwVelTarRateLimTblY  # UB:Derived from original system description
    connect CalRegn01Cmn.PosnTrakgServoIntglLim -> PosnTrakgServo.PosnTrakgServoIntglLim  # UB:Derived from original system description
    connect CalRegn01Cmn.PosnTrakgServoIntgtrAntiWdupGain -> PosnTrakgServo.PosnTrakgServoIntgtrAntiWdupGain  # UB:Derived from original system description
    connect CalRegn01Cmn.PosnTrakgServoIntgtrStCorrnGain -> PosnTrakgServo.PosnTrakgServoIntgtrStCorrnGain  # UB:Derived from original system description
    connect CalRegn01Cmn.PosnTrakgServoLpFilCutOffFrq -> PosnTrakgServo.PosnTrakgServoLpFilCutOffFrq  # UB:Derived from original system description
    connect CalRegn01Cmn.PosnTrakgServoOutpAntiWdupGain -> PosnTrakgServo.PosnTrakgServoOutpAntiWdupGain  # UB:Derived from original system description
    connect CalRegn01Cmn.PosnTrakgServoOutpLim -> PosnTrakgServo.PosnTrakgServoOutpLim  # UB:Derived from original system description
    connect CalRegn01Cmn.PwrSplyNtc0x07BFailStep -> PwrSply.PwrSplyNtc0x07BFailStep  # UB:Derived from original system description
    connect CalRegn01Cmn.PwrSplyNtc0x07BPassStep -> PwrSply.PwrSplyNtc0x07BPassStep  # UB:Derived from original system description
    connect CalRegn01Cmn.PwrSplyNtc0x07CFailStep -> PwrSply.PwrSplyNtc0x07CFailStep  # UB:Derived from original system description
    connect CalRegn01Cmn.PwrSplyNtc0x07CPassStep -> PwrSply.PwrSplyNtc0x07CPassStep  # UB:Derived from original system description
    connect CalRegn01Cmn.PwrSplyNtc0x07DFailStep -> PwrSply.PwrSplyNtc0x07DFailStep  # UB:Derived from original system description
    connect CalRegn01Cmn.PwrSplyNtc0x07DPassStep -> PwrSply.PwrSplyNtc0x07DPassStep  # UB:Derived from original system description
    connect CalRegn01Cmn.SysKineAndEffCmplncErrDerivtvCutOffFrq -> SysKineAndEff.SysKineAndEffCmplncErrDerivtvCutOffFrq  # UB:Derived from original system description
    connect CalRegn01Cmn.SysKineAndEffMotAgScaX -> SysKineAndEff.SysKineAndEffMotAgScaX  # UB:Derived from original system description
    connect CalRegn01Cmn.SysKineAndEffMotToRackEffScaY -> SysKineAndEff.SysKineAndEffMotToRackEffScaY  # UB:Derived from original system description
    connect CalRegn01Cmn.SysKineAndEffRackPosScaY -> SysKineAndEff.SysKineAndEffRackPosScaY  # UB:Derived from original system description
    connect CalRegn01Cmn.TEstimnIgnOffCtrlEna -> TEstimn.TEstimnIgnOffCtrlEna  # UB:Derived from original system description
    connect CalRegn01Cmn.TEstimnIgnOffMsgWaitTi -> TEstimn.TEstimnIgnOffMsgWaitTi  # UB:Derived from original system description
    connect CalRegn01Cmn.TqOscnAmpLimY -> TqOscn.TqOscnAmpLimY  # UB:Derived from original system description
    connect CalRegn01Cmn.TqOscnFallRampRateCal -> TqOscn.TqOscnFallRampRateCal  # UB:Derived from original system description
    connect CalRegn01Cmn.TqOscnFrqIn -> TqOscn.TqOscnFrqIn  # UB:Derived from original system description
    connect CalRegn01Cmn.TqOscnRisngRampRateCal -> TqOscn.TqOscnRisngRampRateCal  # UB:Derived from original system description
    connect CalRegn01Cmn.TqOscnUseRampRateCal -> TqOscn.TqOscnUseRampRateCal  # UB:Derived from original system description
    connect CalRegn01Cmn.TunSelnAuthyHwTqY -> TunSelnAuthy.TunSelnAuthyHwTqY  # UB:Derived from original system description
    connect CalRegn01Cmn.TunSelnAuthyHwVelY -> TunSelnAuthy.TunSelnAuthyHwVelY  # UB:Derived from original system description
    connect CalRegn01Cmn.TunSelnAuthyTunSelnRtDiCmd -> TunSelnAuthy.TunSelnAuthyTunSelnRtDiCmd  # UB:Derived from original system description
    connect CalRegn01Cmn.VehSigCdngDftLatA -> VehSigCdng.VehSigCdngDftLatA  # UB:Derived from original system description
    connect CalRegn01Cmn.VehSigCdngDftLgtA -> VehSigCdng.VehSigCdngDftLgtA  # UB:Derived from original system description
    connect CalRegn01Cmn.VehSigCdngDftVehSpd -> VehSigCdng.VehSigCdngDftVehSpd  # UB:Derived from original system description
    connect CalRegn01Cmn.VehSigCdngDftYawRate -> VehSigCdng.VehSigCdngDftYawRate  # UB:Derived from original system description
    connect CalRegn01Cmn.VehSigCdngLatADifThd -> VehSigCdng.VehSigCdngLatADifThd  # UB:Derived from original system description
    connect CalRegn01Cmn.VehSigCdngLatAFilFrq -> VehSigCdng.VehSigCdngLatAFilFrq  # UB:Derived from original system description
    connect CalRegn01Cmn.VehSigCdngLatASlewRate -> VehSigCdng.VehSigCdngLatASlewRate  # UB:Derived from original system description
    connect CalRegn01Cmn.VehSigCdngLtgADifThd -> VehSigCdng.VehSigCdngLtgADifThd  # UB:Derived from original system description
    connect CalRegn01Cmn.VehSigCdngLtgASlewRate -> VehSigCdng.VehSigCdngLtgASlewRate  # UB:Derived from original system description
    connect CalRegn01Cmn.VehSigCdngVehSpdDifThd -> VehSigCdng.VehSigCdngVehSpdDifThd  # UB:Derived from original system description
    connect CalRegn01Cmn.VehSigCdngVehSpdSlewRate -> VehSigCdng.VehSigCdngVehSpdSlewRate  # UB:Derived from original system description
    connect CalRegn01Cmn.VehSigCdngVehYawSlewRate -> VehSigCdng.VehSigCdngVehYawSlewRate  # UB:Derived from original system description
    connect CalRegn01Cmn.VehSigCdngYawRateDifThd -> VehSigCdng.VehSigCdngYawRateDifThd  # UB:Derived from original system description
    connect CalRegn01Cmn.VehSpdLimrMaxAssiX -> VehSpdLimr.VehSpdLimrMaxAssiX  # UB:Derived from original system description
    connect CalRegn01Cmn.VehSpdLimrMaxAssiY -> VehSpdLimr.VehSpdLimrMaxAssiY  # UB:Derived from original system description
    connect CalRegn01Cmn.VehSpdLimrPosMaxOffs1 -> VehSpdLimr.VehSpdLimrPosMaxOffs1  # UB:Derived from original system description
    connect CalRegn01CmnGroupA.BmwHwAgArbnAndEotPosnAllwExitFromInit -> BmwHwAgArbnAndEotPosn.BmwHwAgArbnAndEotPosnAllwExitFromInit  # UB:Derived from original system description
    connect CalRegn01CmnGroupA.BmwHwAgArbnAndEotPosnMotToHwResl -> BmwHwAgArbnAndEotPosn.BmwHwAgArbnAndEotPosnMotToHwResl  # UB:Derived from original system description
    connect CalRegn01CmnGroupA.BmwHwAgArbnAndEotPosnOffsCorrnTmrThd -> BmwHwAgArbnAndEotPosn.BmwHwAgArbnAndEotPosnOffsCorrnTmrThd  # UB:Derived from original system description
    connect CalRegn01CmnGroupA.BmwHwAgArbnAndEotPosnPinionAgConfRampDwnRate -> BmwHwAgArbnAndEotPosn.BmwHwAgArbnAndEotPosnPinionAgConfRampDwnRate  # UB:Derived from original system description
    connect CalRegn01CmnGroupA.BmwHwAgArbnAndEotPosnPinionAgConfRampUpRate -> BmwHwAgArbnAndEotPosn.BmwHwAgArbnAndEotPosnPinionAgConfRampUpRate  # UB:Derived from original system description
    connect CalRegn01CmnGroupA.BmwHwAgArbnAndEotPosnPinionAgDifThd -> BmwHwAgArbnAndEotPosn.BmwHwAgArbnAndEotPosnPinionAgDifThd  # UB:Derived from original system description
    connect CalRegn01CmnGroupA.BmwHwAgArbnAndEotPosnPinionAgFilFrq -> BmwHwAgArbnAndEotPosn.BmwHwAgArbnAndEotPosnPinionAgFilFrq  # UB:Derived from original system description
    connect CalRegn01CmnGroupA.BmwStReqMgrVehCdnOvrd -> BmwStReqMgr.BmwStReqMgrVehCdnOvrd  # UB:Derived from original system description
    connect CalRegn01CmnGroupA.BmwTunSetHndlrCptDisadOutp -> BmwTunSetHndlr.BmwTunSetHndlrCptDisadOutp  # UB:Derived from original system description
    connect CalRegn01CmnGroupA.BmwTunSetHndlrOvrdDesRtIdx -> BmwTunSetHndlr.BmwTunSetHndlrOvrdDesRtIdx  # UB:Derived from original system description
    connect CalRegn01CmnGroupA.ElecPwrCnsPrstcPwrLoss -> ElecPwrCns.ElecPwrCnsPrstcPwrLoss  # UB:Derived from original system description
    connect CalRegn01CmnGroupA.HwTqTrakgCtrlMotTqCmdOvrlGain -> HwTqTrakgCtrl.HwTqTrakgCtrlMotTqCmdOvrlGain  # UB:Derived from original system description
    connect CalRegn01CmnGroupA.PosnTrakgServoFfGain -> PosnTrakgServo.PosnTrakgServoFfGain  # UB:Derived from original system description
    connect CalRegn01CmnGroupA.PosnTrakgServoFfVelGain -> PosnTrakgServo.PosnTrakgServoFfVelGain  # UB:Derived from original system description
    connect CalRegn01CmnGroupA.PosnTrakgServoGain{1..4} -> PosnTrakgServo.PosnTrakgServoGain{1..4}  # UB:Derived from original system description
    connect CalRegn01CmnGroupA.PosnTrakgServoHwAgTarMgnLimTblY -> PosnTrakgServo.PosnTrakgServoHwAgTarMgnLimTblY  # UB:Derived from original system description
    connect CalRegn01CmnGroupA.PosnTrakgServoIntglGain -> PosnTrakgServo.PosnTrakgServoIntglGain  # UB:Derived from original system description
    connect CalRegn01CmnGroupA.PosnTrakgServoVehSpdTbl -> PosnTrakgServo.PosnTrakgServoVehSpdTbl  # UB:Derived from original system description
    connect CalRegn01CmnGroupC.CtrldVelRtnAntiWdup -> CtrldVelRtn.CtrldVelRtnAntiWdup  # UB:Derived from original system description
    connect CalRegn01CmnGroupC.CtrldVelRtnDampgEna -> CtrldVelRtn.CtrldVelRtnDampgEna  # UB:Derived from original system description
    connect CalRegn01CmnGroupC.CtrldVelRtnDampgScaEna -> CtrldVelRtn.CtrldVelRtnDampgScaEna  # UB:Derived from original system description
    connect CalRegn01CmnGroupC.CtrldVelRtnDrvrTqEna -> CtrldVelRtn.CtrldVelRtnDrvrTqEna  # UB:Derived from original system description
    connect CalRegn01CmnGroupC.CtrldVelRtnDrvrTqMtrxA -> CtrldVelRtn.CtrldVelRtnDrvrTqMtrxA  # UB:Derived from original system description
    connect CalRegn01CmnGroupC.CtrldVelRtnDrvrTqMtrxB -> CtrldVelRtn.CtrldVelRtnDrvrTqMtrxB  # UB:Derived from original system description
    connect CalRegn01CmnGroupC.CtrldVelRtnDrvrTqMtrxC -> CtrldVelRtn.CtrldVelRtnDrvrTqMtrxC  # UB:Derived from original system description
    connect CalRegn01CmnGroupC.CtrldVelRtnDrvrTqMtrxD -> CtrldVelRtn.CtrldVelRtnDrvrTqMtrxD  # UB:Derived from original system description
    connect CalRegn01CmnGroupC.CtrldVelRtnHwAuthyScaX -> CtrldVelRtn.CtrldVelRtnHwAuthyScaX  # UB:Derived from original system description
    connect CalRegn01CmnGroupC.CtrldVelRtnHwAuthyScaY -> CtrldVelRtn.CtrldVelRtnHwAuthyScaY  # UB:Derived from original system description
    connect CalRegn01CmnGroupC.CtrldVelRtnHwAuthySlewThd -> CtrldVelRtn.CtrldVelRtnHwAuthySlewThd  # UB:Derived from original system description
    connect CalRegn01CmnGroupC.CtrldVelRtnRtnCmdLimY -> CtrldVelRtn.CtrldVelRtnRtnCmdLimY  # UB:Derived from original system description
    connect CalRegn01CmnGroupC.CtrldVelRtnTqGrdtScaEna -> CtrldVelRtn.CtrldVelRtnTqGrdtScaEna  # UB:Derived from original system description
    connect CalRegn01CmnGroupC.SteerCmdArbnAndLimFalbckTiThd -> SteerCmdArbnAndLim.SteerCmdArbnAndLimFalbckTiThd  # UB:Derived from original system description
    connect CalRegn01CmnGroupC.SteerCmdArbnAndLimFwTiThd -> SteerCmdArbnAndLim.SteerCmdArbnAndLimFwTiThd  # UB:Derived from original system description
    connect CalRegn01CmnGroupD.EotProtnActvRegnBypMaxThd -> EotProtn.EotProtnActvRegnBypMaxThd  # UB:Derived from original system description
    connect CalRegn01CmnGroupD.EotProtnDampgSlew -> EotProtn.EotProtnDampgSlew  # UB:Derived from original system description
    connect CalRegn01CmnGroupD.EotProtnDftPosn -> EotProtn.EotProtnDftPosn  # UB:Derived from original system description
    connect CalRegn01CmnGroupD.EotProtnHwAgGain -> EotProtn.EotProtnHwAgGain  # UB:Derived from original system description
    connect CalRegn01CmnGroupD.EotProtnHwAgMax -> EotProtn.EotProtnHwAgMax  # UB:Derived from original system description
    connect CalRegn01CmnGroupD.EotProtnHwAgMin -> EotProtn.EotProtnHwAgMin  # UB:Derived from original system description
    connect CalRegn01CmnGroupD.EotProtnRackTrvlLimrEna -> EotProtn.EotProtnRackTrvlLimrEna  # UB:Derived from original system description
    connect CalRegn01CmnGroupD.EotProtnSoftEndStopAuthyThd -> EotProtn.EotProtnSoftEndStopAuthyThd  # UB:Derived from original system description
    connect CalRegn01CmnGroupD.EotProtnSoftEndStopEna -> EotProtn.EotProtnSoftEndStopEna  # UB:Derived from original system description
    connect CalRegn01CmnGroupD.EotProtnSoftEndStopVehSpdThd -> EotProtn.EotProtnSoftEndStopVehSpdThd  # UB:Derived from original system description
    connect CalRegn01IninOptSetA00.DutyCycThermProtnAbsltCtrlTFetMtgtnTblX -> AAACalRegn01IninOptSetA00_Dummy.DutyCycThermProtnAbsltCtrlTFetMtgtnTblX  # UB:Derived from original system description
    connect CalRegn01IninOptSetA00.DutyCycThermProtnAbsltCtrlTTblX -> AAACalRegn01IninOptSetA00_Dummy.DutyCycThermProtnAbsltCtrlTTblX  # UB:Derived from original system description
    connect CalRegn01IninOptSetA00.DutyCycThermProtnAbsltCtrlTTqFetMtgtnTblY -> AAACalRegn01IninOptSetA00_Dummy.DutyCycThermProtnAbsltCtrlTTqFetMtgtnTblY  # UB:Derived from original system description
    connect CalRegn01IninOptSetA00.DutyCycThermProtnAbsltCtrlTTqTblY -> AAACalRegn01IninOptSetA00_Dummy.DutyCycThermProtnAbsltCtrlTTqTblY  # UB:Derived from original system description
    connect CalRegn01IninOptSetA00.DutyCycThermProtnAbsltCuTFetMtgtnTblX -> AAACalRegn01IninOptSetA00_Dummy.DutyCycThermProtnAbsltCuTFetMtgtnTblX  # UB:Derived from original system description
    connect CalRegn01IninOptSetA00.DutyCycThermProtnAbsltCuTTblX -> AAACalRegn01IninOptSetA00_Dummy.DutyCycThermProtnAbsltCuTTblX  # UB:Derived from original system description
    connect CalRegn01IninOptSetA00.DutyCycThermProtnAbsltCuTTqFetMtgtnTblY -> AAACalRegn01IninOptSetA00_Dummy.DutyCycThermProtnAbsltCuTTqFetMtgtnTblY  # UB:Derived from original system description
    connect CalRegn01IninOptSetA00.DutyCycThermProtnAbsltCuTTqTblY -> AAACalRegn01IninOptSetA00_Dummy.DutyCycThermProtnAbsltCuTTqTblY  # UB:Derived from original system description
    connect CalRegn01IninOptSetA00.DutyCycThermProtnAbsltMotVelBreakPt -> AAACalRegn01IninOptSetA00_Dummy.DutyCycThermProtnAbsltMotVelBreakPt  # UB:Derived from original system description
    connect CalRegn01IninOptSetA00.DutyCycThermProtnAbsltTTqSlewHiLim -> AAACalRegn01IninOptSetA00_Dummy.DutyCycThermProtnAbsltTTqSlewHiLim  # UB:Derived from original system description
    connect CalRegn01IninOptSetA00.DutyCycThermProtnAbsltTTqSlewLoLim -> AAACalRegn01IninOptSetA00_Dummy.DutyCycThermProtnAbsltTTqSlewLoLim  # UB:Derived from original system description
    connect CalRegn01IninOptSetA00.DutyCycThermProtnCtrlT -> AAACalRegn01IninOptSetA00_Dummy.DutyCycThermProtnCtrlT  # UB:Derived from original system description
    connect CalRegn01IninOptSetA00.DutyCycThermProtnCtrlTSeln -> AAACalRegn01IninOptSetA00_Dummy.DutyCycThermProtnCtrlTSeln  # UB:Derived from original system description
    connect CalRegn01IninOptSetA00.DutyCycThermProtnDutyCycFildThd -> AAACalRegn01IninOptSetA00_Dummy.DutyCycThermProtnDutyCycFildThd  # UB:Derived from original system description
    connect CalRegn01IninOptSetA00.DutyCycThermProtnIgnOffCtrlEna -> AAACalRegn01IninOptSetA00_Dummy.DutyCycThermProtnIgnOffCtrlEna  # UB:Derived from original system description
    connect CalRegn01IninOptSetA00.DutyCycThermProtnIgnOffMsgWaitTi -> AAACalRegn01IninOptSetA00_Dummy.DutyCycThermProtnIgnOffMsgWaitTi  # UB:Derived from original system description
    connect CalRegn01IninOptSetA00.DutyCycThermProtnLstTblValNonStall -> AAACalRegn01IninOptSetA00_Dummy.DutyCycThermProtnLstTblValNonStall  # UB:Derived from original system description
    connect CalRegn01IninOptSetA00.DutyCycThermProtnLstTblValStall -> AAACalRegn01IninOptSetA00_Dummy.DutyCycThermProtnLstTblValStall  # UB:Derived from original system description
    connect CalRegn01IninOptSetA00.DutyCycThermProtnMotPrTSeln -> AAACalRegn01IninOptSetA00_Dummy.DutyCycThermProtnMotPrTSeln  # UB:Derived from original system description
    connect CalRegn01IninOptSetA00.DutyCycThermProtnMplr1FetMtgtnNonStallTblY -> AAACalRegn01IninOptSetA00_Dummy.DutyCycThermProtnMplr1FetMtgtnNonStallTblY  # UB:Derived from original system description
    connect CalRegn01IninOptSetA00.DutyCycThermProtnMplr1FetMtgtnStallTblY -> AAACalRegn01IninOptSetA00_Dummy.DutyCycThermProtnMplr1FetMtgtnStallTblY  # UB:Derived from original system description
    connect CalRegn01IninOptSetA00.DutyCycThermProtnMplr1NonStallTblY -> AAACalRegn01IninOptSetA00_Dummy.DutyCycThermProtnMplr1NonStallTblY  # UB:Derived from original system description
    connect CalRegn01IninOptSetA00.DutyCycThermProtnMplr1StallTblY -> AAACalRegn01IninOptSetA00_Dummy.DutyCycThermProtnMplr1StallTblY  # UB:Derived from original system description
    connect CalRegn01IninOptSetA00.DutyCycThermProtnMplr2FetMtgtnNonStallTblY -> AAACalRegn01IninOptSetA00_Dummy.DutyCycThermProtnMplr2FetMtgtnNonStallTblY  # UB:Derived from original system description
    connect CalRegn01IninOptSetA00.DutyCycThermProtnMplr2FetMtgtnStallTblY -> AAACalRegn01IninOptSetA00_Dummy.DutyCycThermProtnMplr2FetMtgtnStallTblY  # UB:Derived from original system description
    connect CalRegn01IninOptSetA00.DutyCycThermProtnMplr2NonStallTblY -> AAACalRegn01IninOptSetA00_Dummy.DutyCycThermProtnMplr2NonStallTblY  # UB:Derived from original system description
    connect CalRegn01IninOptSetA00.DutyCycThermProtnMplr2StallTblY -> AAACalRegn01IninOptSetA00_Dummy.DutyCycThermProtnMplr2StallTblY  # UB:Derived from original system description
    connect CalRegn01IninOptSetA00.DutyCycThermProtnMplr3FetMtgtnNonStallTblY -> AAACalRegn01IninOptSetA00_Dummy.DutyCycThermProtnMplr3FetMtgtnNonStallTblY  # UB:Derived from original system description
    connect CalRegn01IninOptSetA00.DutyCycThermProtnMplr3FetMtgtnStallTblY -> AAACalRegn01IninOptSetA00_Dummy.DutyCycThermProtnMplr3FetMtgtnStallTblY  # UB:Derived from original system description
    connect CalRegn01IninOptSetA00.DutyCycThermProtnMplr3NonStallTblY -> AAACalRegn01IninOptSetA00_Dummy.DutyCycThermProtnMplr3NonStallTblY  # UB:Derived from original system description
    connect CalRegn01IninOptSetA00.DutyCycThermProtnMplr3StallTblY -> AAACalRegn01IninOptSetA00_Dummy.DutyCycThermProtnMplr3StallTblY  # UB:Derived from original system description
    connect CalRegn01IninOptSetA00.DutyCycThermProtnMplr4FetMtgtnNonStallTblY -> AAACalRegn01IninOptSetA00_Dummy.DutyCycThermProtnMplr4FetMtgtnNonStallTblY  # UB:Derived from original system description
    connect CalRegn01IninOptSetA00.DutyCycThermProtnMplr4FetMtgtnStallTblY -> AAACalRegn01IninOptSetA00_Dummy.DutyCycThermProtnMplr4FetMtgtnStallTblY  # UB:Derived from original system description
    connect CalRegn01IninOptSetA00.DutyCycThermProtnMplr4NonStallTblY -> AAACalRegn01IninOptSetA00_Dummy.DutyCycThermProtnMplr4NonStallTblY  # UB:Derived from original system description
    connect CalRegn01IninOptSetA00.DutyCycThermProtnMplr4StallTblY -> AAACalRegn01IninOptSetA00_Dummy.DutyCycThermProtnMplr4StallTblY  # UB:Derived from original system description
    connect CalRegn01IninOptSetA00.DutyCycThermProtnMplr5FetMtgtnNonStallTblY -> AAACalRegn01IninOptSetA00_Dummy.DutyCycThermProtnMplr5FetMtgtnNonStallTblY  # UB:Derived from original system description
    connect CalRegn01IninOptSetA00.DutyCycThermProtnMplr5FetMtgtnStallTblY -> AAACalRegn01IninOptSetA00_Dummy.DutyCycThermProtnMplr5FetMtgtnStallTblY  # UB:Derived from original system description
    connect CalRegn01IninOptSetA00.DutyCycThermProtnMplr5NonStallTblY -> AAACalRegn01IninOptSetA00_Dummy.DutyCycThermProtnMplr5NonStallTblY  # UB:Derived from original system description
    connect CalRegn01IninOptSetA00.DutyCycThermProtnMplr5StallTblY -> AAACalRegn01IninOptSetA00_Dummy.DutyCycThermProtnMplr5StallTblY  # UB:Derived from original system description
    connect CalRegn01IninOptSetA00.DutyCycThermProtnMplr6FetMtgtnNonStallTblY -> AAACalRegn01IninOptSetA00_Dummy.DutyCycThermProtnMplr6FetMtgtnNonStallTblY  # UB:Derived from original system description
    connect CalRegn01IninOptSetA00.DutyCycThermProtnMplr6FetMtgtnStallTblY -> AAACalRegn01IninOptSetA00_Dummy.DutyCycThermProtnMplr6FetMtgtnStallTblY  # UB:Derived from original system description
    connect CalRegn01IninOptSetA00.DutyCycThermProtnMplr6NonStallTblY -> AAACalRegn01IninOptSetA00_Dummy.DutyCycThermProtnMplr6NonStallTblY  # UB:Derived from original system description
    connect CalRegn01IninOptSetA00.DutyCycThermProtnMplr6StallTblY -> AAACalRegn01IninOptSetA00_Dummy.DutyCycThermProtnMplr6StallTblY  # UB:Derived from original system description
    connect CalRegn01IninOptSetA00.DutyCycThermProtnMplrFetMtgtnTblX -> AAACalRegn01IninOptSetA00_Dummy.DutyCycThermProtnMplrFetMtgtnTblX  # UB:Derived from original system description
    connect CalRegn01IninOptSetA00.DutyCycThermProtnMplrTblX -> AAACalRegn01IninOptSetA00_Dummy.DutyCycThermProtnMplrTblX  # UB:Derived from original system description
    connect CalRegn01IninOptSetA00.DutyCycThermProtnMplrTSeln -> AAACalRegn01IninOptSetA00_Dummy.DutyCycThermProtnMplrTSeln  # UB:Derived from original system description
    connect CalRegn01IninOptSetA00.DutyCycThermProtnSlowFilTSeln -> AAACalRegn01IninOptSetA00_Dummy.DutyCycThermProtnSlowFilTSeln  # UB:Derived from original system description
    connect CalRegn01IninOptSetA00.DutyCycThermProtnThermLimScaFac -> AAACalRegn01IninOptSetA00_Dummy.DutyCycThermProtnThermLimScaFac  # UB:Derived from original system description
    connect CalRegn01IninOptSetA00.DutyCycThermProtnThermLoadLimTblX -> AAACalRegn01IninOptSetA00_Dummy.DutyCycThermProtnThermLoadLimTblX  # UB:Derived from original system description
    connect CalRegn01IninOptSetA00.DutyCycThermProtnThermLoadLimTblY -> AAACalRegn01IninOptSetA00_Dummy.DutyCycThermProtnThermLoadLimTblY  # UB:Derived from original system description
    connect CalRegn01IninOptSetA00.DutyCycThermProtnTqCmdSlewDwn -> AAACalRegn01IninOptSetA00_Dummy.DutyCycThermProtnTqCmdSlewDwn  # UB:Derived from original system description
    connect CalRegn01IninOptSetA00.DutyCycThermProtnTqCmdSlewUp -> AAACalRegn01IninOptSetA00_Dummy.DutyCycThermProtnTqCmdSlewUp  # UB:Derived from original system description
    connect CalRegn01IninOptSetA00.HiLoadStallLimrMotVelMgnThd -> AAACalRegn01IninOptSetA00_Dummy.HiLoadStallLimrMotVelMgnThd  # UB:Derived from original system description
    connect CalRegn01IninOptSetA00.HiLoadStallLimrStallMotTqCmdFetMtgtnLimX -> AAACalRegn01IninOptSetA00_Dummy.HiLoadStallLimrStallMotTqCmdFetMtgtnLimX  # UB:Derived from original system description
    connect CalRegn01IninOptSetA00.HiLoadStallLimrStallMotTqCmdFetMtgtnLimY -> AAACalRegn01IninOptSetA00_Dummy.HiLoadStallLimrStallMotTqCmdFetMtgtnLimY  # UB:Derived from original system description
    connect CalRegn01IninOptSetA00.HiLoadStallLimrStallMotTqCmdLimX -> AAACalRegn01IninOptSetA00_Dummy.HiLoadStallLimrStallMotTqCmdLimX  # UB:Derived from original system description
    connect CalRegn01IninOptSetA00.HiLoadStallLimrStallMotTqCmdLimY -> AAACalRegn01IninOptSetA00_Dummy.HiLoadStallLimrStallMotTqCmdLimY  # UB:Derived from original system description
    connect CalRegn01IninOptSetA00.HiLoadStallLimrStallMotTqLimSlewRate -> AAACalRegn01IninOptSetA00_Dummy.HiLoadStallLimrStallMotTqLimSlewRate  # UB:Derived from original system description
    connect CalRegn01IninOptSetA00.HiLoadStallLimrStallThermLimSca -> AAACalRegn01IninOptSetA00_Dummy.HiLoadStallLimrStallThermLimSca  # UB:Derived from original system description
    connect CalRegn01IninOptSetA00.LrndRackCentrMotTqThd -> AAACalRegn01IninOptSetA00_Dummy.LrndRackCentrMotTqThd  # UB:Derived from original system description
    connect CalRegn01IninOptSetA00.LrndRackCentrMotVelThd -> AAACalRegn01IninOptSetA00_Dummy.LrndRackCentrMotVelThd  # UB:Derived from original system description
    connect CalRegn01IninOptSetA00.MotCtrlPrmEstimnFetRNom -> AAACalRegn01IninOptSetA00_Dummy.MotCtrlPrmEstimnFetRNom  # UB:Derived from original system description
    connect CalRegn01IninOptSetA00.MotCtrlPrmEstimnMotBackEmfConHiLim -> AAACalRegn01IninOptSetA00_Dummy.MotCtrlPrmEstimnMotBackEmfConHiLim  # UB:Derived from original system description
    connect CalRegn01IninOptSetA00.MotCtrlPrmEstimnMotBackEmfConLoLim -> AAACalRegn01IninOptSetA00_Dummy.MotCtrlPrmEstimnMotBackEmfConLoLim  # UB:Derived from original system description
    connect CalRegn01IninOptSetA00.MotCtrlPrmEstimnMotBackEmfConNom -> AAACalRegn01IninOptSetA00_Dummy.MotCtrlPrmEstimnMotBackEmfConNom  # UB:Derived from original system description
    connect CalRegn01IninOptSetA00.MotCtrlPrmEstimnMotBackEmfConSatnScaIvtrLoaMtgtn -> AAACalRegn01IninOptSetA00_Dummy.MotCtrlPrmEstimnMotBackEmfConSatnScaIvtrLoaMtgtn  # UB:Derived from original system description
    connect CalRegn01IninOptSetA00.MotCtrlPrmEstimnMotBackEmfConSatnX -> AAACalRegn01IninOptSetA00_Dummy.MotCtrlPrmEstimnMotBackEmfConSatnX  # UB:Derived from original system description
    connect CalRegn01IninOptSetA00.MotCtrlPrmEstimnMotBackEmfConSatnY -> AAACalRegn01IninOptSetA00_Dummy.MotCtrlPrmEstimnMotBackEmfConSatnY  # UB:Derived from original system description
    connect CalRegn01IninOptSetA00.MotCtrlPrmEstimnMotCurrDaxInduSatnBilnrSeln -> AAACalRegn01IninOptSetA00_Dummy.MotCtrlPrmEstimnMotCurrDaxInduSatnBilnrSeln  # UB:Derived from original system description
    connect CalRegn01IninOptSetA00.MotCtrlPrmEstimnMotCurrQaxInduSatnX -> AAACalRegn01IninOptSetA00_Dummy.MotCtrlPrmEstimnMotCurrQaxInduSatnX  # UB:Derived from original system description
    connect CalRegn01IninOptSetA00.MotCtrlPrmEstimnMotInduDaxHiLim -> AAACalRegn01IninOptSetA00_Dummy.MotCtrlPrmEstimnMotInduDaxHiLim  # UB:Derived from original system description
    connect CalRegn01IninOptSetA00.MotCtrlPrmEstimnMotInduDaxIvtrLoaMtgtn -> AAACalRegn01IninOptSetA00_Dummy.MotCtrlPrmEstimnMotInduDaxIvtrLoaMtgtn  # UB:Derived from original system description
    connect CalRegn01IninOptSetA00.MotCtrlPrmEstimnMotInduDaxLoLim -> AAACalRegn01IninOptSetA00_Dummy.MotCtrlPrmEstimnMotInduDaxLoLim  # UB:Derived from original system description
    connect CalRegn01IninOptSetA00.MotCtrlPrmEstimnMotInduDaxNom -> AAACalRegn01IninOptSetA00_Dummy.MotCtrlPrmEstimnMotInduDaxNom  # UB:Derived from original system description
    connect CalRegn01IninOptSetA00.MotCtrlPrmEstimnMotInduDaxSatnScaY -> AAACalRegn01IninOptSetA00_Dummy.MotCtrlPrmEstimnMotInduDaxSatnScaY  # UB:Derived from original system description
    connect CalRegn01IninOptSetA00.MotCtrlPrmEstimnMotInduQaxHiLim -> AAACalRegn01IninOptSetA00_Dummy.MotCtrlPrmEstimnMotInduQaxHiLim  # UB:Derived from original system description
    connect CalRegn01IninOptSetA00.MotCtrlPrmEstimnMotInduQaxIvtrLoaMtgtn -> AAACalRegn01IninOptSetA00_Dummy.MotCtrlPrmEstimnMotInduQaxIvtrLoaMtgtn  # UB:Derived from original system description
    connect CalRegn01IninOptSetA00.MotCtrlPrmEstimnMotInduQaxLoLim -> AAACalRegn01IninOptSetA00_Dummy.MotCtrlPrmEstimnMotInduQaxLoLim  # UB:Derived from original system description
    connect CalRegn01IninOptSetA00.MotCtrlPrmEstimnMotInduQaxNom -> AAACalRegn01IninOptSetA00_Dummy.MotCtrlPrmEstimnMotInduQaxNom  # UB:Derived from original system description
    connect CalRegn01IninOptSetA00.MotCtrlPrmEstimnMotInduQaxSatnScaY -> AAACalRegn01IninOptSetA00_Dummy.MotCtrlPrmEstimnMotInduQaxSatnScaY  # UB:Derived from original system description
    connect CalRegn01IninOptSetA00.MotCtrlPrmEstimnMotRHiLim -> AAACalRegn01IninOptSetA00_Dummy.MotCtrlPrmEstimnMotRHiLim  # UB:Derived from original system description
    connect CalRegn01IninOptSetA00.MotCtrlPrmEstimnMotRLoLim -> AAACalRegn01IninOptSetA00_Dummy.MotCtrlPrmEstimnMotRLoLim  # UB:Derived from original system description
    connect CalRegn01IninOptSetA00.MotCtrlPrmEstimnMotRNom -> AAACalRegn01IninOptSetA00_Dummy.MotCtrlPrmEstimnMotRNom  # UB:Derived from original system description
    connect CalRegn01IninOptSetA00.MotCtrlPrmEstimnMotWidgThermCoeff -> AAACalRegn01IninOptSetA00_Dummy.MotCtrlPrmEstimnMotWidgThermCoeff  # UB:Derived from original system description
    connect CalRegn01IninOptSetA00.MotCtrlPrmEstimnTNom -> AAACalRegn01IninOptSetA00_Dummy.MotCtrlPrmEstimnTNom  # UB:Derived from original system description
    connect CalRegn01IninOptSetA00.MotCurrPeakEstimnCurrFilFrq -> AAACalRegn01IninOptSetA00_Dummy.MotCurrPeakEstimnCurrFilFrq  # UB:Derived from original system description
    connect CalRegn01IninOptSetA00.MotCurrPeakEstimnCurrPeakEstimdFilFrq -> AAACalRegn01IninOptSetA00_Dummy.MotCurrPeakEstimnCurrPeakEstimdFilFrq  # UB:Derived from original system description
    connect CalRegn01IninOptSetA00.MotCurrRegCfgMotClsdLoopBwDaxY -> AAACalRegn01IninOptSetA00_Dummy.MotCurrRegCfgMotClsdLoopBwDaxY  # UB:Derived from original system description
    connect CalRegn01IninOptSetA00.MotCurrRegCfgMotClsdLoopBwQaxY -> AAACalRegn01IninOptSetA00_Dummy.MotCurrRegCfgMotClsdLoopBwQaxY  # UB:Derived from original system description
    connect CalRegn01IninOptSetA00.MotCurrRegCfgMotDampgRatDax -> AAACalRegn01IninOptSetA00_Dummy.MotCurrRegCfgMotDampgRatDax  # UB:Derived from original system description
    connect CalRegn01IninOptSetA00.MotCurrRegCfgMotDampgRatQax -> AAACalRegn01IninOptSetA00_Dummy.MotCurrRegCfgMotDampgRatQax  # UB:Derived from original system description
    connect CalRegn01IninOptSetA00.MotCurrRegCfgMotNatFrqDaxY -> AAACalRegn01IninOptSetA00_Dummy.MotCurrRegCfgMotNatFrqDaxY  # UB:Derived from original system description
    connect CalRegn01IninOptSetA00.MotCurrRegCfgMotNatFrqQaxY -> AAACalRegn01IninOptSetA00_Dummy.MotCurrRegCfgMotNatFrqQaxY  # UB:Derived from original system description
    connect CalRegn01IninOptSetA00.MotCurrRegCfgMotRVirtDax -> AAACalRegn01IninOptSetA00_Dummy.MotCurrRegCfgMotRVirtDax  # UB:Derived from original system description
    connect CalRegn01IninOptSetA00.MotCurrRegCfgMotRVirtQax -> AAACalRegn01IninOptSetA00_Dummy.MotCurrRegCfgMotRVirtQax  # UB:Derived from original system description
    connect CalRegn01IninOptSetA00.MotCurrRegCfgMotVelFilFrq -> AAACalRegn01IninOptSetA00_Dummy.MotCurrRegCfgMotVelFilFrq  # UB:Derived from original system description
    connect CalRegn01IninOptSetA00.MotCurrRegVltgLimrCurrLoaScarSlewRate -> AAACalRegn01IninOptSetA00_Dummy.MotCurrRegVltgLimrCurrLoaScarSlewRate  # UB:Derived from original system description
    connect CalRegn01IninOptSetA00.MotCurrRegVltgLimrDaxAntiWdupCoeff -> AAACalRegn01IninOptSetA00_Dummy.MotCurrRegVltgLimrDaxAntiWdupCoeff  # UB:Derived from original system description
    connect CalRegn01IninOptSetA00.MotCurrRegVltgLimrDualEcuLoaScarSlewRate -> AAACalRegn01IninOptSetA00_Dummy.MotCurrRegVltgLimrDualEcuLoaScarSlewRate  # UB:Derived from original system description
    connect CalRegn01IninOptSetA00.MotCurrRegVltgLimrFETLoaScarSlewRate -> AAACalRegn01IninOptSetA00_Dummy.MotCurrRegVltgLimrFETLoaScarSlewRate  # UB:Derived from original system description
    connect CalRegn01IninOptSetA00.MotCurrRegVltgLimrIvtrLoaScarSlewRate -> AAACalRegn01IninOptSetA00_Dummy.MotCurrRegVltgLimrIvtrLoaScarSlewRate  # UB:Derived from original system description
    connect CalRegn01IninOptSetA00.MotCurrRegVltgLimrMotVltgBrdgLpFilFrq -> AAACalRegn01IninOptSetA00_Dummy.MotCurrRegVltgLimrMotVltgBrdgLpFilFrq  # UB:Derived from original system description
    connect CalRegn01IninOptSetA00.MotCurrRegVltgLimrMotVltgDaxIntglHiLim -> AAACalRegn01IninOptSetA00_Dummy.MotCurrRegVltgLimrMotVltgDaxIntglHiLim  # UB:Derived from original system description
    connect CalRegn01IninOptSetA00.MotCurrRegVltgLimrMotVltgDaxIntglLoLim -> AAACalRegn01IninOptSetA00_Dummy.MotCurrRegVltgLimrMotVltgDaxIntglLoLim  # UB:Derived from original system description
    connect CalRegn01IninOptSetA00.MotCurrRegVltgLimrMotVltgQaxFfLpFilFrq -> AAACalRegn01IninOptSetA00_Dummy.MotCurrRegVltgLimrMotVltgQaxFfLpFilFrq  # UB:Derived from original system description
    connect CalRegn01IninOptSetA00.MotCurrRegVltgLimrMotVltgQaxIntglHiLim -> AAACalRegn01IninOptSetA00_Dummy.MotCurrRegVltgLimrMotVltgQaxIntglHiLim  # UB:Derived from original system description
    connect CalRegn01IninOptSetA00.MotCurrRegVltgLimrMotVltgQaxIntglLoLim -> AAACalRegn01IninOptSetA00_Dummy.MotCurrRegVltgLimrMotVltgQaxIntglLoLim  # UB:Derived from original system description
    connect CalRegn01IninOptSetA00.MotCurrRegVltgLimrQaxAntiWdupCoeff -> AAACalRegn01IninOptSetA00_Dummy.MotCurrRegVltgLimrQaxAntiWdupCoeff  # UB:Derived from original system description
    connect CalRegn01IninOptSetA00.MotCurrRegVltgLimrQaxAntiWdupScagDi -> AAACalRegn01IninOptSetA00_Dummy.MotCurrRegVltgLimrQaxAntiWdupScagDi  # UB:Derived from original system description
    connect CalRegn01IninOptSetA00.MotRefMdlCurrDaxBoostGain -> AAACalRegn01IninOptSetA00_Dummy.MotRefMdlCurrDaxBoostGain  # UB:Derived from original system description
    connect CalRegn01IninOptSetA00.MotRefMdlCurrDaxBoostTqScaX -> AAACalRegn01IninOptSetA00_Dummy.MotRefMdlCurrDaxBoostTqScaX  # UB:Derived from original system description
    connect CalRegn01IninOptSetA00.MotRefMdlCurrDaxBoostTqScaY -> AAACalRegn01IninOptSetA00_Dummy.MotRefMdlCurrDaxBoostTqScaY  # UB:Derived from original system description
    connect CalRegn01IninOptSetA00.MotRefMdlCurrDaxQaxRefDelta -> AAACalRegn01IninOptSetA00_Dummy.MotRefMdlCurrDaxQaxRefDelta  # UB:Derived from original system description
    connect CalRegn01IninOptSetA00.MotRefMdlCurrItrnTolr -> AAACalRegn01IninOptSetA00_Dummy.MotRefMdlCurrItrnTolr  # UB:Derived from original system description
    connect CalRegn01IninOptSetA00.MotRefMdlMotCurrDaxMaxSca -> AAACalRegn01IninOptSetA00_Dummy.MotRefMdlMotCurrDaxMaxSca  # UB:Derived from original system description
    connect CalRegn01IninOptSetA00.MotRefMdlQuad13VltgSdlX -> AAACalRegn01IninOptSetA00_Dummy.MotRefMdlQuad13VltgSdlX  # UB:Derived from original system description
    connect CalRegn01IninOptSetA00.MotRefMdlQuad13VltgSdlY -> AAACalRegn01IninOptSetA00_Dummy.MotRefMdlQuad13VltgSdlY  # UB:Derived from original system description
    connect CalRegn01IninOptSetA00.MotRefMdlQuad24VltgSdlX -> AAACalRegn01IninOptSetA00_Dummy.MotRefMdlQuad24VltgSdlX  # UB:Derived from original system description
    connect CalRegn01IninOptSetA00.MotRefMdlQuad24VltgSdlY -> AAACalRegn01IninOptSetA00_Dummy.MotRefMdlQuad24VltgSdlY  # UB:Derived from original system description
    connect CalRegn01IninOptSetA00.MotRefMdlVltgOverRThdSca -> AAACalRegn01IninOptSetA00_Dummy.MotRefMdlVltgOverRThdSca  # UB:Derived from original system description
    connect CalRegn01IninOptSetA00.MotTqTranlDampgCmdLim -> AAACalRegn01IninOptSetA00_Dummy.MotTqTranlDampgCmdLim  # UB:Derived from original system description
    connect CalRegn01IninOptSetA00.MotTqTranlDampgVelThd -> AAACalRegn01IninOptSetA00_Dummy.MotTqTranlDampgVelThd  # UB:Derived from original system description
    connect CalRegn01IninOptSetA00.PwrLimrAssiRednLpFilFrq -> AAACalRegn01IninOptSetA00_Dummy.PwrLimrAssiRednLpFilFrq  # UB:Derived from original system description
    connect CalRegn01IninOptSetA00.PwrLimrBackEmfConStdT -> AAACalRegn01IninOptSetA00_Dummy.PwrLimrBackEmfConStdT  # UB:Derived from original system description
    connect CalRegn01IninOptSetA00.PwrLimrBrdgVltgAdjSlew -> AAACalRegn01IninOptSetA00_Dummy.PwrLimrBrdgVltgAdjSlew  # UB:Derived from original system description
    connect CalRegn01IninOptSetA00.PwrLimrBrdgVltgAltFltAdj -> AAACalRegn01IninOptSetA00_Dummy.PwrLimrBrdgVltgAltFltAdj  # UB:Derived from original system description
    connect CalRegn01IninOptSetA00.PwrLimrFilAssiRednThd -> AAACalRegn01IninOptSetA00_Dummy.PwrLimrFilAssiRednThd  # UB:Derived from original system description
    connect CalRegn01IninOptSetA00.PwrLimrLoVoltAssiRcvrThd -> AAACalRegn01IninOptSetA00_Dummy.PwrLimrLoVoltAssiRcvrThd  # UB:Derived from original system description
    connect CalRegn01IninOptSetA00.PwrLimrLoVoltAssiRcvrTi -> AAACalRegn01IninOptSetA00_Dummy.PwrLimrLoVoltAssiRcvrTi  # UB:Derived from original system description
    connect CalRegn01IninOptSetA00.PwrLimrMotEnvlpX -> AAACalRegn01IninOptSetA00_Dummy.PwrLimrMotEnvlpX  # UB:Derived from original system description
    connect CalRegn01IninOptSetA00.PwrLimrMotEnvlpY -> AAACalRegn01IninOptSetA00_Dummy.PwrLimrMotEnvlpY  # UB:Derived from original system description
    connect CalRegn01IninOptSetA00.PwrLimrMotVelLpFilFrq -> AAACalRegn01IninOptSetA00_Dummy.PwrLimrMotVelLpFilFrq  # UB:Derived from original system description
    connect CalRegn01IninOptSetA00.PwrLimrSpdAdjSlewDec -> AAACalRegn01IninOptSetA00_Dummy.PwrLimrSpdAdjSlewDec  # UB:Derived from original system description
    connect CalRegn01IninOptSetA00.PwrLimrSpdAdjSlewEna -> AAACalRegn01IninOptSetA00_Dummy.PwrLimrSpdAdjSlewEna  # UB:Derived from original system description
    connect CalRegn01IninOptSetA00.PwrLimrSpdAdjSlewInc -> AAACalRegn01IninOptSetA00_Dummy.PwrLimrSpdAdjSlewInc  # UB:Derived from original system description
    connect CalRegn01IninOptSetA00.PwrLimrStdOperMotEnvlpX -> AAACalRegn01IninOptSetA00_Dummy.PwrLimrStdOperMotEnvlpX  # UB:Derived from original system description
    connect CalRegn01IninOptSetA00.PwrLimrStdOperMotEnvlpY -> AAACalRegn01IninOptSetA00_Dummy.PwrLimrStdOperMotEnvlpY  # UB:Derived from original system description
    connect CalRegn01IninOptSetA00.PwrLimrVltgDptMotVelOffsX -> AAACalRegn01IninOptSetA00_Dummy.PwrLimrVltgDptMotVelOffsX  # UB:Derived from original system description
    connect CalRegn01IninOptSetA00.PwrLimrVltgDptMotVelOffsY -> AAACalRegn01IninOptSetA00_Dummy.PwrLimrVltgDptMotVelOffsY  # UB:Derived from original system description
    connect CalRegn01IninOptSetA00.SysGlbPrmSysTqRat -> AAACalRegn01IninOptSetA00_Dummy.SysGlbPrmSysTqRat  # UB:Derived from original system description
    connect CalRegn01IninOptSetA00.TEstimnAmbPwrMplr -> AAACalRegn01IninOptSetA00_Dummy.TEstimnAmbPwrMplr  # UB:Derived from original system description
    connect CalRegn01IninOptSetA00.TEstimnAmbTSca -> AAACalRegn01IninOptSetA00_Dummy.TEstimnAmbTSca  # UB:Derived from original system description
    connect CalRegn01IninOptSetA00.TEstimnAssiMechAmbLpFilFrq -> AAACalRegn01IninOptSetA00_Dummy.TEstimnAssiMechAmbLpFilFrq  # UB:Derived from original system description
    connect CalRegn01IninOptSetA00.TEstimnAssiMechAmbLpFilFrqDualEcuFltMtgtn -> AAACalRegn01IninOptSetA00_Dummy.TEstimnAssiMechAmbLpFilFrqDualEcuFltMtgtn  # UB:Derived from original system description
    connect CalRegn01IninOptSetA00.TEstimnAssiMechAmbLpFilFrqFetMtgtnEna -> AAACalRegn01IninOptSetA00_Dummy.TEstimnAssiMechAmbLpFilFrqFetMtgtnEna  # UB:Derived from original system description
    connect CalRegn01IninOptSetA00.TEstimnAssiMechAmbMplr -> AAACalRegn01IninOptSetA00_Dummy.TEstimnAssiMechAmbMplr  # UB:Derived from original system description
    connect CalRegn01IninOptSetA00.TEstimnAssiMechCorrLim -> AAACalRegn01IninOptSetA00_Dummy.TEstimnAssiMechCorrLim  # UB:Derived from original system description
    connect CalRegn01IninOptSetA00.TEstimnAssiMechDampgSca -> AAACalRegn01IninOptSetA00_Dummy.TEstimnAssiMechDampgSca  # UB:Derived from original system description
    connect CalRegn01IninOptSetA00.TEstimnAssiMechDftT -> AAACalRegn01IninOptSetA00_Dummy.TEstimnAssiMechDftT  # UB:Derived from original system description
    connect CalRegn01IninOptSetA00.TEstimnAssiMechLLFilCoeffA1 -> AAACalRegn01IninOptSetA00_Dummy.TEstimnAssiMechLLFilCoeffA1  # UB:Derived from original system description
    connect CalRegn01IninOptSetA00.TEstimnAssiMechLLFilCoeffB0 -> AAACalRegn01IninOptSetA00_Dummy.TEstimnAssiMechLLFilCoeffB0  # UB:Derived from original system description
    connect CalRegn01IninOptSetA00.TEstimnAssiMechLLFilCoeffB1 -> AAACalRegn01IninOptSetA00_Dummy.TEstimnAssiMechLLFilCoeffB1  # UB:Derived from original system description
    connect CalRegn01IninOptSetA00.TEstimnAssiMechSlew -> AAACalRegn01IninOptSetA00_Dummy.TEstimnAssiMechSlew  # UB:Derived from original system description
    connect CalRegn01IninOptSetA00.TEstimnCorrnTAssiMech -> AAACalRegn01IninOptSetA00_Dummy.TEstimnCorrnTAssiMech  # UB:Derived from original system description
    connect CalRegn01IninOptSetA00.TEstimnCorrnTCu -> AAACalRegn01IninOptSetA00_Dummy.TEstimnCorrnTCu  # UB:Derived from original system description
    connect CalRegn01IninOptSetA00.TEstimnCorrnTMag -> AAACalRegn01IninOptSetA00_Dummy.TEstimnCorrnTMag  # UB:Derived from original system description
    connect CalRegn01IninOptSetA00.TEstimnCorrnTSi -> AAACalRegn01IninOptSetA00_Dummy.TEstimnCorrnTSi  # UB:Derived from original system description
    connect CalRegn01IninOptSetA00.TEstimnCuAmbLpFilFrq -> AAACalRegn01IninOptSetA00_Dummy.TEstimnCuAmbLpFilFrq  # UB:Derived from original system description
    connect CalRegn01IninOptSetA00.TEstimnCuAmbLpFilFrqDualEcuFltMtgtn -> AAACalRegn01IninOptSetA00_Dummy.TEstimnCuAmbLpFilFrqDualEcuFltMtgtn  # UB:Derived from original system description
    connect CalRegn01IninOptSetA00.TEstimnCuAmbLpFilFrqFetMtgtnEna -> AAACalRegn01IninOptSetA00_Dummy.TEstimnCuAmbLpFilFrqFetMtgtnEna  # UB:Derived from original system description
    connect CalRegn01IninOptSetA00.TEstimnCuAmbMplr -> AAACalRegn01IninOptSetA00_Dummy.TEstimnCuAmbMplr  # UB:Derived from original system description
    connect CalRegn01IninOptSetA00.TEstimnCuCorrnLim -> AAACalRegn01IninOptSetA00_Dummy.TEstimnCuCorrnLim  # UB:Derived from original system description
    connect CalRegn01IninOptSetA00.TEstimnCuLLFilCoeffA1 -> AAACalRegn01IninOptSetA00_Dummy.TEstimnCuLLFilCoeffA1  # UB:Derived from original system description
    connect CalRegn01IninOptSetA00.TEstimnCuLLFilCoeffB0 -> AAACalRegn01IninOptSetA00_Dummy.TEstimnCuLLFilCoeffB0  # UB:Derived from original system description
    connect CalRegn01IninOptSetA00.TEstimnCuLLFilCoeffB1 -> AAACalRegn01IninOptSetA00_Dummy.TEstimnCuLLFilCoeffB1  # UB:Derived from original system description
    connect CalRegn01IninOptSetA00.TEstimnEngTSca -> AAACalRegn01IninOptSetA00_Dummy.TEstimnEngTSca  # UB:Derived from original system description
    connect CalRegn01IninOptSetA00.TEstimnMagAmbLpFilFrq -> AAACalRegn01IninOptSetA00_Dummy.TEstimnMagAmbLpFilFrq  # UB:Derived from original system description
    connect CalRegn01IninOptSetA00.TEstimnMagAmbLpFilFrqDualEcuFltMtgtn -> AAACalRegn01IninOptSetA00_Dummy.TEstimnMagAmbLpFilFrqDualEcuFltMtgtn  # UB:Derived from original system description
    connect CalRegn01IninOptSetA00.TEstimnMagAmbLpFilFrqFetMtgtnEna -> AAACalRegn01IninOptSetA00_Dummy.TEstimnMagAmbLpFilFrqFetMtgtnEna  # UB:Derived from original system description
    connect CalRegn01IninOptSetA00.TEstimnMagAmbMplr -> AAACalRegn01IninOptSetA00_Dummy.TEstimnMagAmbMplr  # UB:Derived from original system description
    connect CalRegn01IninOptSetA00.TEstimnMagCorrnLim -> AAACalRegn01IninOptSetA00_Dummy.TEstimnMagCorrnLim  # UB:Derived from original system description
    connect CalRegn01IninOptSetA00.TEstimnMagLLFilCoeffA1 -> AAACalRegn01IninOptSetA00_Dummy.TEstimnMagLLFilCoeffA1  # UB:Derived from original system description
    connect CalRegn01IninOptSetA00.TEstimnMagLLFilCoeffB0 -> AAACalRegn01IninOptSetA00_Dummy.TEstimnMagLLFilCoeffB0  # UB:Derived from original system description
    connect CalRegn01IninOptSetA00.TEstimnMagLLFilCoeffB1 -> AAACalRegn01IninOptSetA00_Dummy.TEstimnMagLLFilCoeffB1  # UB:Derived from original system description
    connect CalRegn01IninOptSetA00.TEstimnSiAmbLpFilFrq -> AAACalRegn01IninOptSetA00_Dummy.TEstimnSiAmbLpFilFrq  # UB:Derived from original system description
    connect CalRegn01IninOptSetA00.TEstimnSiAmbLpFilFrqDualEcuFltMtgtn -> AAACalRegn01IninOptSetA00_Dummy.TEstimnSiAmbLpFilFrqDualEcuFltMtgtn  # UB:Derived from original system description
    connect CalRegn01IninOptSetA00.TEstimnSiAmbLpFilFrqFetMtgtnEna -> AAACalRegn01IninOptSetA00_Dummy.TEstimnSiAmbLpFilFrqFetMtgtnEna  # UB:Derived from original system description
    connect CalRegn01IninOptSetA00.TEstimnSiAmbMplr -> AAACalRegn01IninOptSetA00_Dummy.TEstimnSiAmbMplr  # UB:Derived from original system description
    connect CalRegn01IninOptSetA00.TEstimnSiCorrnLim -> AAACalRegn01IninOptSetA00_Dummy.TEstimnSiCorrnLim  # UB:Derived from original system description
    connect CalRegn01IninOptSetA00.TEstimnSiLLFilCoeffA1 -> AAACalRegn01IninOptSetA00_Dummy.TEstimnSiLLFilCoeffA1  # UB:Derived from original system description
    connect CalRegn01IninOptSetA00.TEstimnSiLLFilCoeffB0 -> AAACalRegn01IninOptSetA00_Dummy.TEstimnSiLLFilCoeffB0  # UB:Derived from original system description
    connect CalRegn01IninOptSetA00.TEstimnSiLLFilCoeffB1 -> AAACalRegn01IninOptSetA00_Dummy.TEstimnSiLLFilCoeffB1  # UB:Derived from original system description
    connect CalRegn01IninOptSetA00.TEstimnTauAssiMech -> AAACalRegn01IninOptSetA00_Dummy.TEstimnTauAssiMech  # UB:Derived from original system description
    connect CalRegn01IninOptSetA00.TEstimnTauCu -> AAACalRegn01IninOptSetA00_Dummy.TEstimnTauCu  # UB:Derived from original system description
    connect CalRegn01IninOptSetA00.TEstimnTauMag -> AAACalRegn01IninOptSetA00_Dummy.TEstimnTauMag  # UB:Derived from original system description
    connect CalRegn01IninOptSetA00.TEstimnTauSi -> AAACalRegn01IninOptSetA00_Dummy.TEstimnTauSi  # UB:Derived from original system description
    connect CalRegn01IninOptSetA00.TEstimnWghtAvrgTDi -> AAACalRegn01IninOptSetA00_Dummy.TEstimnWghtAvrgTDi  # UB:Derived from original system description
    connect CalRegn01IninOptSetA00.VehSpdLimrPosMaxOffs2 -> AAACalRegn01IninOptSetA00_Dummy.VehSpdLimrPosMaxOffs2  # UB:Derived from original system description
    connect CalRegn01IninOptSetA00.MotCurrRegCfgMotRVirtDax -> CDD_MotCurrRegVltgLimr.MotCurrRegCfgMotRVirtDax  # UB:Derived from original system description
    connect CalRegn01IninOptSetA00.MotCurrRegCfgMotRVirtQax -> CDD_MotCurrRegVltgLimr.MotCurrRegCfgMotRVirtQax  # UB:Derived from original system description
    connect CalRegn01IninOptSetA00.MotCurrRegVltgLimrCurrLoaScarSlewRate -> CDD_MotCurrRegVltgLimr.MotCurrRegVltgLimrCurrLoaScarSlewRate  # UB:Derived from original system description
    connect CalRegn01IninOptSetA00.MotCurrRegVltgLimrDaxAntiWdupCoeff -> CDD_MotCurrRegVltgLimr.MotCurrRegVltgLimrDaxAntiWdupCoeff  # UB:Derived from original system description
    connect CalRegn01IninOptSetA00.MotCurrRegVltgLimrDualEcuLoaScarSlewRate -> CDD_MotCurrRegVltgLimr.MotCurrRegVltgLimrDualEcuLoaScarSlewRate  # UB:Derived from original system description
    connect CalRegn01IninOptSetA00.MotCurrRegVltgLimrFETLoaScarSlewRate -> CDD_MotCurrRegVltgLimr.MotCurrRegVltgLimrFETLoaScarSlewRate  # UB:Derived from original system description
    connect CalRegn01IninOptSetA00.MotCurrRegVltgLimrIvtrLoaScarSlewRate -> CDD_MotCurrRegVltgLimr.MotCurrRegVltgLimrIvtrLoaScarSlewRate  # UB:Derived from original system description
    connect CalRegn01IninOptSetA00.MotCurrRegVltgLimrMotVltgBrdgLpFilFrq -> CDD_MotCurrRegVltgLimr.MotCurrRegVltgLimrMotVltgBrdgLpFilFrq  # UB:Derived from original system description
    connect CalRegn01IninOptSetA00.MotCurrRegVltgLimrMotVltgDaxIntglHiLim -> CDD_MotCurrRegVltgLimr.MotCurrRegVltgLimrMotVltgDaxIntglHiLim  # UB:Derived from original system description
    connect CalRegn01IninOptSetA00.MotCurrRegVltgLimrMotVltgDaxIntglLoLim -> CDD_MotCurrRegVltgLimr.MotCurrRegVltgLimrMotVltgDaxIntglLoLim  # UB:Derived from original system description
    connect CalRegn01IninOptSetA00.MotCurrRegVltgLimrMotVltgQaxFfLpFilFrq -> CDD_MotCurrRegVltgLimr.MotCurrRegVltgLimrMotVltgQaxFfLpFilFrq  # UB:Derived from original system description
    connect CalRegn01IninOptSetA00.MotCurrRegVltgLimrMotVltgQaxIntglHiLim -> CDD_MotCurrRegVltgLimr.MotCurrRegVltgLimrMotVltgQaxIntglHiLim  # UB:Derived from original system description
    connect CalRegn01IninOptSetA00.MotCurrRegVltgLimrMotVltgQaxIntglLoLim -> CDD_MotCurrRegVltgLimr.MotCurrRegVltgLimrMotVltgQaxIntglLoLim  # UB:Derived from original system description
    connect CalRegn01IninOptSetA00.MotCurrRegVltgLimrQaxAntiWdupCoeff -> CDD_MotCurrRegVltgLimr.MotCurrRegVltgLimrQaxAntiWdupCoeff  # UB:Derived from original system description
    connect CalRegn01IninOptSetA00.MotCurrRegVltgLimrQaxAntiWdupScagDi -> CDD_MotCurrRegVltgLimr.MotCurrRegVltgLimrQaxAntiWdupScagDi  # UB:Derived from original system description
    connect CalRegn01IninOptSetA00.SysGlbPrmSysTqRat -> CtrldVelRtn.SysGlbPrmSysTqRat  # UB:Derived from original system description
    connect CalRegn01IninOptSetA00.DutyCycThermProtnAbsltCtrlTFetMtgtnTblX -> DutyCycThermProtn.DutyCycThermProtnAbsltCtrlTFetMtgtnTblX  # UB:Derived from original system description
    connect CalRegn01IninOptSetA00.DutyCycThermProtnAbsltCtrlTTblX -> DutyCycThermProtn.DutyCycThermProtnAbsltCtrlTTblX  # UB:Derived from original system description
    connect CalRegn01IninOptSetA00.DutyCycThermProtnAbsltCtrlTTqFetMtgtnTblY -> DutyCycThermProtn.DutyCycThermProtnAbsltCtrlTTqFetMtgtnTblY  # UB:Derived from original system description
    connect CalRegn01IninOptSetA00.DutyCycThermProtnAbsltCtrlTTqTblY -> DutyCycThermProtn.DutyCycThermProtnAbsltCtrlTTqTblY  # UB:Derived from original system description
    connect CalRegn01IninOptSetA00.DutyCycThermProtnAbsltCuTFetMtgtnTblX -> DutyCycThermProtn.DutyCycThermProtnAbsltCuTFetMtgtnTblX  # UB:Derived from original system description
    connect CalRegn01IninOptSetA00.DutyCycThermProtnAbsltCuTTblX -> DutyCycThermProtn.DutyCycThermProtnAbsltCuTTblX  # UB:Derived from original system description
    connect CalRegn01IninOptSetA00.DutyCycThermProtnAbsltCuTTqFetMtgtnTblY -> DutyCycThermProtn.DutyCycThermProtnAbsltCuTTqFetMtgtnTblY  # UB:Derived from original system description
    connect CalRegn01IninOptSetA00.DutyCycThermProtnAbsltCuTTqTblY -> DutyCycThermProtn.DutyCycThermProtnAbsltCuTTqTblY  # UB:Derived from original system description
    connect CalRegn01IninOptSetA00.DutyCycThermProtnAbsltMotVelBreakPt -> DutyCycThermProtn.DutyCycThermProtnAbsltMotVelBreakPt  # UB:Derived from original system description
    connect CalRegn01IninOptSetA00.DutyCycThermProtnAbsltTTqSlewHiLim -> DutyCycThermProtn.DutyCycThermProtnAbsltTTqSlewHiLim  # UB:Derived from original system description
    connect CalRegn01IninOptSetA00.DutyCycThermProtnAbsltTTqSlewLoLim -> DutyCycThermProtn.DutyCycThermProtnAbsltTTqSlewLoLim  # UB:Derived from original system description
    connect CalRegn01IninOptSetA00.DutyCycThermProtnCtrlT -> DutyCycThermProtn.DutyCycThermProtnCtrlT  # UB:Derived from original system description
    connect CalRegn01IninOptSetA00.DutyCycThermProtnCtrlTSeln -> DutyCycThermProtn.DutyCycThermProtnCtrlTSeln  # UB:Derived from original system description
    connect CalRegn01IninOptSetA00.DutyCycThermProtnDutyCycFildThd -> DutyCycThermProtn.DutyCycThermProtnDutyCycFildThd  # UB:Derived from original system description
    connect CalRegn01IninOptSetA00.DutyCycThermProtnIgnOffCtrlEna -> DutyCycThermProtn.DutyCycThermProtnIgnOffCtrlEna  # UB:Derived from original system description
    connect CalRegn01IninOptSetA00.DutyCycThermProtnIgnOffMsgWaitTi -> DutyCycThermProtn.DutyCycThermProtnIgnOffMsgWaitTi  # UB:Derived from original system description
    connect CalRegn01IninOptSetA00.DutyCycThermProtnLstTblValNonStall -> DutyCycThermProtn.DutyCycThermProtnLstTblValNonStall  # UB:Derived from original system description
    connect CalRegn01IninOptSetA00.DutyCycThermProtnLstTblValStall -> DutyCycThermProtn.DutyCycThermProtnLstTblValStall  # UB:Derived from original system description
    connect CalRegn01IninOptSetA00.DutyCycThermProtnMotPrTSeln -> DutyCycThermProtn.DutyCycThermProtnMotPrTSeln  # UB:Derived from original system description
    connect CalRegn01IninOptSetA00.DutyCycThermProtnMplr1FetMtgtnNonStallTblY -> DutyCycThermProtn.DutyCycThermProtnMplr1FetMtgtnNonStallTblY  # UB:Derived from original system description
    connect CalRegn01IninOptSetA00.DutyCycThermProtnMplr1FetMtgtnStallTblY -> DutyCycThermProtn.DutyCycThermProtnMplr1FetMtgtnStallTblY  # UB:Derived from original system description
    connect CalRegn01IninOptSetA00.DutyCycThermProtnMplr1NonStallTblY -> DutyCycThermProtn.DutyCycThermProtnMplr1NonStallTblY  # UB:Derived from original system description
    connect CalRegn01IninOptSetA00.DutyCycThermProtnMplr1StallTblY -> DutyCycThermProtn.DutyCycThermProtnMplr1StallTblY  # UB:Derived from original system description
    connect CalRegn01IninOptSetA00.DutyCycThermProtnMplr2FetMtgtnNonStallTblY -> DutyCycThermProtn.DutyCycThermProtnMplr2FetMtgtnNonStallTblY  # UB:Derived from original system description
    connect CalRegn01IninOptSetA00.DutyCycThermProtnMplr2FetMtgtnStallTblY -> DutyCycThermProtn.DutyCycThermProtnMplr2FetMtgtnStallTblY  # UB:Derived from original system description
    connect CalRegn01IninOptSetA00.DutyCycThermProtnMplr2NonStallTblY -> DutyCycThermProtn.DutyCycThermProtnMplr2NonStallTblY  # UB:Derived from original system description
    connect CalRegn01IninOptSetA00.DutyCycThermProtnMplr2StallTblY -> DutyCycThermProtn.DutyCycThermProtnMplr2StallTblY  # UB:Derived from original system description
    connect CalRegn01IninOptSetA00.DutyCycThermProtnMplr3FetMtgtnNonStallTblY -> DutyCycThermProtn.DutyCycThermProtnMplr3FetMtgtnNonStallTblY  # UB:Derived from original system description
    connect CalRegn01IninOptSetA00.DutyCycThermProtnMplr3FetMtgtnStallTblY -> DutyCycThermProtn.DutyCycThermProtnMplr3FetMtgtnStallTblY  # UB:Derived from original system description
    connect CalRegn01IninOptSetA00.DutyCycThermProtnMplr3NonStallTblY -> DutyCycThermProtn.DutyCycThermProtnMplr3NonStallTblY  # UB:Derived from original system description
    connect CalRegn01IninOptSetA00.DutyCycThermProtnMplr3StallTblY -> DutyCycThermProtn.DutyCycThermProtnMplr3StallTblY  # UB:Derived from original system description
    connect CalRegn01IninOptSetA00.DutyCycThermProtnMplr4FetMtgtnNonStallTblY -> DutyCycThermProtn.DutyCycThermProtnMplr4FetMtgtnNonStallTblY  # UB:Derived from original system description
    connect CalRegn01IninOptSetA00.DutyCycThermProtnMplr4FetMtgtnStallTblY -> DutyCycThermProtn.DutyCycThermProtnMplr4FetMtgtnStallTblY  # UB:Derived from original system description
    connect CalRegn01IninOptSetA00.DutyCycThermProtnMplr4NonStallTblY -> DutyCycThermProtn.DutyCycThermProtnMplr4NonStallTblY  # UB:Derived from original system description
    connect CalRegn01IninOptSetA00.DutyCycThermProtnMplr4StallTblY -> DutyCycThermProtn.DutyCycThermProtnMplr4StallTblY  # UB:Derived from original system description
    connect CalRegn01IninOptSetA00.DutyCycThermProtnMplr5FetMtgtnNonStallTblY -> DutyCycThermProtn.DutyCycThermProtnMplr5FetMtgtnNonStallTblY  # UB:Derived from original system description
    connect CalRegn01IninOptSetA00.DutyCycThermProtnMplr5FetMtgtnStallTblY -> DutyCycThermProtn.DutyCycThermProtnMplr5FetMtgtnStallTblY  # UB:Derived from original system description
    connect CalRegn01IninOptSetA00.DutyCycThermProtnMplr5NonStallTblY -> DutyCycThermProtn.DutyCycThermProtnMplr5NonStallTblY  # UB:Derived from original system description
    connect CalRegn01IninOptSetA00.DutyCycThermProtnMplr5StallTblY -> DutyCycThermProtn.DutyCycThermProtnMplr5StallTblY  # UB:Derived from original system description
    connect CalRegn01IninOptSetA00.DutyCycThermProtnMplr6FetMtgtnNonStallTblY -> DutyCycThermProtn.DutyCycThermProtnMplr6FetMtgtnNonStallTblY  # UB:Derived from original system description
    connect CalRegn01IninOptSetA00.DutyCycThermProtnMplr6FetMtgtnStallTblY -> DutyCycThermProtn.DutyCycThermProtnMplr6FetMtgtnStallTblY  # UB:Derived from original system description
    connect CalRegn01IninOptSetA00.DutyCycThermProtnMplr6NonStallTblY -> DutyCycThermProtn.DutyCycThermProtnMplr6NonStallTblY  # UB:Derived from original system description
    connect CalRegn01IninOptSetA00.DutyCycThermProtnMplr6StallTblY -> DutyCycThermProtn.DutyCycThermProtnMplr6StallTblY  # UB:Derived from original system description
    connect CalRegn01IninOptSetA00.DutyCycThermProtnMplrFetMtgtnTblX -> DutyCycThermProtn.DutyCycThermProtnMplrFetMtgtnTblX  # UB:Derived from original system description
    connect CalRegn01IninOptSetA00.DutyCycThermProtnMplrTblX -> DutyCycThermProtn.DutyCycThermProtnMplrTblX  # UB:Derived from original system description
    connect CalRegn01IninOptSetA00.DutyCycThermProtnMplrTSeln -> DutyCycThermProtn.DutyCycThermProtnMplrTSeln  # UB:Derived from original system description
    connect CalRegn01IninOptSetA00.DutyCycThermProtnSlowFilTSeln -> DutyCycThermProtn.DutyCycThermProtnSlowFilTSeln  # UB:Derived from original system description
    connect CalRegn01IninOptSetA00.DutyCycThermProtnThermLimScaFac -> DutyCycThermProtn.DutyCycThermProtnThermLimScaFac  # UB:Derived from original system description
    connect CalRegn01IninOptSetA00.DutyCycThermProtnThermLoadLimTblX -> DutyCycThermProtn.DutyCycThermProtnThermLoadLimTblX  # UB:Derived from original system description
    connect CalRegn01IninOptSetA00.DutyCycThermProtnThermLoadLimTblY -> DutyCycThermProtn.DutyCycThermProtnThermLoadLimTblY  # UB:Derived from original system description
    connect CalRegn01IninOptSetA00.DutyCycThermProtnTqCmdSlewDwn -> DutyCycThermProtn.DutyCycThermProtnTqCmdSlewDwn  # UB:Derived from original system description
    connect CalRegn01IninOptSetA00.DutyCycThermProtnTqCmdSlewUp -> DutyCycThermProtn.DutyCycThermProtnTqCmdSlewUp  # UB:Derived from original system description
    connect CalRegn01IninOptSetA00.HiLoadStallLimrMotVelMgnThd -> HiLoadStallLimr.HiLoadStallLimrMotVelMgnThd  # UB:Derived from original system description
    connect CalRegn01IninOptSetA00.HiLoadStallLimrStallMotTqCmdFetMtgtnLimX -> HiLoadStallLimr.HiLoadStallLimrStallMotTqCmdFetMtgtnLimX  # UB:Derived from original system description
    connect CalRegn01IninOptSetA00.HiLoadStallLimrStallMotTqCmdFetMtgtnLimY -> HiLoadStallLimr.HiLoadStallLimrStallMotTqCmdFetMtgtnLimY  # UB:Derived from original system description
    connect CalRegn01IninOptSetA00.HiLoadStallLimrStallMotTqCmdLimX -> HiLoadStallLimr.HiLoadStallLimrStallMotTqCmdLimX  # UB:Derived from original system description
    connect CalRegn01IninOptSetA00.HiLoadStallLimrStallMotTqCmdLimY -> HiLoadStallLimr.HiLoadStallLimrStallMotTqCmdLimY  # UB:Derived from original system description
    connect CalRegn01IninOptSetA00.HiLoadStallLimrStallMotTqLimSlewRate -> HiLoadStallLimr.HiLoadStallLimrStallMotTqLimSlewRate  # UB:Derived from original system description
    connect CalRegn01IninOptSetA00.HiLoadStallLimrStallThermLimSca -> HiLoadStallLimr.HiLoadStallLimrStallThermLimSca  # UB:Derived from original system description
    connect CalRegn01IninOptSetA00.SysGlbPrmSysTqRat -> HwRefTqSum.SysGlbPrmSysTqRat  # UB:Derived from original system description
    connect CalRegn01IninOptSetA00.LrndRackCentrMotTqThd -> LrndRackCentr.LrndRackCentrMotTqThd  # UB:Derived from original system description
    connect CalRegn01IninOptSetA00.LrndRackCentrMotVelThd -> LrndRackCentr.LrndRackCentrMotVelThd  # UB:Derived from original system description
    connect CalRegn01IninOptSetA00.MotCtrlPrmEstimnFetRNom -> MotCtrlPrmEstimn.MotCtrlPrmEstimnFetRNom  # UB:Derived from original system description
    connect CalRegn01IninOptSetA00.MotCtrlPrmEstimnMotBackEmfConHiLim -> MotCtrlPrmEstimn.MotCtrlPrmEstimnMotBackEmfConHiLim  # UB:Derived from original system description
    connect CalRegn01IninOptSetA00.MotCtrlPrmEstimnMotBackEmfConLoLim -> MotCtrlPrmEstimn.MotCtrlPrmEstimnMotBackEmfConLoLim  # UB:Derived from original system description
    connect CalRegn01IninOptSetA00.MotCtrlPrmEstimnMotBackEmfConNom -> MotCtrlPrmEstimn.MotCtrlPrmEstimnMotBackEmfConNom  # UB:Derived from original system description
    connect CalRegn01IninOptSetA00.MotCtrlPrmEstimnMotBackEmfConSatnScaIvtrLoaMtgtn -> MotCtrlPrmEstimn.MotCtrlPrmEstimnMotBackEmfConSatnScaIvtrLoaMtgtn  # UB:Derived from original system description
    connect CalRegn01IninOptSetA00.MotCtrlPrmEstimnMotBackEmfConSatnX -> MotCtrlPrmEstimn.MotCtrlPrmEstimnMotBackEmfConSatnX  # UB:Derived from original system description
    connect CalRegn01IninOptSetA00.MotCtrlPrmEstimnMotBackEmfConSatnY -> MotCtrlPrmEstimn.MotCtrlPrmEstimnMotBackEmfConSatnY  # UB:Derived from original system description
    connect CalRegn01IninOptSetA00.MotCtrlPrmEstimnMotCurrDaxInduSatnBilnrSeln -> MotCtrlPrmEstimn.MotCtrlPrmEstimnMotCurrDaxInduSatnBilnrSeln  # UB:Derived from original system description
    connect CalRegn01IninOptSetA00.MotCtrlPrmEstimnMotCurrQaxInduSatnX -> MotCtrlPrmEstimn.MotCtrlPrmEstimnMotCurrQaxInduSatnX  # UB:Derived from original system description
    connect CalRegn01IninOptSetA00.MotCtrlPrmEstimnMotInduDaxHiLim -> MotCtrlPrmEstimn.MotCtrlPrmEstimnMotInduDaxHiLim  # UB:Derived from original system description
    connect CalRegn01IninOptSetA00.MotCtrlPrmEstimnMotInduDaxIvtrLoaMtgtn -> MotCtrlPrmEstimn.MotCtrlPrmEstimnMotInduDaxIvtrLoaMtgtn  # UB:Derived from original system description
    connect CalRegn01IninOptSetA00.MotCtrlPrmEstimnMotInduDaxLoLim -> MotCtrlPrmEstimn.MotCtrlPrmEstimnMotInduDaxLoLim  # UB:Derived from original system description
    connect CalRegn01IninOptSetA00.MotCtrlPrmEstimnMotInduDaxNom -> MotCtrlPrmEstimn.MotCtrlPrmEstimnMotInduDaxNom  # UB:Derived from original system description
    connect CalRegn01IninOptSetA00.MotCtrlPrmEstimnMotInduDaxSatnScaY -> MotCtrlPrmEstimn.MotCtrlPrmEstimnMotInduDaxSatnScaY  # UB:Derived from original system description
    connect CalRegn01IninOptSetA00.MotCtrlPrmEstimnMotInduQaxHiLim -> MotCtrlPrmEstimn.MotCtrlPrmEstimnMotInduQaxHiLim  # UB:Derived from original system description
    connect CalRegn01IninOptSetA00.MotCtrlPrmEstimnMotInduQaxIvtrLoaMtgtn -> MotCtrlPrmEstimn.MotCtrlPrmEstimnMotInduQaxIvtrLoaMtgtn  # UB:Derived from original system description
    connect CalRegn01IninOptSetA00.MotCtrlPrmEstimnMotInduQaxLoLim -> MotCtrlPrmEstimn.MotCtrlPrmEstimnMotInduQaxLoLim  # UB:Derived from original system description
    connect CalRegn01IninOptSetA00.MotCtrlPrmEstimnMotInduQaxNom -> MotCtrlPrmEstimn.MotCtrlPrmEstimnMotInduQaxNom  # UB:Derived from original system description
    connect CalRegn01IninOptSetA00.MotCtrlPrmEstimnMotInduQaxSatnScaY -> MotCtrlPrmEstimn.MotCtrlPrmEstimnMotInduQaxSatnScaY  # UB:Derived from original system description
    connect CalRegn01IninOptSetA00.MotCtrlPrmEstimnMotRHiLim -> MotCtrlPrmEstimn.MotCtrlPrmEstimnMotRHiLim  # UB:Derived from original system description
    connect CalRegn01IninOptSetA00.MotCtrlPrmEstimnMotRLoLim -> MotCtrlPrmEstimn.MotCtrlPrmEstimnMotRLoLim  # UB:Derived from original system description
    connect CalRegn01IninOptSetA00.MotCtrlPrmEstimnMotRNom -> MotCtrlPrmEstimn.MotCtrlPrmEstimnMotRNom  # UB:Derived from original system description
    connect CalRegn01IninOptSetA00.MotCtrlPrmEstimnMotWidgThermCoeff -> MotCtrlPrmEstimn.MotCtrlPrmEstimnMotWidgThermCoeff  # UB:Derived from original system description
    connect CalRegn01IninOptSetA00.MotCtrlPrmEstimnTNom -> MotCtrlPrmEstimn.MotCtrlPrmEstimnTNom  # UB:Derived from original system description
    connect CalRegn01IninOptSetA00.MotCurrPeakEstimnCurrFilFrq -> MotCurrPeakEstimn.MotCurrPeakEstimnCurrFilFrq  # UB:Derived from original system description
    connect CalRegn01IninOptSetA00.MotCurrPeakEstimnCurrPeakEstimdFilFrq -> MotCurrPeakEstimn.MotCurrPeakEstimnCurrPeakEstimdFilFrq  # UB:Derived from original system description
    connect CalRegn01IninOptSetA00.MotCurrRegCfgMotClsdLoopBwDaxY -> MotCurrRegCfg.MotCurrRegCfgMotClsdLoopBwDaxY  # UB:Derived from original system description
    connect CalRegn01IninOptSetA00.MotCurrRegCfgMotClsdLoopBwQaxY -> MotCurrRegCfg.MotCurrRegCfgMotClsdLoopBwQaxY  # UB:Derived from original system description
    connect CalRegn01IninOptSetA00.MotCurrRegCfgMotDampgRatDax -> MotCurrRegCfg.MotCurrRegCfgMotDampgRatDax  # UB:Derived from original system description
    connect CalRegn01IninOptSetA00.MotCurrRegCfgMotDampgRatQax -> MotCurrRegCfg.MotCurrRegCfgMotDampgRatQax  # UB:Derived from original system description
    connect CalRegn01IninOptSetA00.MotCurrRegCfgMotNatFrqDaxY -> MotCurrRegCfg.MotCurrRegCfgMotNatFrqDaxY  # UB:Derived from original system description
    connect CalRegn01IninOptSetA00.MotCurrRegCfgMotNatFrqQaxY -> MotCurrRegCfg.MotCurrRegCfgMotNatFrqQaxY  # UB:Derived from original system description
    connect CalRegn01IninOptSetA00.MotCurrRegCfgMotRVirtDax -> MotCurrRegCfg.MotCurrRegCfgMotRVirtDax  # UB:Derived from original system description
    connect CalRegn01IninOptSetA00.MotCurrRegCfgMotRVirtQax -> MotCurrRegCfg.MotCurrRegCfgMotRVirtQax  # UB:Derived from original system description
    connect CalRegn01IninOptSetA00.MotCurrRegCfgMotVelFilFrq -> MotCurrRegCfg.MotCurrRegCfgMotVelFilFrq  # UB:Derived from original system description
    connect CalRegn01IninOptSetA00.MotRefMdlCurrDaxBoostGain -> MotRefMdl.MotRefMdlCurrDaxBoostGain  # UB:Derived from original system description
    connect CalRegn01IninOptSetA00.MotRefMdlCurrDaxBoostTqScaX -> MotRefMdl.MotRefMdlCurrDaxBoostTqScaX  # UB:Derived from original system description
    connect CalRegn01IninOptSetA00.MotRefMdlCurrDaxBoostTqScaY -> MotRefMdl.MotRefMdlCurrDaxBoostTqScaY  # UB:Derived from original system description
    connect CalRegn01IninOptSetA00.MotRefMdlCurrDaxQaxRefDelta -> MotRefMdl.MotRefMdlCurrDaxQaxRefDelta  # UB:Derived from original system description
    connect CalRegn01IninOptSetA00.MotRefMdlCurrItrnTolr -> MotRefMdl.MotRefMdlCurrItrnTolr  # UB:Derived from original system description
    connect CalRegn01IninOptSetA00.MotRefMdlMotCurrDaxMaxSca -> MotRefMdl.MotRefMdlMotCurrDaxMaxSca  # UB:Derived from original system description
    connect CalRegn01IninOptSetA00.MotRefMdlQuad13VltgSdlX -> MotRefMdl.MotRefMdlQuad13VltgSdlX  # UB:Derived from original system description
    connect CalRegn01IninOptSetA00.MotRefMdlQuad13VltgSdlY -> MotRefMdl.MotRefMdlQuad13VltgSdlY  # UB:Derived from original system description
    connect CalRegn01IninOptSetA00.MotRefMdlQuad24VltgSdlX -> MotRefMdl.MotRefMdlQuad24VltgSdlX  # UB:Derived from original system description
    connect CalRegn01IninOptSetA00.MotRefMdlQuad24VltgSdlY -> MotRefMdl.MotRefMdlQuad24VltgSdlY  # UB:Derived from original system description
    connect CalRegn01IninOptSetA00.MotRefMdlVltgOverRThdSca -> MotRefMdl.MotRefMdlVltgOverRThdSca  # UB:Derived from original system description
    connect CalRegn01IninOptSetA00.MotTqTranlDampgCmdLim -> MotTqTranlDampg.MotTqTranlDampgCmdLim  # UB:Derived from original system description
    connect CalRegn01IninOptSetA00.MotTqTranlDampgVelThd -> MotTqTranlDampg.MotTqTranlDampgVelThd  # UB:Derived from original system description
    connect CalRegn01IninOptSetA00.SysGlbPrmSysTqRat -> PosnTrakgServo.SysGlbPrmSysTqRat  # UB:Derived from original system description
    connect CalRegn01IninOptSetA00.PwrLimrAssiRednLpFilFrq -> PwrLimr.PwrLimrAssiRednLpFilFrq  # UB:Derived from original system description
    connect CalRegn01IninOptSetA00.PwrLimrBackEmfConStdT -> PwrLimr.PwrLimrBackEmfConStdT  # UB:Derived from original system description
    connect CalRegn01IninOptSetA00.PwrLimrBrdgVltgAdjSlew -> PwrLimr.PwrLimrBrdgVltgAdjSlew  # UB:Derived from original system description
    connect CalRegn01IninOptSetA00.PwrLimrBrdgVltgAltFltAdj -> PwrLimr.PwrLimrBrdgVltgAltFltAdj  # UB:Derived from original system description
    connect CalRegn01IninOptSetA00.PwrLimrFilAssiRednThd -> PwrLimr.PwrLimrFilAssiRednThd  # UB:Derived from original system description
    connect CalRegn01IninOptSetA00.PwrLimrLoVoltAssiRcvrThd -> PwrLimr.PwrLimrLoVoltAssiRcvrThd  # UB:Derived from original system description
    connect CalRegn01IninOptSetA00.PwrLimrLoVoltAssiRcvrTi -> PwrLimr.PwrLimrLoVoltAssiRcvrTi  # UB:Derived from original system description
    connect CalRegn01IninOptSetA00.PwrLimrMotEnvlpX -> PwrLimr.PwrLimrMotEnvlpX  # UB:Derived from original system description
    connect CalRegn01IninOptSetA00.PwrLimrMotEnvlpY -> PwrLimr.PwrLimrMotEnvlpY  # UB:Derived from original system description
    connect CalRegn01IninOptSetA00.PwrLimrMotVelLpFilFrq -> PwrLimr.PwrLimrMotVelLpFilFrq  # UB:Derived from original system description
    connect CalRegn01IninOptSetA00.PwrLimrSpdAdjSlewDec -> PwrLimr.PwrLimrSpdAdjSlewDec  # UB:Derived from original system description
    connect CalRegn01IninOptSetA00.PwrLimrSpdAdjSlewEna -> PwrLimr.PwrLimrSpdAdjSlewEna  # UB:Derived from original system description
    connect CalRegn01IninOptSetA00.PwrLimrSpdAdjSlewInc -> PwrLimr.PwrLimrSpdAdjSlewInc  # UB:Derived from original system description
    connect CalRegn01IninOptSetA00.PwrLimrStdOperMotEnvlpX -> PwrLimr.PwrLimrStdOperMotEnvlpX  # UB:Derived from original system description
    connect CalRegn01IninOptSetA00.PwrLimrStdOperMotEnvlpY -> PwrLimr.PwrLimrStdOperMotEnvlpY  # UB:Derived from original system description
    connect CalRegn01IninOptSetA00.PwrLimrVltgDptMotVelOffsX -> PwrLimr.PwrLimrVltgDptMotVelOffsX  # UB:Derived from original system description
    connect CalRegn01IninOptSetA00.PwrLimrVltgDptMotVelOffsY -> PwrLimr.PwrLimrVltgDptMotVelOffsY  # UB:Derived from original system description
    connect CalRegn01IninOptSetA00.TEstimnAmbPwrMplr -> TEstimn.TEstimnAmbPwrMplr  # UB:Derived from original system description
    connect CalRegn01IninOptSetA00.TEstimnAmbTSca -> TEstimn.TEstimnAmbTSca  # UB:Derived from original system description
    connect CalRegn01IninOptSetA00.TEstimnAssiMechAmbLpFilFrq -> TEstimn.TEstimnAssiMechAmbLpFilFrq  # UB:Derived from original system description
    connect CalRegn01IninOptSetA00.TEstimnAssiMechAmbLpFilFrqDualEcuFltMtgtn -> TEstimn.TEstimnAssiMechAmbLpFilFrqDualEcuFltMtgtn  # UB:Derived from original system description
    connect CalRegn01IninOptSetA00.TEstimnAssiMechAmbLpFilFrqFetMtgtnEna -> TEstimn.TEstimnAssiMechAmbLpFilFrqFetMtgtnEna  # UB:Derived from original system description
    connect CalRegn01IninOptSetA00.TEstimnAssiMechAmbMplr -> TEstimn.TEstimnAssiMechAmbMplr  # UB:Derived from original system description
    connect CalRegn01IninOptSetA00.TEstimnAssiMechCorrLim -> TEstimn.TEstimnAssiMechCorrLim  # UB:Derived from original system description
    connect CalRegn01IninOptSetA00.TEstimnAssiMechDampgSca -> TEstimn.TEstimnAssiMechDampgSca  # UB:Derived from original system description
    connect CalRegn01IninOptSetA00.TEstimnAssiMechDftT -> TEstimn.TEstimnAssiMechDftT  # UB:Derived from original system description
    connect CalRegn01IninOptSetA00.TEstimnAssiMechLLFilCoeffA1 -> TEstimn.TEstimnAssiMechLLFilCoeffA1  # UB:Derived from original system description
    connect CalRegn01IninOptSetA00.TEstimnAssiMechLLFilCoeffB0 -> TEstimn.TEstimnAssiMechLLFilCoeffB0  # UB:Derived from original system description
    connect CalRegn01IninOptSetA00.TEstimnAssiMechLLFilCoeffB1 -> TEstimn.TEstimnAssiMechLLFilCoeffB1  # UB:Derived from original system description
    connect CalRegn01IninOptSetA00.TEstimnAssiMechSlew -> TEstimn.TEstimnAssiMechSlew  # UB:Derived from original system description
    connect CalRegn01IninOptSetA00.TEstimnCorrnTAssiMech -> TEstimn.TEstimnCorrnTAssiMech  # UB:Derived from original system description
    connect CalRegn01IninOptSetA00.TEstimnCorrnTCu -> TEstimn.TEstimnCorrnTCu  # UB:Derived from original system description
    connect CalRegn01IninOptSetA00.TEstimnCorrnTMag -> TEstimn.TEstimnCorrnTMag  # UB:Derived from original system description
    connect CalRegn01IninOptSetA00.TEstimnCorrnTSi -> TEstimn.TEstimnCorrnTSi  # UB:Derived from original system description
    connect CalRegn01IninOptSetA00.TEstimnCuAmbLpFilFrq -> TEstimn.TEstimnCuAmbLpFilFrq  # UB:Derived from original system description
    connect CalRegn01IninOptSetA00.TEstimnCuAmbLpFilFrqDualEcuFltMtgtn -> TEstimn.TEstimnCuAmbLpFilFrqDualEcuFltMtgtn  # UB:Derived from original system description
    connect CalRegn01IninOptSetA00.TEstimnCuAmbLpFilFrqFetMtgtnEna -> TEstimn.TEstimnCuAmbLpFilFrqFetMtgtnEna  # UB:Derived from original system description
    connect CalRegn01IninOptSetA00.TEstimnCuAmbMplr -> TEstimn.TEstimnCuAmbMplr  # UB:Derived from original system description
    connect CalRegn01IninOptSetA00.TEstimnCuCorrnLim -> TEstimn.TEstimnCuCorrnLim  # UB:Derived from original system description
    connect CalRegn01IninOptSetA00.TEstimnCuLLFilCoeffA1 -> TEstimn.TEstimnCuLLFilCoeffA1  # UB:Derived from original system description
    connect CalRegn01IninOptSetA00.TEstimnCuLLFilCoeffB0 -> TEstimn.TEstimnCuLLFilCoeffB0  # UB:Derived from original system description
    connect CalRegn01IninOptSetA00.TEstimnCuLLFilCoeffB1 -> TEstimn.TEstimnCuLLFilCoeffB1  # UB:Derived from original system description
    connect CalRegn01IninOptSetA00.TEstimnEngTSca -> TEstimn.TEstimnEngTSca  # UB:Derived from original system description
    connect CalRegn01IninOptSetA00.TEstimnMagAmbLpFilFrq -> TEstimn.TEstimnMagAmbLpFilFrq  # UB:Derived from original system description
    connect CalRegn01IninOptSetA00.TEstimnMagAmbLpFilFrqDualEcuFltMtgtn -> TEstimn.TEstimnMagAmbLpFilFrqDualEcuFltMtgtn  # UB:Derived from original system description
    connect CalRegn01IninOptSetA00.TEstimnMagAmbLpFilFrqFetMtgtnEna -> TEstimn.TEstimnMagAmbLpFilFrqFetMtgtnEna  # UB:Derived from original system description
    connect CalRegn01IninOptSetA00.TEstimnMagAmbMplr -> TEstimn.TEstimnMagAmbMplr  # UB:Derived from original system description
    connect CalRegn01IninOptSetA00.TEstimnMagCorrnLim -> TEstimn.TEstimnMagCorrnLim  # UB:Derived from original system description
    connect CalRegn01IninOptSetA00.TEstimnMagLLFilCoeffA1 -> TEstimn.TEstimnMagLLFilCoeffA1  # UB:Derived from original system description
    connect CalRegn01IninOptSetA00.TEstimnMagLLFilCoeffB0 -> TEstimn.TEstimnMagLLFilCoeffB0  # UB:Derived from original system description
    connect CalRegn01IninOptSetA00.TEstimnMagLLFilCoeffB1 -> TEstimn.TEstimnMagLLFilCoeffB1  # UB:Derived from original system description
    connect CalRegn01IninOptSetA00.TEstimnSiAmbLpFilFrq -> TEstimn.TEstimnSiAmbLpFilFrq  # UB:Derived from original system description
    connect CalRegn01IninOptSetA00.TEstimnSiAmbLpFilFrqDualEcuFltMtgtn -> TEstimn.TEstimnSiAmbLpFilFrqDualEcuFltMtgtn  # UB:Derived from original system description
    connect CalRegn01IninOptSetA00.TEstimnSiAmbLpFilFrqFetMtgtnEna -> TEstimn.TEstimnSiAmbLpFilFrqFetMtgtnEna  # UB:Derived from original system description
    connect CalRegn01IninOptSetA00.TEstimnSiAmbMplr -> TEstimn.TEstimnSiAmbMplr  # UB:Derived from original system description
    connect CalRegn01IninOptSetA00.TEstimnSiCorrnLim -> TEstimn.TEstimnSiCorrnLim  # UB:Derived from original system description
    connect CalRegn01IninOptSetA00.TEstimnSiLLFilCoeffA1 -> TEstimn.TEstimnSiLLFilCoeffA1  # UB:Derived from original system description
    connect CalRegn01IninOptSetA00.TEstimnSiLLFilCoeffB0 -> TEstimn.TEstimnSiLLFilCoeffB0  # UB:Derived from original system description
    connect CalRegn01IninOptSetA00.TEstimnSiLLFilCoeffB1 -> TEstimn.TEstimnSiLLFilCoeffB1  # UB:Derived from original system description
    connect CalRegn01IninOptSetA00.TEstimnTauAssiMech -> TEstimn.TEstimnTauAssiMech  # UB:Derived from original system description
    connect CalRegn01IninOptSetA00.TEstimnTauCu -> TEstimn.TEstimnTauCu  # UB:Derived from original system description
    connect CalRegn01IninOptSetA00.TEstimnTauMag -> TEstimn.TEstimnTauMag  # UB:Derived from original system description
    connect CalRegn01IninOptSetA00.TEstimnTauSi -> TEstimn.TEstimnTauSi  # UB:Derived from original system description
    connect CalRegn01IninOptSetA00.TEstimnWghtAvrgTDi -> TEstimn.TEstimnWghtAvrgTDi  # UB:Derived from original system description
    connect CalRegn01IninOptSetA00.VehSpdLimrPosMaxOffs2 -> VehSpdLimr.VehSpdLimrPosMaxOffs2  # UB:Derived from original system description
    connect CalRegn01IninOptSetA01.DutyCycThermProtnAbsltCtrlTFetMtgtnTblX -> AAACalRegn01IninOptSetA01_Dummy.DutyCycThermProtnAbsltCtrlTFetMtgtnTblX  # UB:Derived from original system description
    connect CalRegn01IninOptSetA01.DutyCycThermProtnAbsltCtrlTTblX -> AAACalRegn01IninOptSetA01_Dummy.DutyCycThermProtnAbsltCtrlTTblX  # UB:Derived from original system description
    connect CalRegn01IninOptSetA01.DutyCycThermProtnAbsltCtrlTTqFetMtgtnTblY -> AAACalRegn01IninOptSetA01_Dummy.DutyCycThermProtnAbsltCtrlTTqFetMtgtnTblY  # UB:Derived from original system description
    connect CalRegn01IninOptSetA01.DutyCycThermProtnAbsltCtrlTTqTblY -> AAACalRegn01IninOptSetA01_Dummy.DutyCycThermProtnAbsltCtrlTTqTblY  # UB:Derived from original system description
    connect CalRegn01IninOptSetA01.DutyCycThermProtnAbsltCuTFetMtgtnTblX -> AAACalRegn01IninOptSetA01_Dummy.DutyCycThermProtnAbsltCuTFetMtgtnTblX  # UB:Derived from original system description
    connect CalRegn01IninOptSetA01.DutyCycThermProtnAbsltCuTTblX -> AAACalRegn01IninOptSetA01_Dummy.DutyCycThermProtnAbsltCuTTblX  # UB:Derived from original system description
    connect CalRegn01IninOptSetA01.DutyCycThermProtnAbsltCuTTqFetMtgtnTblY -> AAACalRegn01IninOptSetA01_Dummy.DutyCycThermProtnAbsltCuTTqFetMtgtnTblY  # UB:Derived from original system description
    connect CalRegn01IninOptSetA01.DutyCycThermProtnAbsltCuTTqTblY -> AAACalRegn01IninOptSetA01_Dummy.DutyCycThermProtnAbsltCuTTqTblY  # UB:Derived from original system description
    connect CalRegn01IninOptSetA01.DutyCycThermProtnAbsltMotVelBreakPt -> AAACalRegn01IninOptSetA01_Dummy.DutyCycThermProtnAbsltMotVelBreakPt  # UB:Derived from original system description
    connect CalRegn01IninOptSetA01.DutyCycThermProtnAbsltTTqSlewHiLim -> AAACalRegn01IninOptSetA01_Dummy.DutyCycThermProtnAbsltTTqSlewHiLim  # UB:Derived from original system description
    connect CalRegn01IninOptSetA01.DutyCycThermProtnAbsltTTqSlewLoLim -> AAACalRegn01IninOptSetA01_Dummy.DutyCycThermProtnAbsltTTqSlewLoLim  # UB:Derived from original system description
    connect CalRegn01IninOptSetA01.DutyCycThermProtnCtrlT -> AAACalRegn01IninOptSetA01_Dummy.DutyCycThermProtnCtrlT  # UB:Derived from original system description
    connect CalRegn01IninOptSetA01.DutyCycThermProtnCtrlTSeln -> AAACalRegn01IninOptSetA01_Dummy.DutyCycThermProtnCtrlTSeln  # UB:Derived from original system description
    connect CalRegn01IninOptSetA01.DutyCycThermProtnDutyCycFildThd -> AAACalRegn01IninOptSetA01_Dummy.DutyCycThermProtnDutyCycFildThd  # UB:Derived from original system description
    connect CalRegn01IninOptSetA01.DutyCycThermProtnIgnOffCtrlEna -> AAACalRegn01IninOptSetA01_Dummy.DutyCycThermProtnIgnOffCtrlEna  # UB:Derived from original system description
    connect CalRegn01IninOptSetA01.DutyCycThermProtnIgnOffMsgWaitTi -> AAACalRegn01IninOptSetA01_Dummy.DutyCycThermProtnIgnOffMsgWaitTi  # UB:Derived from original system description
    connect CalRegn01IninOptSetA01.DutyCycThermProtnLstTblValNonStall -> AAACalRegn01IninOptSetA01_Dummy.DutyCycThermProtnLstTblValNonStall  # UB:Derived from original system description
    connect CalRegn01IninOptSetA01.DutyCycThermProtnLstTblValStall -> AAACalRegn01IninOptSetA01_Dummy.DutyCycThermProtnLstTblValStall  # UB:Derived from original system description
    connect CalRegn01IninOptSetA01.DutyCycThermProtnMotPrTSeln -> AAACalRegn01IninOptSetA01_Dummy.DutyCycThermProtnMotPrTSeln  # UB:Derived from original system description
    connect CalRegn01IninOptSetA01.DutyCycThermProtnMplr1FetMtgtnNonStallTblY -> AAACalRegn01IninOptSetA01_Dummy.DutyCycThermProtnMplr1FetMtgtnNonStallTblY  # UB:Derived from original system description
    connect CalRegn01IninOptSetA01.DutyCycThermProtnMplr1FetMtgtnStallTblY -> AAACalRegn01IninOptSetA01_Dummy.DutyCycThermProtnMplr1FetMtgtnStallTblY  # UB:Derived from original system description
    connect CalRegn01IninOptSetA01.DutyCycThermProtnMplr1NonStallTblY -> AAACalRegn01IninOptSetA01_Dummy.DutyCycThermProtnMplr1NonStallTblY  # UB:Derived from original system description
    connect CalRegn01IninOptSetA01.DutyCycThermProtnMplr1StallTblY -> AAACalRegn01IninOptSetA01_Dummy.DutyCycThermProtnMplr1StallTblY  # UB:Derived from original system description
    connect CalRegn01IninOptSetA01.DutyCycThermProtnMplr2FetMtgtnNonStallTblY -> AAACalRegn01IninOptSetA01_Dummy.DutyCycThermProtnMplr2FetMtgtnNonStallTblY  # UB:Derived from original system description
    connect CalRegn01IninOptSetA01.DutyCycThermProtnMplr2FetMtgtnStallTblY -> AAACalRegn01IninOptSetA01_Dummy.DutyCycThermProtnMplr2FetMtgtnStallTblY  # UB:Derived from original system description
    connect CalRegn01IninOptSetA01.DutyCycThermProtnMplr2NonStallTblY -> AAACalRegn01IninOptSetA01_Dummy.DutyCycThermProtnMplr2NonStallTblY  # UB:Derived from original system description
    connect CalRegn01IninOptSetA01.DutyCycThermProtnMplr2StallTblY -> AAACalRegn01IninOptSetA01_Dummy.DutyCycThermProtnMplr2StallTblY  # UB:Derived from original system description
    connect CalRegn01IninOptSetA01.DutyCycThermProtnMplr3FetMtgtnNonStallTblY -> AAACalRegn01IninOptSetA01_Dummy.DutyCycThermProtnMplr3FetMtgtnNonStallTblY  # UB:Derived from original system description
    connect CalRegn01IninOptSetA01.DutyCycThermProtnMplr3FetMtgtnStallTblY -> AAACalRegn01IninOptSetA01_Dummy.DutyCycThermProtnMplr3FetMtgtnStallTblY  # UB:Derived from original system description
    connect CalRegn01IninOptSetA01.DutyCycThermProtnMplr3NonStallTblY -> AAACalRegn01IninOptSetA01_Dummy.DutyCycThermProtnMplr3NonStallTblY  # UB:Derived from original system description
    connect CalRegn01IninOptSetA01.DutyCycThermProtnMplr3StallTblY -> AAACalRegn01IninOptSetA01_Dummy.DutyCycThermProtnMplr3StallTblY  # UB:Derived from original system description
    connect CalRegn01IninOptSetA01.DutyCycThermProtnMplr4FetMtgtnNonStallTblY -> AAACalRegn01IninOptSetA01_Dummy.DutyCycThermProtnMplr4FetMtgtnNonStallTblY  # UB:Derived from original system description
    connect CalRegn01IninOptSetA01.DutyCycThermProtnMplr4FetMtgtnStallTblY -> AAACalRegn01IninOptSetA01_Dummy.DutyCycThermProtnMplr4FetMtgtnStallTblY  # UB:Derived from original system description
    connect CalRegn01IninOptSetA01.DutyCycThermProtnMplr4NonStallTblY -> AAACalRegn01IninOptSetA01_Dummy.DutyCycThermProtnMplr4NonStallTblY  # UB:Derived from original system description
    connect CalRegn01IninOptSetA01.DutyCycThermProtnMplr4StallTblY -> AAACalRegn01IninOptSetA01_Dummy.DutyCycThermProtnMplr4StallTblY  # UB:Derived from original system description
    connect CalRegn01IninOptSetA01.DutyCycThermProtnMplr5FetMtgtnNonStallTblY -> AAACalRegn01IninOptSetA01_Dummy.DutyCycThermProtnMplr5FetMtgtnNonStallTblY  # UB:Derived from original system description
    connect CalRegn01IninOptSetA01.DutyCycThermProtnMplr5FetMtgtnStallTblY -> AAACalRegn01IninOptSetA01_Dummy.DutyCycThermProtnMplr5FetMtgtnStallTblY  # UB:Derived from original system description
    connect CalRegn01IninOptSetA01.DutyCycThermProtnMplr5NonStallTblY -> AAACalRegn01IninOptSetA01_Dummy.DutyCycThermProtnMplr5NonStallTblY  # UB:Derived from original system description
    connect CalRegn01IninOptSetA01.DutyCycThermProtnMplr5StallTblY -> AAACalRegn01IninOptSetA01_Dummy.DutyCycThermProtnMplr5StallTblY  # UB:Derived from original system description
    connect CalRegn01IninOptSetA01.DutyCycThermProtnMplr6FetMtgtnNonStallTblY -> AAACalRegn01IninOptSetA01_Dummy.DutyCycThermProtnMplr6FetMtgtnNonStallTblY  # UB:Derived from original system description
    connect CalRegn01IninOptSetA01.DutyCycThermProtnMplr6FetMtgtnStallTblY -> AAACalRegn01IninOptSetA01_Dummy.DutyCycThermProtnMplr6FetMtgtnStallTblY  # UB:Derived from original system description
    connect CalRegn01IninOptSetA01.DutyCycThermProtnMplr6NonStallTblY -> AAACalRegn01IninOptSetA01_Dummy.DutyCycThermProtnMplr6NonStallTblY  # UB:Derived from original system description
    connect CalRegn01IninOptSetA01.DutyCycThermProtnMplr6StallTblY -> AAACalRegn01IninOptSetA01_Dummy.DutyCycThermProtnMplr6StallTblY  # UB:Derived from original system description
    connect CalRegn01IninOptSetA01.DutyCycThermProtnMplrFetMtgtnTblX -> AAACalRegn01IninOptSetA01_Dummy.DutyCycThermProtnMplrFetMtgtnTblX  # UB:Derived from original system description
    connect CalRegn01IninOptSetA01.DutyCycThermProtnMplrTblX -> AAACalRegn01IninOptSetA01_Dummy.DutyCycThermProtnMplrTblX  # UB:Derived from original system description
    connect CalRegn01IninOptSetA01.DutyCycThermProtnMplrTSeln -> AAACalRegn01IninOptSetA01_Dummy.DutyCycThermProtnMplrTSeln  # UB:Derived from original system description
    connect CalRegn01IninOptSetA01.DutyCycThermProtnSlowFilTSeln -> AAACalRegn01IninOptSetA01_Dummy.DutyCycThermProtnSlowFilTSeln  # UB:Derived from original system description
    connect CalRegn01IninOptSetA01.DutyCycThermProtnThermLimScaFac -> AAACalRegn01IninOptSetA01_Dummy.DutyCycThermProtnThermLimScaFac  # UB:Derived from original system description
    connect CalRegn01IninOptSetA01.DutyCycThermProtnThermLoadLimTblX -> AAACalRegn01IninOptSetA01_Dummy.DutyCycThermProtnThermLoadLimTblX  # UB:Derived from original system description
    connect CalRegn01IninOptSetA01.DutyCycThermProtnThermLoadLimTblY -> AAACalRegn01IninOptSetA01_Dummy.DutyCycThermProtnThermLoadLimTblY  # UB:Derived from original system description
    connect CalRegn01IninOptSetA01.DutyCycThermProtnTqCmdSlewDwn -> AAACalRegn01IninOptSetA01_Dummy.DutyCycThermProtnTqCmdSlewDwn  # UB:Derived from original system description
    connect CalRegn01IninOptSetA01.DutyCycThermProtnTqCmdSlewUp -> AAACalRegn01IninOptSetA01_Dummy.DutyCycThermProtnTqCmdSlewUp  # UB:Derived from original system description
    connect CalRegn01IninOptSetA01.HiLoadStallLimrMotVelMgnThd -> AAACalRegn01IninOptSetA01_Dummy.HiLoadStallLimrMotVelMgnThd  # UB:Derived from original system description
    connect CalRegn01IninOptSetA01.HiLoadStallLimrStallMotTqCmdFetMtgtnLimX -> AAACalRegn01IninOptSetA01_Dummy.HiLoadStallLimrStallMotTqCmdFetMtgtnLimX  # UB:Derived from original system description
    connect CalRegn01IninOptSetA01.HiLoadStallLimrStallMotTqCmdFetMtgtnLimY -> AAACalRegn01IninOptSetA01_Dummy.HiLoadStallLimrStallMotTqCmdFetMtgtnLimY  # UB:Derived from original system description
    connect CalRegn01IninOptSetA01.HiLoadStallLimrStallMotTqCmdLimX -> AAACalRegn01IninOptSetA01_Dummy.HiLoadStallLimrStallMotTqCmdLimX  # UB:Derived from original system description
    connect CalRegn01IninOptSetA01.HiLoadStallLimrStallMotTqCmdLimY -> AAACalRegn01IninOptSetA01_Dummy.HiLoadStallLimrStallMotTqCmdLimY  # UB:Derived from original system description
    connect CalRegn01IninOptSetA01.HiLoadStallLimrStallMotTqLimSlewRate -> AAACalRegn01IninOptSetA01_Dummy.HiLoadStallLimrStallMotTqLimSlewRate  # UB:Derived from original system description
    connect CalRegn01IninOptSetA01.HiLoadStallLimrStallThermLimSca -> AAACalRegn01IninOptSetA01_Dummy.HiLoadStallLimrStallThermLimSca  # UB:Derived from original system description
    connect CalRegn01IninOptSetA01.LrndRackCentrMotTqThd -> AAACalRegn01IninOptSetA01_Dummy.LrndRackCentrMotTqThd  # UB:Derived from original system description
    connect CalRegn01IninOptSetA01.LrndRackCentrMotVelThd -> AAACalRegn01IninOptSetA01_Dummy.LrndRackCentrMotVelThd  # UB:Derived from original system description
    connect CalRegn01IninOptSetA01.MotCtrlPrmEstimnFetRNom -> AAACalRegn01IninOptSetA01_Dummy.MotCtrlPrmEstimnFetRNom  # UB:Derived from original system description
    connect CalRegn01IninOptSetA01.MotCtrlPrmEstimnMotBackEmfConHiLim -> AAACalRegn01IninOptSetA01_Dummy.MotCtrlPrmEstimnMotBackEmfConHiLim  # UB:Derived from original system description
    connect CalRegn01IninOptSetA01.MotCtrlPrmEstimnMotBackEmfConLoLim -> AAACalRegn01IninOptSetA01_Dummy.MotCtrlPrmEstimnMotBackEmfConLoLim  # UB:Derived from original system description
    connect CalRegn01IninOptSetA01.MotCtrlPrmEstimnMotBackEmfConNom -> AAACalRegn01IninOptSetA01_Dummy.MotCtrlPrmEstimnMotBackEmfConNom  # UB:Derived from original system description
    connect CalRegn01IninOptSetA01.MotCtrlPrmEstimnMotBackEmfConSatnScaIvtrLoaMtgtn -> AAACalRegn01IninOptSetA01_Dummy.MotCtrlPrmEstimnMotBackEmfConSatnScaIvtrLoaMtgtn  # UB:Derived from original system description
    connect CalRegn01IninOptSetA01.MotCtrlPrmEstimnMotBackEmfConSatnX -> AAACalRegn01IninOptSetA01_Dummy.MotCtrlPrmEstimnMotBackEmfConSatnX  # UB:Derived from original system description
    connect CalRegn01IninOptSetA01.MotCtrlPrmEstimnMotBackEmfConSatnY -> AAACalRegn01IninOptSetA01_Dummy.MotCtrlPrmEstimnMotBackEmfConSatnY  # UB:Derived from original system description
    connect CalRegn01IninOptSetA01.MotCtrlPrmEstimnMotCurrDaxInduSatnBilnrSeln -> AAACalRegn01IninOptSetA01_Dummy.MotCtrlPrmEstimnMotCurrDaxInduSatnBilnrSeln  # UB:Derived from original system description
    connect CalRegn01IninOptSetA01.MotCtrlPrmEstimnMotCurrQaxInduSatnX -> AAACalRegn01IninOptSetA01_Dummy.MotCtrlPrmEstimnMotCurrQaxInduSatnX  # UB:Derived from original system description
    connect CalRegn01IninOptSetA01.MotCtrlPrmEstimnMotInduDaxHiLim -> AAACalRegn01IninOptSetA01_Dummy.MotCtrlPrmEstimnMotInduDaxHiLim  # UB:Derived from original system description
    connect CalRegn01IninOptSetA01.MotCtrlPrmEstimnMotInduDaxIvtrLoaMtgtn -> AAACalRegn01IninOptSetA01_Dummy.MotCtrlPrmEstimnMotInduDaxIvtrLoaMtgtn  # UB:Derived from original system description
    connect CalRegn01IninOptSetA01.MotCtrlPrmEstimnMotInduDaxLoLim -> AAACalRegn01IninOptSetA01_Dummy.MotCtrlPrmEstimnMotInduDaxLoLim  # UB:Derived from original system description
    connect CalRegn01IninOptSetA01.MotCtrlPrmEstimnMotInduDaxNom -> AAACalRegn01IninOptSetA01_Dummy.MotCtrlPrmEstimnMotInduDaxNom  # UB:Derived from original system description
    connect CalRegn01IninOptSetA01.MotCtrlPrmEstimnMotInduDaxSatnScaY -> AAACalRegn01IninOptSetA01_Dummy.MotCtrlPrmEstimnMotInduDaxSatnScaY  # UB:Derived from original system description
    connect CalRegn01IninOptSetA01.MotCtrlPrmEstimnMotInduQaxHiLim -> AAACalRegn01IninOptSetA01_Dummy.MotCtrlPrmEstimnMotInduQaxHiLim  # UB:Derived from original system description
    connect CalRegn01IninOptSetA01.MotCtrlPrmEstimnMotInduQaxIvtrLoaMtgtn -> AAACalRegn01IninOptSetA01_Dummy.MotCtrlPrmEstimnMotInduQaxIvtrLoaMtgtn  # UB:Derived from original system description
    connect CalRegn01IninOptSetA01.MotCtrlPrmEstimnMotInduQaxLoLim -> AAACalRegn01IninOptSetA01_Dummy.MotCtrlPrmEstimnMotInduQaxLoLim  # UB:Derived from original system description
    connect CalRegn01IninOptSetA01.MotCtrlPrmEstimnMotInduQaxNom -> AAACalRegn01IninOptSetA01_Dummy.MotCtrlPrmEstimnMotInduQaxNom  # UB:Derived from original system description
    connect CalRegn01IninOptSetA01.MotCtrlPrmEstimnMotInduQaxSatnScaY -> AAACalRegn01IninOptSetA01_Dummy.MotCtrlPrmEstimnMotInduQaxSatnScaY  # UB:Derived from original system description
    connect CalRegn01IninOptSetA01.MotCtrlPrmEstimnMotRHiLim -> AAACalRegn01IninOptSetA01_Dummy.MotCtrlPrmEstimnMotRHiLim  # UB:Derived from original system description
    connect CalRegn01IninOptSetA01.MotCtrlPrmEstimnMotRLoLim -> AAACalRegn01IninOptSetA01_Dummy.MotCtrlPrmEstimnMotRLoLim  # UB:Derived from original system description
    connect CalRegn01IninOptSetA01.MotCtrlPrmEstimnMotRNom -> AAACalRegn01IninOptSetA01_Dummy.MotCtrlPrmEstimnMotRNom  # UB:Derived from original system description
    connect CalRegn01IninOptSetA01.MotCtrlPrmEstimnMotWidgThermCoeff -> AAACalRegn01IninOptSetA01_Dummy.MotCtrlPrmEstimnMotWidgThermCoeff  # UB:Derived from original system description
    connect CalRegn01IninOptSetA01.MotCtrlPrmEstimnTNom -> AAACalRegn01IninOptSetA01_Dummy.MotCtrlPrmEstimnTNom  # UB:Derived from original system description
    connect CalRegn01IninOptSetA01.MotCurrPeakEstimnCurrFilFrq -> AAACalRegn01IninOptSetA01_Dummy.MotCurrPeakEstimnCurrFilFrq  # UB:Derived from original system description
    connect CalRegn01IninOptSetA01.MotCurrPeakEstimnCurrPeakEstimdFilFrq -> AAACalRegn01IninOptSetA01_Dummy.MotCurrPeakEstimnCurrPeakEstimdFilFrq  # UB:Derived from original system description
    connect CalRegn01IninOptSetA01.MotCurrRegCfgMotClsdLoopBwDaxY -> AAACalRegn01IninOptSetA01_Dummy.MotCurrRegCfgMotClsdLoopBwDaxY  # UB:Derived from original system description
    connect CalRegn01IninOptSetA01.MotCurrRegCfgMotClsdLoopBwQaxY -> AAACalRegn01IninOptSetA01_Dummy.MotCurrRegCfgMotClsdLoopBwQaxY  # UB:Derived from original system description
    connect CalRegn01IninOptSetA01.MotCurrRegCfgMotDampgRatDax -> AAACalRegn01IninOptSetA01_Dummy.MotCurrRegCfgMotDampgRatDax  # UB:Derived from original system description
    connect CalRegn01IninOptSetA01.MotCurrRegCfgMotDampgRatQax -> AAACalRegn01IninOptSetA01_Dummy.MotCurrRegCfgMotDampgRatQax  # UB:Derived from original system description
    connect CalRegn01IninOptSetA01.MotCurrRegCfgMotNatFrqDaxY -> AAACalRegn01IninOptSetA01_Dummy.MotCurrRegCfgMotNatFrqDaxY  # UB:Derived from original system description
    connect CalRegn01IninOptSetA01.MotCurrRegCfgMotNatFrqQaxY -> AAACalRegn01IninOptSetA01_Dummy.MotCurrRegCfgMotNatFrqQaxY  # UB:Derived from original system description
    connect CalRegn01IninOptSetA01.MotCurrRegCfgMotRVirtDax -> AAACalRegn01IninOptSetA01_Dummy.MotCurrRegCfgMotRVirtDax  # UB:Derived from original system description
    connect CalRegn01IninOptSetA01.MotCurrRegCfgMotRVirtQax -> AAACalRegn01IninOptSetA01_Dummy.MotCurrRegCfgMotRVirtQax  # UB:Derived from original system description
    connect CalRegn01IninOptSetA01.MotCurrRegCfgMotVelFilFrq -> AAACalRegn01IninOptSetA01_Dummy.MotCurrRegCfgMotVelFilFrq  # UB:Derived from original system description
    connect CalRegn01IninOptSetA01.MotCurrRegVltgLimrCurrLoaScarSlewRate -> AAACalRegn01IninOptSetA01_Dummy.MotCurrRegVltgLimrCurrLoaScarSlewRate  # UB:Derived from original system description
    connect CalRegn01IninOptSetA01.MotCurrRegVltgLimrDaxAntiWdupCoeff -> AAACalRegn01IninOptSetA01_Dummy.MotCurrRegVltgLimrDaxAntiWdupCoeff  # UB:Derived from original system description
    connect CalRegn01IninOptSetA01.MotCurrRegVltgLimrDualEcuLoaScarSlewRate -> AAACalRegn01IninOptSetA01_Dummy.MotCurrRegVltgLimrDualEcuLoaScarSlewRate  # UB:Derived from original system description
    connect CalRegn01IninOptSetA01.MotCurrRegVltgLimrFETLoaScarSlewRate -> AAACalRegn01IninOptSetA01_Dummy.MotCurrRegVltgLimrFETLoaScarSlewRate  # UB:Derived from original system description
    connect CalRegn01IninOptSetA01.MotCurrRegVltgLimrIvtrLoaScarSlewRate -> AAACalRegn01IninOptSetA01_Dummy.MotCurrRegVltgLimrIvtrLoaScarSlewRate  # UB:Derived from original system description
    connect CalRegn01IninOptSetA01.MotCurrRegVltgLimrMotVltgBrdgLpFilFrq -> AAACalRegn01IninOptSetA01_Dummy.MotCurrRegVltgLimrMotVltgBrdgLpFilFrq  # UB:Derived from original system description
    connect CalRegn01IninOptSetA01.MotCurrRegVltgLimrMotVltgDaxIntglHiLim -> AAACalRegn01IninOptSetA01_Dummy.MotCurrRegVltgLimrMotVltgDaxIntglHiLim  # UB:Derived from original system description
    connect CalRegn01IninOptSetA01.MotCurrRegVltgLimrMotVltgDaxIntglLoLim -> AAACalRegn01IninOptSetA01_Dummy.MotCurrRegVltgLimrMotVltgDaxIntglLoLim  # UB:Derived from original system description
    connect CalRegn01IninOptSetA01.MotCurrRegVltgLimrMotVltgQaxFfLpFilFrq -> AAACalRegn01IninOptSetA01_Dummy.MotCurrRegVltgLimrMotVltgQaxFfLpFilFrq  # UB:Derived from original system description
    connect CalRegn01IninOptSetA01.MotCurrRegVltgLimrMotVltgQaxIntglHiLim -> AAACalRegn01IninOptSetA01_Dummy.MotCurrRegVltgLimrMotVltgQaxIntglHiLim  # UB:Derived from original system description
    connect CalRegn01IninOptSetA01.MotCurrRegVltgLimrMotVltgQaxIntglLoLim -> AAACalRegn01IninOptSetA01_Dummy.MotCurrRegVltgLimrMotVltgQaxIntglLoLim  # UB:Derived from original system description
    connect CalRegn01IninOptSetA01.MotCurrRegVltgLimrQaxAntiWdupCoeff -> AAACalRegn01IninOptSetA01_Dummy.MotCurrRegVltgLimrQaxAntiWdupCoeff  # UB:Derived from original system description
    connect CalRegn01IninOptSetA01.MotCurrRegVltgLimrQaxAntiWdupScagDi -> AAACalRegn01IninOptSetA01_Dummy.MotCurrRegVltgLimrQaxAntiWdupScagDi  # UB:Derived from original system description
    connect CalRegn01IninOptSetA01.MotRefMdlCurrDaxBoostGain -> AAACalRegn01IninOptSetA01_Dummy.MotRefMdlCurrDaxBoostGain  # UB:Derived from original system description
    connect CalRegn01IninOptSetA01.MotRefMdlCurrDaxBoostTqScaX -> AAACalRegn01IninOptSetA01_Dummy.MotRefMdlCurrDaxBoostTqScaX  # UB:Derived from original system description
    connect CalRegn01IninOptSetA01.MotRefMdlCurrDaxBoostTqScaY -> AAACalRegn01IninOptSetA01_Dummy.MotRefMdlCurrDaxBoostTqScaY  # UB:Derived from original system description
    connect CalRegn01IninOptSetA01.MotRefMdlCurrDaxQaxRefDelta -> AAACalRegn01IninOptSetA01_Dummy.MotRefMdlCurrDaxQaxRefDelta  # UB:Derived from original system description
    connect CalRegn01IninOptSetA01.MotRefMdlCurrItrnTolr -> AAACalRegn01IninOptSetA01_Dummy.MotRefMdlCurrItrnTolr  # UB:Derived from original system description
    connect CalRegn01IninOptSetA01.MotRefMdlMotCurrDaxMaxSca -> AAACalRegn01IninOptSetA01_Dummy.MotRefMdlMotCurrDaxMaxSca  # UB:Derived from original system description
    connect CalRegn01IninOptSetA01.MotRefMdlQuad13VltgSdlX -> AAACalRegn01IninOptSetA01_Dummy.MotRefMdlQuad13VltgSdlX  # UB:Derived from original system description
    connect CalRegn01IninOptSetA01.MotRefMdlQuad13VltgSdlY -> AAACalRegn01IninOptSetA01_Dummy.MotRefMdlQuad13VltgSdlY  # UB:Derived from original system description
    connect CalRegn01IninOptSetA01.MotRefMdlQuad24VltgSdlX -> AAACalRegn01IninOptSetA01_Dummy.MotRefMdlQuad24VltgSdlX  # UB:Derived from original system description
    connect CalRegn01IninOptSetA01.MotRefMdlQuad24VltgSdlY -> AAACalRegn01IninOptSetA01_Dummy.MotRefMdlQuad24VltgSdlY  # UB:Derived from original system description
    connect CalRegn01IninOptSetA01.MotRefMdlVltgOverRThdSca -> AAACalRegn01IninOptSetA01_Dummy.MotRefMdlVltgOverRThdSca  # UB:Derived from original system description
    connect CalRegn01IninOptSetA01.MotTqTranlDampgCmdLim -> AAACalRegn01IninOptSetA01_Dummy.MotTqTranlDampgCmdLim  # UB:Derived from original system description
    connect CalRegn01IninOptSetA01.MotTqTranlDampgVelThd -> AAACalRegn01IninOptSetA01_Dummy.MotTqTranlDampgVelThd  # UB:Derived from original system description
    connect CalRegn01IninOptSetA01.PwrLimrAssiRednLpFilFrq -> AAACalRegn01IninOptSetA01_Dummy.PwrLimrAssiRednLpFilFrq  # UB:Derived from original system description
    connect CalRegn01IninOptSetA01.PwrLimrBackEmfConStdT -> AAACalRegn01IninOptSetA01_Dummy.PwrLimrBackEmfConStdT  # UB:Derived from original system description
    connect CalRegn01IninOptSetA01.PwrLimrBrdgVltgAdjSlew -> AAACalRegn01IninOptSetA01_Dummy.PwrLimrBrdgVltgAdjSlew  # UB:Derived from original system description
    connect CalRegn01IninOptSetA01.PwrLimrBrdgVltgAltFltAdj -> AAACalRegn01IninOptSetA01_Dummy.PwrLimrBrdgVltgAltFltAdj  # UB:Derived from original system description
    connect CalRegn01IninOptSetA01.PwrLimrFilAssiRednThd -> AAACalRegn01IninOptSetA01_Dummy.PwrLimrFilAssiRednThd  # UB:Derived from original system description
    connect CalRegn01IninOptSetA01.PwrLimrLoVoltAssiRcvrThd -> AAACalRegn01IninOptSetA01_Dummy.PwrLimrLoVoltAssiRcvrThd  # UB:Derived from original system description
    connect CalRegn01IninOptSetA01.PwrLimrLoVoltAssiRcvrTi -> AAACalRegn01IninOptSetA01_Dummy.PwrLimrLoVoltAssiRcvrTi  # UB:Derived from original system description
    connect CalRegn01IninOptSetA01.PwrLimrMotEnvlpX -> AAACalRegn01IninOptSetA01_Dummy.PwrLimrMotEnvlpX  # UB:Derived from original system description
    connect CalRegn01IninOptSetA01.PwrLimrMotEnvlpY -> AAACalRegn01IninOptSetA01_Dummy.PwrLimrMotEnvlpY  # UB:Derived from original system description
    connect CalRegn01IninOptSetA01.PwrLimrMotVelLpFilFrq -> AAACalRegn01IninOptSetA01_Dummy.PwrLimrMotVelLpFilFrq  # UB:Derived from original system description
    connect CalRegn01IninOptSetA01.PwrLimrSpdAdjSlewDec -> AAACalRegn01IninOptSetA01_Dummy.PwrLimrSpdAdjSlewDec  # UB:Derived from original system description
    connect CalRegn01IninOptSetA01.PwrLimrSpdAdjSlewEna -> AAACalRegn01IninOptSetA01_Dummy.PwrLimrSpdAdjSlewEna  # UB:Derived from original system description
    connect CalRegn01IninOptSetA01.PwrLimrSpdAdjSlewInc -> AAACalRegn01IninOptSetA01_Dummy.PwrLimrSpdAdjSlewInc  # UB:Derived from original system description
    connect CalRegn01IninOptSetA01.PwrLimrStdOperMotEnvlpX -> AAACalRegn01IninOptSetA01_Dummy.PwrLimrStdOperMotEnvlpX  # UB:Derived from original system description
    connect CalRegn01IninOptSetA01.PwrLimrStdOperMotEnvlpY -> AAACalRegn01IninOptSetA01_Dummy.PwrLimrStdOperMotEnvlpY  # UB:Derived from original system description
    connect CalRegn01IninOptSetA01.PwrLimrVltgDptMotVelOffsX -> AAACalRegn01IninOptSetA01_Dummy.PwrLimrVltgDptMotVelOffsX  # UB:Derived from original system description
    connect CalRegn01IninOptSetA01.PwrLimrVltgDptMotVelOffsY -> AAACalRegn01IninOptSetA01_Dummy.PwrLimrVltgDptMotVelOffsY  # UB:Derived from original system description
    connect CalRegn01IninOptSetA01.SysGlbPrmSysTqRat -> AAACalRegn01IninOptSetA01_Dummy.SysGlbPrmSysTqRat  # UB:Derived from original system description
    connect CalRegn01IninOptSetA01.TEstimnAmbPwrMplr -> AAACalRegn01IninOptSetA01_Dummy.TEstimnAmbPwrMplr  # UB:Derived from original system description
    connect CalRegn01IninOptSetA01.TEstimnAmbTSca -> AAACalRegn01IninOptSetA01_Dummy.TEstimnAmbTSca  # UB:Derived from original system description
    connect CalRegn01IninOptSetA01.TEstimnAssiMechAmbLpFilFrq -> AAACalRegn01IninOptSetA01_Dummy.TEstimnAssiMechAmbLpFilFrq  # UB:Derived from original system description
    connect CalRegn01IninOptSetA01.TEstimnAssiMechAmbLpFilFrqDualEcuFltMtgtn -> AAACalRegn01IninOptSetA01_Dummy.TEstimnAssiMechAmbLpFilFrqDualEcuFltMtgtn  # UB:Derived from original system description
    connect CalRegn01IninOptSetA01.TEstimnAssiMechAmbLpFilFrqFetMtgtnEna -> AAACalRegn01IninOptSetA01_Dummy.TEstimnAssiMechAmbLpFilFrqFetMtgtnEna  # UB:Derived from original system description
    connect CalRegn01IninOptSetA01.TEstimnAssiMechAmbMplr -> AAACalRegn01IninOptSetA01_Dummy.TEstimnAssiMechAmbMplr  # UB:Derived from original system description
    connect CalRegn01IninOptSetA01.TEstimnAssiMechCorrLim -> AAACalRegn01IninOptSetA01_Dummy.TEstimnAssiMechCorrLim  # UB:Derived from original system description
    connect CalRegn01IninOptSetA01.TEstimnAssiMechDampgSca -> AAACalRegn01IninOptSetA01_Dummy.TEstimnAssiMechDampgSca  # UB:Derived from original system description
    connect CalRegn01IninOptSetA01.TEstimnAssiMechDftT -> AAACalRegn01IninOptSetA01_Dummy.TEstimnAssiMechDftT  # UB:Derived from original system description
    connect CalRegn01IninOptSetA01.TEstimnAssiMechLLFilCoeffA1 -> AAACalRegn01IninOptSetA01_Dummy.TEstimnAssiMechLLFilCoeffA1  # UB:Derived from original system description
    connect CalRegn01IninOptSetA01.TEstimnAssiMechLLFilCoeffB0 -> AAACalRegn01IninOptSetA01_Dummy.TEstimnAssiMechLLFilCoeffB0  # UB:Derived from original system description
    connect CalRegn01IninOptSetA01.TEstimnAssiMechLLFilCoeffB1 -> AAACalRegn01IninOptSetA01_Dummy.TEstimnAssiMechLLFilCoeffB1  # UB:Derived from original system description
    connect CalRegn01IninOptSetA01.TEstimnAssiMechSlew -> AAACalRegn01IninOptSetA01_Dummy.TEstimnAssiMechSlew  # UB:Derived from original system description
    connect CalRegn01IninOptSetA01.TEstimnCorrnTAssiMech -> AAACalRegn01IninOptSetA01_Dummy.TEstimnCorrnTAssiMech  # UB:Derived from original system description
    connect CalRegn01IninOptSetA01.TEstimnCorrnTCu -> AAACalRegn01IninOptSetA01_Dummy.TEstimnCorrnTCu  # UB:Derived from original system description
    connect CalRegn01IninOptSetA01.TEstimnCorrnTMag -> AAACalRegn01IninOptSetA01_Dummy.TEstimnCorrnTMag  # UB:Derived from original system description
    connect CalRegn01IninOptSetA01.TEstimnCorrnTSi -> AAACalRegn01IninOptSetA01_Dummy.TEstimnCorrnTSi  # UB:Derived from original system description
    connect CalRegn01IninOptSetA01.TEstimnCuAmbLpFilFrq -> AAACalRegn01IninOptSetA01_Dummy.TEstimnCuAmbLpFilFrq  # UB:Derived from original system description
    connect CalRegn01IninOptSetA01.TEstimnCuAmbLpFilFrqDualEcuFltMtgtn -> AAACalRegn01IninOptSetA01_Dummy.TEstimnCuAmbLpFilFrqDualEcuFltMtgtn  # UB:Derived from original system description
    connect CalRegn01IninOptSetA01.TEstimnCuAmbLpFilFrqFetMtgtnEna -> AAACalRegn01IninOptSetA01_Dummy.TEstimnCuAmbLpFilFrqFetMtgtnEna  # UB:Derived from original system description
    connect CalRegn01IninOptSetA01.TEstimnCuAmbMplr -> AAACalRegn01IninOptSetA01_Dummy.TEstimnCuAmbMplr  # UB:Derived from original system description
    connect CalRegn01IninOptSetA01.TEstimnCuCorrnLim -> AAACalRegn01IninOptSetA01_Dummy.TEstimnCuCorrnLim  # UB:Derived from original system description
    connect CalRegn01IninOptSetA01.TEstimnCuLLFilCoeffA1 -> AAACalRegn01IninOptSetA01_Dummy.TEstimnCuLLFilCoeffA1  # UB:Derived from original system description
    connect CalRegn01IninOptSetA01.TEstimnCuLLFilCoeffB0 -> AAACalRegn01IninOptSetA01_Dummy.TEstimnCuLLFilCoeffB0  # UB:Derived from original system description
    connect CalRegn01IninOptSetA01.TEstimnCuLLFilCoeffB1 -> AAACalRegn01IninOptSetA01_Dummy.TEstimnCuLLFilCoeffB1  # UB:Derived from original system description
    connect CalRegn01IninOptSetA01.TEstimnEngTSca -> AAACalRegn01IninOptSetA01_Dummy.TEstimnEngTSca  # UB:Derived from original system description
    connect CalRegn01IninOptSetA01.TEstimnMagAmbLpFilFrq -> AAACalRegn01IninOptSetA01_Dummy.TEstimnMagAmbLpFilFrq  # UB:Derived from original system description
    connect CalRegn01IninOptSetA01.TEstimnMagAmbLpFilFrqDualEcuFltMtgtn -> AAACalRegn01IninOptSetA01_Dummy.TEstimnMagAmbLpFilFrqDualEcuFltMtgtn  # UB:Derived from original system description
    connect CalRegn01IninOptSetA01.TEstimnMagAmbLpFilFrqFetMtgtnEna -> AAACalRegn01IninOptSetA01_Dummy.TEstimnMagAmbLpFilFrqFetMtgtnEna  # UB:Derived from original system description
    connect CalRegn01IninOptSetA01.TEstimnMagAmbMplr -> AAACalRegn01IninOptSetA01_Dummy.TEstimnMagAmbMplr  # UB:Derived from original system description
    connect CalRegn01IninOptSetA01.TEstimnMagCorrnLim -> AAACalRegn01IninOptSetA01_Dummy.TEstimnMagCorrnLim  # UB:Derived from original system description
    connect CalRegn01IninOptSetA01.TEstimnMagLLFilCoeffA1 -> AAACalRegn01IninOptSetA01_Dummy.TEstimnMagLLFilCoeffA1  # UB:Derived from original system description
    connect CalRegn01IninOptSetA01.TEstimnMagLLFilCoeffB0 -> AAACalRegn01IninOptSetA01_Dummy.TEstimnMagLLFilCoeffB0  # UB:Derived from original system description
    connect CalRegn01IninOptSetA01.TEstimnMagLLFilCoeffB1 -> AAACalRegn01IninOptSetA01_Dummy.TEstimnMagLLFilCoeffB1  # UB:Derived from original system description
    connect CalRegn01IninOptSetA01.TEstimnSiAmbLpFilFrq -> AAACalRegn01IninOptSetA01_Dummy.TEstimnSiAmbLpFilFrq  # UB:Derived from original system description
    connect CalRegn01IninOptSetA01.TEstimnSiAmbLpFilFrqDualEcuFltMtgtn -> AAACalRegn01IninOptSetA01_Dummy.TEstimnSiAmbLpFilFrqDualEcuFltMtgtn  # UB:Derived from original system description
    connect CalRegn01IninOptSetA01.TEstimnSiAmbLpFilFrqFetMtgtnEna -> AAACalRegn01IninOptSetA01_Dummy.TEstimnSiAmbLpFilFrqFetMtgtnEna  # UB:Derived from original system description
    connect CalRegn01IninOptSetA01.TEstimnSiAmbMplr -> AAACalRegn01IninOptSetA01_Dummy.TEstimnSiAmbMplr  # UB:Derived from original system description
    connect CalRegn01IninOptSetA01.TEstimnSiCorrnLim -> AAACalRegn01IninOptSetA01_Dummy.TEstimnSiCorrnLim  # UB:Derived from original system description
    connect CalRegn01IninOptSetA01.TEstimnSiLLFilCoeffA1 -> AAACalRegn01IninOptSetA01_Dummy.TEstimnSiLLFilCoeffA1  # UB:Derived from original system description
    connect CalRegn01IninOptSetA01.TEstimnSiLLFilCoeffB0 -> AAACalRegn01IninOptSetA01_Dummy.TEstimnSiLLFilCoeffB0  # UB:Derived from original system description
    connect CalRegn01IninOptSetA01.TEstimnSiLLFilCoeffB1 -> AAACalRegn01IninOptSetA01_Dummy.TEstimnSiLLFilCoeffB1  # UB:Derived from original system description
    connect CalRegn01IninOptSetA01.TEstimnTauAssiMech -> AAACalRegn01IninOptSetA01_Dummy.TEstimnTauAssiMech  # UB:Derived from original system description
    connect CalRegn01IninOptSetA01.TEstimnTauCu -> AAACalRegn01IninOptSetA01_Dummy.TEstimnTauCu  # UB:Derived from original system description
    connect CalRegn01IninOptSetA01.TEstimnTauMag -> AAACalRegn01IninOptSetA01_Dummy.TEstimnTauMag  # UB:Derived from original system description
    connect CalRegn01IninOptSetA01.TEstimnTauSi -> AAACalRegn01IninOptSetA01_Dummy.TEstimnTauSi  # UB:Derived from original system description
    connect CalRegn01IninOptSetA01.TEstimnWghtAvrgTDi -> AAACalRegn01IninOptSetA01_Dummy.TEstimnWghtAvrgTDi  # UB:Derived from original system description
    connect CalRegn01IninOptSetA01.VehSpdLimrPosMaxOffs2 -> AAACalRegn01IninOptSetA01_Dummy.VehSpdLimrPosMaxOffs2  # UB:Derived from original system description
    connect CalRegn01IninOptSetA02.DutyCycThermProtnAbsltCtrlTFetMtgtnTblX -> AAACalRegn01IninOptSetA02_Dummy.DutyCycThermProtnAbsltCtrlTFetMtgtnTblX  # UB:Derived from original system description
    connect CalRegn01IninOptSetA02.DutyCycThermProtnAbsltCtrlTTblX -> AAACalRegn01IninOptSetA02_Dummy.DutyCycThermProtnAbsltCtrlTTblX  # UB:Derived from original system description
    connect CalRegn01IninOptSetA02.DutyCycThermProtnAbsltCtrlTTqFetMtgtnTblY -> AAACalRegn01IninOptSetA02_Dummy.DutyCycThermProtnAbsltCtrlTTqFetMtgtnTblY  # UB:Derived from original system description
    connect CalRegn01IninOptSetA02.DutyCycThermProtnAbsltCtrlTTqTblY -> AAACalRegn01IninOptSetA02_Dummy.DutyCycThermProtnAbsltCtrlTTqTblY  # UB:Derived from original system description
    connect CalRegn01IninOptSetA02.DutyCycThermProtnAbsltCuTFetMtgtnTblX -> AAACalRegn01IninOptSetA02_Dummy.DutyCycThermProtnAbsltCuTFetMtgtnTblX  # UB:Derived from original system description
    connect CalRegn01IninOptSetA02.DutyCycThermProtnAbsltCuTTblX -> AAACalRegn01IninOptSetA02_Dummy.DutyCycThermProtnAbsltCuTTblX  # UB:Derived from original system description
    connect CalRegn01IninOptSetA02.DutyCycThermProtnAbsltCuTTqFetMtgtnTblY -> AAACalRegn01IninOptSetA02_Dummy.DutyCycThermProtnAbsltCuTTqFetMtgtnTblY  # UB:Derived from original system description
    connect CalRegn01IninOptSetA02.DutyCycThermProtnAbsltCuTTqTblY -> AAACalRegn01IninOptSetA02_Dummy.DutyCycThermProtnAbsltCuTTqTblY  # UB:Derived from original system description
    connect CalRegn01IninOptSetA02.DutyCycThermProtnAbsltMotVelBreakPt -> AAACalRegn01IninOptSetA02_Dummy.DutyCycThermProtnAbsltMotVelBreakPt  # UB:Derived from original system description
    connect CalRegn01IninOptSetA02.DutyCycThermProtnAbsltTTqSlewHiLim -> AAACalRegn01IninOptSetA02_Dummy.DutyCycThermProtnAbsltTTqSlewHiLim  # UB:Derived from original system description
    connect CalRegn01IninOptSetA02.DutyCycThermProtnAbsltTTqSlewLoLim -> AAACalRegn01IninOptSetA02_Dummy.DutyCycThermProtnAbsltTTqSlewLoLim  # UB:Derived from original system description
    connect CalRegn01IninOptSetA02.DutyCycThermProtnCtrlT -> AAACalRegn01IninOptSetA02_Dummy.DutyCycThermProtnCtrlT  # UB:Derived from original system description
    connect CalRegn01IninOptSetA02.DutyCycThermProtnCtrlTSeln -> AAACalRegn01IninOptSetA02_Dummy.DutyCycThermProtnCtrlTSeln  # UB:Derived from original system description
    connect CalRegn01IninOptSetA02.DutyCycThermProtnDutyCycFildThd -> AAACalRegn01IninOptSetA02_Dummy.DutyCycThermProtnDutyCycFildThd  # UB:Derived from original system description
    connect CalRegn01IninOptSetA02.DutyCycThermProtnIgnOffCtrlEna -> AAACalRegn01IninOptSetA02_Dummy.DutyCycThermProtnIgnOffCtrlEna  # UB:Derived from original system description
    connect CalRegn01IninOptSetA02.DutyCycThermProtnIgnOffMsgWaitTi -> AAACalRegn01IninOptSetA02_Dummy.DutyCycThermProtnIgnOffMsgWaitTi  # UB:Derived from original system description
    connect CalRegn01IninOptSetA02.DutyCycThermProtnLstTblValNonStall -> AAACalRegn01IninOptSetA02_Dummy.DutyCycThermProtnLstTblValNonStall  # UB:Derived from original system description
    connect CalRegn01IninOptSetA02.DutyCycThermProtnLstTblValStall -> AAACalRegn01IninOptSetA02_Dummy.DutyCycThermProtnLstTblValStall  # UB:Derived from original system description
    connect CalRegn01IninOptSetA02.DutyCycThermProtnMotPrTSeln -> AAACalRegn01IninOptSetA02_Dummy.DutyCycThermProtnMotPrTSeln  # UB:Derived from original system description
    connect CalRegn01IninOptSetA02.DutyCycThermProtnMplr1FetMtgtnNonStallTblY -> AAACalRegn01IninOptSetA02_Dummy.DutyCycThermProtnMplr1FetMtgtnNonStallTblY  # UB:Derived from original system description
    connect CalRegn01IninOptSetA02.DutyCycThermProtnMplr1FetMtgtnStallTblY -> AAACalRegn01IninOptSetA02_Dummy.DutyCycThermProtnMplr1FetMtgtnStallTblY  # UB:Derived from original system description
    connect CalRegn01IninOptSetA02.DutyCycThermProtnMplr1NonStallTblY -> AAACalRegn01IninOptSetA02_Dummy.DutyCycThermProtnMplr1NonStallTblY  # UB:Derived from original system description
    connect CalRegn01IninOptSetA02.DutyCycThermProtnMplr1StallTblY -> AAACalRegn01IninOptSetA02_Dummy.DutyCycThermProtnMplr1StallTblY  # UB:Derived from original system description
    connect CalRegn01IninOptSetA02.DutyCycThermProtnMplr2FetMtgtnNonStallTblY -> AAACalRegn01IninOptSetA02_Dummy.DutyCycThermProtnMplr2FetMtgtnNonStallTblY  # UB:Derived from original system description
    connect CalRegn01IninOptSetA02.DutyCycThermProtnMplr2FetMtgtnStallTblY -> AAACalRegn01IninOptSetA02_Dummy.DutyCycThermProtnMplr2FetMtgtnStallTblY  # UB:Derived from original system description
    connect CalRegn01IninOptSetA02.DutyCycThermProtnMplr2NonStallTblY -> AAACalRegn01IninOptSetA02_Dummy.DutyCycThermProtnMplr2NonStallTblY  # UB:Derived from original system description
    connect CalRegn01IninOptSetA02.DutyCycThermProtnMplr2StallTblY -> AAACalRegn01IninOptSetA02_Dummy.DutyCycThermProtnMplr2StallTblY  # UB:Derived from original system description
    connect CalRegn01IninOptSetA02.DutyCycThermProtnMplr3FetMtgtnNonStallTblY -> AAACalRegn01IninOptSetA02_Dummy.DutyCycThermProtnMplr3FetMtgtnNonStallTblY  # UB:Derived from original system description
    connect CalRegn01IninOptSetA02.DutyCycThermProtnMplr3FetMtgtnStallTblY -> AAACalRegn01IninOptSetA02_Dummy.DutyCycThermProtnMplr3FetMtgtnStallTblY  # UB:Derived from original system description
    connect CalRegn01IninOptSetA02.DutyCycThermProtnMplr3NonStallTblY -> AAACalRegn01IninOptSetA02_Dummy.DutyCycThermProtnMplr3NonStallTblY  # UB:Derived from original system description
    connect CalRegn01IninOptSetA02.DutyCycThermProtnMplr3StallTblY -> AAACalRegn01IninOptSetA02_Dummy.DutyCycThermProtnMplr3StallTblY  # UB:Derived from original system description
    connect CalRegn01IninOptSetA02.DutyCycThermProtnMplr4FetMtgtnNonStallTblY -> AAACalRegn01IninOptSetA02_Dummy.DutyCycThermProtnMplr4FetMtgtnNonStallTblY  # UB:Derived from original system description
    connect CalRegn01IninOptSetA02.DutyCycThermProtnMplr4FetMtgtnStallTblY -> AAACalRegn01IninOptSetA02_Dummy.DutyCycThermProtnMplr4FetMtgtnStallTblY  # UB:Derived from original system description
    connect CalRegn01IninOptSetA02.DutyCycThermProtnMplr4NonStallTblY -> AAACalRegn01IninOptSetA02_Dummy.DutyCycThermProtnMplr4NonStallTblY  # UB:Derived from original system description
    connect CalRegn01IninOptSetA02.DutyCycThermProtnMplr4StallTblY -> AAACalRegn01IninOptSetA02_Dummy.DutyCycThermProtnMplr4StallTblY  # UB:Derived from original system description
    connect CalRegn01IninOptSetA02.DutyCycThermProtnMplr5FetMtgtnNonStallTblY -> AAACalRegn01IninOptSetA02_Dummy.DutyCycThermProtnMplr5FetMtgtnNonStallTblY  # UB:Derived from original system description
    connect CalRegn01IninOptSetA02.DutyCycThermProtnMplr5FetMtgtnStallTblY -> AAACalRegn01IninOptSetA02_Dummy.DutyCycThermProtnMplr5FetMtgtnStallTblY  # UB:Derived from original system description
    connect CalRegn01IninOptSetA02.DutyCycThermProtnMplr5NonStallTblY -> AAACalRegn01IninOptSetA02_Dummy.DutyCycThermProtnMplr5NonStallTblY  # UB:Derived from original system description
    connect CalRegn01IninOptSetA02.DutyCycThermProtnMplr5StallTblY -> AAACalRegn01IninOptSetA02_Dummy.DutyCycThermProtnMplr5StallTblY  # UB:Derived from original system description
    connect CalRegn01IninOptSetA02.DutyCycThermProtnMplr6FetMtgtnNonStallTblY -> AAACalRegn01IninOptSetA02_Dummy.DutyCycThermProtnMplr6FetMtgtnNonStallTblY  # UB:Derived from original system description
    connect CalRegn01IninOptSetA02.DutyCycThermProtnMplr6FetMtgtnStallTblY -> AAACalRegn01IninOptSetA02_Dummy.DutyCycThermProtnMplr6FetMtgtnStallTblY  # UB:Derived from original system description
    connect CalRegn01IninOptSetA02.DutyCycThermProtnMplr6NonStallTblY -> AAACalRegn01IninOptSetA02_Dummy.DutyCycThermProtnMplr6NonStallTblY  # UB:Derived from original system description
    connect CalRegn01IninOptSetA02.DutyCycThermProtnMplr6StallTblY -> AAACalRegn01IninOptSetA02_Dummy.DutyCycThermProtnMplr6StallTblY  # UB:Derived from original system description
    connect CalRegn01IninOptSetA02.DutyCycThermProtnMplrFetMtgtnTblX -> AAACalRegn01IninOptSetA02_Dummy.DutyCycThermProtnMplrFetMtgtnTblX  # UB:Derived from original system description
    connect CalRegn01IninOptSetA02.DutyCycThermProtnMplrTblX -> AAACalRegn01IninOptSetA02_Dummy.DutyCycThermProtnMplrTblX  # UB:Derived from original system description
    connect CalRegn01IninOptSetA02.DutyCycThermProtnMplrTSeln -> AAACalRegn01IninOptSetA02_Dummy.DutyCycThermProtnMplrTSeln  # UB:Derived from original system description
    connect CalRegn01IninOptSetA02.DutyCycThermProtnSlowFilTSeln -> AAACalRegn01IninOptSetA02_Dummy.DutyCycThermProtnSlowFilTSeln  # UB:Derived from original system description
    connect CalRegn01IninOptSetA02.DutyCycThermProtnThermLimScaFac -> AAACalRegn01IninOptSetA02_Dummy.DutyCycThermProtnThermLimScaFac  # UB:Derived from original system description
    connect CalRegn01IninOptSetA02.DutyCycThermProtnThermLoadLimTblX -> AAACalRegn01IninOptSetA02_Dummy.DutyCycThermProtnThermLoadLimTblX  # UB:Derived from original system description
    connect CalRegn01IninOptSetA02.DutyCycThermProtnThermLoadLimTblY -> AAACalRegn01IninOptSetA02_Dummy.DutyCycThermProtnThermLoadLimTblY  # UB:Derived from original system description
    connect CalRegn01IninOptSetA02.DutyCycThermProtnTqCmdSlewDwn -> AAACalRegn01IninOptSetA02_Dummy.DutyCycThermProtnTqCmdSlewDwn  # UB:Derived from original system description
    connect CalRegn01IninOptSetA02.DutyCycThermProtnTqCmdSlewUp -> AAACalRegn01IninOptSetA02_Dummy.DutyCycThermProtnTqCmdSlewUp  # UB:Derived from original system description
    connect CalRegn01IninOptSetA02.HiLoadStallLimrMotVelMgnThd -> AAACalRegn01IninOptSetA02_Dummy.HiLoadStallLimrMotVelMgnThd  # UB:Derived from original system description
    connect CalRegn01IninOptSetA02.HiLoadStallLimrStallMotTqCmdFetMtgtnLimX -> AAACalRegn01IninOptSetA02_Dummy.HiLoadStallLimrStallMotTqCmdFetMtgtnLimX  # UB:Derived from original system description
    connect CalRegn01IninOptSetA02.HiLoadStallLimrStallMotTqCmdFetMtgtnLimY -> AAACalRegn01IninOptSetA02_Dummy.HiLoadStallLimrStallMotTqCmdFetMtgtnLimY  # UB:Derived from original system description
    connect CalRegn01IninOptSetA02.HiLoadStallLimrStallMotTqCmdLimX -> AAACalRegn01IninOptSetA02_Dummy.HiLoadStallLimrStallMotTqCmdLimX  # UB:Derived from original system description
    connect CalRegn01IninOptSetA02.HiLoadStallLimrStallMotTqCmdLimY -> AAACalRegn01IninOptSetA02_Dummy.HiLoadStallLimrStallMotTqCmdLimY  # UB:Derived from original system description
    connect CalRegn01IninOptSetA02.HiLoadStallLimrStallMotTqLimSlewRate -> AAACalRegn01IninOptSetA02_Dummy.HiLoadStallLimrStallMotTqLimSlewRate  # UB:Derived from original system description
    connect CalRegn01IninOptSetA02.HiLoadStallLimrStallThermLimSca -> AAACalRegn01IninOptSetA02_Dummy.HiLoadStallLimrStallThermLimSca  # UB:Derived from original system description
    connect CalRegn01IninOptSetA02.LrndRackCentrMotTqThd -> AAACalRegn01IninOptSetA02_Dummy.LrndRackCentrMotTqThd  # UB:Derived from original system description
    connect CalRegn01IninOptSetA02.LrndRackCentrMotVelThd -> AAACalRegn01IninOptSetA02_Dummy.LrndRackCentrMotVelThd  # UB:Derived from original system description
    connect CalRegn01IninOptSetA02.MotCtrlPrmEstimnFetRNom -> AAACalRegn01IninOptSetA02_Dummy.MotCtrlPrmEstimnFetRNom  # UB:Derived from original system description
    connect CalRegn01IninOptSetA02.MotCtrlPrmEstimnMotBackEmfConHiLim -> AAACalRegn01IninOptSetA02_Dummy.MotCtrlPrmEstimnMotBackEmfConHiLim  # UB:Derived from original system description
    connect CalRegn01IninOptSetA02.MotCtrlPrmEstimnMotBackEmfConLoLim -> AAACalRegn01IninOptSetA02_Dummy.MotCtrlPrmEstimnMotBackEmfConLoLim  # UB:Derived from original system description
    connect CalRegn01IninOptSetA02.MotCtrlPrmEstimnMotBackEmfConNom -> AAACalRegn01IninOptSetA02_Dummy.MotCtrlPrmEstimnMotBackEmfConNom  # UB:Derived from original system description
    connect CalRegn01IninOptSetA02.MotCtrlPrmEstimnMotBackEmfConSatnScaIvtrLoaMtgtn -> AAACalRegn01IninOptSetA02_Dummy.MotCtrlPrmEstimnMotBackEmfConSatnScaIvtrLoaMtgtn  # UB:Derived from original system description
    connect CalRegn01IninOptSetA02.MotCtrlPrmEstimnMotBackEmfConSatnX -> AAACalRegn01IninOptSetA02_Dummy.MotCtrlPrmEstimnMotBackEmfConSatnX  # UB:Derived from original system description
    connect CalRegn01IninOptSetA02.MotCtrlPrmEstimnMotBackEmfConSatnY -> AAACalRegn01IninOptSetA02_Dummy.MotCtrlPrmEstimnMotBackEmfConSatnY  # UB:Derived from original system description
    connect CalRegn01IninOptSetA02.MotCtrlPrmEstimnMotCurrDaxInduSatnBilnrSeln -> AAACalRegn01IninOptSetA02_Dummy.MotCtrlPrmEstimnMotCurrDaxInduSatnBilnrSeln  # UB:Derived from original system description
    connect CalRegn01IninOptSetA02.MotCtrlPrmEstimnMotCurrQaxInduSatnX -> AAACalRegn01IninOptSetA02_Dummy.MotCtrlPrmEstimnMotCurrQaxInduSatnX  # UB:Derived from original system description
    connect CalRegn01IninOptSetA02.MotCtrlPrmEstimnMotInduDaxHiLim -> AAACalRegn01IninOptSetA02_Dummy.MotCtrlPrmEstimnMotInduDaxHiLim  # UB:Derived from original system description
    connect CalRegn01IninOptSetA02.MotCtrlPrmEstimnMotInduDaxIvtrLoaMtgtn -> AAACalRegn01IninOptSetA02_Dummy.MotCtrlPrmEstimnMotInduDaxIvtrLoaMtgtn  # UB:Derived from original system description
    connect CalRegn01IninOptSetA02.MotCtrlPrmEstimnMotInduDaxLoLim -> AAACalRegn01IninOptSetA02_Dummy.MotCtrlPrmEstimnMotInduDaxLoLim  # UB:Derived from original system description
    connect CalRegn01IninOptSetA02.MotCtrlPrmEstimnMotInduDaxNom -> AAACalRegn01IninOptSetA02_Dummy.MotCtrlPrmEstimnMotInduDaxNom  # UB:Derived from original system description
    connect CalRegn01IninOptSetA02.MotCtrlPrmEstimnMotInduDaxSatnScaY -> AAACalRegn01IninOptSetA02_Dummy.MotCtrlPrmEstimnMotInduDaxSatnScaY  # UB:Derived from original system description
    connect CalRegn01IninOptSetA02.MotCtrlPrmEstimnMotInduQaxHiLim -> AAACalRegn01IninOptSetA02_Dummy.MotCtrlPrmEstimnMotInduQaxHiLim  # UB:Derived from original system description
    connect CalRegn01IninOptSetA02.MotCtrlPrmEstimnMotInduQaxIvtrLoaMtgtn -> AAACalRegn01IninOptSetA02_Dummy.MotCtrlPrmEstimnMotInduQaxIvtrLoaMtgtn  # UB:Derived from original system description
    connect CalRegn01IninOptSetA02.MotCtrlPrmEstimnMotInduQaxLoLim -> AAACalRegn01IninOptSetA02_Dummy.MotCtrlPrmEstimnMotInduQaxLoLim  # UB:Derived from original system description
    connect CalRegn01IninOptSetA02.MotCtrlPrmEstimnMotInduQaxNom -> AAACalRegn01IninOptSetA02_Dummy.MotCtrlPrmEstimnMotInduQaxNom  # UB:Derived from original system description
    connect CalRegn01IninOptSetA02.MotCtrlPrmEstimnMotInduQaxSatnScaY -> AAACalRegn01IninOptSetA02_Dummy.MotCtrlPrmEstimnMotInduQaxSatnScaY  # UB:Derived from original system description
    connect CalRegn01IninOptSetA02.MotCtrlPrmEstimnMotRHiLim -> AAACalRegn01IninOptSetA02_Dummy.MotCtrlPrmEstimnMotRHiLim  # UB:Derived from original system description
    connect CalRegn01IninOptSetA02.MotCtrlPrmEstimnMotRLoLim -> AAACalRegn01IninOptSetA02_Dummy.MotCtrlPrmEstimnMotRLoLim  # UB:Derived from original system description
    connect CalRegn01IninOptSetA02.MotCtrlPrmEstimnMotRNom -> AAACalRegn01IninOptSetA02_Dummy.MotCtrlPrmEstimnMotRNom  # UB:Derived from original system description
    connect CalRegn01IninOptSetA02.MotCtrlPrmEstimnMotWidgThermCoeff -> AAACalRegn01IninOptSetA02_Dummy.MotCtrlPrmEstimnMotWidgThermCoeff  # UB:Derived from original system description
    connect CalRegn01IninOptSetA02.MotCtrlPrmEstimnTNom -> AAACalRegn01IninOptSetA02_Dummy.MotCtrlPrmEstimnTNom  # UB:Derived from original system description
    connect CalRegn01IninOptSetA02.MotCurrPeakEstimnCurrFilFrq -> AAACalRegn01IninOptSetA02_Dummy.MotCurrPeakEstimnCurrFilFrq  # UB:Derived from original system description
    connect CalRegn01IninOptSetA02.MotCurrPeakEstimnCurrPeakEstimdFilFrq -> AAACalRegn01IninOptSetA02_Dummy.MotCurrPeakEstimnCurrPeakEstimdFilFrq  # UB:Derived from original system description
    connect CalRegn01IninOptSetA02.MotCurrRegCfgMotClsdLoopBwDaxY -> AAACalRegn01IninOptSetA02_Dummy.MotCurrRegCfgMotClsdLoopBwDaxY  # UB:Derived from original system description
    connect CalRegn01IninOptSetA02.MotCurrRegCfgMotClsdLoopBwQaxY -> AAACalRegn01IninOptSetA02_Dummy.MotCurrRegCfgMotClsdLoopBwQaxY  # UB:Derived from original system description
    connect CalRegn01IninOptSetA02.MotCurrRegCfgMotDampgRatDax -> AAACalRegn01IninOptSetA02_Dummy.MotCurrRegCfgMotDampgRatDax  # UB:Derived from original system description
    connect CalRegn01IninOptSetA02.MotCurrRegCfgMotDampgRatQax -> AAACalRegn01IninOptSetA02_Dummy.MotCurrRegCfgMotDampgRatQax  # UB:Derived from original system description
    connect CalRegn01IninOptSetA02.MotCurrRegCfgMotNatFrqDaxY -> AAACalRegn01IninOptSetA02_Dummy.MotCurrRegCfgMotNatFrqDaxY  # UB:Derived from original system description
    connect CalRegn01IninOptSetA02.MotCurrRegCfgMotNatFrqQaxY -> AAACalRegn01IninOptSetA02_Dummy.MotCurrRegCfgMotNatFrqQaxY  # UB:Derived from original system description
    connect CalRegn01IninOptSetA02.MotCurrRegCfgMotRVirtDax -> AAACalRegn01IninOptSetA02_Dummy.MotCurrRegCfgMotRVirtDax  # UB:Derived from original system description
    connect CalRegn01IninOptSetA02.MotCurrRegCfgMotRVirtQax -> AAACalRegn01IninOptSetA02_Dummy.MotCurrRegCfgMotRVirtQax  # UB:Derived from original system description
    connect CalRegn01IninOptSetA02.MotCurrRegCfgMotVelFilFrq -> AAACalRegn01IninOptSetA02_Dummy.MotCurrRegCfgMotVelFilFrq  # UB:Derived from original system description
    connect CalRegn01IninOptSetA02.MotCurrRegVltgLimrCurrLoaScarSlewRate -> AAACalRegn01IninOptSetA02_Dummy.MotCurrRegVltgLimrCurrLoaScarSlewRate  # UB:Derived from original system description
    connect CalRegn01IninOptSetA02.MotCurrRegVltgLimrDaxAntiWdupCoeff -> AAACalRegn01IninOptSetA02_Dummy.MotCurrRegVltgLimrDaxAntiWdupCoeff  # UB:Derived from original system description
    connect CalRegn01IninOptSetA02.MotCurrRegVltgLimrDualEcuLoaScarSlewRate -> AAACalRegn01IninOptSetA02_Dummy.MotCurrRegVltgLimrDualEcuLoaScarSlewRate  # UB:Derived from original system description
    connect CalRegn01IninOptSetA02.MotCurrRegVltgLimrFETLoaScarSlewRate -> AAACalRegn01IninOptSetA02_Dummy.MotCurrRegVltgLimrFETLoaScarSlewRate  # UB:Derived from original system description
    connect CalRegn01IninOptSetA02.MotCurrRegVltgLimrIvtrLoaScarSlewRate -> AAACalRegn01IninOptSetA02_Dummy.MotCurrRegVltgLimrIvtrLoaScarSlewRate  # UB:Derived from original system description
    connect CalRegn01IninOptSetA02.MotCurrRegVltgLimrMotVltgBrdgLpFilFrq -> AAACalRegn01IninOptSetA02_Dummy.MotCurrRegVltgLimrMotVltgBrdgLpFilFrq  # UB:Derived from original system description
    connect CalRegn01IninOptSetA02.MotCurrRegVltgLimrMotVltgDaxIntglHiLim -> AAACalRegn01IninOptSetA02_Dummy.MotCurrRegVltgLimrMotVltgDaxIntglHiLim  # UB:Derived from original system description
    connect CalRegn01IninOptSetA02.MotCurrRegVltgLimrMotVltgDaxIntglLoLim -> AAACalRegn01IninOptSetA02_Dummy.MotCurrRegVltgLimrMotVltgDaxIntglLoLim  # UB:Derived from original system description
    connect CalRegn01IninOptSetA02.MotCurrRegVltgLimrMotVltgQaxFfLpFilFrq -> AAACalRegn01IninOptSetA02_Dummy.MotCurrRegVltgLimrMotVltgQaxFfLpFilFrq  # UB:Derived from original system description
    connect CalRegn01IninOptSetA02.MotCurrRegVltgLimrMotVltgQaxIntglHiLim -> AAACalRegn01IninOptSetA02_Dummy.MotCurrRegVltgLimrMotVltgQaxIntglHiLim  # UB:Derived from original system description
    connect CalRegn01IninOptSetA02.MotCurrRegVltgLimrMotVltgQaxIntglLoLim -> AAACalRegn01IninOptSetA02_Dummy.MotCurrRegVltgLimrMotVltgQaxIntglLoLim  # UB:Derived from original system description
    connect CalRegn01IninOptSetA02.MotCurrRegVltgLimrQaxAntiWdupCoeff -> AAACalRegn01IninOptSetA02_Dummy.MotCurrRegVltgLimrQaxAntiWdupCoeff  # UB:Derived from original system description
    connect CalRegn01IninOptSetA02.MotCurrRegVltgLimrQaxAntiWdupScagDi -> AAACalRegn01IninOptSetA02_Dummy.MotCurrRegVltgLimrQaxAntiWdupScagDi  # UB:Derived from original system description
    connect CalRegn01IninOptSetA02.MotRefMdlCurrDaxBoostGain -> AAACalRegn01IninOptSetA02_Dummy.MotRefMdlCurrDaxBoostGain  # UB:Derived from original system description
    connect CalRegn01IninOptSetA02.MotRefMdlCurrDaxBoostTqScaX -> AAACalRegn01IninOptSetA02_Dummy.MotRefMdlCurrDaxBoostTqScaX  # UB:Derived from original system description
    connect CalRegn01IninOptSetA02.MotRefMdlCurrDaxBoostTqScaY -> AAACalRegn01IninOptSetA02_Dummy.MotRefMdlCurrDaxBoostTqScaY  # UB:Derived from original system description
    connect CalRegn01IninOptSetA02.MotRefMdlCurrDaxQaxRefDelta -> AAACalRegn01IninOptSetA02_Dummy.MotRefMdlCurrDaxQaxRefDelta  # UB:Derived from original system description
    connect CalRegn01IninOptSetA02.MotRefMdlCurrItrnTolr -> AAACalRegn01IninOptSetA02_Dummy.MotRefMdlCurrItrnTolr  # UB:Derived from original system description
    connect CalRegn01IninOptSetA02.MotRefMdlMotCurrDaxMaxSca -> AAACalRegn01IninOptSetA02_Dummy.MotRefMdlMotCurrDaxMaxSca  # UB:Derived from original system description
    connect CalRegn01IninOptSetA02.MotRefMdlQuad13VltgSdlX -> AAACalRegn01IninOptSetA02_Dummy.MotRefMdlQuad13VltgSdlX  # UB:Derived from original system description
    connect CalRegn01IninOptSetA02.MotRefMdlQuad13VltgSdlY -> AAACalRegn01IninOptSetA02_Dummy.MotRefMdlQuad13VltgSdlY  # UB:Derived from original system description
    connect CalRegn01IninOptSetA02.MotRefMdlQuad24VltgSdlX -> AAACalRegn01IninOptSetA02_Dummy.MotRefMdlQuad24VltgSdlX  # UB:Derived from original system description
    connect CalRegn01IninOptSetA02.MotRefMdlQuad24VltgSdlY -> AAACalRegn01IninOptSetA02_Dummy.MotRefMdlQuad24VltgSdlY  # UB:Derived from original system description
    connect CalRegn01IninOptSetA02.MotRefMdlVltgOverRThdSca -> AAACalRegn01IninOptSetA02_Dummy.MotRefMdlVltgOverRThdSca  # UB:Derived from original system description
    connect CalRegn01IninOptSetA02.MotTqTranlDampgCmdLim -> AAACalRegn01IninOptSetA02_Dummy.MotTqTranlDampgCmdLim  # UB:Derived from original system description
    connect CalRegn01IninOptSetA02.MotTqTranlDampgVelThd -> AAACalRegn01IninOptSetA02_Dummy.MotTqTranlDampgVelThd  # UB:Derived from original system description
    connect CalRegn01IninOptSetA02.PwrLimrAssiRednLpFilFrq -> AAACalRegn01IninOptSetA02_Dummy.PwrLimrAssiRednLpFilFrq  # UB:Derived from original system description
    connect CalRegn01IninOptSetA02.PwrLimrBackEmfConStdT -> AAACalRegn01IninOptSetA02_Dummy.PwrLimrBackEmfConStdT  # UB:Derived from original system description
    connect CalRegn01IninOptSetA02.PwrLimrBrdgVltgAdjSlew -> AAACalRegn01IninOptSetA02_Dummy.PwrLimrBrdgVltgAdjSlew  # UB:Derived from original system description
    connect CalRegn01IninOptSetA02.PwrLimrBrdgVltgAltFltAdj -> AAACalRegn01IninOptSetA02_Dummy.PwrLimrBrdgVltgAltFltAdj  # UB:Derived from original system description
    connect CalRegn01IninOptSetA02.PwrLimrFilAssiRednThd -> AAACalRegn01IninOptSetA02_Dummy.PwrLimrFilAssiRednThd  # UB:Derived from original system description
    connect CalRegn01IninOptSetA02.PwrLimrLoVoltAssiRcvrThd -> AAACalRegn01IninOptSetA02_Dummy.PwrLimrLoVoltAssiRcvrThd  # UB:Derived from original system description
    connect CalRegn01IninOptSetA02.PwrLimrLoVoltAssiRcvrTi -> AAACalRegn01IninOptSetA02_Dummy.PwrLimrLoVoltAssiRcvrTi  # UB:Derived from original system description
    connect CalRegn01IninOptSetA02.PwrLimrMotEnvlpX -> AAACalRegn01IninOptSetA02_Dummy.PwrLimrMotEnvlpX  # UB:Derived from original system description
    connect CalRegn01IninOptSetA02.PwrLimrMotEnvlpY -> AAACalRegn01IninOptSetA02_Dummy.PwrLimrMotEnvlpY  # UB:Derived from original system description
    connect CalRegn01IninOptSetA02.PwrLimrMotVelLpFilFrq -> AAACalRegn01IninOptSetA02_Dummy.PwrLimrMotVelLpFilFrq  # UB:Derived from original system description
    connect CalRegn01IninOptSetA02.PwrLimrSpdAdjSlewDec -> AAACalRegn01IninOptSetA02_Dummy.PwrLimrSpdAdjSlewDec  # UB:Derived from original system description
    connect CalRegn01IninOptSetA02.PwrLimrSpdAdjSlewEna -> AAACalRegn01IninOptSetA02_Dummy.PwrLimrSpdAdjSlewEna  # UB:Derived from original system description
    connect CalRegn01IninOptSetA02.PwrLimrSpdAdjSlewInc -> AAACalRegn01IninOptSetA02_Dummy.PwrLimrSpdAdjSlewInc  # UB:Derived from original system description
    connect CalRegn01IninOptSetA02.PwrLimrStdOperMotEnvlpX -> AAACalRegn01IninOptSetA02_Dummy.PwrLimrStdOperMotEnvlpX  # UB:Derived from original system description
    connect CalRegn01IninOptSetA02.PwrLimrStdOperMotEnvlpY -> AAACalRegn01IninOptSetA02_Dummy.PwrLimrStdOperMotEnvlpY  # UB:Derived from original system description
    connect CalRegn01IninOptSetA02.PwrLimrVltgDptMotVelOffsX -> AAACalRegn01IninOptSetA02_Dummy.PwrLimrVltgDptMotVelOffsX  # UB:Derived from original system description
    connect CalRegn01IninOptSetA02.PwrLimrVltgDptMotVelOffsY -> AAACalRegn01IninOptSetA02_Dummy.PwrLimrVltgDptMotVelOffsY  # UB:Derived from original system description
    connect CalRegn01IninOptSetA02.SysGlbPrmSysTqRat -> AAACalRegn01IninOptSetA02_Dummy.SysGlbPrmSysTqRat  # UB:Derived from original system description
    connect CalRegn01IninOptSetA02.TEstimnAmbPwrMplr -> AAACalRegn01IninOptSetA02_Dummy.TEstimnAmbPwrMplr  # UB:Derived from original system description
    connect CalRegn01IninOptSetA02.TEstimnAmbTSca -> AAACalRegn01IninOptSetA02_Dummy.TEstimnAmbTSca  # UB:Derived from original system description
    connect CalRegn01IninOptSetA02.TEstimnAssiMechAmbLpFilFrq -> AAACalRegn01IninOptSetA02_Dummy.TEstimnAssiMechAmbLpFilFrq  # UB:Derived from original system description
    connect CalRegn01IninOptSetA02.TEstimnAssiMechAmbLpFilFrqDualEcuFltMtgtn -> AAACalRegn01IninOptSetA02_Dummy.TEstimnAssiMechAmbLpFilFrqDualEcuFltMtgtn  # UB:Derived from original system description
    connect CalRegn01IninOptSetA02.TEstimnAssiMechAmbLpFilFrqFetMtgtnEna -> AAACalRegn01IninOptSetA02_Dummy.TEstimnAssiMechAmbLpFilFrqFetMtgtnEna  # UB:Derived from original system description
    connect CalRegn01IninOptSetA02.TEstimnAssiMechAmbMplr -> AAACalRegn01IninOptSetA02_Dummy.TEstimnAssiMechAmbMplr  # UB:Derived from original system description
    connect CalRegn01IninOptSetA02.TEstimnAssiMechCorrLim -> AAACalRegn01IninOptSetA02_Dummy.TEstimnAssiMechCorrLim  # UB:Derived from original system description
    connect CalRegn01IninOptSetA02.TEstimnAssiMechDampgSca -> AAACalRegn01IninOptSetA02_Dummy.TEstimnAssiMechDampgSca  # UB:Derived from original system description
    connect CalRegn01IninOptSetA02.TEstimnAssiMechDftT -> AAACalRegn01IninOptSetA02_Dummy.TEstimnAssiMechDftT  # UB:Derived from original system description
    connect CalRegn01IninOptSetA02.TEstimnAssiMechLLFilCoeffA1 -> AAACalRegn01IninOptSetA02_Dummy.TEstimnAssiMechLLFilCoeffA1  # UB:Derived from original system description
    connect CalRegn01IninOptSetA02.TEstimnAssiMechLLFilCoeffB0 -> AAACalRegn01IninOptSetA02_Dummy.TEstimnAssiMechLLFilCoeffB0  # UB:Derived from original system description
    connect CalRegn01IninOptSetA02.TEstimnAssiMechLLFilCoeffB1 -> AAACalRegn01IninOptSetA02_Dummy.TEstimnAssiMechLLFilCoeffB1  # UB:Derived from original system description
    connect CalRegn01IninOptSetA02.TEstimnAssiMechSlew -> AAACalRegn01IninOptSetA02_Dummy.TEstimnAssiMechSlew  # UB:Derived from original system description
    connect CalRegn01IninOptSetA02.TEstimnCorrnTAssiMech -> AAACalRegn01IninOptSetA02_Dummy.TEstimnCorrnTAssiMech  # UB:Derived from original system description
    connect CalRegn01IninOptSetA02.TEstimnCorrnTCu -> AAACalRegn01IninOptSetA02_Dummy.TEstimnCorrnTCu  # UB:Derived from original system description
    connect CalRegn01IninOptSetA02.TEstimnCorrnTMag -> AAACalRegn01IninOptSetA02_Dummy.TEstimnCorrnTMag  # UB:Derived from original system description
    connect CalRegn01IninOptSetA02.TEstimnCorrnTSi -> AAACalRegn01IninOptSetA02_Dummy.TEstimnCorrnTSi  # UB:Derived from original system description
    connect CalRegn01IninOptSetA02.TEstimnCuAmbLpFilFrq -> AAACalRegn01IninOptSetA02_Dummy.TEstimnCuAmbLpFilFrq  # UB:Derived from original system description
    connect CalRegn01IninOptSetA02.TEstimnCuAmbLpFilFrqDualEcuFltMtgtn -> AAACalRegn01IninOptSetA02_Dummy.TEstimnCuAmbLpFilFrqDualEcuFltMtgtn  # UB:Derived from original system description
    connect CalRegn01IninOptSetA02.TEstimnCuAmbLpFilFrqFetMtgtnEna -> AAACalRegn01IninOptSetA02_Dummy.TEstimnCuAmbLpFilFrqFetMtgtnEna  # UB:Derived from original system description
    connect CalRegn01IninOptSetA02.TEstimnCuAmbMplr -> AAACalRegn01IninOptSetA02_Dummy.TEstimnCuAmbMplr  # UB:Derived from original system description
    connect CalRegn01IninOptSetA02.TEstimnCuCorrnLim -> AAACalRegn01IninOptSetA02_Dummy.TEstimnCuCorrnLim  # UB:Derived from original system description
    connect CalRegn01IninOptSetA02.TEstimnCuLLFilCoeffA1 -> AAACalRegn01IninOptSetA02_Dummy.TEstimnCuLLFilCoeffA1  # UB:Derived from original system description
    connect CalRegn01IninOptSetA02.TEstimnCuLLFilCoeffB0 -> AAACalRegn01IninOptSetA02_Dummy.TEstimnCuLLFilCoeffB0  # UB:Derived from original system description
    connect CalRegn01IninOptSetA02.TEstimnCuLLFilCoeffB1 -> AAACalRegn01IninOptSetA02_Dummy.TEstimnCuLLFilCoeffB1  # UB:Derived from original system description
    connect CalRegn01IninOptSetA02.TEstimnEngTSca -> AAACalRegn01IninOptSetA02_Dummy.TEstimnEngTSca  # UB:Derived from original system description
    connect CalRegn01IninOptSetA02.TEstimnMagAmbLpFilFrq -> AAACalRegn01IninOptSetA02_Dummy.TEstimnMagAmbLpFilFrq  # UB:Derived from original system description
    connect CalRegn01IninOptSetA02.TEstimnMagAmbLpFilFrqDualEcuFltMtgtn -> AAACalRegn01IninOptSetA02_Dummy.TEstimnMagAmbLpFilFrqDualEcuFltMtgtn  # UB:Derived from original system description
    connect CalRegn01IninOptSetA02.TEstimnMagAmbLpFilFrqFetMtgtnEna -> AAACalRegn01IninOptSetA02_Dummy.TEstimnMagAmbLpFilFrqFetMtgtnEna  # UB:Derived from original system description
    connect CalRegn01IninOptSetA02.TEstimnMagAmbMplr -> AAACalRegn01IninOptSetA02_Dummy.TEstimnMagAmbMplr  # UB:Derived from original system description
    connect CalRegn01IninOptSetA02.TEstimnMagCorrnLim -> AAACalRegn01IninOptSetA02_Dummy.TEstimnMagCorrnLim  # UB:Derived from original system description
    connect CalRegn01IninOptSetA02.TEstimnMagLLFilCoeffA1 -> AAACalRegn01IninOptSetA02_Dummy.TEstimnMagLLFilCoeffA1  # UB:Derived from original system description
    connect CalRegn01IninOptSetA02.TEstimnMagLLFilCoeffB0 -> AAACalRegn01IninOptSetA02_Dummy.TEstimnMagLLFilCoeffB0  # UB:Derived from original system description
    connect CalRegn01IninOptSetA02.TEstimnMagLLFilCoeffB1 -> AAACalRegn01IninOptSetA02_Dummy.TEstimnMagLLFilCoeffB1  # UB:Derived from original system description
    connect CalRegn01IninOptSetA02.TEstimnSiAmbLpFilFrq -> AAACalRegn01IninOptSetA02_Dummy.TEstimnSiAmbLpFilFrq  # UB:Derived from original system description
    connect CalRegn01IninOptSetA02.TEstimnSiAmbLpFilFrqDualEcuFltMtgtn -> AAACalRegn01IninOptSetA02_Dummy.TEstimnSiAmbLpFilFrqDualEcuFltMtgtn  # UB:Derived from original system description
    connect CalRegn01IninOptSetA02.TEstimnSiAmbLpFilFrqFetMtgtnEna -> AAACalRegn01IninOptSetA02_Dummy.TEstimnSiAmbLpFilFrqFetMtgtnEna  # UB:Derived from original system description
    connect CalRegn01IninOptSetA02.TEstimnSiAmbMplr -> AAACalRegn01IninOptSetA02_Dummy.TEstimnSiAmbMplr  # UB:Derived from original system description
    connect CalRegn01IninOptSetA02.TEstimnSiCorrnLim -> AAACalRegn01IninOptSetA02_Dummy.TEstimnSiCorrnLim  # UB:Derived from original system description
    connect CalRegn01IninOptSetA02.TEstimnSiLLFilCoeffA1 -> AAACalRegn01IninOptSetA02_Dummy.TEstimnSiLLFilCoeffA1  # UB:Derived from original system description
    connect CalRegn01IninOptSetA02.TEstimnSiLLFilCoeffB0 -> AAACalRegn01IninOptSetA02_Dummy.TEstimnSiLLFilCoeffB0  # UB:Derived from original system description
    connect CalRegn01IninOptSetA02.TEstimnSiLLFilCoeffB1 -> AAACalRegn01IninOptSetA02_Dummy.TEstimnSiLLFilCoeffB1  # UB:Derived from original system description
    connect CalRegn01IninOptSetA02.TEstimnTauAssiMech -> AAACalRegn01IninOptSetA02_Dummy.TEstimnTauAssiMech  # UB:Derived from original system description
    connect CalRegn01IninOptSetA02.TEstimnTauCu -> AAACalRegn01IninOptSetA02_Dummy.TEstimnTauCu  # UB:Derived from original system description
    connect CalRegn01IninOptSetA02.TEstimnTauMag -> AAACalRegn01IninOptSetA02_Dummy.TEstimnTauMag  # UB:Derived from original system description
    connect CalRegn01IninOptSetA02.TEstimnTauSi -> AAACalRegn01IninOptSetA02_Dummy.TEstimnTauSi  # UB:Derived from original system description
    connect CalRegn01IninOptSetA02.TEstimnWghtAvrgTDi -> AAACalRegn01IninOptSetA02_Dummy.TEstimnWghtAvrgTDi  # UB:Derived from original system description
    connect CalRegn01IninOptSetA02.VehSpdLimrPosMaxOffs2 -> AAACalRegn01IninOptSetA02_Dummy.VehSpdLimrPosMaxOffs2  # UB:Derived from original system description
    connect CalRegn01IninOptSetA03.DutyCycThermProtnAbsltCtrlTFetMtgtnTblX -> AAACalRegn01IninOptSetA03_Dummy.DutyCycThermProtnAbsltCtrlTFetMtgtnTblX  # UB:Derived from original system description
    connect CalRegn01IninOptSetA03.DutyCycThermProtnAbsltCtrlTTblX -> AAACalRegn01IninOptSetA03_Dummy.DutyCycThermProtnAbsltCtrlTTblX  # UB:Derived from original system description
    connect CalRegn01IninOptSetA03.DutyCycThermProtnAbsltCtrlTTqFetMtgtnTblY -> AAACalRegn01IninOptSetA03_Dummy.DutyCycThermProtnAbsltCtrlTTqFetMtgtnTblY  # UB:Derived from original system description
    connect CalRegn01IninOptSetA03.DutyCycThermProtnAbsltCtrlTTqTblY -> AAACalRegn01IninOptSetA03_Dummy.DutyCycThermProtnAbsltCtrlTTqTblY  # UB:Derived from original system description
    connect CalRegn01IninOptSetA03.DutyCycThermProtnAbsltCuTFetMtgtnTblX -> AAACalRegn01IninOptSetA03_Dummy.DutyCycThermProtnAbsltCuTFetMtgtnTblX  # UB:Derived from original system description
    connect CalRegn01IninOptSetA03.DutyCycThermProtnAbsltCuTTblX -> AAACalRegn01IninOptSetA03_Dummy.DutyCycThermProtnAbsltCuTTblX  # UB:Derived from original system description
    connect CalRegn01IninOptSetA03.DutyCycThermProtnAbsltCuTTqFetMtgtnTblY -> AAACalRegn01IninOptSetA03_Dummy.DutyCycThermProtnAbsltCuTTqFetMtgtnTblY  # UB:Derived from original system description
    connect CalRegn01IninOptSetA03.DutyCycThermProtnAbsltCuTTqTblY -> AAACalRegn01IninOptSetA03_Dummy.DutyCycThermProtnAbsltCuTTqTblY  # UB:Derived from original system description
    connect CalRegn01IninOptSetA03.DutyCycThermProtnAbsltMotVelBreakPt -> AAACalRegn01IninOptSetA03_Dummy.DutyCycThermProtnAbsltMotVelBreakPt  # UB:Derived from original system description
    connect CalRegn01IninOptSetA03.DutyCycThermProtnAbsltTTqSlewHiLim -> AAACalRegn01IninOptSetA03_Dummy.DutyCycThermProtnAbsltTTqSlewHiLim  # UB:Derived from original system description
    connect CalRegn01IninOptSetA03.DutyCycThermProtnAbsltTTqSlewLoLim -> AAACalRegn01IninOptSetA03_Dummy.DutyCycThermProtnAbsltTTqSlewLoLim  # UB:Derived from original system description
    connect CalRegn01IninOptSetA03.DutyCycThermProtnCtrlT -> AAACalRegn01IninOptSetA03_Dummy.DutyCycThermProtnCtrlT  # UB:Derived from original system description
    connect CalRegn01IninOptSetA03.DutyCycThermProtnCtrlTSeln -> AAACalRegn01IninOptSetA03_Dummy.DutyCycThermProtnCtrlTSeln  # UB:Derived from original system description
    connect CalRegn01IninOptSetA03.DutyCycThermProtnDutyCycFildThd -> AAACalRegn01IninOptSetA03_Dummy.DutyCycThermProtnDutyCycFildThd  # UB:Derived from original system description
    connect CalRegn01IninOptSetA03.DutyCycThermProtnIgnOffCtrlEna -> AAACalRegn01IninOptSetA03_Dummy.DutyCycThermProtnIgnOffCtrlEna  # UB:Derived from original system description
    connect CalRegn01IninOptSetA03.DutyCycThermProtnIgnOffMsgWaitTi -> AAACalRegn01IninOptSetA03_Dummy.DutyCycThermProtnIgnOffMsgWaitTi  # UB:Derived from original system description
    connect CalRegn01IninOptSetA03.DutyCycThermProtnLstTblValNonStall -> AAACalRegn01IninOptSetA03_Dummy.DutyCycThermProtnLstTblValNonStall  # UB:Derived from original system description
    connect CalRegn01IninOptSetA03.DutyCycThermProtnLstTblValStall -> AAACalRegn01IninOptSetA03_Dummy.DutyCycThermProtnLstTblValStall  # UB:Derived from original system description
    connect CalRegn01IninOptSetA03.DutyCycThermProtnMotPrTSeln -> AAACalRegn01IninOptSetA03_Dummy.DutyCycThermProtnMotPrTSeln  # UB:Derived from original system description
    connect CalRegn01IninOptSetA03.DutyCycThermProtnMplr1FetMtgtnNonStallTblY -> AAACalRegn01IninOptSetA03_Dummy.DutyCycThermProtnMplr1FetMtgtnNonStallTblY  # UB:Derived from original system description
    connect CalRegn01IninOptSetA03.DutyCycThermProtnMplr1FetMtgtnStallTblY -> AAACalRegn01IninOptSetA03_Dummy.DutyCycThermProtnMplr1FetMtgtnStallTblY  # UB:Derived from original system description
    connect CalRegn01IninOptSetA03.DutyCycThermProtnMplr1NonStallTblY -> AAACalRegn01IninOptSetA03_Dummy.DutyCycThermProtnMplr1NonStallTblY  # UB:Derived from original system description
    connect CalRegn01IninOptSetA03.DutyCycThermProtnMplr1StallTblY -> AAACalRegn01IninOptSetA03_Dummy.DutyCycThermProtnMplr1StallTblY  # UB:Derived from original system description
    connect CalRegn01IninOptSetA03.DutyCycThermProtnMplr2FetMtgtnNonStallTblY -> AAACalRegn01IninOptSetA03_Dummy.DutyCycThermProtnMplr2FetMtgtnNonStallTblY  # UB:Derived from original system description
    connect CalRegn01IninOptSetA03.DutyCycThermProtnMplr2FetMtgtnStallTblY -> AAACalRegn01IninOptSetA03_Dummy.DutyCycThermProtnMplr2FetMtgtnStallTblY  # UB:Derived from original system description
    connect CalRegn01IninOptSetA03.DutyCycThermProtnMplr2NonStallTblY -> AAACalRegn01IninOptSetA03_Dummy.DutyCycThermProtnMplr2NonStallTblY  # UB:Derived from original system description
    connect CalRegn01IninOptSetA03.DutyCycThermProtnMplr2StallTblY -> AAACalRegn01IninOptSetA03_Dummy.DutyCycThermProtnMplr2StallTblY  # UB:Derived from original system description
    connect CalRegn01IninOptSetA03.DutyCycThermProtnMplr3FetMtgtnNonStallTblY -> AAACalRegn01IninOptSetA03_Dummy.DutyCycThermProtnMplr3FetMtgtnNonStallTblY  # UB:Derived from original system description
    connect CalRegn01IninOptSetA03.DutyCycThermProtnMplr3FetMtgtnStallTblY -> AAACalRegn01IninOptSetA03_Dummy.DutyCycThermProtnMplr3FetMtgtnStallTblY  # UB:Derived from original system description
    connect CalRegn01IninOptSetA03.DutyCycThermProtnMplr3NonStallTblY -> AAACalRegn01IninOptSetA03_Dummy.DutyCycThermProtnMplr3NonStallTblY  # UB:Derived from original system description
    connect CalRegn01IninOptSetA03.DutyCycThermProtnMplr3StallTblY -> AAACalRegn01IninOptSetA03_Dummy.DutyCycThermProtnMplr3StallTblY  # UB:Derived from original system description
    connect CalRegn01IninOptSetA03.DutyCycThermProtnMplr4FetMtgtnNonStallTblY -> AAACalRegn01IninOptSetA03_Dummy.DutyCycThermProtnMplr4FetMtgtnNonStallTblY  # UB:Derived from original system description
    connect CalRegn01IninOptSetA03.DutyCycThermProtnMplr4FetMtgtnStallTblY -> AAACalRegn01IninOptSetA03_Dummy.DutyCycThermProtnMplr4FetMtgtnStallTblY  # UB:Derived from original system description
    connect CalRegn01IninOptSetA03.DutyCycThermProtnMplr4NonStallTblY -> AAACalRegn01IninOptSetA03_Dummy.DutyCycThermProtnMplr4NonStallTblY  # UB:Derived from original system description
    connect CalRegn01IninOptSetA03.DutyCycThermProtnMplr4StallTblY -> AAACalRegn01IninOptSetA03_Dummy.DutyCycThermProtnMplr4StallTblY  # UB:Derived from original system description
    connect CalRegn01IninOptSetA03.DutyCycThermProtnMplr5FetMtgtnNonStallTblY -> AAACalRegn01IninOptSetA03_Dummy.DutyCycThermProtnMplr5FetMtgtnNonStallTblY  # UB:Derived from original system description
    connect CalRegn01IninOptSetA03.DutyCycThermProtnMplr5FetMtgtnStallTblY -> AAACalRegn01IninOptSetA03_Dummy.DutyCycThermProtnMplr5FetMtgtnStallTblY  # UB:Derived from original system description
    connect CalRegn01IninOptSetA03.DutyCycThermProtnMplr5NonStallTblY -> AAACalRegn01IninOptSetA03_Dummy.DutyCycThermProtnMplr5NonStallTblY  # UB:Derived from original system description
    connect CalRegn01IninOptSetA03.DutyCycThermProtnMplr5StallTblY -> AAACalRegn01IninOptSetA03_Dummy.DutyCycThermProtnMplr5StallTblY  # UB:Derived from original system description
    connect CalRegn01IninOptSetA03.DutyCycThermProtnMplr6FetMtgtnNonStallTblY -> AAACalRegn01IninOptSetA03_Dummy.DutyCycThermProtnMplr6FetMtgtnNonStallTblY  # UB:Derived from original system description
    connect CalRegn01IninOptSetA03.DutyCycThermProtnMplr6FetMtgtnStallTblY -> AAACalRegn01IninOptSetA03_Dummy.DutyCycThermProtnMplr6FetMtgtnStallTblY  # UB:Derived from original system description
    connect CalRegn01IninOptSetA03.DutyCycThermProtnMplr6NonStallTblY -> AAACalRegn01IninOptSetA03_Dummy.DutyCycThermProtnMplr6NonStallTblY  # UB:Derived from original system description
    connect CalRegn01IninOptSetA03.DutyCycThermProtnMplr6StallTblY -> AAACalRegn01IninOptSetA03_Dummy.DutyCycThermProtnMplr6StallTblY  # UB:Derived from original system description
    connect CalRegn01IninOptSetA03.DutyCycThermProtnMplrFetMtgtnTblX -> AAACalRegn01IninOptSetA03_Dummy.DutyCycThermProtnMplrFetMtgtnTblX  # UB:Derived from original system description
    connect CalRegn01IninOptSetA03.DutyCycThermProtnMplrTblX -> AAACalRegn01IninOptSetA03_Dummy.DutyCycThermProtnMplrTblX  # UB:Derived from original system description
    connect CalRegn01IninOptSetA03.DutyCycThermProtnMplrTSeln -> AAACalRegn01IninOptSetA03_Dummy.DutyCycThermProtnMplrTSeln  # UB:Derived from original system description
    connect CalRegn01IninOptSetA03.DutyCycThermProtnSlowFilTSeln -> AAACalRegn01IninOptSetA03_Dummy.DutyCycThermProtnSlowFilTSeln  # UB:Derived from original system description
    connect CalRegn01IninOptSetA03.DutyCycThermProtnThermLimScaFac -> AAACalRegn01IninOptSetA03_Dummy.DutyCycThermProtnThermLimScaFac  # UB:Derived from original system description
    connect CalRegn01IninOptSetA03.DutyCycThermProtnThermLoadLimTblX -> AAACalRegn01IninOptSetA03_Dummy.DutyCycThermProtnThermLoadLimTblX  # UB:Derived from original system description
    connect CalRegn01IninOptSetA03.DutyCycThermProtnThermLoadLimTblY -> AAACalRegn01IninOptSetA03_Dummy.DutyCycThermProtnThermLoadLimTblY  # UB:Derived from original system description
    connect CalRegn01IninOptSetA03.DutyCycThermProtnTqCmdSlewDwn -> AAACalRegn01IninOptSetA03_Dummy.DutyCycThermProtnTqCmdSlewDwn  # UB:Derived from original system description
    connect CalRegn01IninOptSetA03.DutyCycThermProtnTqCmdSlewUp -> AAACalRegn01IninOptSetA03_Dummy.DutyCycThermProtnTqCmdSlewUp  # UB:Derived from original system description
    connect CalRegn01IninOptSetA03.HiLoadStallLimrMotVelMgnThd -> AAACalRegn01IninOptSetA03_Dummy.HiLoadStallLimrMotVelMgnThd  # UB:Derived from original system description
    connect CalRegn01IninOptSetA03.HiLoadStallLimrStallMotTqCmdFetMtgtnLimX -> AAACalRegn01IninOptSetA03_Dummy.HiLoadStallLimrStallMotTqCmdFetMtgtnLimX  # UB:Derived from original system description
    connect CalRegn01IninOptSetA03.HiLoadStallLimrStallMotTqCmdFetMtgtnLimY -> AAACalRegn01IninOptSetA03_Dummy.HiLoadStallLimrStallMotTqCmdFetMtgtnLimY  # UB:Derived from original system description
    connect CalRegn01IninOptSetA03.HiLoadStallLimrStallMotTqCmdLimX -> AAACalRegn01IninOptSetA03_Dummy.HiLoadStallLimrStallMotTqCmdLimX  # UB:Derived from original system description
    connect CalRegn01IninOptSetA03.HiLoadStallLimrStallMotTqCmdLimY -> AAACalRegn01IninOptSetA03_Dummy.HiLoadStallLimrStallMotTqCmdLimY  # UB:Derived from original system description
    connect CalRegn01IninOptSetA03.HiLoadStallLimrStallMotTqLimSlewRate -> AAACalRegn01IninOptSetA03_Dummy.HiLoadStallLimrStallMotTqLimSlewRate  # UB:Derived from original system description
    connect CalRegn01IninOptSetA03.HiLoadStallLimrStallThermLimSca -> AAACalRegn01IninOptSetA03_Dummy.HiLoadStallLimrStallThermLimSca  # UB:Derived from original system description
    connect CalRegn01IninOptSetA03.LrndRackCentrMotTqThd -> AAACalRegn01IninOptSetA03_Dummy.LrndRackCentrMotTqThd  # UB:Derived from original system description
    connect CalRegn01IninOptSetA03.LrndRackCentrMotVelThd -> AAACalRegn01IninOptSetA03_Dummy.LrndRackCentrMotVelThd  # UB:Derived from original system description
    connect CalRegn01IninOptSetA03.MotCtrlPrmEstimnFetRNom -> AAACalRegn01IninOptSetA03_Dummy.MotCtrlPrmEstimnFetRNom  # UB:Derived from original system description
    connect CalRegn01IninOptSetA03.MotCtrlPrmEstimnMotBackEmfConHiLim -> AAACalRegn01IninOptSetA03_Dummy.MotCtrlPrmEstimnMotBackEmfConHiLim  # UB:Derived from original system description
    connect CalRegn01IninOptSetA03.MotCtrlPrmEstimnMotBackEmfConLoLim -> AAACalRegn01IninOptSetA03_Dummy.MotCtrlPrmEstimnMotBackEmfConLoLim  # UB:Derived from original system description
    connect CalRegn01IninOptSetA03.MotCtrlPrmEstimnMotBackEmfConNom -> AAACalRegn01IninOptSetA03_Dummy.MotCtrlPrmEstimnMotBackEmfConNom  # UB:Derived from original system description
    connect CalRegn01IninOptSetA03.MotCtrlPrmEstimnMotBackEmfConSatnScaIvtrLoaMtgtn -> AAACalRegn01IninOptSetA03_Dummy.MotCtrlPrmEstimnMotBackEmfConSatnScaIvtrLoaMtgtn  # UB:Derived from original system description
    connect CalRegn01IninOptSetA03.MotCtrlPrmEstimnMotBackEmfConSatnX -> AAACalRegn01IninOptSetA03_Dummy.MotCtrlPrmEstimnMotBackEmfConSatnX  # UB:Derived from original system description
    connect CalRegn01IninOptSetA03.MotCtrlPrmEstimnMotBackEmfConSatnY -> AAACalRegn01IninOptSetA03_Dummy.MotCtrlPrmEstimnMotBackEmfConSatnY  # UB:Derived from original system description
    connect CalRegn01IninOptSetA03.MotCtrlPrmEstimnMotCurrDaxInduSatnBilnrSeln -> AAACalRegn01IninOptSetA03_Dummy.MotCtrlPrmEstimnMotCurrDaxInduSatnBilnrSeln  # UB:Derived from original system description
    connect CalRegn01IninOptSetA03.MotCtrlPrmEstimnMotCurrQaxInduSatnX -> AAACalRegn01IninOptSetA03_Dummy.MotCtrlPrmEstimnMotCurrQaxInduSatnX  # UB:Derived from original system description
    connect CalRegn01IninOptSetA03.MotCtrlPrmEstimnMotInduDaxHiLim -> AAACalRegn01IninOptSetA03_Dummy.MotCtrlPrmEstimnMotInduDaxHiLim  # UB:Derived from original system description
    connect CalRegn01IninOptSetA03.MotCtrlPrmEstimnMotInduDaxIvtrLoaMtgtn -> AAACalRegn01IninOptSetA03_Dummy.MotCtrlPrmEstimnMotInduDaxIvtrLoaMtgtn  # UB:Derived from original system description
    connect CalRegn01IninOptSetA03.MotCtrlPrmEstimnMotInduDaxLoLim -> AAACalRegn01IninOptSetA03_Dummy.MotCtrlPrmEstimnMotInduDaxLoLim  # UB:Derived from original system description
    connect CalRegn01IninOptSetA03.MotCtrlPrmEstimnMotInduDaxNom -> AAACalRegn01IninOptSetA03_Dummy.MotCtrlPrmEstimnMotInduDaxNom  # UB:Derived from original system description
    connect CalRegn01IninOptSetA03.MotCtrlPrmEstimnMotInduDaxSatnScaY -> AAACalRegn01IninOptSetA03_Dummy.MotCtrlPrmEstimnMotInduDaxSatnScaY  # UB:Derived from original system description
    connect CalRegn01IninOptSetA03.MotCtrlPrmEstimnMotInduQaxHiLim -> AAACalRegn01IninOptSetA03_Dummy.MotCtrlPrmEstimnMotInduQaxHiLim  # UB:Derived from original system description
    connect CalRegn01IninOptSetA03.MotCtrlPrmEstimnMotInduQaxIvtrLoaMtgtn -> AAACalRegn01IninOptSetA03_Dummy.MotCtrlPrmEstimnMotInduQaxIvtrLoaMtgtn  # UB:Derived from original system description
    connect CalRegn01IninOptSetA03.MotCtrlPrmEstimnMotInduQaxLoLim -> AAACalRegn01IninOptSetA03_Dummy.MotCtrlPrmEstimnMotInduQaxLoLim  # UB:Derived from original system description
    connect CalRegn01IninOptSetA03.MotCtrlPrmEstimnMotInduQaxNom -> AAACalRegn01IninOptSetA03_Dummy.MotCtrlPrmEstimnMotInduQaxNom  # UB:Derived from original system description
    connect CalRegn01IninOptSetA03.MotCtrlPrmEstimnMotInduQaxSatnScaY -> AAACalRegn01IninOptSetA03_Dummy.MotCtrlPrmEstimnMotInduQaxSatnScaY  # UB:Derived from original system description
    connect CalRegn01IninOptSetA03.MotCtrlPrmEstimnMotRHiLim -> AAACalRegn01IninOptSetA03_Dummy.MotCtrlPrmEstimnMotRHiLim  # UB:Derived from original system description
    connect CalRegn01IninOptSetA03.MotCtrlPrmEstimnMotRLoLim -> AAACalRegn01IninOptSetA03_Dummy.MotCtrlPrmEstimnMotRLoLim  # UB:Derived from original system description
    connect CalRegn01IninOptSetA03.MotCtrlPrmEstimnMotRNom -> AAACalRegn01IninOptSetA03_Dummy.MotCtrlPrmEstimnMotRNom  # UB:Derived from original system description
    connect CalRegn01IninOptSetA03.MotCtrlPrmEstimnMotWidgThermCoeff -> AAACalRegn01IninOptSetA03_Dummy.MotCtrlPrmEstimnMotWidgThermCoeff  # UB:Derived from original system description
    connect CalRegn01IninOptSetA03.MotCtrlPrmEstimnTNom -> AAACalRegn01IninOptSetA03_Dummy.MotCtrlPrmEstimnTNom  # UB:Derived from original system description
    connect CalRegn01IninOptSetA03.MotCurrPeakEstimnCurrFilFrq -> AAACalRegn01IninOptSetA03_Dummy.MotCurrPeakEstimnCurrFilFrq  # UB:Derived from original system description
    connect CalRegn01IninOptSetA03.MotCurrPeakEstimnCurrPeakEstimdFilFrq -> AAACalRegn01IninOptSetA03_Dummy.MotCurrPeakEstimnCurrPeakEstimdFilFrq  # UB:Derived from original system description
    connect CalRegn01IninOptSetA03.MotCurrRegCfgMotClsdLoopBwDaxY -> AAACalRegn01IninOptSetA03_Dummy.MotCurrRegCfgMotClsdLoopBwDaxY  # UB:Derived from original system description
    connect CalRegn01IninOptSetA03.MotCurrRegCfgMotClsdLoopBwQaxY -> AAACalRegn01IninOptSetA03_Dummy.MotCurrRegCfgMotClsdLoopBwQaxY  # UB:Derived from original system description
    connect CalRegn01IninOptSetA03.MotCurrRegCfgMotDampgRatDax -> AAACalRegn01IninOptSetA03_Dummy.MotCurrRegCfgMotDampgRatDax  # UB:Derived from original system description
    connect CalRegn01IninOptSetA03.MotCurrRegCfgMotDampgRatQax -> AAACalRegn01IninOptSetA03_Dummy.MotCurrRegCfgMotDampgRatQax  # UB:Derived from original system description
    connect CalRegn01IninOptSetA03.MotCurrRegCfgMotNatFrqDaxY -> AAACalRegn01IninOptSetA03_Dummy.MotCurrRegCfgMotNatFrqDaxY  # UB:Derived from original system description
    connect CalRegn01IninOptSetA03.MotCurrRegCfgMotNatFrqQaxY -> AAACalRegn01IninOptSetA03_Dummy.MotCurrRegCfgMotNatFrqQaxY  # UB:Derived from original system description
    connect CalRegn01IninOptSetA03.MotCurrRegCfgMotRVirtDax -> AAACalRegn01IninOptSetA03_Dummy.MotCurrRegCfgMotRVirtDax  # UB:Derived from original system description
    connect CalRegn01IninOptSetA03.MotCurrRegCfgMotRVirtQax -> AAACalRegn01IninOptSetA03_Dummy.MotCurrRegCfgMotRVirtQax  # UB:Derived from original system description
    connect CalRegn01IninOptSetA03.MotCurrRegCfgMotVelFilFrq -> AAACalRegn01IninOptSetA03_Dummy.MotCurrRegCfgMotVelFilFrq  # UB:Derived from original system description
    connect CalRegn01IninOptSetA03.MotCurrRegVltgLimrCurrLoaScarSlewRate -> AAACalRegn01IninOptSetA03_Dummy.MotCurrRegVltgLimrCurrLoaScarSlewRate  # UB:Derived from original system description
    connect CalRegn01IninOptSetA03.MotCurrRegVltgLimrDaxAntiWdupCoeff -> AAACalRegn01IninOptSetA03_Dummy.MotCurrRegVltgLimrDaxAntiWdupCoeff  # UB:Derived from original system description
    connect CalRegn01IninOptSetA03.MotCurrRegVltgLimrDualEcuLoaScarSlewRate -> AAACalRegn01IninOptSetA03_Dummy.MotCurrRegVltgLimrDualEcuLoaScarSlewRate  # UB:Derived from original system description
    connect CalRegn01IninOptSetA03.MotCurrRegVltgLimrFETLoaScarSlewRate -> AAACalRegn01IninOptSetA03_Dummy.MotCurrRegVltgLimrFETLoaScarSlewRate  # UB:Derived from original system description
    connect CalRegn01IninOptSetA03.MotCurrRegVltgLimrIvtrLoaScarSlewRate -> AAACalRegn01IninOptSetA03_Dummy.MotCurrRegVltgLimrIvtrLoaScarSlewRate  # UB:Derived from original system description
    connect CalRegn01IninOptSetA03.MotCurrRegVltgLimrMotVltgBrdgLpFilFrq -> AAACalRegn01IninOptSetA03_Dummy.MotCurrRegVltgLimrMotVltgBrdgLpFilFrq  # UB:Derived from original system description
    connect CalRegn01IninOptSetA03.MotCurrRegVltgLimrMotVltgDaxIntglHiLim -> AAACalRegn01IninOptSetA03_Dummy.MotCurrRegVltgLimrMotVltgDaxIntglHiLim  # UB:Derived from original system description
    connect CalRegn01IninOptSetA03.MotCurrRegVltgLimrMotVltgDaxIntglLoLim -> AAACalRegn01IninOptSetA03_Dummy.MotCurrRegVltgLimrMotVltgDaxIntglLoLim  # UB:Derived from original system description
    connect CalRegn01IninOptSetA03.MotCurrRegVltgLimrMotVltgQaxFfLpFilFrq -> AAACalRegn01IninOptSetA03_Dummy.MotCurrRegVltgLimrMotVltgQaxFfLpFilFrq  # UB:Derived from original system description
    connect CalRegn01IninOptSetA03.MotCurrRegVltgLimrMotVltgQaxIntglHiLim -> AAACalRegn01IninOptSetA03_Dummy.MotCurrRegVltgLimrMotVltgQaxIntglHiLim  # UB:Derived from original system description
    connect CalRegn01IninOptSetA03.MotCurrRegVltgLimrMotVltgQaxIntglLoLim -> AAACalRegn01IninOptSetA03_Dummy.MotCurrRegVltgLimrMotVltgQaxIntglLoLim  # UB:Derived from original system description
    connect CalRegn01IninOptSetA03.MotCurrRegVltgLimrQaxAntiWdupCoeff -> AAACalRegn01IninOptSetA03_Dummy.MotCurrRegVltgLimrQaxAntiWdupCoeff  # UB:Derived from original system description
    connect CalRegn01IninOptSetA03.MotCurrRegVltgLimrQaxAntiWdupScagDi -> AAACalRegn01IninOptSetA03_Dummy.MotCurrRegVltgLimrQaxAntiWdupScagDi  # UB:Derived from original system description
    connect CalRegn01IninOptSetA03.MotRefMdlCurrDaxBoostGain -> AAACalRegn01IninOptSetA03_Dummy.MotRefMdlCurrDaxBoostGain  # UB:Derived from original system description
    connect CalRegn01IninOptSetA03.MotRefMdlCurrDaxBoostTqScaX -> AAACalRegn01IninOptSetA03_Dummy.MotRefMdlCurrDaxBoostTqScaX  # UB:Derived from original system description
    connect CalRegn01IninOptSetA03.MotRefMdlCurrDaxBoostTqScaY -> AAACalRegn01IninOptSetA03_Dummy.MotRefMdlCurrDaxBoostTqScaY  # UB:Derived from original system description
    connect CalRegn01IninOptSetA03.MotRefMdlCurrDaxQaxRefDelta -> AAACalRegn01IninOptSetA03_Dummy.MotRefMdlCurrDaxQaxRefDelta  # UB:Derived from original system description
    connect CalRegn01IninOptSetA03.MotRefMdlCurrItrnTolr -> AAACalRegn01IninOptSetA03_Dummy.MotRefMdlCurrItrnTolr  # UB:Derived from original system description
    connect CalRegn01IninOptSetA03.MotRefMdlMotCurrDaxMaxSca -> AAACalRegn01IninOptSetA03_Dummy.MotRefMdlMotCurrDaxMaxSca  # UB:Derived from original system description
    connect CalRegn01IninOptSetA03.MotRefMdlQuad13VltgSdlX -> AAACalRegn01IninOptSetA03_Dummy.MotRefMdlQuad13VltgSdlX  # UB:Derived from original system description
    connect CalRegn01IninOptSetA03.MotRefMdlQuad13VltgSdlY -> AAACalRegn01IninOptSetA03_Dummy.MotRefMdlQuad13VltgSdlY  # UB:Derived from original system description
    connect CalRegn01IninOptSetA03.MotRefMdlQuad24VltgSdlX -> AAACalRegn01IninOptSetA03_Dummy.MotRefMdlQuad24VltgSdlX  # UB:Derived from original system description
    connect CalRegn01IninOptSetA03.MotRefMdlQuad24VltgSdlY -> AAACalRegn01IninOptSetA03_Dummy.MotRefMdlQuad24VltgSdlY  # UB:Derived from original system description
    connect CalRegn01IninOptSetA03.MotRefMdlVltgOverRThdSca -> AAACalRegn01IninOptSetA03_Dummy.MotRefMdlVltgOverRThdSca  # UB:Derived from original system description
    connect CalRegn01IninOptSetA03.MotTqTranlDampgCmdLim -> AAACalRegn01IninOptSetA03_Dummy.MotTqTranlDampgCmdLim  # UB:Derived from original system description
    connect CalRegn01IninOptSetA03.MotTqTranlDampgVelThd -> AAACalRegn01IninOptSetA03_Dummy.MotTqTranlDampgVelThd  # UB:Derived from original system description
    connect CalRegn01IninOptSetA03.PwrLimrAssiRednLpFilFrq -> AAACalRegn01IninOptSetA03_Dummy.PwrLimrAssiRednLpFilFrq  # UB:Derived from original system description
    connect CalRegn01IninOptSetA03.PwrLimrBackEmfConStdT -> AAACalRegn01IninOptSetA03_Dummy.PwrLimrBackEmfConStdT  # UB:Derived from original system description
    connect CalRegn01IninOptSetA03.PwrLimrBrdgVltgAdjSlew -> AAACalRegn01IninOptSetA03_Dummy.PwrLimrBrdgVltgAdjSlew  # UB:Derived from original system description
    connect CalRegn01IninOptSetA03.PwrLimrBrdgVltgAltFltAdj -> AAACalRegn01IninOptSetA03_Dummy.PwrLimrBrdgVltgAltFltAdj  # UB:Derived from original system description
    connect CalRegn01IninOptSetA03.PwrLimrFilAssiRednThd -> AAACalRegn01IninOptSetA03_Dummy.PwrLimrFilAssiRednThd  # UB:Derived from original system description
    connect CalRegn01IninOptSetA03.PwrLimrLoVoltAssiRcvrThd -> AAACalRegn01IninOptSetA03_Dummy.PwrLimrLoVoltAssiRcvrThd  # UB:Derived from original system description
    connect CalRegn01IninOptSetA03.PwrLimrLoVoltAssiRcvrTi -> AAACalRegn01IninOptSetA03_Dummy.PwrLimrLoVoltAssiRcvrTi  # UB:Derived from original system description
    connect CalRegn01IninOptSetA03.PwrLimrMotEnvlpX -> AAACalRegn01IninOptSetA03_Dummy.PwrLimrMotEnvlpX  # UB:Derived from original system description
    connect CalRegn01IninOptSetA03.PwrLimrMotEnvlpY -> AAACalRegn01IninOptSetA03_Dummy.PwrLimrMotEnvlpY  # UB:Derived from original system description
    connect CalRegn01IninOptSetA03.PwrLimrMotVelLpFilFrq -> AAACalRegn01IninOptSetA03_Dummy.PwrLimrMotVelLpFilFrq  # UB:Derived from original system description
    connect CalRegn01IninOptSetA03.PwrLimrSpdAdjSlewDec -> AAACalRegn01IninOptSetA03_Dummy.PwrLimrSpdAdjSlewDec  # UB:Derived from original system description
    connect CalRegn01IninOptSetA03.PwrLimrSpdAdjSlewEna -> AAACalRegn01IninOptSetA03_Dummy.PwrLimrSpdAdjSlewEna  # UB:Derived from original system description
    connect CalRegn01IninOptSetA03.PwrLimrSpdAdjSlewInc -> AAACalRegn01IninOptSetA03_Dummy.PwrLimrSpdAdjSlewInc  # UB:Derived from original system description
    connect CalRegn01IninOptSetA03.PwrLimrStdOperMotEnvlpX -> AAACalRegn01IninOptSetA03_Dummy.PwrLimrStdOperMotEnvlpX  # UB:Derived from original system description
    connect CalRegn01IninOptSetA03.PwrLimrStdOperMotEnvlpY -> AAACalRegn01IninOptSetA03_Dummy.PwrLimrStdOperMotEnvlpY  # UB:Derived from original system description
    connect CalRegn01IninOptSetA03.PwrLimrVltgDptMotVelOffsX -> AAACalRegn01IninOptSetA03_Dummy.PwrLimrVltgDptMotVelOffsX  # UB:Derived from original system description
    connect CalRegn01IninOptSetA03.PwrLimrVltgDptMotVelOffsY -> AAACalRegn01IninOptSetA03_Dummy.PwrLimrVltgDptMotVelOffsY  # UB:Derived from original system description
    connect CalRegn01IninOptSetA03.SysGlbPrmSysTqRat -> AAACalRegn01IninOptSetA03_Dummy.SysGlbPrmSysTqRat  # UB:Derived from original system description
    connect CalRegn01IninOptSetA03.TEstimnAmbPwrMplr -> AAACalRegn01IninOptSetA03_Dummy.TEstimnAmbPwrMplr  # UB:Derived from original system description
    connect CalRegn01IninOptSetA03.TEstimnAmbTSca -> AAACalRegn01IninOptSetA03_Dummy.TEstimnAmbTSca  # UB:Derived from original system description
    connect CalRegn01IninOptSetA03.TEstimnAssiMechAmbLpFilFrq -> AAACalRegn01IninOptSetA03_Dummy.TEstimnAssiMechAmbLpFilFrq  # UB:Derived from original system description
    connect CalRegn01IninOptSetA03.TEstimnAssiMechAmbLpFilFrqDualEcuFltMtgtn -> AAACalRegn01IninOptSetA03_Dummy.TEstimnAssiMechAmbLpFilFrqDualEcuFltMtgtn  # UB:Derived from original system description
    connect CalRegn01IninOptSetA03.TEstimnAssiMechAmbLpFilFrqFetMtgtnEna -> AAACalRegn01IninOptSetA03_Dummy.TEstimnAssiMechAmbLpFilFrqFetMtgtnEna  # UB:Derived from original system description
    connect CalRegn01IninOptSetA03.TEstimnAssiMechAmbMplr -> AAACalRegn01IninOptSetA03_Dummy.TEstimnAssiMechAmbMplr  # UB:Derived from original system description
