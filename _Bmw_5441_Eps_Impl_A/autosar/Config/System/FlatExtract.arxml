[part 4 of 4: package /COM/VECTOR/CFG/WORKFLOW/SYSDESC/SYNC]
AUTOSAR XML (schema 4-3-0)
package /COM/VECTOR/CFG/WORKFLOW/SYSDESC/SYNC  (continued)
  composition sw component type COMPOSITIONTYPE  (continued)
    connect CalRegn01Inin02GroupD.EotProtnMotSpdIncptSca -> AAACalRegn01Inin02GroupD_Dummy.EotProtnMotSpdIncptSca  # UB:Derived from original system description
    connect CalRegn01Inin02GroupD.EotProtnMotSpdIncptX -> AAACalRegn01Inin02GroupD_Dummy.EotProtnMotSpdIncptX  # UB:Derived from original system description
    connect CalRegn01Inin02GroupD.EotProtnMotSpdIncptY -> AAACalRegn01Inin02GroupD_Dummy.EotProtnMotSpdIncptY  # UB:Derived from original system description
    connect CalRegn01Inin02GroupD.EotProtnMotVelGain -> AAACalRegn01Inin02GroupD_Dummy.EotProtnMotVelGain  # UB:Derived from original system description
    connect CalRegn01Inin02GroupD.EotProtnNormDampgY -> AAACalRegn01Inin02GroupD_Dummy.EotProtnNormDampgY  # UB:Derived from original system description
    connect CalRegn01Inin02GroupD.EotProtnPosnRampStep -> AAACalRegn01Inin02GroupD_Dummy.EotProtnPosnRampStep  # UB:Derived from original system description
    connect CalRegn01Inin02GroupD.EotProtnRackTrvlLimrAuthyThd -> AAACalRegn01Inin02GroupD_Dummy.EotProtnRackTrvlLimrAuthyThd  # UB:Derived from original system description
    connect CalRegn01Inin02GroupD.EotProtnRackTrvlLimrAuthyThdLimd -> AAACalRegn01Inin02GroupD_Dummy.EotProtnRackTrvlLimrAuthyThdLimd  # UB:Derived from original system description
    connect CalRegn01Inin02GroupD.EotProtnRackTrvlLimrRng -> AAACalRegn01Inin02GroupD_Dummy.EotProtnRackTrvlLimrRng  # UB:Derived from original system description
    connect CalRegn01Inin02GroupD.EotProtnRackTrvlLimrRngLimd -> AAACalRegn01Inin02GroupD_Dummy.EotProtnRackTrvlLimrRngLimd  # UB:Derived from original system description
    connect CalRegn01Inin02GroupD.EotProtnRackTrvlLimrVehSpdThd -> AAACalRegn01Inin02GroupD_Dummy.EotProtnRackTrvlLimrVehSpdThd  # UB:Derived from original system description
    connect CalRegn01Inin02GroupD.EotProtnRunEotVelImpctAndSoftEndStop -> AAACalRegn01Inin02GroupD_Dummy.EotProtnRunEotVelImpctAndSoftEndStop  # UB:Derived from original system description
    connect CalRegn01Inin02GroupD.InertiaCmpVelAssiBasdDampgCoeffX -> AAACalRegn01Inin02GroupD_Dummy.InertiaCmpVelAssiBasdDampgCoeffX  # UB:Derived from original system description
    connect CalRegn01Inin02GroupD.InertiaCmpVelAssiBasdDampgRollgWhlImbRejctnOnY -> AAACalRegn01Inin02GroupD_Dummy.InertiaCmpVelAssiBasdDampgRollgWhlImbRejctnOnY  # UB:Derived from original system description
    connect CalRegn01Inin02GroupD.InertiaCmpVelAssiBasdDampgRollgY -> AAACalRegn01Inin02GroupD_Dummy.InertiaCmpVelAssiBasdDampgRollgY  # UB:Derived from original system description
    connect CalRegn01Inin02GroupD.InertiaCmpVelAssiBasdDampgStatWhlImbRejctnOnY -> AAACalRegn01Inin02GroupD_Dummy.InertiaCmpVelAssiBasdDampgStatWhlImbRejctnOnY  # UB:Derived from original system description
    connect CalRegn01Inin02GroupD.InertiaCmpVelAssiBasdDampgStatY -> AAACalRegn01Inin02GroupD_Dummy.InertiaCmpVelAssiBasdDampgStatY  # UB:Derived from original system description
    connect CalRegn01Inin02GroupD.InertiaCmpVelCmdScaY -> AAACalRegn01Inin02GroupD_Dummy.InertiaCmpVelCmdScaY  # UB:Derived from original system description
    connect CalRegn01Inin02GroupD.InertiaCmpVelDampgDecelGain -> AAACalRegn01Inin02GroupD_Dummy.InertiaCmpVelDampgDecelGain  # UB:Derived from original system description
    connect CalRegn01Inin02GroupD.InertiaCmpVelDampgDecelGainFallSlew -> AAACalRegn01Inin02GroupD_Dummy.InertiaCmpVelDampgDecelGainFallSlew  # UB:Derived from original system description
    connect CalRegn01Inin02GroupD.InertiaCmpVelDampgDecelGainRisngSlewX -> AAACalRegn01Inin02GroupD_Dummy.InertiaCmpVelDampgDecelGainRisngSlewX  # UB:Derived from original system description
    connect CalRegn01Inin02GroupD.InertiaCmpVelDampgDecelGainRisngSlewY -> AAACalRegn01Inin02GroupD_Dummy.InertiaCmpVelDampgDecelGainRisngSlewY  # UB:Derived from original system description
    connect CalRegn01Inin02GroupD.InertiaCmpVelDampgFilFrq -> AAACalRegn01Inin02GroupD_Dummy.InertiaCmpVelDampgFilFrq  # UB:Derived from original system description
    connect CalRegn01Inin02GroupD.InertiaCmpVelDampgFilFrqWhlImbRejctnOn -> AAACalRegn01Inin02GroupD_Dummy.InertiaCmpVelDampgFilFrqWhlImbRejctnOn  # UB:Derived from original system description
    connect CalRegn01Inin02GroupD.InertiaCmpVelDampgGainOffThd -> AAACalRegn01Inin02GroupD_Dummy.InertiaCmpVelDampgGainOffThd  # UB:Derived from original system description
    connect CalRegn01Inin02GroupD.InertiaCmpVelDampgGainOnThd -> AAACalRegn01Inin02GroupD_Dummy.InertiaCmpVelDampgGainOnThd  # UB:Derived from original system description
    connect CalRegn01Inin02GroupD.InertiaCmpVelDampgSpdBlndY -> AAACalRegn01Inin02GroupD_Dummy.InertiaCmpVelDampgSpdBlndY  # UB:Derived from original system description
    connect CalRegn01Inin02GroupD.InertiaCmpVelDampgWhlImbRejctnBlndX -> AAACalRegn01Inin02GroupD_Dummy.InertiaCmpVelDampgWhlImbRejctnBlndX  # UB:Derived from original system description
    connect CalRegn01Inin02GroupD.InertiaCmpVelDampgWhlImbRejctnBlndY -> AAACalRegn01Inin02GroupD_Dummy.InertiaCmpVelDampgWhlImbRejctnBlndY  # UB:Derived from original system description
    connect CalRegn01Inin02GroupD.InertiaCmpVelDecelGainEnaCal -> AAACalRegn01Inin02GroupD_Dummy.InertiaCmpVelDecelGainEnaCal  # UB:Derived from original system description
    connect CalRegn01Inin02GroupD.InertiaCmpVelModWhlImbRejctnBlndX -> AAACalRegn01Inin02GroupD_Dummy.InertiaCmpVelModWhlImbRejctnBlndX  # UB:Derived from original system description
    connect CalRegn01Inin02GroupD.InertiaCmpVelModWhlImbRejctnBlndY -> AAACalRegn01Inin02GroupD_Dummy.InertiaCmpVelModWhlImbRejctnBlndY  # UB:Derived from original system description
    connect CalRegn01Inin02GroupD.InertiaCmpVelMotInertia -> AAACalRegn01Inin02GroupD_Dummy.InertiaCmpVelMotInertia  # UB:Derived from original system description
    connect CalRegn01Inin02GroupD.InertiaCmpVelMotVelBasdOutpScagX -> AAACalRegn01Inin02GroupD_Dummy.InertiaCmpVelMotVelBasdOutpScagX  # UB:Derived from original system description
    connect CalRegn01Inin02GroupD.InertiaCmpVelMotVelBasdOutpScagY -> AAACalRegn01Inin02GroupD_Dummy.InertiaCmpVelMotVelBasdOutpScagY  # UB:Derived from original system description
    connect CalRegn01Inin02GroupD.InertiaCmpVelNotchBlndY -> AAACalRegn01Inin02GroupD_Dummy.InertiaCmpVelNotchBlndY  # UB:Derived from original system description
    connect CalRegn01Inin02GroupD.InertiaCmpVelNotchFilStruct -> AAACalRegn01Inin02GroupD_Dummy.InertiaCmpVelNotchFilStruct  # UB:Derived from original system description
    connect CalRegn01Inin02GroupD.InertiaCmpVelTqSnsrVelFilFrq -> AAACalRegn01Inin02GroupD_Dummy.InertiaCmpVelTqSnsrVelFilFrq  # UB:Derived from original system description
    connect CalRegn01Inin02GroupD.InertiaCmpVelTqSnsrVelSca -> AAACalRegn01Inin02GroupD_Dummy.InertiaCmpVelTqSnsrVelSca  # UB:Derived from original system description
    connect CalRegn01Inin03.BmwHwAgArbnAndEotPosnKineIntegrityDiagcMaxRackLim -> AAACalRegn01Inin03_Dummy.BmwHwAgArbnAndEotPosnKineIntegrityDiagcMaxRackLim  # UB:Derived from original system description
    connect CalRegn01Inin03.EffortScaBlndX -> AAACalRegn01Inin03_Dummy.EffortScaBlndX  # UB:Derived from original system description
    connect CalRegn01Inin03.EffortScaBlndY -> AAACalRegn01Inin03_Dummy.EffortScaBlndY  # UB:Derived from original system description
    connect CalRegn01Inin03.EffortScaRackFThd -> AAACalRegn01Inin03_Dummy.EffortScaRackFThd  # UB:Derived from original system description
    connect CalRegn01Inin03.PosnTrakgServoArbnFltMtgtnLpFilCutOffFrq -> AAACalRegn01Inin03_Dummy.PosnTrakgServoArbnFltMtgtnLpFilCutOffFrq  # UB:Derived from original system description
    connect CalRegn01Inin03.PullCmpActvHwTqFilFrqLrngEna -> AAACalRegn01Inin03_Dummy.PullCmpActvHwTqFilFrqLrngEna  # UB:Derived from original system description
    connect CalRegn01Inin03.PullCmpActvYawRateFilFrq -> AAACalRegn01Inin03_Dummy.PullCmpActvYawRateFilFrq  # UB:Derived from original system description
    connect CalRegn01Inin03.SysFricLrngAvrgFricFrq -> AAACalRegn01Inin03_Dummy.SysFricLrngAvrgFricFrq  # UB:Derived from original system description
    connect CalRegn01Inin03.SysFricLrngBasLineEolFric -> AAACalRegn01Inin03_Dummy.SysFricLrngBasLineEolFric  # UB:Derived from original system description
    connect CalRegn01Inin03.SysFricLrngBasLineFric -> AAACalRegn01Inin03_Dummy.SysFricLrngBasLineFric  # UB:Derived from original system description
    connect CalRegn01Inin03.SysFricLrngBasLineHys -> AAACalRegn01Inin03_Dummy.SysFricLrngBasLineHys  # UB:Derived from original system description
    connect CalRegn01Inin03.SysFricLrngBasLineRngCntr -> AAACalRegn01Inin03_Dummy.SysFricLrngBasLineRngCntr  # UB:Derived from original system description
    connect CalRegn01Inin03.SysFricLrngDataPrepLpFilFrq -> AAACalRegn01Inin03_Dummy.SysFricLrngDataPrepLpFilFrq  # UB:Derived from original system description
    connect CalRegn01Inin03.SysFricLrngDebStep -> AAACalRegn01Inin03_Dummy.SysFricLrngDebStep  # UB:Derived from original system description
    connect CalRegn01Inin03.SysFricLrngEolFricDifHiLim -> AAACalRegn01Inin03_Dummy.SysFricLrngEolFricDifHiLim  # UB:Derived from original system description
    connect CalRegn01Inin03.SysFricLrngEolFricDifLoLim -> AAACalRegn01Inin03_Dummy.SysFricLrngEolFricDifLoLim  # UB:Derived from original system description
    connect CalRegn01Inin03.SysFricLrngEolFricDifScagFac -> AAACalRegn01Inin03_Dummy.SysFricLrngEolFricDifScagFac  # UB:Derived from original system description
    connect CalRegn01Inin03.SysFricLrngFricChgWght -> AAACalRegn01Inin03_Dummy.SysFricLrngFricChgWght  # UB:Derived from original system description
    connect CalRegn01Inin03.SysFricLrngFricDiagcThd -> AAACalRegn01Inin03_Dummy.SysFricLrngFricDiagcThd  # UB:Derived from original system description
    connect CalRegn01Inin03.SysFricLrngFricHysHwAgPt -> AAACalRegn01Inin03_Dummy.SysFricLrngFricHysHwAgPt  # UB:Derived from original system description
    connect CalRegn01Inin03.SysFricLrngFricOffs -> AAACalRegn01Inin03_Dummy.SysFricLrngFricOffs  # UB:Derived from original system description
    connect CalRegn01Inin03.SysFricLrngFricOffsHiLim -> AAACalRegn01Inin03_Dummy.SysFricLrngFricOffsHiLim  # UB:Derived from original system description
    connect CalRegn01Inin03.SysFricLrngFricOffsLoLim -> AAACalRegn01Inin03_Dummy.SysFricLrngFricOffsLoLim  # UB:Derived from original system description
    connect CalRegn01Inin03.SysFricLrngFricOffsLpFilFrq -> AAACalRegn01Inin03_Dummy.SysFricLrngFricOffsLpFilFrq  # UB:Derived from original system description
    connect CalRegn01Inin03.SysFricLrngGain -> AAACalRegn01Inin03_Dummy.SysFricLrngGain  # UB:Derived from original system description
    connect CalRegn01Inin03.SysFricLrngHiFricDebStep -> AAACalRegn01Inin03_Dummy.SysFricLrngHiFricDebStep  # UB:Derived from original system description
    connect CalRegn01Inin03.SysFricLrngHiFricDiagcThd -> AAACalRegn01Inin03_Dummy.SysFricLrngHiFricDiagcThd  # UB:Derived from original system description
    connect CalRegn01Inin03.SysFricLrngHwPosnAuthyThd -> AAACalRegn01Inin03_Dummy.SysFricLrngHwPosnAuthyThd  # UB:Derived from original system description
    connect CalRegn01Inin03.SysFricLrngHwVelConstrLim -> AAACalRegn01Inin03_Dummy.SysFricLrngHwVelConstrLim  # UB:Derived from original system description
    connect CalRegn01Inin03.SysFricLrngHwVelHiLim -> AAACalRegn01Inin03_Dummy.SysFricLrngHwVelHiLim  # UB:Derived from original system description
    connect CalRegn01Inin03.SysFricLrngHwVelLoLim -> AAACalRegn01Inin03_Dummy.SysFricLrngHwVelLoLim  # UB:Derived from original system description
    connect CalRegn01Inin03.SysFricLrngIgnCycFricChgLim -> AAACalRegn01Inin03_Dummy.SysFricLrngIgnCycFricChgLim  # UB:Derived from original system description
    connect CalRegn01Inin03.SysFricLrngIgnCycFricOffs -> AAACalRegn01Inin03_Dummy.SysFricLrngIgnCycFricOffs  # UB:Derived from original system description
    connect CalRegn01Inin03.SysFricLrngIvsTrsmRatX -> AAACalRegn01Inin03_Dummy.SysFricLrngIvsTrsmRatX  # UB:Derived from original system description
    connect CalRegn01Inin03.SysFricLrngIvsTrsmRatY -> AAACalRegn01Inin03_Dummy.SysFricLrngIvsTrsmRatY  # UB:Derived from original system description
    connect CalRegn01Inin03.SysFricLrngLatAHiLim -> AAACalRegn01Inin03_Dummy.SysFricLrngLatAHiLim  # UB:Derived from original system description
    connect CalRegn01Inin03.SysFricLrngLatALoLim -> AAACalRegn01Inin03_Dummy.SysFricLrngLatALoLim  # UB:Derived from original system description
    connect CalRegn01Inin03.SysFricLrngMaskVehSpd -> AAACalRegn01Inin03_Dummy.SysFricLrngMaskVehSpd  # UB:Derived from original system description
    connect CalRegn01Inin03.SysFricLrngRngCntrThd -> AAACalRegn01Inin03_Dummy.SysFricLrngRngCntrThd  # UB:Derived from original system description
    connect CalRegn01Inin03.SysFricLrngThd -> AAACalRegn01Inin03_Dummy.SysFricLrngThd  # UB:Derived from original system description
    connect CalRegn01Inin03.SysFricLrngTHiLim -> AAACalRegn01Inin03_Dummy.SysFricLrngTHiLim  # UB:Derived from original system description
    connect CalRegn01Inin03.SysFricLrngTLoLim -> AAACalRegn01Inin03_Dummy.SysFricLrngTLoLim  # UB:Derived from original system description
    connect CalRegn01Inin03.SysFricLrngVehSpd -> AAACalRegn01Inin03_Dummy.SysFricLrngVehSpd  # UB:Derived from original system description
    connect CalRegn01Inin03.SysGlbPrmSysKineRat -> AAACalRegn01Inin03_Dummy.SysGlbPrmSysKineRat  # UB:Derived from original system description
    connect CalRegn01Inin03.SysGlbPrmVehSpdBilnrSeln -> AAACalRegn01Inin03_Dummy.SysGlbPrmVehSpdBilnrSeln  # UB:Derived from original system description
    connect CalRegn01Inin03.SysKineAndEffMotAgToRackPosRatScaY -> AAACalRegn01Inin03_Dummy.SysKineAndEffMotAgToRackPosRatScaY  # UB:Derived from original system description
    connect CalRegn01Inin03.SysKineAndEffPinionAgToRackPosRatScaY -> AAACalRegn01Inin03_Dummy.SysKineAndEffPinionAgToRackPosRatScaY  # UB:Derived from original system description
    connect CalRegn01Inin03.SysKineAndEffPinionToRackEffScaY -> AAACalRegn01Inin03_Dummy.SysKineAndEffPinionToRackEffScaY  # UB:Derived from original system description
    connect CalRegn01Inin03.SysKineAndEffRoadWhlFromRackPosScaY -> AAACalRegn01Inin03_Dummy.SysKineAndEffRoadWhlFromRackPosScaY  # UB:Derived from original system description
    connect CalRegn01Inin03.SysKineAndEffSteerArmLenFromRackPosScaY -> AAACalRegn01Inin03_Dummy.SysKineAndEffSteerArmLenFromRackPosScaY  # UB:Derived from original system description
    connect CalRegn01Inin03.TunSelnAuthyVehSpdX -> AAACalRegn01Inin03_Dummy.TunSelnAuthyVehSpdX  # UB:Derived from original system description
    connect CalRegn01Inin03GroupA.BmwHwAgArbnAndEotPosnEotCcwMax -> AAACalRegn01Inin03GroupA_Dummy.BmwHwAgArbnAndEotPosnEotCcwMax  # UB:Derived from original system description
    connect CalRegn01Inin03GroupA.BmwHwAgArbnAndEotPosnEotCcwMin -> AAACalRegn01Inin03GroupA_Dummy.BmwHwAgArbnAndEotPosnEotCcwMin  # UB:Derived from original system description
    connect CalRegn01Inin03GroupA.BmwHwAgArbnAndEotPosnEotCwMax -> AAACalRegn01Inin03GroupA_Dummy.BmwHwAgArbnAndEotPosnEotCwMax  # UB:Derived from original system description
    connect CalRegn01Inin03GroupA.BmwHwAgArbnAndEotPosnEotCwMin -> AAACalRegn01Inin03GroupA_Dummy.BmwHwAgArbnAndEotPosnEotCwMin  # UB:Derived from original system description
    connect CalRegn01Inin03GroupA.BmwPwrPrkgDampgDiScadDampg -> AAACalRegn01Inin03GroupA_Dummy.BmwPwrPrkgDampgDiScadDampg  # UB:Derived from original system description
    connect CalRegn01Inin03GroupA.BmwPwrPrkgDampgMaxRate -> AAACalRegn01Inin03GroupA_Dummy.BmwPwrPrkgDampgMaxRate  # UB:Derived from original system description
    connect CalRegn01Inin03GroupA.EpsStEstimnMtrxA -> AAACalRegn01Inin03GroupA_Dummy.EpsStEstimnMtrxA  # UB:Derived from original system description
    connect CalRegn01Inin03GroupA.EpsStEstimnMtrxB -> AAACalRegn01Inin03GroupA_Dummy.EpsStEstimnMtrxB  # UB:Derived from original system description
    connect CalRegn01Inin03GroupA.EpsStEstimnMtrxC -> AAACalRegn01Inin03GroupA_Dummy.EpsStEstimnMtrxC  # UB:Derived from original system description
    connect CalRegn01Inin03GroupA.EpsStEstimnMtrxD -> AAACalRegn01Inin03GroupA_Dummy.EpsStEstimnMtrxD  # UB:Derived from original system description
    connect CalRegn01Inin03GroupA.HwTqTrakgCtrlFbGain{1..5} -> AAACalRegn01Inin03GroupA_Dummy.HwTqTrakgCtrlFbGain{1..5}  # UB:Derived from original system description
    connect CalRegn01Inin03GroupA.HwTqTrakgCtrlFfGainScaY -> AAACalRegn01Inin03GroupA_Dummy.HwTqTrakgCtrlFfGainScaY  # UB:Derived from original system description
    connect CalRegn01Inin03GroupA.HwTqTrakgCtrlVehSpdScaX -> AAACalRegn01Inin03GroupA_Dummy.HwTqTrakgCtrlVehSpdScaX  # UB:Derived from original system description
    connect CalRegn01Inin03GroupA.PosnTrakgServoEnaBlndFacTblX -> AAACalRegn01Inin03GroupA_Dummy.PosnTrakgServoEnaBlndFacTblX  # UB:Derived from original system description
    connect CalRegn01Inin03GroupA.PosnTrakgServoEnaBlndFacTblY -> AAACalRegn01Inin03GroupA_Dummy.PosnTrakgServoEnaBlndFacTblY  # UB:Derived from original system description
    connect CalRegn01Inin03GroupA.PosnTrakgServoGainArbnFltMtgtn -> AAACalRegn01Inin03GroupA_Dummy.PosnTrakgServoGainArbnFltMtgtn  # UB:Derived from original system description
    connect CalRegn01Inin03GroupA.PullCmpActvCmpLrnTiDecShoTerm -> AAACalRegn01Inin03GroupA_Dummy.PullCmpActvCmpLrnTiDecShoTerm  # UB:Derived from original system description
    connect CalRegn01Inin03GroupA.PullCmpActvCmpLrnTiIncShoTerm -> AAACalRegn01Inin03GroupA_Dummy.PullCmpActvCmpLrnTiIncShoTerm  # UB:Derived from original system description
    connect CalRegn01Inin03GroupA.PullCmpActvCmpLrnTiLongTerm -> AAACalRegn01Inin03GroupA_Dummy.PullCmpActvCmpLrnTiLongTerm  # UB:Derived from original system description
    connect CalRegn01Inin03GroupA.PullCmpActvCmpShoTermRstHwAgThd -> AAACalRegn01Inin03GroupA_Dummy.PullCmpActvCmpShoTermRstHwAgThd  # UB:Derived from original system description
    connect CalRegn01Inin03GroupA.PullCmpActvCmpShoTermRstHwTqThd -> AAACalRegn01Inin03GroupA_Dummy.PullCmpActvCmpShoTermRstHwTqThd  # UB:Derived from original system description
    connect CalRegn01Inin03GroupA.PullCmpActvCmpShoTermRstLatAThd -> AAACalRegn01Inin03GroupA_Dummy.PullCmpActvCmpShoTermRstLatAThd  # UB:Derived from original system description
    connect CalRegn01Inin03GroupA.PullCmpActvCmpShoTermRstYawRateThd -> AAACalRegn01Inin03GroupA_Dummy.PullCmpActvCmpShoTermRstYawRateThd  # UB:Derived from original system description
    connect CalRegn01Inin03GroupA.PullCmpActvEna -> AAACalRegn01Inin03GroupA_Dummy.PullCmpActvEna  # UB:Derived from original system description
    connect CalRegn01Inin03GroupA.PullCmpActvHwTqFilFrqLongTerm -> AAACalRegn01Inin03GroupA_Dummy.PullCmpActvHwTqFilFrqLongTerm  # UB:Derived from original system description
    connect CalRegn01Inin03GroupA.PullCmpActvHwTqFilFrqShoTerm -> AAACalRegn01Inin03GroupA_Dummy.PullCmpActvHwTqFilFrqShoTerm  # UB:Derived from original system description
    connect CalRegn01Inin03GroupA.PullCmpActvLongTermLim -> AAACalRegn01Inin03GroupA_Dummy.PullCmpActvLongTermLim  # UB:Derived from original system description
    connect CalRegn01Inin03GroupA.PullCmpActvLrngEnaAgConfMinMgn -> AAACalRegn01Inin03GroupA_Dummy.PullCmpActvLrngEnaAgConfMinMgn  # UB:Derived from original system description
    connect CalRegn01Inin03GroupA.PullCmpActvLrngEnaHwAgMaxMgn -> AAACalRegn01Inin03GroupA_Dummy.PullCmpActvLrngEnaHwAgMaxMgn  # UB:Derived from original system description
    connect CalRegn01Inin03GroupA.PullCmpActvLrngEnaHwTqMaxMgn -> AAACalRegn01Inin03GroupA_Dummy.PullCmpActvLrngEnaHwTqMaxMgn  # UB:Derived from original system description
    connect CalRegn01Inin03GroupA.PullCmpActvLrngEnaHwVelMaxMgn -> AAACalRegn01Inin03GroupA_Dummy.PullCmpActvLrngEnaHwVelMaxMgn  # UB:Derived from original system description
    connect CalRegn01Inin03GroupA.PullCmpActvLrngEnaLatAMaxMgn -> AAACalRegn01Inin03GroupA_Dummy.PullCmpActvLrngEnaLatAMaxMgn  # UB:Derived from original system description
    connect CalRegn01Inin03GroupA.PullCmpActvLrngEnaTiThd -> AAACalRegn01Inin03GroupA_Dummy.PullCmpActvLrngEnaTiThd  # UB:Derived from original system description
    connect CalRegn01Inin03GroupA.PullCmpActvLrngEnaVehSpdMaxMgn -> AAACalRegn01Inin03GroupA_Dummy.PullCmpActvLrngEnaVehSpdMaxMgn  # UB:Derived from original system description
    connect CalRegn01Inin03GroupA.PullCmpActvLrngEnaVehSpdMinMgn -> AAACalRegn01Inin03GroupA_Dummy.PullCmpActvLrngEnaVehSpdMinMgn  # UB:Derived from original system description
    connect CalRegn01Inin03GroupA.PullCmpActvLrngEnaVehSpdRateMaxMgn -> AAACalRegn01Inin03GroupA_Dummy.PullCmpActvLrngEnaVehSpdRateMaxMgn  # UB:Derived from original system description
    connect CalRegn01Inin03GroupA.PullCmpActvLrngEnaYawRateMaxMgn -> AAACalRegn01Inin03GroupA_Dummy.PullCmpActvLrngEnaYawRateMaxMgn  # UB:Derived from original system description
    connect CalRegn01Inin03GroupA.PullCmpActvOpstSignTiShoTerm -> AAACalRegn01Inin03GroupA_Dummy.PullCmpActvOpstSignTiShoTerm  # UB:Derived from original system description
    connect CalRegn01Inin03GroupA.PullCmpActvOutpMaxRate -> AAACalRegn01Inin03GroupA_Dummy.PullCmpActvOutpMaxRate  # UB:Derived from original system description
    connect CalRegn01Inin03GroupA.PullCmpActvPullCmpShoTermLim -> AAACalRegn01Inin03GroupA_Dummy.PullCmpActvPullCmpShoTermLim  # UB:Derived from original system description
    connect CalRegn01Inin03GroupA.PullCmpActvPullCmpTotLim -> AAACalRegn01Inin03GroupA_Dummy.PullCmpActvPullCmpTotLim  # UB:Derived from original system description
    connect CalRegn01Inin03GroupA.PullCmpActvPullErrLimLongTerm -> AAACalRegn01Inin03GroupA_Dummy.PullCmpActvPullErrLimLongTerm  # UB:Derived from original system description
    connect CalRegn01Inin03GroupA.PullCmpActvPullErrMgnThd -> AAACalRegn01Inin03GroupA_Dummy.PullCmpActvPullErrMgnThd  # UB:Derived from original system description
    connect CalRegn01Inin03GroupA.PullCmpActvPullErrShoTermLim -> AAACalRegn01Inin03GroupA_Dummy.PullCmpActvPullErrShoTermLim  # UB:Derived from original system description
    connect CalRegn01Inin03GroupA.PullCmpActvShoTermRampTi -> AAACalRegn01Inin03GroupA_Dummy.PullCmpActvShoTermRampTi  # UB:Derived from original system description
    connect CalRegn01Inin03GroupA.PullCmpActvVehSpdScaTblX -> AAACalRegn01Inin03GroupA_Dummy.PullCmpActvVehSpdScaTblX  # UB:Derived from original system description
    connect CalRegn01Inin03GroupA.PullCmpActvVehSpdScaTblY -> AAACalRegn01Inin03GroupA_Dummy.PullCmpActvVehSpdScaTblY  # UB:Derived from original system description
    connect CalRegn01Inin03GroupC.CtrldVelRtnDesVelLpFilFrq -> AAACalRegn01Inin03GroupC_Dummy.CtrldVelRtnDesVelLpFilFrq  # UB:Derived from original system description
    connect CalRegn01Inin03GroupC.CtrldVelRtnHwTqLpFilFrq -> AAACalRegn01Inin03GroupC_Dummy.CtrldVelRtnHwTqLpFilFrq  # UB:Derived from original system description
    connect CalRegn01Inin03GroupC.CtrldVelRtnHwTqScaSelnSlewHiLim -> AAACalRegn01Inin03GroupC_Dummy.CtrldVelRtnHwTqScaSelnSlewHiLim  # UB:Derived from original system description
    connect CalRegn01Inin03GroupC.CtrldVelRtnHwTqScaSelnSlewLoLim -> AAACalRegn01Inin03GroupC_Dummy.CtrldVelRtnHwTqScaSelnSlewLoLim  # UB:Derived from original system description
    connect CalRegn01Inin03GroupC.CtrldVelRtnHwTqScaSelnTqThd -> AAACalRegn01Inin03GroupC_Dummy.CtrldVelRtnHwTqScaSelnTqThd  # UB:Derived from original system description
    connect CalRegn01Inin03GroupC.CtrldVelRtnHwTqScaSelnVelThd -> AAACalRegn01Inin03GroupC_Dummy.CtrldVelRtnHwTqScaSelnVelThd  # UB:Derived from original system description
    connect CalRegn01Inin03GroupC.CtrldVelRtnIntgrLimY -> AAACalRegn01Inin03GroupC_Dummy.CtrldVelRtnIntgrLimY  # UB:Derived from original system description
    connect CalRegn01Inin03GroupC.CtrldVelRtnOffsSlewThd -> AAACalRegn01Inin03GroupC_Dummy.CtrldVelRtnOffsSlewThd  # UB:Derived from original system description
    connect CalRegn01Inin03GroupC.CtrldVelRtnOffsThd -> AAACalRegn01Inin03GroupC_Dummy.CtrldVelRtnOffsThd  # UB:Derived from original system description
    connect CalRegn01Inin03GroupC.CtrldVelRtnScaLpFilFrq -> AAACalRegn01Inin03GroupC_Dummy.CtrldVelRtnScaLpFilFrq  # UB:Derived from original system description
    connect CalRegn01Inin03GroupC.FalbckAssiAssiX -> AAACalRegn01Inin03GroupC_Dummy.FalbckAssiAssiX  # UB:Derived from original system description
    connect CalRegn01Inin03GroupC.FalbckAssiAssiY -> AAACalRegn01Inin03GroupC_Dummy.FalbckAssiAssiY  # UB:Derived from original system description
    connect CalRegn01Inin03GroupC.FalbckAssiNotchFil -> AAACalRegn01Inin03GroupC_Dummy.FalbckAssiNotchFil  # UB:Derived from original system description
    connect CalRegn01Inin03GroupC.GlbLimrBndX -> AAACalRegn01Inin03GroupC_Dummy.GlbLimrBndX  # UB:Derived from original system description
    connect CalRegn01Inin03GroupC.GlbLimrBndY -> AAACalRegn01Inin03GroupC_Dummy.GlbLimrBndY  # UB:Derived from original system description
    connect CalRegn01Inin03GroupC.GlbLimrNotchFilStruct -> AAACalRegn01Inin03GroupC_Dummy.GlbLimrNotchFilStruct  # UB:Derived from original system description
    connect CalRegn01Inin03GroupC.GlbLimrVehSpdBilnrSeln -> AAACalRegn01Inin03GroupC_Dummy.GlbLimrVehSpdBilnrSeln  # UB:Derived from original system description
    connect CalRegn01Inin03GroupD.EotProtnDampgVehSpdTbl -> AAACalRegn01Inin03GroupD_Dummy.EotProtnDampgVehSpdTbl  # UB:Derived from original system description
    connect CalRegn01Inin03GroupD.EotProtnDeltaTqThd -> AAACalRegn01Inin03GroupD_Dummy.EotProtnDeltaTqThd  # UB:Derived from original system description
    connect CalRegn01Inin03GroupD.EotProtnEntrGainAuthyThd -> AAACalRegn01Inin03GroupD_Dummy.EotProtnEntrGainAuthyThd  # UB:Derived from original system description
    connect CalRegn01Inin03GroupD.EotProtnEntrGainVehSpdTbl -> AAACalRegn01Inin03GroupD_Dummy.EotProtnEntrGainVehSpdTbl  # UB:Derived from original system description
    connect CalRegn01Inin03GroupD.EotProtnEntrGainX -> AAACalRegn01Inin03GroupD_Dummy.EotProtnEntrGainX  # UB:Derived from original system description
    connect CalRegn01Inin03GroupD.EotProtnEntrGainY -> AAACalRegn01Inin03GroupD_Dummy.EotProtnEntrGainY  # UB:Derived from original system description
    connect CalRegn01Inin03GroupD.EotProtnEntrStLpFilFrq -> AAACalRegn01Inin03GroupD_Dummy.EotProtnEntrStLpFilFrq  # UB:Derived from original system description
    connect CalRegn01Inin03GroupD.EotProtnExitDampgY -> AAACalRegn01Inin03GroupD_Dummy.EotProtnExitDampgY  # UB:Derived from original system description
    connect CalRegn01Inin03GroupD.EotProtnExitStLpFilFrq -> AAACalRegn01Inin03GroupD_Dummy.EotProtnExitStLpFilFrq  # UB:Derived from original system description
    connect CalRegn01Inin03GroupD.EotProtnHwDegDampgX -> AAACalRegn01Inin03GroupD_Dummy.EotProtnHwDegDampgX  # UB:Derived from original system description
    connect CalRegn01Inin03GroupD.EotProtnHwTqLpFilFrq -> AAACalRegn01Inin03GroupD_Dummy.EotProtnHwTqLpFilFrq  # UB:Derived from original system description
    connect CalRegn01Inin03GroupD.EotProtnHwTqScaX -> AAACalRegn01Inin03GroupD_Dummy.EotProtnHwTqScaX  # UB:Derived from original system description
    connect CalRegn01Inin03GroupD.EotProtnLoAuthyEntrGainY -> AAACalRegn01Inin03GroupD_Dummy.EotProtnLoAuthyEntrGainY  # UB:Derived from original system description
    connect CalRegn01Inin03GroupD.EotProtnMotSpdIncptSca -> AAACalRegn01Inin03GroupD_Dummy.EotProtnMotSpdIncptSca  # UB:Derived from original system description
    connect CalRegn01Inin03GroupD.EotProtnMotSpdIncptX -> AAACalRegn01Inin03GroupD_Dummy.EotProtnMotSpdIncptX  # UB:Derived from original system description
    connect CalRegn01Inin03GroupD.EotProtnMotSpdIncptY -> AAACalRegn01Inin03GroupD_Dummy.EotProtnMotSpdIncptY  # UB:Derived from original system description
    connect CalRegn01Inin03GroupD.EotProtnMotVelGain -> AAACalRegn01Inin03GroupD_Dummy.EotProtnMotVelGain  # UB:Derived from original system description
    connect CalRegn01Inin03GroupD.EotProtnNormDampgY -> AAACalRegn01Inin03GroupD_Dummy.EotProtnNormDampgY  # UB:Derived from original system description
    connect CalRegn01Inin03GroupD.EotProtnPosnRampStep -> AAACalRegn01Inin03GroupD_Dummy.EotProtnPosnRampStep  # UB:Derived from original system description
    connect CalRegn01Inin03GroupD.EotProtnRackTrvlLimrAuthyThd -> AAACalRegn01Inin03GroupD_Dummy.EotProtnRackTrvlLimrAuthyThd  # UB:Derived from original system description
    connect CalRegn01Inin03GroupD.EotProtnRackTrvlLimrAuthyThdLimd -> AAACalRegn01Inin03GroupD_Dummy.EotProtnRackTrvlLimrAuthyThdLimd  # UB:Derived from original system description
    connect CalRegn01Inin03GroupD.EotProtnRackTrvlLimrRng -> AAACalRegn01Inin03GroupD_Dummy.EotProtnRackTrvlLimrRng  # UB:Derived from original system description
    connect CalRegn01Inin03GroupD.EotProtnRackTrvlLimrRngLimd -> AAACalRegn01Inin03GroupD_Dummy.EotProtnRackTrvlLimrRngLimd  # UB:Derived from original system description
    connect CalRegn01Inin03GroupD.EotProtnRackTrvlLimrVehSpdThd -> AAACalRegn01Inin03GroupD_Dummy.EotProtnRackTrvlLimrVehSpdThd  # UB:Derived from original system description
    connect CalRegn01Inin03GroupD.EotProtnRunEotVelImpctAndSoftEndStop -> AAACalRegn01Inin03GroupD_Dummy.EotProtnRunEotVelImpctAndSoftEndStop  # UB:Derived from original system description
    connect CalRegn01Inin03GroupD.InertiaCmpVelAssiBasdDampgCoeffX -> AAACalRegn01Inin03GroupD_Dummy.InertiaCmpVelAssiBasdDampgCoeffX  # UB:Derived from original system description
    connect CalRegn01Inin03GroupD.InertiaCmpVelAssiBasdDampgRollgWhlImbRejctnOnY -> AAACalRegn01Inin03GroupD_Dummy.InertiaCmpVelAssiBasdDampgRollgWhlImbRejctnOnY  # UB:Derived from original system description
    connect CalRegn01Inin03GroupD.InertiaCmpVelAssiBasdDampgRollgY -> AAACalRegn01Inin03GroupD_Dummy.InertiaCmpVelAssiBasdDampgRollgY  # UB:Derived from original system description
    connect CalRegn01Inin03GroupD.InertiaCmpVelAssiBasdDampgStatWhlImbRejctnOnY -> AAACalRegn01Inin03GroupD_Dummy.InertiaCmpVelAssiBasdDampgStatWhlImbRejctnOnY  # UB:Derived from original system description
    connect CalRegn01Inin03GroupD.InertiaCmpVelAssiBasdDampgStatY -> AAACalRegn01Inin03GroupD_Dummy.InertiaCmpVelAssiBasdDampgStatY  # UB:Derived from original system description
    connect CalRegn01Inin03GroupD.InertiaCmpVelCmdScaY -> AAACalRegn01Inin03GroupD_Dummy.InertiaCmpVelCmdScaY  # UB:Derived from original system description
    connect CalRegn01Inin03GroupD.InertiaCmpVelDampgDecelGain -> AAACalRegn01Inin03GroupD_Dummy.InertiaCmpVelDampgDecelGain  # UB:Derived from original system description
    connect CalRegn01Inin03GroupD.InertiaCmpVelDampgDecelGainFallSlew -> AAACalRegn01Inin03GroupD_Dummy.InertiaCmpVelDampgDecelGainFallSlew  # UB:Derived from original system description
    connect CalRegn01Inin03GroupD.InertiaCmpVelDampgDecelGainRisngSlewX -> AAACalRegn01Inin03GroupD_Dummy.InertiaCmpVelDampgDecelGainRisngSlewX  # UB:Derived from original system description
    connect CalRegn01Inin03GroupD.InertiaCmpVelDampgDecelGainRisngSlewY -> AAACalRegn01Inin03GroupD_Dummy.InertiaCmpVelDampgDecelGainRisngSlewY  # UB:Derived from original system description
    connect CalRegn01Inin03GroupD.InertiaCmpVelDampgFilFrq -> AAACalRegn01Inin03GroupD_Dummy.InertiaCmpVelDampgFilFrq  # UB:Derived from original system description
    connect CalRegn01Inin03GroupD.InertiaCmpVelDampgFilFrqWhlImbRejctnOn -> AAACalRegn01Inin03GroupD_Dummy.InertiaCmpVelDampgFilFrqWhlImbRejctnOn  # UB:Derived from original system description
    connect CalRegn01Inin03GroupD.InertiaCmpVelDampgGainOffThd -> AAACalRegn01Inin03GroupD_Dummy.InertiaCmpVelDampgGainOffThd  # UB:Derived from original system description
    connect CalRegn01Inin03GroupD.InertiaCmpVelDampgGainOnThd -> AAACalRegn01Inin03GroupD_Dummy.InertiaCmpVelDampgGainOnThd  # UB:Derived from original system description
    connect CalRegn01Inin03GroupD.InertiaCmpVelDampgSpdBlndY -> AAACalRegn01Inin03GroupD_Dummy.InertiaCmpVelDampgSpdBlndY  # UB:Derived from original system description
    connect CalRegn01Inin03GroupD.InertiaCmpVelDampgWhlImbRejctnBlndX -> AAACalRegn01Inin03GroupD_Dummy.InertiaCmpVelDampgWhlImbRejctnBlndX  # UB:Derived from original system description
    connect CalRegn01Inin03GroupD.InertiaCmpVelDampgWhlImbRejctnBlndY -> AAACalRegn01Inin03GroupD_Dummy.InertiaCmpVelDampgWhlImbRejctnBlndY  # UB:Derived from original system description
    connect CalRegn01Inin03GroupD.InertiaCmpVelDecelGainEnaCal -> AAACalRegn01Inin03GroupD_Dummy.InertiaCmpVelDecelGainEnaCal  # UB:Derived from original system description
    connect CalRegn01Inin03GroupD.InertiaCmpVelModWhlImbRejctnBlndX -> AAACalRegn01Inin03GroupD_Dummy.InertiaCmpVelModWhlImbRejctnBlndX  # UB:Derived from original system description
    connect CalRegn01Inin03GroupD.InertiaCmpVelModWhlImbRejctnBlndY -> AAACalRegn01Inin03GroupD_Dummy.InertiaCmpVelModWhlImbRejctnBlndY  # UB:Derived from original system description
    connect CalRegn01Inin03GroupD.InertiaCmpVelMotInertia -> AAACalRegn01Inin03GroupD_Dummy.InertiaCmpVelMotInertia  # UB:Derived from original system description
    connect CalRegn01Inin03GroupD.InertiaCmpVelMotVelBasdOutpScagX -> AAACalRegn01Inin03GroupD_Dummy.InertiaCmpVelMotVelBasdOutpScagX  # UB:Derived from original system description
    connect CalRegn01Inin03GroupD.InertiaCmpVelMotVelBasdOutpScagY -> AAACalRegn01Inin03GroupD_Dummy.InertiaCmpVelMotVelBasdOutpScagY  # UB:Derived from original system description
    connect CalRegn01Inin03GroupD.InertiaCmpVelNotchBlndY -> AAACalRegn01Inin03GroupD_Dummy.InertiaCmpVelNotchBlndY  # UB:Derived from original system description
    connect CalRegn01Inin03GroupD.InertiaCmpVelNotchFilStruct -> AAACalRegn01Inin03GroupD_Dummy.InertiaCmpVelNotchFilStruct  # UB:Derived from original system description
    connect CalRegn01Inin03GroupD.InertiaCmpVelTqSnsrVelFilFrq -> AAACalRegn01Inin03GroupD_Dummy.InertiaCmpVelTqSnsrVelFilFrq  # UB:Derived from original system description
    connect CalRegn01Inin03GroupD.InertiaCmpVelTqSnsrVelSca -> AAACalRegn01Inin03GroupD_Dummy.InertiaCmpVelTqSnsrVelSca  # UB:Derived from original system description
    connect CalRegn01Inin04.BmwHwAgArbnAndEotPosnKineIntegrityDiagcMaxRackLim -> AAACalRegn01Inin04_Dummy.BmwHwAgArbnAndEotPosnKineIntegrityDiagcMaxRackLim  # UB:Derived from original system description
    connect CalRegn01Inin04.EffortScaBlndX -> AAACalRegn01Inin04_Dummy.EffortScaBlndX  # UB:Derived from original system description
    connect CalRegn01Inin04.EffortScaBlndY -> AAACalRegn01Inin04_Dummy.EffortScaBlndY  # UB:Derived from original system description
    connect CalRegn01Inin04.EffortScaRackFThd -> AAACalRegn01Inin04_Dummy.EffortScaRackFThd  # UB:Derived from original system description
    connect CalRegn01Inin04.PosnTrakgServoArbnFltMtgtnLpFilCutOffFrq -> AAACalRegn01Inin04_Dummy.PosnTrakgServoArbnFltMtgtnLpFilCutOffFrq  # UB:Derived from original system description
    connect CalRegn01Inin04.PullCmpActvHwTqFilFrqLrngEna -> AAACalRegn01Inin04_Dummy.PullCmpActvHwTqFilFrqLrngEna  # UB:Derived from original system description
    connect CalRegn01Inin04.PullCmpActvYawRateFilFrq -> AAACalRegn01Inin04_Dummy.PullCmpActvYawRateFilFrq  # UB:Derived from original system description
    connect CalRegn01Inin04.SysFricLrngAvrgFricFrq -> AAACalRegn01Inin04_Dummy.SysFricLrngAvrgFricFrq  # UB:Derived from original system description
    connect CalRegn01Inin04.SysFricLrngBasLineEolFric -> AAACalRegn01Inin04_Dummy.SysFricLrngBasLineEolFric  # UB:Derived from original system description
    connect CalRegn01Inin04.SysFricLrngBasLineFric -> AAACalRegn01Inin04_Dummy.SysFricLrngBasLineFric  # UB:Derived from original system description
    connect CalRegn01Inin04.SysFricLrngBasLineHys -> AAACalRegn01Inin04_Dummy.SysFricLrngBasLineHys  # UB:Derived from original system description
    connect CalRegn01Inin04.SysFricLrngBasLineRngCntr -> AAACalRegn01Inin04_Dummy.SysFricLrngBasLineRngCntr  # UB:Derived from original system description
    connect CalRegn01Inin04.SysFricLrngDataPrepLpFilFrq -> AAACalRegn01Inin04_Dummy.SysFricLrngDataPrepLpFilFrq  # UB:Derived from original system description
    connect CalRegn01Inin04.SysFricLrngDebStep -> AAACalRegn01Inin04_Dummy.SysFricLrngDebStep  # UB:Derived from original system description
    connect CalRegn01Inin04.SysFricLrngEolFricDifHiLim -> AAACalRegn01Inin04_Dummy.SysFricLrngEolFricDifHiLim  # UB:Derived from original system description
    connect CalRegn01Inin04.SysFricLrngEolFricDifLoLim -> AAACalRegn01Inin04_Dummy.SysFricLrngEolFricDifLoLim  # UB:Derived from original system description
    connect CalRegn01Inin04.SysFricLrngEolFricDifScagFac -> AAACalRegn01Inin04_Dummy.SysFricLrngEolFricDifScagFac  # UB:Derived from original system description
    connect CalRegn01Inin04.SysFricLrngFricChgWght -> AAACalRegn01Inin04_Dummy.SysFricLrngFricChgWght  # UB:Derived from original system description
    connect CalRegn01Inin04.SysFricLrngFricDiagcThd -> AAACalRegn01Inin04_Dummy.SysFricLrngFricDiagcThd  # UB:Derived from original system description
    connect CalRegn01Inin04.SysFricLrngFricHysHwAgPt -> AAACalRegn01Inin04_Dummy.SysFricLrngFricHysHwAgPt  # UB:Derived from original system description
    connect CalRegn01Inin04.SysFricLrngFricOffs -> AAACalRegn01Inin04_Dummy.SysFricLrngFricOffs  # UB:Derived from original system description
    connect CalRegn01Inin04.SysFricLrngFricOffsHiLim -> AAACalRegn01Inin04_Dummy.SysFricLrngFricOffsHiLim  # UB:Derived from original system description
    connect CalRegn01Inin04.SysFricLrngFricOffsLoLim -> AAACalRegn01Inin04_Dummy.SysFricLrngFricOffsLoLim  # UB:Derived from original system description
    connect CalRegn01Inin04.SysFricLrngFricOffsLpFilFrq -> AAACalRegn01Inin04_Dummy.SysFricLrngFricOffsLpFilFrq  # UB:Derived from original system description
    connect CalRegn01Inin04.SysFricLrngGain -> AAACalRegn01Inin04_Dummy.SysFricLrngGain  # UB:Derived from original system description
    connect CalRegn01Inin04.SysFricLrngHiFricDebStep -> AAACalRegn01Inin04_Dummy.SysFricLrngHiFricDebStep  # UB:Derived from original system description
    connect CalRegn01Inin04.SysFricLrngHiFricDiagcThd -> AAACalRegn01Inin04_Dummy.SysFricLrngHiFricDiagcThd  # UB:Derived from original system description
    connect CalRegn01Inin04.SysFricLrngHwPosnAuthyThd -> AAACalRegn01Inin04_Dummy.SysFricLrngHwPosnAuthyThd  # UB:Derived from original system description
    connect CalRegn01Inin04.SysFricLrngHwVelConstrLim -> AAACalRegn01Inin04_Dummy.SysFricLrngHwVelConstrLim  # UB:Derived from original system description
    connect CalRegn01Inin04.SysFricLrngHwVelHiLim -> AAACalRegn01Inin04_Dummy.SysFricLrngHwVelHiLim  # UB:Derived from original system description
    connect CalRegn01Inin04.SysFricLrngHwVelLoLim -> AAACalRegn01Inin04_Dummy.SysFricLrngHwVelLoLim  # UB:Derived from original system description
    connect CalRegn01Inin04.SysFricLrngIgnCycFricChgLim -> AAACalRegn01Inin04_Dummy.SysFricLrngIgnCycFricChgLim  # UB:Derived from original system description
    connect CalRegn01Inin04.SysFricLrngIgnCycFricOffs -> AAACalRegn01Inin04_Dummy.SysFricLrngIgnCycFricOffs  # UB:Derived from original system description
    connect CalRegn01Inin04.SysFricLrngIvsTrsmRatX -> AAACalRegn01Inin04_Dummy.SysFricLrngIvsTrsmRatX  # UB:Derived from original system description
    connect CalRegn01Inin04.SysFricLrngIvsTrsmRatY -> AAACalRegn01Inin04_Dummy.SysFricLrngIvsTrsmRatY  # UB:Derived from original system description
    connect CalRegn01Inin04.SysFricLrngLatAHiLim -> AAACalRegn01Inin04_Dummy.SysFricLrngLatAHiLim  # UB:Derived from original system description
    connect CalRegn01Inin04.SysFricLrngLatALoLim -> AAACalRegn01Inin04_Dummy.SysFricLrngLatALoLim  # UB:Derived from original system description
    connect CalRegn01Inin04.SysFricLrngMaskVehSpd -> AAACalRegn01Inin04_Dummy.SysFricLrngMaskVehSpd  # UB:Derived from original system description
    connect CalRegn01Inin04.SysFricLrngRngCntrThd -> AAACalRegn01Inin04_Dummy.SysFricLrngRngCntrThd  # UB:Derived from original system description
    connect CalRegn01Inin04.SysFricLrngThd -> AAACalRegn01Inin04_Dummy.SysFricLrngThd  # UB:Derived from original system description
    connect CalRegn01Inin04.SysFricLrngTHiLim -> AAACalRegn01Inin04_Dummy.SysFricLrngTHiLim  # UB:Derived from original system description
    connect CalRegn01Inin04.SysFricLrngTLoLim -> AAACalRegn01Inin04_Dummy.SysFricLrngTLoLim  # UB:Derived from original system description
    connect CalRegn01Inin04.SysFricLrngVehSpd -> AAACalRegn01Inin04_Dummy.SysFricLrngVehSpd  # UB:Derived from original system description
    connect CalRegn01Inin04.SysGlbPrmSysKineRat -> AAACalRegn01Inin04_Dummy.SysGlbPrmSysKineRat  # UB:Derived from original system description
    connect CalRegn01Inin04.SysGlbPrmVehSpdBilnrSeln -> AAACalRegn01Inin04_Dummy.SysGlbPrmVehSpdBilnrSeln  # UB:Derived from original system description
    connect CalRegn01Inin04.SysKineAndEffMotAgToRackPosRatScaY -> AAACalRegn01Inin04_Dummy.SysKineAndEffMotAgToRackPosRatScaY  # UB:Derived from original system description
    connect CalRegn01Inin04.SysKineAndEffPinionAgToRackPosRatScaY -> AAACalRegn01Inin04_Dummy.SysKineAndEffPinionAgToRackPosRatScaY  # UB:Derived from original system description
    connect CalRegn01Inin04.SysKineAndEffPinionToRackEffScaY -> AAACalRegn01Inin04_Dummy.SysKineAndEffPinionToRackEffScaY  # UB:Derived from original system description
    connect CalRegn01Inin04.SysKineAndEffRoadWhlFromRackPosScaY -> AAACalRegn01Inin04_Dummy.SysKineAndEffRoadWhlFromRackPosScaY  # UB:Derived from original system description
    connect CalRegn01Inin04.SysKineAndEffSteerArmLenFromRackPosScaY -> AAACalRegn01Inin04_Dummy.SysKineAndEffSteerArmLenFromRackPosScaY  # UB:Derived from original system description
    connect CalRegn01Inin04.TunSelnAuthyVehSpdX -> AAACalRegn01Inin04_Dummy.TunSelnAuthyVehSpdX  # UB:Derived from original system description
    connect CalRegn01Inin04GroupA.BmwHwAgArbnAndEotPosnEotCcwMax -> AAACalRegn01Inin04GroupA_Dummy.BmwHwAgArbnAndEotPosnEotCcwMax  # UB:Derived from original system description
    connect CalRegn01Inin04GroupA.BmwHwAgArbnAndEotPosnEotCcwMin -> AAACalRegn01Inin04GroupA_Dummy.BmwHwAgArbnAndEotPosnEotCcwMin  # UB:Derived from original system description
    connect CalRegn01Inin04GroupA.BmwHwAgArbnAndEotPosnEotCwMax -> AAACalRegn01Inin04GroupA_Dummy.BmwHwAgArbnAndEotPosnEotCwMax  # UB:Derived from original system description
    connect CalRegn01Inin04GroupA.BmwHwAgArbnAndEotPosnEotCwMin -> AAACalRegn01Inin04GroupA_Dummy.BmwHwAgArbnAndEotPosnEotCwMin  # UB:Derived from original system description
    connect CalRegn01Inin04GroupA.BmwPwrPrkgDampgDiScadDampg -> AAACalRegn01Inin04GroupA_Dummy.BmwPwrPrkgDampgDiScadDampg  # UB:Derived from original system description
    connect CalRegn01Inin04GroupA.BmwPwrPrkgDampgMaxRate -> AAACalRegn01Inin04GroupA_Dummy.BmwPwrPrkgDampgMaxRate  # UB:Derived from original system description
    connect CalRegn01Inin04GroupA.EpsStEstimnMtrxA -> AAACalRegn01Inin04GroupA_Dummy.EpsStEstimnMtrxA  # UB:Derived from original system description
    connect CalRegn01Inin04GroupA.EpsStEstimnMtrxB -> AAACalRegn01Inin04GroupA_Dummy.EpsStEstimnMtrxB  # UB:Derived from original system description
    connect CalRegn01Inin04GroupA.EpsStEstimnMtrxC -> AAACalRegn01Inin04GroupA_Dummy.EpsStEstimnMtrxC  # UB:Derived from original system description
    connect CalRegn01Inin04GroupA.EpsStEstimnMtrxD -> AAACalRegn01Inin04GroupA_Dummy.EpsStEstimnMtrxD  # UB:Derived from original system description
    connect CalRegn01Inin04GroupA.HwTqTrakgCtrlFbGain{1..5} -> AAACalRegn01Inin04GroupA_Dummy.HwTqTrakgCtrlFbGain{1..5}  # UB:Derived from original system description
    connect CalRegn01Inin04GroupA.HwTqTrakgCtrlFfGainScaY -> AAACalRegn01Inin04GroupA_Dummy.HwTqTrakgCtrlFfGainScaY  # UB:Derived from original system description
    connect CalRegn01Inin04GroupA.HwTqTrakgCtrlVehSpdScaX -> AAACalRegn01Inin04GroupA_Dummy.HwTqTrakgCtrlVehSpdScaX  # UB:Derived from original system description
    connect CalRegn01Inin04GroupA.PosnTrakgServoEnaBlndFacTblX -> AAACalRegn01Inin04GroupA_Dummy.PosnTrakgServoEnaBlndFacTblX  # UB:Derived from original system description
    connect CalRegn01Inin04GroupA.PosnTrakgServoEnaBlndFacTblY -> AAACalRegn01Inin04GroupA_Dummy.PosnTrakgServoEnaBlndFacTblY  # UB:Derived from original system description
    connect CalRegn01Inin04GroupA.PosnTrakgServoGainArbnFltMtgtn -> AAACalRegn01Inin04GroupA_Dummy.PosnTrakgServoGainArbnFltMtgtn  # UB:Derived from original system description
    connect CalRegn01Inin04GroupA.PullCmpActvCmpLrnTiDecShoTerm -> AAACalRegn01Inin04GroupA_Dummy.PullCmpActvCmpLrnTiDecShoTerm  # UB:Derived from original system description
    connect CalRegn01Inin04GroupA.PullCmpActvCmpLrnTiIncShoTerm -> AAACalRegn01Inin04GroupA_Dummy.PullCmpActvCmpLrnTiIncShoTerm  # UB:Derived from original system description
    connect CalRegn01Inin04GroupA.PullCmpActvCmpLrnTiLongTerm -> AAACalRegn01Inin04GroupA_Dummy.PullCmpActvCmpLrnTiLongTerm  # UB:Derived from original system description
    connect CalRegn01Inin04GroupA.PullCmpActvCmpShoTermRstHwAgThd -> AAACalRegn01Inin04GroupA_Dummy.PullCmpActvCmpShoTermRstHwAgThd  # UB:Derived from original system description
    connect CalRegn01Inin04GroupA.PullCmpActvCmpShoTermRstHwTqThd -> AAACalRegn01Inin04GroupA_Dummy.PullCmpActvCmpShoTermRstHwTqThd  # UB:Derived from original system description
    connect CalRegn01Inin04GroupA.PullCmpActvCmpShoTermRstLatAThd -> AAACalRegn01Inin04GroupA_Dummy.PullCmpActvCmpShoTermRstLatAThd  # UB:Derived from original system description
    connect CalRegn01Inin04GroupA.PullCmpActvCmpShoTermRstYawRateThd -> AAACalRegn01Inin04GroupA_Dummy.PullCmpActvCmpShoTermRstYawRateThd  # UB:Derived from original system description
    connect CalRegn01Inin04GroupA.PullCmpActvEna -> AAACalRegn01Inin04GroupA_Dummy.PullCmpActvEna  # UB:Derived from original system description
    connect CalRegn01Inin04GroupA.PullCmpActvHwTqFilFrqLongTerm -> AAACalRegn01Inin04GroupA_Dummy.PullCmpActvHwTqFilFrqLongTerm  # UB:Derived from original system description
    connect CalRegn01Inin04GroupA.PullCmpActvHwTqFilFrqShoTerm -> AAACalRegn01Inin04GroupA_Dummy.PullCmpActvHwTqFilFrqShoTerm  # UB:Derived from original system description
    connect CalRegn01Inin04GroupA.PullCmpActvLongTermLim -> AAACalRegn01Inin04GroupA_Dummy.PullCmpActvLongTermLim  # UB:Derived from original system description
    connect CalRegn01Inin04GroupA.PullCmpActvLrngEnaAgConfMinMgn -> AAACalRegn01Inin04GroupA_Dummy.PullCmpActvLrngEnaAgConfMinMgn  # UB:Derived from original system description
    connect CalRegn01Inin04GroupA.PullCmpActvLrngEnaHwAgMaxMgn -> AAACalRegn01Inin04GroupA_Dummy.PullCmpActvLrngEnaHwAgMaxMgn  # UB:Derived from original system description
    connect CalRegn01Inin04GroupA.PullCmpActvLrngEnaHwTqMaxMgn -> AAACalRegn01Inin04GroupA_Dummy.PullCmpActvLrngEnaHwTqMaxMgn  # UB:Derived from original system description
    connect CalRegn01Inin04GroupA.PullCmpActvLrngEnaHwVelMaxMgn -> AAACalRegn01Inin04GroupA_Dummy.PullCmpActvLrngEnaHwVelMaxMgn  # UB:Derived from original system description
    connect CalRegn01Inin04GroupA.PullCmpActvLrngEnaLatAMaxMgn -> AAACalRegn01Inin04GroupA_Dummy.PullCmpActvLrngEnaLatAMaxMgn  # UB:Derived from original system description
    connect CalRegn01Inin04GroupA.PullCmpActvLrngEnaTiThd -> AAACalRegn01Inin04GroupA_Dummy.PullCmpActvLrngEnaTiThd  # UB:Derived from original system description
    connect CalRegn01Inin04GroupA.PullCmpActvLrngEnaVehSpdMaxMgn -> AAACalRegn01Inin04GroupA_Dummy.PullCmpActvLrngEnaVehSpdMaxMgn  # UB:Derived from original system description
    connect CalRegn01Inin04GroupA.PullCmpActvLrngEnaVehSpdMinMgn -> AAACalRegn01Inin04GroupA_Dummy.PullCmpActvLrngEnaVehSpdMinMgn  # UB:Derived from original system description
    connect CalRegn01Inin04GroupA.PullCmpActvLrngEnaVehSpdRateMaxMgn -> AAACalRegn01Inin04GroupA_Dummy.PullCmpActvLrngEnaVehSpdRateMaxMgn  # UB:Derived from original system description
    connect CalRegn01Inin04GroupA.PullCmpActvLrngEnaYawRateMaxMgn -> AAACalRegn01Inin04GroupA_Dummy.PullCmpActvLrngEnaYawRateMaxMgn  # UB:Derived from original system description
    connect CalRegn01Inin04GroupA.PullCmpActvOpstSignTiShoTerm -> AAACalRegn01Inin04GroupA_Dummy.PullCmpActvOpstSignTiShoTerm  # UB:Derived from original system description
    connect CalRegn01Inin04GroupA.PullCmpActvOutpMaxRate -> AAACalRegn01Inin04GroupA_Dummy.PullCmpActvOutpMaxRate  # UB:Derived from original system description
    connect CalRegn01Inin04GroupA.PullCmpActvPullCmpShoTermLim -> AAACalRegn01Inin04GroupA_Dummy.PullCmpActvPullCmpShoTermLim  # UB:Derived from original system description
    connect CalRegn01Inin04GroupA.PullCmpActvPullCmpTotLim -> AAACalRegn01Inin04GroupA_Dummy.PullCmpActvPullCmpTotLim  # UB:Derived from original system description
    connect CalRegn01Inin04GroupA.PullCmpActvPullErrLimLongTerm -> AAACalRegn01Inin04GroupA_Dummy.PullCmpActvPullErrLimLongTerm  # UB:Derived from original system description
    connect CalRegn01Inin04GroupA.PullCmpActvPullErrMgnThd -> AAACalRegn01Inin04GroupA_Dummy.PullCmpActvPullErrMgnThd  # UB:Derived from original system description
    connect CalRegn01Inin04GroupA.PullCmpActvPullErrShoTermLim -> AAACalRegn01Inin04GroupA_Dummy.PullCmpActvPullErrShoTermLim  # UB:Derived from original system description
    connect CalRegn01Inin04GroupA.PullCmpActvShoTermRampTi -> AAACalRegn01Inin04GroupA_Dummy.PullCmpActvShoTermRampTi  # UB:Derived from original system description
    connect CalRegn01Inin04GroupA.PullCmpActvVehSpdScaTblX -> AAACalRegn01Inin04GroupA_Dummy.PullCmpActvVehSpdScaTblX  # UB:Derived from original system description
    connect CalRegn01Inin04GroupA.PullCmpActvVehSpdScaTblY -> AAACalRegn01Inin04GroupA_Dummy.PullCmpActvVehSpdScaTblY  # UB:Derived from original system description
    connect CalRegn01Inin04GroupC.CtrldVelRtnDesVelLpFilFrq -> AAACalRegn01Inin04GroupC_Dummy.CtrldVelRtnDesVelLpFilFrq  # UB:Derived from original system description
    connect CalRegn01Inin04GroupC.CtrldVelRtnHwTqLpFilFrq -> AAACalRegn01Inin04GroupC_Dummy.CtrldVelRtnHwTqLpFilFrq  # UB:Derived from original system description
    connect CalRegn01Inin04GroupC.CtrldVelRtnHwTqScaSelnSlewHiLim -> AAACalRegn01Inin04GroupC_Dummy.CtrldVelRtnHwTqScaSelnSlewHiLim  # UB:Derived from original system description
    connect CalRegn01Inin04GroupC.CtrldVelRtnHwTqScaSelnSlewLoLim -> AAACalRegn01Inin04GroupC_Dummy.CtrldVelRtnHwTqScaSelnSlewLoLim  # UB:Derived from original system description
    connect CalRegn01Inin04GroupC.CtrldVelRtnHwTqScaSelnTqThd -> AAACalRegn01Inin04GroupC_Dummy.CtrldVelRtnHwTqScaSelnTqThd  # UB:Derived from original system description
    connect CalRegn01Inin04GroupC.CtrldVelRtnHwTqScaSelnVelThd -> AAACalRegn01Inin04GroupC_Dummy.CtrldVelRtnHwTqScaSelnVelThd  # UB:Derived from original system description
    connect CalRegn01Inin04GroupC.CtrldVelRtnIntgrLimY -> AAACalRegn01Inin04GroupC_Dummy.CtrldVelRtnIntgrLimY  # UB:Derived from original system description
    connect CalRegn01Inin04GroupC.CtrldVelRtnOffsSlewThd -> AAACalRegn01Inin04GroupC_Dummy.CtrldVelRtnOffsSlewThd  # UB:Derived from original system description
    connect CalRegn01Inin04GroupC.CtrldVelRtnOffsThd -> AAACalRegn01Inin04GroupC_Dummy.CtrldVelRtnOffsThd  # UB:Derived from original system description
    connect CalRegn01Inin04GroupC.CtrldVelRtnScaLpFilFrq -> AAACalRegn01Inin04GroupC_Dummy.CtrldVelRtnScaLpFilFrq  # UB:Derived from original system description
    connect CalRegn01Inin04GroupC.FalbckAssiAssiX -> AAACalRegn01Inin04GroupC_Dummy.FalbckAssiAssiX  # UB:Derived from original system description
    connect CalRegn01Inin04GroupC.FalbckAssiAssiY -> AAACalRegn01Inin04GroupC_Dummy.FalbckAssiAssiY  # UB:Derived from original system description
    connect CalRegn01Inin04GroupC.FalbckAssiNotchFil -> AAACalRegn01Inin04GroupC_Dummy.FalbckAssiNotchFil  # UB:Derived from original system description
    connect CalRegn01Inin04GroupC.GlbLimrBndX -> AAACalRegn01Inin04GroupC_Dummy.GlbLimrBndX  # UB:Derived from original system description
    connect CalRegn01Inin04GroupC.GlbLimrBndY -> AAACalRegn01Inin04GroupC_Dummy.GlbLimrBndY  # UB:Derived from original system description
    connect CalRegn01Inin04GroupC.GlbLimrNotchFilStruct -> AAACalRegn01Inin04GroupC_Dummy.GlbLimrNotchFilStruct  # UB:Derived from original system description
    connect CalRegn01Inin04GroupC.GlbLimrVehSpdBilnrSeln -> AAACalRegn01Inin04GroupC_Dummy.GlbLimrVehSpdBilnrSeln  # UB:Derived from original system description
    connect CalRegn01Inin04GroupD.EotProtnDampgVehSpdTbl -> AAACalRegn01Inin04GroupD_Dummy.EotProtnDampgVehSpdTbl  # UB:Derived from original system description
    connect CalRegn01Inin04GroupD.EotProtnDeltaTqThd -> AAACalRegn01Inin04GroupD_Dummy.EotProtnDeltaTqThd  # UB:Derived from original system description
    connect CalRegn01Inin04GroupD.EotProtnEntrGainAuthyThd -> AAACalRegn01Inin04GroupD_Dummy.EotProtnEntrGainAuthyThd  # UB:Derived from original system description
    connect CalRegn01Inin04GroupD.EotProtnEntrGainVehSpdTbl -> AAACalRegn01Inin04GroupD_Dummy.EotProtnEntrGainVehSpdTbl  # UB:Derived from original system description
    connect CalRegn01Inin04GroupD.EotProtnEntrGainX -> AAACalRegn01Inin04GroupD_Dummy.EotProtnEntrGainX  # UB:Derived from original system description
    connect CalRegn01Inin04GroupD.EotProtnEntrGainY -> AAACalRegn01Inin04GroupD_Dummy.EotProtnEntrGainY  # UB:Derived from original system description
    connect CalRegn01Inin04GroupD.EotProtnEntrStLpFilFrq -> AAACalRegn01Inin04GroupD_Dummy.EotProtnEntrStLpFilFrq  # UB:Derived from original system description
    connect CalRegn01Inin04GroupD.EotProtnExitDampgY -> AAACalRegn01Inin04GroupD_Dummy.EotProtnExitDampgY  # UB:Derived from original system description
    connect CalRegn01Inin04GroupD.EotProtnExitStLpFilFrq -> AAACalRegn01Inin04GroupD_Dummy.EotProtnExitStLpFilFrq  # UB:Derived from original system description
    connect CalRegn01Inin04GroupD.EotProtnHwDegDampgX -> AAACalRegn01Inin04GroupD_Dummy.EotProtnHwDegDampgX  # UB:Derived from original system description
    connect CalRegn01Inin04GroupD.EotProtnHwTqLpFilFrq -> AAACalRegn01Inin04GroupD_Dummy.EotProtnHwTqLpFilFrq  # UB:Derived from original system description
    connect CalRegn01Inin04GroupD.EotProtnHwTqScaX -> AAACalRegn01Inin04GroupD_Dummy.EotProtnHwTqScaX  # UB:Derived from original system description
    connect CalRegn01Inin04GroupD.EotProtnLoAuthyEntrGainY -> AAACalRegn01Inin04GroupD_Dummy.EotProtnLoAuthyEntrGainY  # UB:Derived from original system description
    connect CalRegn01Inin04GroupD.EotProtnMotSpdIncptSca -> AAACalRegn01Inin04GroupD_Dummy.EotProtnMotSpdIncptSca  # UB:Derived from original system description
    connect CalRegn01Inin04GroupD.EotProtnMotSpdIncptX -> AAACalRegn01Inin04GroupD_Dummy.EotProtnMotSpdIncptX  # UB:Derived from original system description
    connect CalRegn01Inin04GroupD.EotProtnMotSpdIncptY -> AAACalRegn01Inin04GroupD_Dummy.EotProtnMotSpdIncptY  # UB:Derived from original system description
    connect CalRegn01Inin04GroupD.EotProtnMotVelGain -> AAACalRegn01Inin04GroupD_Dummy.EotProtnMotVelGain  # UB:Derived from original system description
    connect CalRegn01Inin04GroupD.EotProtnNormDampgY -> AAACalRegn01Inin04GroupD_Dummy.EotProtnNormDampgY  # UB:Derived from original system description
    connect CalRegn01Inin04GroupD.EotProtnPosnRampStep -> AAACalRegn01Inin04GroupD_Dummy.EotProtnPosnRampStep  # UB:Derived from original system description
    connect CalRegn01Inin04GroupD.EotProtnRackTrvlLimrAuthyThd -> AAACalRegn01Inin04GroupD_Dummy.EotProtnRackTrvlLimrAuthyThd  # UB:Derived from original system description
    connect CalRegn01Inin04GroupD.EotProtnRackTrvlLimrAuthyThdLimd -> AAACalRegn01Inin04GroupD_Dummy.EotProtnRackTrvlLimrAuthyThdLimd  # UB:Derived from original system description
    connect CalRegn01Inin04GroupD.EotProtnRackTrvlLimrRng -> AAACalRegn01Inin04GroupD_Dummy.EotProtnRackTrvlLimrRng  # UB:Derived from original system description
    connect CalRegn01Inin04GroupD.EotProtnRackTrvlLimrRngLimd -> AAACalRegn01Inin04GroupD_Dummy.EotProtnRackTrvlLimrRngLimd  # UB:Derived from original system description
    connect CalRegn01Inin04GroupD.EotProtnRackTrvlLimrVehSpdThd -> AAACalRegn01Inin04GroupD_Dummy.EotProtnRackTrvlLimrVehSpdThd  # UB:Derived from original system description
    connect CalRegn01Inin04GroupD.EotProtnRunEotVelImpctAndSoftEndStop -> AAACalRegn01Inin04GroupD_Dummy.EotProtnRunEotVelImpctAndSoftEndStop  # UB:Derived from original system description
    connect CalRegn01Inin04GroupD.InertiaCmpVelAssiBasdDampgCoeffX -> AAACalRegn01Inin04GroupD_Dummy.InertiaCmpVelAssiBasdDampgCoeffX  # UB:Derived from original system description
    connect CalRegn01Inin04GroupD.InertiaCmpVelAssiBasdDampgRollgWhlImbRejctnOnY -> AAACalRegn01Inin04GroupD_Dummy.InertiaCmpVelAssiBasdDampgRollgWhlImbRejctnOnY  # UB:Derived from original system description
    connect CalRegn01Inin04GroupD.InertiaCmpVelAssiBasdDampgRollgY -> AAACalRegn01Inin04GroupD_Dummy.InertiaCmpVelAssiBasdDampgRollgY  # UB:Derived from original system description
    connect CalRegn01Inin04GroupD.InertiaCmpVelAssiBasdDampgStatWhlImbRejctnOnY -> AAACalRegn01Inin04GroupD_Dummy.InertiaCmpVelAssiBasdDampgStatWhlImbRejctnOnY  # UB:Derived from original system description
    connect CalRegn01Inin04GroupD.InertiaCmpVelAssiBasdDampgStatY -> AAACalRegn01Inin04GroupD_Dummy.InertiaCmpVelAssiBasdDampgStatY  # UB:Derived from original system description
    connect CalRegn01Inin04GroupD.InertiaCmpVelCmdScaY -> AAACalRegn01Inin04GroupD_Dummy.InertiaCmpVelCmdScaY  # UB:Derived from original system description
    connect CalRegn01Inin04GroupD.InertiaCmpVelDampgDecelGain -> AAACalRegn01Inin04GroupD_Dummy.InertiaCmpVelDampgDecelGain  # UB:Derived from original system description
    connect CalRegn01Inin04GroupD.InertiaCmpVelDampgDecelGainFallSlew -> AAACalRegn01Inin04GroupD_Dummy.InertiaCmpVelDampgDecelGainFallSlew  # UB:Derived from original system description
    connect CalRegn01Inin04GroupD.InertiaCmpVelDampgDecelGainRisngSlewX -> AAACalRegn01Inin04GroupD_Dummy.InertiaCmpVelDampgDecelGainRisngSlewX  # UB:Derived from original system description
    connect CalRegn01Inin04GroupD.InertiaCmpVelDampgDecelGainRisngSlewY -> AAACalRegn01Inin04GroupD_Dummy.InertiaCmpVelDampgDecelGainRisngSlewY  # UB:Derived from original system description
    connect CalRegn01Inin04GroupD.InertiaCmpVelDampgFilFrq -> AAACalRegn01Inin04GroupD_Dummy.InertiaCmpVelDampgFilFrq  # UB:Derived from original system description
    connect CalRegn01Inin04GroupD.InertiaCmpVelDampgFilFrqWhlImbRejctnOn -> AAACalRegn01Inin04GroupD_Dummy.InertiaCmpVelDampgFilFrqWhlImbRejctnOn  # UB:Derived from original system description
    connect CalRegn01Inin04GroupD.InertiaCmpVelDampgGainOffThd -> AAACalRegn01Inin04GroupD_Dummy.InertiaCmpVelDampgGainOffThd  # UB:Derived from original system description
    connect CalRegn01Inin04GroupD.InertiaCmpVelDampgGainOnThd -> AAACalRegn01Inin04GroupD_Dummy.InertiaCmpVelDampgGainOnThd  # UB:Derived from original system description
    connect CalRegn01Inin04GroupD.InertiaCmpVelDampgSpdBlndY -> AAACalRegn01Inin04GroupD_Dummy.InertiaCmpVelDampgSpdBlndY  # UB:Derived from original system description
    connect CalRegn01Inin04GroupD.InertiaCmpVelDampgWhlImbRejctnBlndX -> AAACalRegn01Inin04GroupD_Dummy.InertiaCmpVelDampgWhlImbRejctnBlndX  # UB:Derived from original system description
    connect CalRegn01Inin04GroupD.InertiaCmpVelDampgWhlImbRejctnBlndY -> AAACalRegn01Inin04GroupD_Dummy.InertiaCmpVelDampgWhlImbRejctnBlndY  # UB:Derived from original system description
    connect CalRegn01Inin04GroupD.InertiaCmpVelDecelGainEnaCal -> AAACalRegn01Inin04GroupD_Dummy.InertiaCmpVelDecelGainEnaCal  # UB:Derived from original system description
    connect CalRegn01Inin04GroupD.InertiaCmpVelModWhlImbRejctnBlndX -> AAACalRegn01Inin04GroupD_Dummy.InertiaCmpVelModWhlImbRejctnBlndX  # UB:Derived from original system description
    connect CalRegn01Inin04GroupD.InertiaCmpVelModWhlImbRejctnBlndY -> AAACalRegn01Inin04GroupD_Dummy.InertiaCmpVelModWhlImbRejctnBlndY  # UB:Derived from original system description
    connect CalRegn01Inin04GroupD.InertiaCmpVelMotInertia -> AAACalRegn01Inin04GroupD_Dummy.InertiaCmpVelMotInertia  # UB:Derived from original system description
    connect CalRegn01Inin04GroupD.InertiaCmpVelMotVelBasdOutpScagX -> AAACalRegn01Inin04GroupD_Dummy.InertiaCmpVelMotVelBasdOutpScagX  # UB:Derived from original system description
    connect CalRegn01Inin04GroupD.InertiaCmpVelMotVelBasdOutpScagY -> AAACalRegn01Inin04GroupD_Dummy.InertiaCmpVelMotVelBasdOutpScagY  # UB:Derived from original system description
    connect CalRegn01Inin04GroupD.InertiaCmpVelNotchBlndY -> AAACalRegn01Inin04GroupD_Dummy.InertiaCmpVelNotchBlndY  # UB:Derived from original system description
    connect CalRegn01Inin04GroupD.InertiaCmpVelNotchFilStruct -> AAACalRegn01Inin04GroupD_Dummy.InertiaCmpVelNotchFilStruct  # UB:Derived from original system description
    connect CalRegn01Inin04GroupD.InertiaCmpVelTqSnsrVelFilFrq -> AAACalRegn01Inin04GroupD_Dummy.InertiaCmpVelTqSnsrVelFilFrq  # UB:Derived from original system description
    connect CalRegn01Inin04GroupD.InertiaCmpVelTqSnsrVelSca -> AAACalRegn01Inin04GroupD_Dummy.InertiaCmpVelTqSnsrVelSca  # UB:Derived from original system description
    connect CalRegn01Inin05.BmwHwAgArbnAndEotPosnKineIntegrityDiagcMaxRackLim -> AAACalRegn01Inin05_Dummy.BmwHwAgArbnAndEotPosnKineIntegrityDiagcMaxRackLim  # UB:Derived from original system description
    connect CalRegn01Inin05.EffortScaBlndX -> AAACalRegn01Inin05_Dummy.EffortScaBlndX  # UB:Derived from original system description
    connect CalRegn01Inin05.EffortScaBlndY -> AAACalRegn01Inin05_Dummy.EffortScaBlndY  # UB:Derived from original system description
    connect CalRegn01Inin05.EffortScaRackFThd -> AAACalRegn01Inin05_Dummy.EffortScaRackFThd  # UB:Derived from original system description
    connect CalRegn01Inin05.PosnTrakgServoArbnFltMtgtnLpFilCutOffFrq -> AAACalRegn01Inin05_Dummy.PosnTrakgServoArbnFltMtgtnLpFilCutOffFrq  # UB:Derived from original system description
    connect CalRegn01Inin05.PullCmpActvHwTqFilFrqLrngEna -> AAACalRegn01Inin05_Dummy.PullCmpActvHwTqFilFrqLrngEna  # UB:Derived from original system description
    connect CalRegn01Inin05.PullCmpActvYawRateFilFrq -> AAACalRegn01Inin05_Dummy.PullCmpActvYawRateFilFrq  # UB:Derived from original system description
    connect CalRegn01Inin05.SysFricLrngAvrgFricFrq -> AAACalRegn01Inin05_Dummy.SysFricLrngAvrgFricFrq  # UB:Derived from original system description
    connect CalRegn01Inin05.SysFricLrngBasLineEolFric -> AAACalRegn01Inin05_Dummy.SysFricLrngBasLineEolFric  # UB:Derived from original system description
    connect CalRegn01Inin05.SysFricLrngBasLineFric -> AAACalRegn01Inin05_Dummy.SysFricLrngBasLineFric  # UB:Derived from original system description
    connect CalRegn01Inin05.SysFricLrngBasLineHys -> AAACalRegn01Inin05_Dummy.SysFricLrngBasLineHys  # UB:Derived from original system description
    connect CalRegn01Inin05.SysFricLrngBasLineRngCntr -> AAACalRegn01Inin05_Dummy.SysFricLrngBasLineRngCntr  # UB:Derived from original system description
    connect CalRegn01Inin05.SysFricLrngDataPrepLpFilFrq -> AAACalRegn01Inin05_Dummy.SysFricLrngDataPrepLpFilFrq  # UB:Derived from original system description
    connect CalRegn01Inin05.SysFricLrngDebStep -> AAACalRegn01Inin05_Dummy.SysFricLrngDebStep  # UB:Derived from original system description
    connect CalRegn01Inin05.SysFricLrngEolFricDifHiLim -> AAACalRegn01Inin05_Dummy.SysFricLrngEolFricDifHiLim  # UB:Derived from original system description
    connect CalRegn01Inin05.SysFricLrngEolFricDifLoLim -> AAACalRegn01Inin05_Dummy.SysFricLrngEolFricDifLoLim  # UB:Derived from original system description
    connect CalRegn01Inin05.SysFricLrngEolFricDifScagFac -> AAACalRegn01Inin05_Dummy.SysFricLrngEolFricDifScagFac  # UB:Derived from original system description
    connect CalRegn01Inin05.SysFricLrngFricChgWght -> AAACalRegn01Inin05_Dummy.SysFricLrngFricChgWght  # UB:Derived from original system description
    connect CalRegn01Inin05.SysFricLrngFricDiagcThd -> AAACalRegn01Inin05_Dummy.SysFricLrngFricDiagcThd  # UB:Derived from original system description
    connect CalRegn01Inin05.SysFricLrngFricHysHwAgPt -> AAACalRegn01Inin05_Dummy.SysFricLrngFricHysHwAgPt  # UB:Derived from original system description
    connect CalRegn01Inin05.SysFricLrngFricOffs -> AAACalRegn01Inin05_Dummy.SysFricLrngFricOffs  # UB:Derived from original system description
    connect CalRegn01Inin05.SysFricLrngFricOffsHiLim -> AAACalRegn01Inin05_Dummy.SysFricLrngFricOffsHiLim  # UB:Derived from original system description
    connect CalRegn01Inin05.SysFricLrngFricOffsLoLim -> AAACalRegn01Inin05_Dummy.SysFricLrngFricOffsLoLim  # UB:Derived from original system description
    connect CalRegn01Inin05.SysFricLrngFricOffsLpFilFrq -> AAACalRegn01Inin05_Dummy.SysFricLrngFricOffsLpFilFrq  # UB:Derived from original system description
    connect CalRegn01Inin05.SysFricLrngGain -> AAACalRegn01Inin05_Dummy.SysFricLrngGain  # UB:Derived from original system description
    connect CalRegn01Inin05.SysFricLrngHiFricDebStep -> AAACalRegn01Inin05_Dummy.SysFricLrngHiFricDebStep  # UB:Derived from original system description
    connect CalRegn01Inin05.SysFricLrngHiFricDiagcThd -> AAACalRegn01Inin05_Dummy.SysFricLrngHiFricDiagcThd  # UB:Derived from original system description
    connect CalRegn01Inin05.SysFricLrngHwPosnAuthyThd -> AAACalRegn01Inin05_Dummy.SysFricLrngHwPosnAuthyThd  # UB:Derived from original system description
    connect CalRegn01Inin05.SysFricLrngHwVelConstrLim -> AAACalRegn01Inin05_Dummy.SysFricLrngHwVelConstrLim  # UB:Derived from original system description
    connect CalRegn01Inin05.SysFricLrngHwVelHiLim -> AAACalRegn01Inin05_Dummy.SysFricLrngHwVelHiLim  # UB:Derived from original system description
    connect CalRegn01Inin05.SysFricLrngHwVelLoLim -> AAACalRegn01Inin05_Dummy.SysFricLrngHwVelLoLim  # UB:Derived from original system description
    connect CalRegn01Inin05.SysFricLrngIgnCycFricChgLim -> AAACalRegn01Inin05_Dummy.SysFricLrngIgnCycFricChgLim  # UB:Derived from original system description
    connect CalRegn01Inin05.SysFricLrngIgnCycFricOffs -> AAACalRegn01Inin05_Dummy.SysFricLrngIgnCycFricOffs  # UB:Derived from original system description
    connect CalRegn01Inin05.SysFricLrngIvsTrsmRatX -> AAACalRegn01Inin05_Dummy.SysFricLrngIvsTrsmRatX  # UB:Derived from original system description
    connect CalRegn01Inin05.SysFricLrngIvsTrsmRatY -> AAACalRegn01Inin05_Dummy.SysFricLrngIvsTrsmRatY  # UB:Derived from original system description
    connect CalRegn01Inin05.SysFricLrngLatAHiLim -> AAACalRegn01Inin05_Dummy.SysFricLrngLatAHiLim  # UB:Derived from original system description
    connect CalRegn01Inin05.SysFricLrngLatALoLim -> AAACalRegn01Inin05_Dummy.SysFricLrngLatALoLim  # UB:Derived from original system description
    connect CalRegn01Inin05.SysFricLrngMaskVehSpd -> AAACalRegn01Inin05_Dummy.SysFricLrngMaskVehSpd  # UB:Derived from original system description
    connect CalRegn01Inin05.SysFricLrngRngCntrThd -> AAACalRegn01Inin05_Dummy.SysFricLrngRngCntrThd  # UB:Derived from original system description
    connect CalRegn01Inin05.SysFricLrngThd -> AAACalRegn01Inin05_Dummy.SysFricLrngThd  # UB:Derived from original system description
    connect CalRegn01Inin05.SysFricLrngTHiLim -> AAACalRegn01Inin05_Dummy.SysFricLrngTHiLim  # UB:Derived from original system description
    connect CalRegn01Inin05.SysFricLrngTLoLim -> AAACalRegn01Inin05_Dummy.SysFricLrngTLoLim  # UB:Derived from original system description
    connect CalRegn01Inin05.SysFricLrngVehSpd -> AAACalRegn01Inin05_Dummy.SysFricLrngVehSpd  # UB:Derived from original system description
    connect CalRegn01Inin05.SysGlbPrmSysKineRat -> AAACalRegn01Inin05_Dummy.SysGlbPrmSysKineRat  # UB:Derived from original system description
    connect CalRegn01Inin05.SysGlbPrmVehSpdBilnrSeln -> AAACalRegn01Inin05_Dummy.SysGlbPrmVehSpdBilnrSeln  # UB:Derived from original system description
    connect CalRegn01Inin05.SysKineAndEffMotAgToRackPosRatScaY -> AAACalRegn01Inin05_Dummy.SysKineAndEffMotAgToRackPosRatScaY  # UB:Derived from original system description
    connect CalRegn01Inin05.SysKineAndEffPinionAgToRackPosRatScaY -> AAACalRegn01Inin05_Dummy.SysKineAndEffPinionAgToRackPosRatScaY  # UB:Derived from original system description
    connect CalRegn01Inin05.SysKineAndEffPinionToRackEffScaY -> AAACalRegn01Inin05_Dummy.SysKineAndEffPinionToRackEffScaY  # UB:Derived from original system description
    connect CalRegn01Inin05.SysKineAndEffRoadWhlFromRackPosScaY -> AAACalRegn01Inin05_Dummy.SysKineAndEffRoadWhlFromRackPosScaY  # UB:Derived from original system description
    connect CalRegn01Inin05.SysKineAndEffSteerArmLenFromRackPosScaY -> AAACalRegn01Inin05_Dummy.SysKineAndEffSteerArmLenFromRackPosScaY  # UB:Derived from original system description
    connect CalRegn01Inin05.TunSelnAuthyVehSpdX -> AAACalRegn01Inin05_Dummy.TunSelnAuthyVehSpdX  # UB:Derived from original system description
    connect CalRegn01Inin05GroupA.BmwHwAgArbnAndEotPosnEotCcwMax -> AAACalRegn01Inin05GroupA_Dummy.BmwHwAgArbnAndEotPosnEotCcwMax  # UB:Derived from original system description
    connect CalRegn01Inin05GroupA.BmwHwAgArbnAndEotPosnEotCcwMin -> AAACalRegn01Inin05GroupA_Dummy.BmwHwAgArbnAndEotPosnEotCcwMin  # UB:Derived from original system description
    connect CalRegn01Inin05GroupA.BmwHwAgArbnAndEotPosnEotCwMax -> AAACalRegn01Inin05GroupA_Dummy.BmwHwAgArbnAndEotPosnEotCwMax  # UB:Derived from original system description
    connect CalRegn01Inin05GroupA.BmwHwAgArbnAndEotPosnEotCwMin -> AAACalRegn01Inin05GroupA_Dummy.BmwHwAgArbnAndEotPosnEotCwMin  # UB:Derived from original system description
    connect CalRegn01Inin05GroupA.BmwPwrPrkgDampgDiScadDampg -> AAACalRegn01Inin05GroupA_Dummy.BmwPwrPrkgDampgDiScadDampg  # UB:Derived from original system description
    connect CalRegn01Inin05GroupA.BmwPwrPrkgDampgMaxRate -> AAACalRegn01Inin05GroupA_Dummy.BmwPwrPrkgDampgMaxRate  # UB:Derived from original system description
    connect CalRegn01Inin05GroupA.EpsStEstimnMtrxA -> AAACalRegn01Inin05GroupA_Dummy.EpsStEstimnMtrxA  # UB:Derived from original system description
    connect CalRegn01Inin05GroupA.EpsStEstimnMtrxB -> AAACalRegn01Inin05GroupA_Dummy.EpsStEstimnMtrxB  # UB:Derived from original system description
    connect CalRegn01Inin05GroupA.EpsStEstimnMtrxC -> AAACalRegn01Inin05GroupA_Dummy.EpsStEstimnMtrxC  # UB:Derived from original system description
    connect CalRegn01Inin05GroupA.EpsStEstimnMtrxD -> AAACalRegn01Inin05GroupA_Dummy.EpsStEstimnMtrxD  # UB:Derived from original system description
    connect CalRegn01Inin05GroupA.HwTqTrakgCtrlFbGain{1..5} -> AAACalRegn01Inin05GroupA_Dummy.HwTqTrakgCtrlFbGain{1..5}  # UB:Derived from original system description
    connect CalRegn01Inin05GroupA.HwTqTrakgCtrlFfGainScaY -> AAACalRegn01Inin05GroupA_Dummy.HwTqTrakgCtrlFfGainScaY  # UB:Derived from original system description
    connect CalRegn01Inin05GroupA.HwTqTrakgCtrlVehSpdScaX -> AAACalRegn01Inin05GroupA_Dummy.HwTqTrakgCtrlVehSpdScaX  # UB:Derived from original system description
    connect CalRegn01Inin05GroupA.PosnTrakgServoEnaBlndFacTblX -> AAACalRegn01Inin05GroupA_Dummy.PosnTrakgServoEnaBlndFacTblX  # UB:Derived from original system description
    connect CalRegn01Inin05GroupA.PosnTrakgServoEnaBlndFacTblY -> AAACalRegn01Inin05GroupA_Dummy.PosnTrakgServoEnaBlndFacTblY  # UB:Derived from original system description
    connect CalRegn01Inin05GroupA.PosnTrakgServoGainArbnFltMtgtn -> AAACalRegn01Inin05GroupA_Dummy.PosnTrakgServoGainArbnFltMtgtn  # UB:Derived from original system description
    connect CalRegn01Inin05GroupA.PullCmpActvCmpLrnTiDecShoTerm -> AAACalRegn01Inin05GroupA_Dummy.PullCmpActvCmpLrnTiDecShoTerm  # UB:Derived from original system description
    connect CalRegn01Inin05GroupA.PullCmpActvCmpLrnTiIncShoTerm -> AAACalRegn01Inin05GroupA_Dummy.PullCmpActvCmpLrnTiIncShoTerm  # UB:Derived from original system description
    connect CalRegn01Inin05GroupA.PullCmpActvCmpLrnTiLongTerm -> AAACalRegn01Inin05GroupA_Dummy.PullCmpActvCmpLrnTiLongTerm  # UB:Derived from original system description
    connect CalRegn01Inin05GroupA.PullCmpActvCmpShoTermRstHwAgThd -> AAACalRegn01Inin05GroupA_Dummy.PullCmpActvCmpShoTermRstHwAgThd  # UB:Derived from original system description
    connect CalRegn01Inin05GroupA.PullCmpActvCmpShoTermRstHwTqThd -> AAACalRegn01Inin05GroupA_Dummy.PullCmpActvCmpShoTermRstHwTqThd  # UB:Derived from original system description
    connect CalRegn01Inin05GroupA.PullCmpActvCmpShoTermRstLatAThd -> AAACalRegn01Inin05GroupA_Dummy.PullCmpActvCmpShoTermRstLatAThd  # UB:Derived from original system description
    connect CalRegn01Inin05GroupA.PullCmpActvCmpShoTermRstYawRateThd -> AAACalRegn01Inin05GroupA_Dummy.PullCmpActvCmpShoTermRstYawRateThd  # UB:Derived from original system description
    connect CalRegn01Inin05GroupA.PullCmpActvEna -> AAACalRegn01Inin05GroupA_Dummy.PullCmpActvEna  # UB:Derived from original system description
    connect CalRegn01Inin05GroupA.PullCmpActvHwTqFilFrqLongTerm -> AAACalRegn01Inin05GroupA_Dummy.PullCmpActvHwTqFilFrqLongTerm  # UB:Derived from original system description
    connect CalRegn01Inin05GroupA.PullCmpActvHwTqFilFrqShoTerm -> AAACalRegn01Inin05GroupA_Dummy.PullCmpActvHwTqFilFrqShoTerm  # UB:Derived from original system description
    connect CalRegn01Inin05GroupA.PullCmpActvLongTermLim -> AAACalRegn01Inin05GroupA_Dummy.PullCmpActvLongTermLim  # UB:Derived from original system description
    connect CalRegn01Inin05GroupA.PullCmpActvLrngEnaAgConfMinMgn -> AAACalRegn01Inin05GroupA_Dummy.PullCmpActvLrngEnaAgConfMinMgn  # UB:Derived from original system description
    connect CalRegn01Inin05GroupA.PullCmpActvLrngEnaHwAgMaxMgn -> AAACalRegn01Inin05GroupA_Dummy.PullCmpActvLrngEnaHwAgMaxMgn  # UB:Derived from original system description
    connect CalRegn01Inin05GroupA.PullCmpActvLrngEnaHwTqMaxMgn -> AAACalRegn01Inin05GroupA_Dummy.PullCmpActvLrngEnaHwTqMaxMgn  # UB:Derived from original system description
    connect CalRegn01Inin05GroupA.PullCmpActvLrngEnaHwVelMaxMgn -> AAACalRegn01Inin05GroupA_Dummy.PullCmpActvLrngEnaHwVelMaxMgn  # UB:Derived from original system description
    connect CalRegn01Inin05GroupA.PullCmpActvLrngEnaLatAMaxMgn -> AAACalRegn01Inin05GroupA_Dummy.PullCmpActvLrngEnaLatAMaxMgn  # UB:Derived from original system description
    connect CalRegn01Inin05GroupA.PullCmpActvLrngEnaTiThd -> AAACalRegn01Inin05GroupA_Dummy.PullCmpActvLrngEnaTiThd  # UB:Derived from original system description
    connect CalRegn01Inin05GroupA.PullCmpActvLrngEnaVehSpdMaxMgn -> AAACalRegn01Inin05GroupA_Dummy.PullCmpActvLrngEnaVehSpdMaxMgn  # UB:Derived from original system description
    connect CalRegn01Inin05GroupA.PullCmpActvLrngEnaVehSpdMinMgn -> AAACalRegn01Inin05GroupA_Dummy.PullCmpActvLrngEnaVehSpdMinMgn  # UB:Derived from original system description
    connect CalRegn01Inin05GroupA.PullCmpActvLrngEnaVehSpdRateMaxMgn -> AAACalRegn01Inin05GroupA_Dummy.PullCmpActvLrngEnaVehSpdRateMaxMgn  # UB:Derived from original system description
    connect CalRegn01Inin05GroupA.PullCmpActvLrngEnaYawRateMaxMgn -> AAACalRegn01Inin05GroupA_Dummy.PullCmpActvLrngEnaYawRateMaxMgn  # UB:Derived from original system description
    connect CalRegn01Inin05GroupA.PullCmpActvOpstSignTiShoTerm -> AAACalRegn01Inin05GroupA_Dummy.PullCmpActvOpstSignTiShoTerm  # UB:Derived from original system description
    connect CalRegn01Inin05GroupA.PullCmpActvOutpMaxRate -> AAACalRegn01Inin05GroupA_Dummy.PullCmpActvOutpMaxRate  # UB:Derived from original system description
    connect CalRegn01Inin05GroupA.PullCmpActvPullCmpShoTermLim -> AAACalRegn01Inin05GroupA_Dummy.PullCmpActvPullCmpShoTermLim  # UB:Derived from original system description
    connect CalRegn01Inin05GroupA.PullCmpActvPullCmpTotLim -> AAACalRegn01Inin05GroupA_Dummy.PullCmpActvPullCmpTotLim  # UB:Derived from original system description
    connect CalRegn01Inin05GroupA.PullCmpActvPullErrLimLongTerm -> AAACalRegn01Inin05GroupA_Dummy.PullCmpActvPullErrLimLongTerm  # UB:Derived from original system description
    connect CalRegn01Inin05GroupA.PullCmpActvPullErrMgnThd -> AAACalRegn01Inin05GroupA_Dummy.PullCmpActvPullErrMgnThd  # UB:Derived from original system description
    connect CalRegn01Inin05GroupA.PullCmpActvPullErrShoTermLim -> AAACalRegn01Inin05GroupA_Dummy.PullCmpActvPullErrShoTermLim  # UB:Derived from original system description
    connect CalRegn01Inin05GroupA.PullCmpActvShoTermRampTi -> AAACalRegn01Inin05GroupA_Dummy.PullCmpActvShoTermRampTi  # UB:Derived from original system description
    connect CalRegn01Inin05GroupA.PullCmpActvVehSpdScaTblX -> AAACalRegn01Inin05GroupA_Dummy.PullCmpActvVehSpdScaTblX  # UB:Derived from original system description
    connect CalRegn01Inin05GroupA.PullCmpActvVehSpdScaTblY -> AAACalRegn01Inin05GroupA_Dummy.PullCmpActvVehSpdScaTblY  # UB:Derived from original system description
    connect CalRegn01Inin05GroupC.CtrldVelRtnDesVelLpFilFrq -> AAACalRegn01Inin05GroupC_Dummy.CtrldVelRtnDesVelLpFilFrq  # UB:Derived from original system description
    connect CalRegn01Inin05GroupC.CtrldVelRtnHwTqLpFilFrq -> AAACalRegn01Inin05GroupC_Dummy.CtrldVelRtnHwTqLpFilFrq  # UB:Derived from original system description
    connect CalRegn01Inin05GroupC.CtrldVelRtnHwTqScaSelnSlewHiLim -> AAACalRegn01Inin05GroupC_Dummy.CtrldVelRtnHwTqScaSelnSlewHiLim  # UB:Derived from original system description
    connect CalRegn01Inin05GroupC.CtrldVelRtnHwTqScaSelnSlewLoLim -> AAACalRegn01Inin05GroupC_Dummy.CtrldVelRtnHwTqScaSelnSlewLoLim  # UB:Derived from original system description
    connect CalRegn01Inin05GroupC.CtrldVelRtnHwTqScaSelnTqThd -> AAACalRegn01Inin05GroupC_Dummy.CtrldVelRtnHwTqScaSelnTqThd  # UB:Derived from original system description
    connect CalRegn01Inin05GroupC.CtrldVelRtnHwTqScaSelnVelThd -> AAACalRegn01Inin05GroupC_Dummy.CtrldVelRtnHwTqScaSelnVelThd  # UB:Derived from original system description
    connect CalRegn01Inin05GroupC.CtrldVelRtnIntgrLimY -> AAACalRegn01Inin05GroupC_Dummy.CtrldVelRtnIntgrLimY  # UB:Derived from original system description
    connect CalRegn01Inin05GroupC.CtrldVelRtnOffsSlewThd -> AAACalRegn01Inin05GroupC_Dummy.CtrldVelRtnOffsSlewThd  # UB:Derived from original system description
    connect CalRegn01Inin05GroupC.CtrldVelRtnOffsThd -> AAACalRegn01Inin05GroupC_Dummy.CtrldVelRtnOffsThd  # UB:Derived from original system description
    connect CalRegn01Inin05GroupC.CtrldVelRtnScaLpFilFrq -> AAACalRegn01Inin05GroupC_Dummy.CtrldVelRtnScaLpFilFrq  # UB:Derived from original system description
    connect CalRegn01Inin05GroupC.FalbckAssiAssiX -> AAACalRegn01Inin05GroupC_Dummy.FalbckAssiAssiX  # UB:Derived from original system description
    connect CalRegn01Inin05GroupC.FalbckAssiAssiY -> AAACalRegn01Inin05GroupC_Dummy.FalbckAssiAssiY  # UB:Derived from original system description
    connect CalRegn01Inin05GroupC.FalbckAssiNotchFil -> AAACalRegn01Inin05GroupC_Dummy.FalbckAssiNotchFil  # UB:Derived from original system description
    connect CalRegn01Inin05GroupC.GlbLimrBndX -> AAACalRegn01Inin05GroupC_Dummy.GlbLimrBndX  # UB:Derived from original system description
    connect CalRegn01Inin05GroupC.GlbLimrBndY -> AAACalRegn01Inin05GroupC_Dummy.GlbLimrBndY  # UB:Derived from original system description
    connect CalRegn01Inin05GroupC.GlbLimrNotchFilStruct -> AAACalRegn01Inin05GroupC_Dummy.GlbLimrNotchFilStruct  # UB:Derived from original system description
    connect CalRegn01Inin05GroupC.GlbLimrVehSpdBilnrSeln -> AAACalRegn01Inin05GroupC_Dummy.GlbLimrVehSpdBilnrSeln  # UB:Derived from original system description
    connect CalRegn01Inin05GroupD.EotProtnDampgVehSpdTbl -> AAACalRegn01Inin05GroupD_Dummy.EotProtnDampgVehSpdTbl  # UB:Derived from original system description
    connect CalRegn01Inin05GroupD.EotProtnDeltaTqThd -> AAACalRegn01Inin05GroupD_Dummy.EotProtnDeltaTqThd  # UB:Derived from original system description
    connect CalRegn01Inin05GroupD.EotProtnEntrGainAuthyThd -> AAACalRegn01Inin05GroupD_Dummy.EotProtnEntrGainAuthyThd  # UB:Derived from original system description
    connect CalRegn01Inin05GroupD.EotProtnEntrGainVehSpdTbl -> AAACalRegn01Inin05GroupD_Dummy.EotProtnEntrGainVehSpdTbl  # UB:Derived from original system description
    connect CalRegn01Inin05GroupD.EotProtnEntrGainX -> AAACalRegn01Inin05GroupD_Dummy.EotProtnEntrGainX  # UB:Derived from original system description
    connect CalRegn01Inin05GroupD.EotProtnEntrGainY -> AAACalRegn01Inin05GroupD_Dummy.EotProtnEntrGainY  # UB:Derived from original system description
    connect CalRegn01Inin05GroupD.EotProtnEntrStLpFilFrq -> AAACalRegn01Inin05GroupD_Dummy.EotProtnEntrStLpFilFrq  # UB:Derived from original system description
    connect CalRegn01Inin05GroupD.EotProtnExitDampgY -> AAACalRegn01Inin05GroupD_Dummy.EotProtnExitDampgY  # UB:Derived from original system description
    connect CalRegn01Inin05GroupD.EotProtnExitStLpFilFrq -> AAACalRegn01Inin05GroupD_Dummy.EotProtnExitStLpFilFrq  # UB:Derived from original system description
    connect CalRegn01Inin05GroupD.EotProtnHwDegDampgX -> AAACalRegn01Inin05GroupD_Dummy.EotProtnHwDegDampgX  # UB:Derived from original system description
    connect CalRegn01Inin05GroupD.EotProtnHwTqLpFilFrq -> AAACalRegn01Inin05GroupD_Dummy.EotProtnHwTqLpFilFrq  # UB:Derived from original system description
    connect CalRegn01Inin05GroupD.EotProtnHwTqScaX -> AAACalRegn01Inin05GroupD_Dummy.EotProtnHwTqScaX  # UB:Derived from original system description
    connect CalRegn01Inin05GroupD.EotProtnLoAuthyEntrGainY -> AAACalRegn01Inin05GroupD_Dummy.EotProtnLoAuthyEntrGainY  # UB:Derived from original system description
    connect CalRegn01Inin05GroupD.EotProtnMotSpdIncptSca -> AAACalRegn01Inin05GroupD_Dummy.EotProtnMotSpdIncptSca  # UB:Derived from original system description
    connect CalRegn01Inin05GroupD.EotProtnMotSpdIncptX -> AAACalRegn01Inin05GroupD_Dummy.EotProtnMotSpdIncptX  # UB:Derived from original system description
    connect CalRegn01Inin05GroupD.EotProtnMotSpdIncptY -> AAACalRegn01Inin05GroupD_Dummy.EotProtnMotSpdIncptY  # UB:Derived from original system description
    connect CalRegn01Inin05GroupD.EotProtnMotVelGain -> AAACalRegn01Inin05GroupD_Dummy.EotProtnMotVelGain  # UB:Derived from original system description
    connect CalRegn01Inin05GroupD.EotProtnNormDampgY -> AAACalRegn01Inin05GroupD_Dummy.EotProtnNormDampgY  # UB:Derived from original system description
    connect CalRegn01Inin05GroupD.EotProtnPosnRampStep -> AAACalRegn01Inin05GroupD_Dummy.EotProtnPosnRampStep  # UB:Derived from original system description
    connect CalRegn01Inin05GroupD.EotProtnRackTrvlLimrAuthyThd -> AAACalRegn01Inin05GroupD_Dummy.EotProtnRackTrvlLimrAuthyThd  # UB:Derived from original system description
    connect CalRegn01Inin05GroupD.EotProtnRackTrvlLimrAuthyThdLimd -> AAACalRegn01Inin05GroupD_Dummy.EotProtnRackTrvlLimrAuthyThdLimd  # UB:Derived from original system description
    connect CalRegn01Inin05GroupD.EotProtnRackTrvlLimrRng -> AAACalRegn01Inin05GroupD_Dummy.EotProtnRackTrvlLimrRng  # UB:Derived from original system description
    connect CalRegn01Inin05GroupD.EotProtnRackTrvlLimrRngLimd -> AAACalRegn01Inin05GroupD_Dummy.EotProtnRackTrvlLimrRngLimd  # UB:Derived from original system description
    connect CalRegn01Inin05GroupD.EotProtnRackTrvlLimrVehSpdThd -> AAACalRegn01Inin05GroupD_Dummy.EotProtnRackTrvlLimrVehSpdThd  # UB:Derived from original system description
    connect CalRegn01Inin05GroupD.EotProtnRunEotVelImpctAndSoftEndStop -> AAACalRegn01Inin05GroupD_Dummy.EotProtnRunEotVelImpctAndSoftEndStop  # UB:Derived from original system description
    connect CalRegn01Inin05GroupD.InertiaCmpVelAssiBasdDampgCoeffX -> AAACalRegn01Inin05GroupD_Dummy.InertiaCmpVelAssiBasdDampgCoeffX  # UB:Derived from original system description
    connect CalRegn01Inin05GroupD.InertiaCmpVelAssiBasdDampgRollgWhlImbRejctnOnY -> AAACalRegn01Inin05GroupD_Dummy.InertiaCmpVelAssiBasdDampgRollgWhlImbRejctnOnY  # UB:Derived from original system description
    connect CalRegn01Inin05GroupD.InertiaCmpVelAssiBasdDampgRollgY -> AAACalRegn01Inin05GroupD_Dummy.InertiaCmpVelAssiBasdDampgRollgY  # UB:Derived from original system description
    connect CalRegn01Inin05GroupD.InertiaCmpVelAssiBasdDampgStatWhlImbRejctnOnY -> AAACalRegn01Inin05GroupD_Dummy.InertiaCmpVelAssiBasdDampgStatWhlImbRejctnOnY  # UB:Derived from original system description
    connect CalRegn01Inin05GroupD.InertiaCmpVelAssiBasdDampgStatY -> AAACalRegn01Inin05GroupD_Dummy.InertiaCmpVelAssiBasdDampgStatY  # UB:Derived from original system description
    connect CalRegn01Inin05GroupD.InertiaCmpVelCmdScaY -> AAACalRegn01Inin05GroupD_Dummy.InertiaCmpVelCmdScaY  # UB:Derived from original system description
    connect CalRegn01Inin05GroupD.InertiaCmpVelDampgDecelGain -> AAACalRegn01Inin05GroupD_Dummy.InertiaCmpVelDampgDecelGain  # UB:Derived from original system description
    connect CalRegn01Inin05GroupD.InertiaCmpVelDampgDecelGainFallSlew -> AAACalRegn01Inin05GroupD_Dummy.InertiaCmpVelDampgDecelGainFallSlew  # UB:Derived from original system description
    connect CalRegn01Inin05GroupD.InertiaCmpVelDampgDecelGainRisngSlewX -> AAACalRegn01Inin05GroupD_Dummy.InertiaCmpVelDampgDecelGainRisngSlewX  # UB:Derived from original system description
    connect CalRegn01Inin05GroupD.InertiaCmpVelDampgDecelGainRisngSlewY -> AAACalRegn01Inin05GroupD_Dummy.InertiaCmpVelDampgDecelGainRisngSlewY  # UB:Derived from original system description
    connect CalRegn01Inin05GroupD.InertiaCmpVelDampgFilFrq -> AAACalRegn01Inin05GroupD_Dummy.InertiaCmpVelDampgFilFrq  # UB:Derived from original system description
    connect CalRegn01Inin05GroupD.InertiaCmpVelDampgFilFrqWhlImbRejctnOn -> AAACalRegn01Inin05GroupD_Dummy.InertiaCmpVelDampgFilFrqWhlImbRejctnOn  # UB:Derived from original system description
    connect CalRegn01Inin05GroupD.InertiaCmpVelDampgGainOffThd -> AAACalRegn01Inin05GroupD_Dummy.InertiaCmpVelDampgGainOffThd  # UB:Derived from original system description
    connect CalRegn01Inin05GroupD.InertiaCmpVelDampgGainOnThd -> AAACalRegn01Inin05GroupD_Dummy.InertiaCmpVelDampgGainOnThd  # UB:Derived from original system description
    connect CalRegn01Inin05GroupD.InertiaCmpVelDampgSpdBlndY -> AAACalRegn01Inin05GroupD_Dummy.InertiaCmpVelDampgSpdBlndY  # UB:Derived from original system description
    connect CalRegn01Inin05GroupD.InertiaCmpVelDampgWhlImbRejctnBlndX -> AAACalRegn01Inin05GroupD_Dummy.InertiaCmpVelDampgWhlImbRejctnBlndX  # UB:Derived from original system description
    connect CalRegn01Inin05GroupD.InertiaCmpVelDampgWhlImbRejctnBlndY -> AAACalRegn01Inin05GroupD_Dummy.InertiaCmpVelDampgWhlImbRejctnBlndY  # UB:Derived from original system description
    connect CalRegn01Inin05GroupD.InertiaCmpVelDecelGainEnaCal -> AAACalRegn01Inin05GroupD_Dummy.InertiaCmpVelDecelGainEnaCal  # UB:Derived from original system description
    connect CalRegn01Inin05GroupD.InertiaCmpVelModWhlImbRejctnBlndX -> AAACalRegn01Inin05GroupD_Dummy.InertiaCmpVelModWhlImbRejctnBlndX  # UB:Derived from original system description
    connect CalRegn01Inin05GroupD.InertiaCmpVelModWhlImbRejctnBlndY -> AAACalRegn01Inin05GroupD_Dummy.InertiaCmpVelModWhlImbRejctnBlndY  # UB:Derived from original system description
    connect CalRegn01Inin05GroupD.InertiaCmpVelMotInertia -> AAACalRegn01Inin05GroupD_Dummy.InertiaCmpVelMotInertia  # UB:Derived from original system description
    connect CalRegn01Inin05GroupD.InertiaCmpVelMotVelBasdOutpScagX -> AAACalRegn01Inin05GroupD_Dummy.InertiaCmpVelMotVelBasdOutpScagX  # UB:Derived from original system description
    connect CalRegn01Inin05GroupD.InertiaCmpVelMotVelBasdOutpScagY -> AAACalRegn01Inin05GroupD_Dummy.InertiaCmpVelMotVelBasdOutpScagY  # UB:Derived from original system description
    connect CalRegn01Inin05GroupD.InertiaCmpVelNotchBlndY -> AAACalRegn01Inin05GroupD_Dummy.InertiaCmpVelNotchBlndY  # UB:Derived from original system description
    connect CalRegn01Inin05GroupD.InertiaCmpVelNotchFilStruct -> AAACalRegn01Inin05GroupD_Dummy.InertiaCmpVelNotchFilStruct  # UB:Derived from original system description
    connect CalRegn01Inin05GroupD.InertiaCmpVelTqSnsrVelFilFrq -> AAACalRegn01Inin05GroupD_Dummy.InertiaCmpVelTqSnsrVelFilFrq  # UB:Derived from original system description
    connect CalRegn01Inin05GroupD.InertiaCmpVelTqSnsrVelSca -> AAACalRegn01Inin05GroupD_Dummy.InertiaCmpVelTqSnsrVelSca  # UB:Derived from original system description
    connect CalRegn01Inin06.BmwHwAgArbnAndEotPosnKineIntegrityDiagcMaxRackLim -> AAACalRegn01Inin06_Dummy.BmwHwAgArbnAndEotPosnKineIntegrityDiagcMaxRackLim  # UB:Derived from original system description
    connect CalRegn01Inin06.EffortScaBlndX -> AAACalRegn01Inin06_Dummy.EffortScaBlndX  # UB:Derived from original system description
    connect CalRegn01Inin06.EffortScaBlndY -> AAACalRegn01Inin06_Dummy.EffortScaBlndY  # UB:Derived from original system description
    connect CalRegn01Inin06.EffortScaRackFThd -> AAACalRegn01Inin06_Dummy.EffortScaRackFThd  # UB:Derived from original system description
    connect CalRegn01Inin06.PosnTrakgServoArbnFltMtgtnLpFilCutOffFrq -> AAACalRegn01Inin06_Dummy.PosnTrakgServoArbnFltMtgtnLpFilCutOffFrq  # UB:Derived from original system description
    connect CalRegn01Inin06.PullCmpActvHwTqFilFrqLrngEna -> AAACalRegn01Inin06_Dummy.PullCmpActvHwTqFilFrqLrngEna  # UB:Derived from original system description
    connect CalRegn01Inin06.PullCmpActvYawRateFilFrq -> AAACalRegn01Inin06_Dummy.PullCmpActvYawRateFilFrq  # UB:Derived from original system description
    connect CalRegn01Inin06.SysFricLrngAvrgFricFrq -> AAACalRegn01Inin06_Dummy.SysFricLrngAvrgFricFrq  # UB:Derived from original system description
    connect CalRegn01Inin06.SysFricLrngBasLineEolFric -> AAACalRegn01Inin06_Dummy.SysFricLrngBasLineEolFric  # UB:Derived from original system description
    connect CalRegn01Inin06.SysFricLrngBasLineFric -> AAACalRegn01Inin06_Dummy.SysFricLrngBasLineFric  # UB:Derived from original system description
    connect CalRegn01Inin06.SysFricLrngBasLineHys -> AAACalRegn01Inin06_Dummy.SysFricLrngBasLineHys  # UB:Derived from original system description
    connect CalRegn01Inin06.SysFricLrngBasLineRngCntr -> AAACalRegn01Inin06_Dummy.SysFricLrngBasLineRngCntr  # UB:Derived from original system description
    connect CalRegn01Inin06.SysFricLrngDataPrepLpFilFrq -> AAACalRegn01Inin06_Dummy.SysFricLrngDataPrepLpFilFrq  # UB:Derived from original system description
    connect CalRegn01Inin06.SysFricLrngDebStep -> AAACalRegn01Inin06_Dummy.SysFricLrngDebStep  # UB:Derived from original system description
    connect CalRegn01Inin06.SysFricLrngEolFricDifHiLim -> AAACalRegn01Inin06_Dummy.SysFricLrngEolFricDifHiLim  # UB:Derived from original system description
    connect CalRegn01Inin06.SysFricLrngEolFricDifLoLim -> AAACalRegn01Inin06_Dummy.SysFricLrngEolFricDifLoLim  # UB:Derived from original system description
    connect CalRegn01Inin06.SysFricLrngEolFricDifScagFac -> AAACalRegn01Inin06_Dummy.SysFricLrngEolFricDifScagFac  # UB:Derived from original system description
    connect CalRegn01Inin06.SysFricLrngFricChgWght -> AAACalRegn01Inin06_Dummy.SysFricLrngFricChgWght  # UB:Derived from original system description
    connect CalRegn01Inin06.SysFricLrngFricDiagcThd -> AAACalRegn01Inin06_Dummy.SysFricLrngFricDiagcThd  # UB:Derived from original system description
    connect CalRegn01Inin06.SysFricLrngFricHysHwAgPt -> AAACalRegn01Inin06_Dummy.SysFricLrngFricHysHwAgPt  # UB:Derived from original system description
    connect CalRegn01Inin06.SysFricLrngFricOffs -> AAACalRegn01Inin06_Dummy.SysFricLrngFricOffs  # UB:Derived from original system description
    connect CalRegn01Inin06.SysFricLrngFricOffsHiLim -> AAACalRegn01Inin06_Dummy.SysFricLrngFricOffsHiLim  # UB:Derived from original system description
    connect CalRegn01Inin06.SysFricLrngFricOffsLoLim -> AAACalRegn01Inin06_Dummy.SysFricLrngFricOffsLoLim  # UB:Derived from original system description
    connect CalRegn01Inin06.SysFricLrngFricOffsLpFilFrq -> AAACalRegn01Inin06_Dummy.SysFricLrngFricOffsLpFilFrq  # UB:Derived from original system description
    connect CalRegn01Inin06.SysFricLrngGain -> AAACalRegn01Inin06_Dummy.SysFricLrngGain  # UB:Derived from original system description
    connect CalRegn01Inin06.SysFricLrngHiFricDebStep -> AAACalRegn01Inin06_Dummy.SysFricLrngHiFricDebStep  # UB:Derived from original system description
    connect CalRegn01Inin06.SysFricLrngHiFricDiagcThd -> AAACalRegn01Inin06_Dummy.SysFricLrngHiFricDiagcThd  # UB:Derived from original system description
    connect CalRegn01Inin06.SysFricLrngHwPosnAuthyThd -> AAACalRegn01Inin06_Dummy.SysFricLrngHwPosnAuthyThd  # UB:Derived from original system description
    connect CalRegn01Inin06.SysFricLrngHwVelConstrLim -> AAACalRegn01Inin06_Dummy.SysFricLrngHwVelConstrLim  # UB:Derived from original system description
    connect CalRegn01Inin06.SysFricLrngHwVelHiLim -> AAACalRegn01Inin06_Dummy.SysFricLrngHwVelHiLim  # UB:Derived from original system description
    connect CalRegn01Inin06.SysFricLrngHwVelLoLim -> AAACalRegn01Inin06_Dummy.SysFricLrngHwVelLoLim  # UB:Derived from original system description
    connect CalRegn01Inin06.SysFricLrngIgnCycFricChgLim -> AAACalRegn01Inin06_Dummy.SysFricLrngIgnCycFricChgLim  # UB:Derived from original system description
    connect CalRegn01Inin06.SysFricLrngIgnCycFricOffs -> AAACalRegn01Inin06_Dummy.SysFricLrngIgnCycFricOffs  # UB:Derived from original system description
    connect CalRegn01Inin06.SysFricLrngIvsTrsmRatX -> AAACalRegn01Inin06_Dummy.SysFricLrngIvsTrsmRatX  # UB:Derived from original system description
    connect CalRegn01Inin06.SysFricLrngIvsTrsmRatY -> AAACalRegn01Inin06_Dummy.SysFricLrngIvsTrsmRatY  # UB:Derived from original system description
    connect CalRegn01Inin06.SysFricLrngLatAHiLim -> AAACalRegn01Inin06_Dummy.SysFricLrngLatAHiLim  # UB:Derived from original system description
    connect CalRegn01Inin06.SysFricLrngLatALoLim -> AAACalRegn01Inin06_Dummy.SysFricLrngLatALoLim  # UB:Derived from original system description
    connect CalRegn01Inin06.SysFricLrngMaskVehSpd -> AAACalRegn01Inin06_Dummy.SysFricLrngMaskVehSpd  # UB:Derived from original system description
    connect CalRegn01Inin06.SysFricLrngRngCntrThd -> AAACalRegn01Inin06_Dummy.SysFricLrngRngCntrThd  # UB:Derived from original system description
    connect CalRegn01Inin06.SysFricLrngThd -> AAACalRegn01Inin06_Dummy.SysFricLrngThd  # UB:Derived from original system description
    connect CalRegn01Inin06.SysFricLrngTHiLim -> AAACalRegn01Inin06_Dummy.SysFricLrngTHiLim  # UB:Derived from original system description
    connect CalRegn01Inin06.SysFricLrngTLoLim -> AAACalRegn01Inin06_Dummy.SysFricLrngTLoLim  # UB:Derived from original system description
    connect CalRegn01Inin06.SysFricLrngVehSpd -> AAACalRegn01Inin06_Dummy.SysFricLrngVehSpd  # UB:Derived from original system description
    connect CalRegn01Inin06.SysGlbPrmSysKineRat -> AAACalRegn01Inin06_Dummy.SysGlbPrmSysKineRat  # UB:Derived from original system description
    connect CalRegn01Inin06.SysGlbPrmVehSpdBilnrSeln -> AAACalRegn01Inin06_Dummy.SysGlbPrmVehSpdBilnrSeln  # UB:Derived from original system description
    connect CalRegn01Inin06.SysKineAndEffMotAgToRackPosRatScaY -> AAACalRegn01Inin06_Dummy.SysKineAndEffMotAgToRackPosRatScaY  # UB:Derived from original system description
    connect CalRegn01Inin06.SysKineAndEffPinionAgToRackPosRatScaY -> AAACalRegn01Inin06_Dummy.SysKineAndEffPinionAgToRackPosRatScaY  # UB:Derived from original system description
    connect CalRegn01Inin06.SysKineAndEffPinionToRackEffScaY -> AAACalRegn01Inin06_Dummy.SysKineAndEffPinionToRackEffScaY  # UB:Derived from original system description
    connect CalRegn01Inin06.SysKineAndEffRoadWhlFromRackPosScaY -> AAACalRegn01Inin06_Dummy.SysKineAndEffRoadWhlFromRackPosScaY  # UB:Derived from original system description
    connect CalRegn01Inin06.SysKineAndEffSteerArmLenFromRackPosScaY -> AAACalRegn01Inin06_Dummy.SysKineAndEffSteerArmLenFromRackPosScaY  # UB:Derived from original system description
    connect CalRegn01Inin06.TunSelnAuthyVehSpdX -> AAACalRegn01Inin06_Dummy.TunSelnAuthyVehSpdX  # UB:Derived from original system description
    connect CalRegn01Inin06GroupA.BmwHwAgArbnAndEotPosnEotCcwMax -> AAACalRegn01Inin06GroupA_Dummy.BmwHwAgArbnAndEotPosnEotCcwMax  # UB:Derived from original system description
    connect CalRegn01Inin06GroupA.BmwHwAgArbnAndEotPosnEotCcwMin -> AAACalRegn01Inin06GroupA_Dummy.BmwHwAgArbnAndEotPosnEotCcwMin  # UB:Derived from original system description
    connect CalRegn01Inin06GroupA.BmwHwAgArbnAndEotPosnEotCwMax -> AAACalRegn01Inin06GroupA_Dummy.BmwHwAgArbnAndEotPosnEotCwMax  # UB:Derived from original system description
    connect CalRegn01Inin06GroupA.BmwHwAgArbnAndEotPosnEotCwMin -> AAACalRegn01Inin06GroupA_Dummy.BmwHwAgArbnAndEotPosnEotCwMin  # UB:Derived from original system description
    connect CalRegn01Inin06GroupA.BmwPwrPrkgDampgDiScadDampg -> AAACalRegn01Inin06GroupA_Dummy.BmwPwrPrkgDampgDiScadDampg  # UB:Derived from original system description
    connect CalRegn01Inin06GroupA.BmwPwrPrkgDampgMaxRate -> AAACalRegn01Inin06GroupA_Dummy.BmwPwrPrkgDampgMaxRate  # UB:Derived from original system description
    connect CalRegn01Inin06GroupA.EpsStEstimnMtrxA -> AAACalRegn01Inin06GroupA_Dummy.EpsStEstimnMtrxA  # UB:Derived from original system description
    connect CalRegn01Inin06GroupA.EpsStEstimnMtrxB -> AAACalRegn01Inin06GroupA_Dummy.EpsStEstimnMtrxB  # UB:Derived from original system description
    connect CalRegn01Inin06GroupA.EpsStEstimnMtrxC -> AAACalRegn01Inin06GroupA_Dummy.EpsStEstimnMtrxC  # UB:Derived from original system description
    connect CalRegn01Inin06GroupA.EpsStEstimnMtrxD -> AAACalRegn01Inin06GroupA_Dummy.EpsStEstimnMtrxD  # UB:Derived from original system description
    connect CalRegn01Inin06GroupA.HwTqTrakgCtrlFbGain{1..5} -> AAACalRegn01Inin06GroupA_Dummy.HwTqTrakgCtrlFbGain{1..5}  # UB:Derived from original system description
    connect CalRegn01Inin06GroupA.HwTqTrakgCtrlFfGainScaY -> AAACalRegn01Inin06GroupA_Dummy.HwTqTrakgCtrlFfGainScaY  # UB:Derived from original system description
    connect CalRegn01Inin06GroupA.HwTqTrakgCtrlVehSpdScaX -> AAACalRegn01Inin06GroupA_Dummy.HwTqTrakgCtrlVehSpdScaX  # UB:Derived from original system description
    connect CalRegn01Inin06GroupA.PosnTrakgServoEnaBlndFacTblX -> AAACalRegn01Inin06GroupA_Dummy.PosnTrakgServoEnaBlndFacTblX  # UB:Derived from original system description
    connect CalRegn01Inin06GroupA.PosnTrakgServoEnaBlndFacTblY -> AAACalRegn01Inin06GroupA_Dummy.PosnTrakgServoEnaBlndFacTblY  # UB:Derived from original system description
    connect CalRegn01Inin06GroupA.PosnTrakgServoGainArbnFltMtgtn -> AAACalRegn01Inin06GroupA_Dummy.PosnTrakgServoGainArbnFltMtgtn  # UB:Derived from original system description
    connect CalRegn01Inin06GroupA.PullCmpActvCmpLrnTiDecShoTerm -> AAACalRegn01Inin06GroupA_Dummy.PullCmpActvCmpLrnTiDecShoTerm  # UB:Derived from original system description
    connect CalRegn01Inin06GroupA.PullCmpActvCmpLrnTiIncShoTerm -> AAACalRegn01Inin06GroupA_Dummy.PullCmpActvCmpLrnTiIncShoTerm  # UB:Derived from original system description
    connect CalRegn01Inin06GroupA.PullCmpActvCmpLrnTiLongTerm -> AAACalRegn01Inin06GroupA_Dummy.PullCmpActvCmpLrnTiLongTerm  # UB:Derived from original system description
    connect CalRegn01Inin06GroupA.PullCmpActvCmpShoTermRstHwAgThd -> AAACalRegn01Inin06GroupA_Dummy.PullCmpActvCmpShoTermRstHwAgThd  # UB:Derived from original system description
    connect CalRegn01Inin06GroupA.PullCmpActvCmpShoTermRstHwTqThd -> AAACalRegn01Inin06GroupA_Dummy.PullCmpActvCmpShoTermRstHwTqThd  # UB:Derived from original system description
    connect CalRegn01Inin06GroupA.PullCmpActvCmpShoTermRstLatAThd -> AAACalRegn01Inin06GroupA_Dummy.PullCmpActvCmpShoTermRstLatAThd  # UB:Derived from original system description
    connect CalRegn01Inin06GroupA.PullCmpActvCmpShoTermRstYawRateThd -> AAACalRegn01Inin06GroupA_Dummy.PullCmpActvCmpShoTermRstYawRateThd  # UB:Derived from original system description
    connect CalRegn01Inin06GroupA.PullCmpActvEna -> AAACalRegn01Inin06GroupA_Dummy.PullCmpActvEna  # UB:Derived from original system description
    connect CalRegn01Inin06GroupA.PullCmpActvHwTqFilFrqLongTerm -> AAACalRegn01Inin06GroupA_Dummy.PullCmpActvHwTqFilFrqLongTerm  # UB:Derived from original system description
    connect CalRegn01Inin06GroupA.PullCmpActvHwTqFilFrqShoTerm -> AAACalRegn01Inin06GroupA_Dummy.PullCmpActvHwTqFilFrqShoTerm  # UB:Derived from original system description
    connect CalRegn01Inin06GroupA.PullCmpActvLongTermLim -> AAACalRegn01Inin06GroupA_Dummy.PullCmpActvLongTermLim  # UB:Derived from original system description
    connect CalRegn01Inin06GroupA.PullCmpActvLrngEnaAgConfMinMgn -> AAACalRegn01Inin06GroupA_Dummy.PullCmpActvLrngEnaAgConfMinMgn  # UB:Derived from original system description
    connect CalRegn01Inin06GroupA.PullCmpActvLrngEnaHwAgMaxMgn -> AAACalRegn01Inin06GroupA_Dummy.PullCmpActvLrngEnaHwAgMaxMgn  # UB:Derived from original system description
    connect CalRegn01Inin06GroupA.PullCmpActvLrngEnaHwTqMaxMgn -> AAACalRegn01Inin06GroupA_Dummy.PullCmpActvLrngEnaHwTqMaxMgn  # UB:Derived from original system description
    connect CalRegn01Inin06GroupA.PullCmpActvLrngEnaHwVelMaxMgn -> AAACalRegn01Inin06GroupA_Dummy.PullCmpActvLrngEnaHwVelMaxMgn  # UB:Derived from original system description
    connect CalRegn01Inin06GroupA.PullCmpActvLrngEnaLatAMaxMgn -> AAACalRegn01Inin06GroupA_Dummy.PullCmpActvLrngEnaLatAMaxMgn  # UB:Derived from original system description
    connect CalRegn01Inin06GroupA.PullCmpActvLrngEnaTiThd -> AAACalRegn01Inin06GroupA_Dummy.PullCmpActvLrngEnaTiThd  # UB:Derived from original system description
    connect CalRegn01Inin06GroupA.PullCmpActvLrngEnaVehSpdMaxMgn -> AAACalRegn01Inin06GroupA_Dummy.PullCmpActvLrngEnaVehSpdMaxMgn  # UB:Derived from original system description
    connect CalRegn01Inin06GroupA.PullCmpActvLrngEnaVehSpdMinMgn -> AAACalRegn01Inin06GroupA_Dummy.PullCmpActvLrngEnaVehSpdMinMgn  # UB:Derived from original system description
    connect CalRegn01Inin06GroupA.PullCmpActvLrngEnaVehSpdRateMaxMgn -> AAACalRegn01Inin06GroupA_Dummy.PullCmpActvLrngEnaVehSpdRateMaxMgn  # UB:Derived from original system description
    connect CalRegn01Inin06GroupA.PullCmpActvLrngEnaYawRateMaxMgn -> AAACalRegn01Inin06GroupA_Dummy.PullCmpActvLrngEnaYawRateMaxMgn  # UB:Derived from original system description
    connect CalRegn01Inin06GroupA.PullCmpActvOpstSignTiShoTerm -> AAACalRegn01Inin06GroupA_Dummy.PullCmpActvOpstSignTiShoTerm  # UB:Derived from original system description
    connect CalRegn01Inin06GroupA.PullCmpActvOutpMaxRate -> AAACalRegn01Inin06GroupA_Dummy.PullCmpActvOutpMaxRate  # UB:Derived from original system description
    connect CalRegn01Inin06GroupA.PullCmpActvPullCmpShoTermLim -> AAACalRegn01Inin06GroupA_Dummy.PullCmpActvPullCmpShoTermLim  # UB:Derived from original system description
    connect CalRegn01Inin06GroupA.PullCmpActvPullCmpTotLim -> AAACalRegn01Inin06GroupA_Dummy.PullCmpActvPullCmpTotLim  # UB:Derived from original system description
    connect CalRegn01Inin06GroupA.PullCmpActvPullErrLimLongTerm -> AAACalRegn01Inin06GroupA_Dummy.PullCmpActvPullErrLimLongTerm  # UB:Derived from original system description
    connect CalRegn01Inin06GroupA.PullCmpActvPullErrMgnThd -> AAACalRegn01Inin06GroupA_Dummy.PullCmpActvPullErrMgnThd  # UB:Derived from original system description
    connect CalRegn01Inin06GroupA.PullCmpActvPullErrShoTermLim -> AAACalRegn01Inin06GroupA_Dummy.PullCmpActvPullErrShoTermLim  # UB:Derived from original system description
    connect CalRegn01Inin06GroupA.PullCmpActvShoTermRampTi -> AAACalRegn01Inin06GroupA_Dummy.PullCmpActvShoTermRampTi  # UB:Derived from original system description
    connect CalRegn01Inin06GroupA.PullCmpActvVehSpdScaTblX -> AAACalRegn01Inin06GroupA_Dummy.PullCmpActvVehSpdScaTblX  # UB:Derived from original system description
    connect CalRegn01Inin06GroupA.PullCmpActvVehSpdScaTblY -> AAACalRegn01Inin06GroupA_Dummy.PullCmpActvVehSpdScaTblY  # UB:Derived from original system description
    connect CalRegn01Inin06GroupC.CtrldVelRtnDesVelLpFilFrq -> AAACalRegn01Inin06GroupC_Dummy.CtrldVelRtnDesVelLpFilFrq  # UB:Derived from original system description
    connect CalRegn01Inin06GroupC.CtrldVelRtnHwTqLpFilFrq -> AAACalRegn01Inin06GroupC_Dummy.CtrldVelRtnHwTqLpFilFrq  # UB:Derived from original system description
    connect CalRegn01Inin06GroupC.CtrldVelRtnHwTqScaSelnSlewHiLim -> AAACalRegn01Inin06GroupC_Dummy.CtrldVelRtnHwTqScaSelnSlewHiLim  # UB:Derived from original system description
    connect CalRegn01Inin06GroupC.CtrldVelRtnHwTqScaSelnSlewLoLim -> AAACalRegn01Inin06GroupC_Dummy.CtrldVelRtnHwTqScaSelnSlewLoLim  # UB:Derived from original system description
    connect CalRegn01Inin06GroupC.CtrldVelRtnHwTqScaSelnTqThd -> AAACalRegn01Inin06GroupC_Dummy.CtrldVelRtnHwTqScaSelnTqThd  # UB:Derived from original system description
    connect CalRegn01Inin06GroupC.CtrldVelRtnHwTqScaSelnVelThd -> AAACalRegn01Inin06GroupC_Dummy.CtrldVelRtnHwTqScaSelnVelThd  # UB:Derived from original system description
    connect CalRegn01Inin06GroupC.CtrldVelRtnIntgrLimY -> AAACalRegn01Inin06GroupC_Dummy.CtrldVelRtnIntgrLimY  # UB:Derived from original system description
    connect CalRegn01Inin06GroupC.CtrldVelRtnOffsSlewThd -> AAACalRegn01Inin06GroupC_Dummy.CtrldVelRtnOffsSlewThd  # UB:Derived from original system description
    connect CalRegn01Inin06GroupC.CtrldVelRtnOffsThd -> AAACalRegn01Inin06GroupC_Dummy.CtrldVelRtnOffsThd  # UB:Derived from original system description
    connect CalRegn01Inin06GroupC.CtrldVelRtnScaLpFilFrq -> AAACalRegn01Inin06GroupC_Dummy.CtrldVelRtnScaLpFilFrq  # UB:Derived from original system description
    connect CalRegn01Inin06GroupC.FalbckAssiAssiX -> AAACalRegn01Inin06GroupC_Dummy.FalbckAssiAssiX  # UB:Derived from original system description
    connect CalRegn01Inin06GroupC.FalbckAssiAssiY -> AAACalRegn01Inin06GroupC_Dummy.FalbckAssiAssiY  # UB:Derived from original system description
    connect CalRegn01Inin06GroupC.FalbckAssiNotchFil -> AAACalRegn01Inin06GroupC_Dummy.FalbckAssiNotchFil  # UB:Derived from original system description
    connect CalRegn01Inin06GroupC.GlbLimrBndX -> AAACalRegn01Inin06GroupC_Dummy.GlbLimrBndX  # UB:Derived from original system description
    connect CalRegn01Inin06GroupC.GlbLimrBndY -> AAACalRegn01Inin06GroupC_Dummy.GlbLimrBndY  # UB:Derived from original system description
    connect CalRegn01Inin06GroupC.GlbLimrNotchFilStruct -> AAACalRegn01Inin06GroupC_Dummy.GlbLimrNotchFilStruct  # UB:Derived from original system description
    connect CalRegn01Inin06GroupC.GlbLimrVehSpdBilnrSeln -> AAACalRegn01Inin06GroupC_Dummy.GlbLimrVehSpdBilnrSeln  # UB:Derived from original system description
    connect CalRegn01Inin06GroupD.EotProtnDampgVehSpdTbl -> AAACalRegn01Inin06GroupD_Dummy.EotProtnDampgVehSpdTbl  # UB:Derived from original system description
    connect CalRegn01Inin06GroupD.EotProtnDeltaTqThd -> AAACalRegn01Inin06GroupD_Dummy.EotProtnDeltaTqThd  # UB:Derived from original system description
    connect CalRegn01Inin06GroupD.EotProtnEntrGainAuthyThd -> AAACalRegn01Inin06GroupD_Dummy.EotProtnEntrGainAuthyThd  # UB:Derived from original system description
    connect CalRegn01Inin06GroupD.EotProtnEntrGainVehSpdTbl -> AAACalRegn01Inin06GroupD_Dummy.EotProtnEntrGainVehSpdTbl  # UB:Derived from original system description
    connect CalRegn01Inin06GroupD.EotProtnEntrGainX -> AAACalRegn01Inin06GroupD_Dummy.EotProtnEntrGainX  # UB:Derived from original system description
    connect CalRegn01Inin06GroupD.EotProtnEntrGainY -> AAACalRegn01Inin06GroupD_Dummy.EotProtnEntrGainY  # UB:Derived from original system description
    connect CalRegn01Inin06GroupD.EotProtnEntrStLpFilFrq -> AAACalRegn01Inin06GroupD_Dummy.EotProtnEntrStLpFilFrq  # UB:Derived from original system description
    connect CalRegn01Inin06GroupD.EotProtnExitDampgY -> AAACalRegn01Inin06GroupD_Dummy.EotProtnExitDampgY  # UB:Derived from original system description
    connect CalRegn01Inin06GroupD.EotProtnExitStLpFilFrq -> AAACalRegn01Inin06GroupD_Dummy.EotProtnExitStLpFilFrq  # UB:Derived from original system description
    connect CalRegn01Inin06GroupD.EotProtnHwDegDampgX -> AAACalRegn01Inin06GroupD_Dummy.EotProtnHwDegDampgX  # UB:Derived from original system description
    connect CalRegn01Inin06GroupD.EotProtnHwTqLpFilFrq -> AAACalRegn01Inin06GroupD_Dummy.EotProtnHwTqLpFilFrq  # UB:Derived from original system description
    connect CalRegn01Inin06GroupD.EotProtnHwTqScaX -> AAACalRegn01Inin06GroupD_Dummy.EotProtnHwTqScaX  # UB:Derived from original system description
    connect CalRegn01Inin06GroupD.EotProtnLoAuthyEntrGainY -> AAACalRegn01Inin06GroupD_Dummy.EotProtnLoAuthyEntrGainY  # UB:Derived from original system description
    connect CalRegn01Inin06GroupD.EotProtnMotSpdIncptSca -> AAACalRegn01Inin06GroupD_Dummy.EotProtnMotSpdIncptSca  # UB:Derived from original system description
    connect CalRegn01Inin06GroupD.EotProtnMotSpdIncptX -> AAACalRegn01Inin06GroupD_Dummy.EotProtnMotSpdIncptX  # UB:Derived from original system description
    connect CalRegn01Inin06GroupD.EotProtnMotSpdIncptY -> AAACalRegn01Inin06GroupD_Dummy.EotProtnMotSpdIncptY  # UB:Derived from original system description
    connect CalRegn01Inin06GroupD.EotProtnMotVelGain -> AAACalRegn01Inin06GroupD_Dummy.EotProtnMotVelGain  # UB:Derived from original system description
    connect CalRegn01Inin06GroupD.EotProtnNormDampgY -> AAACalRegn01Inin06GroupD_Dummy.EotProtnNormDampgY  # UB:Derived from original system description
    connect CalRegn01Inin06GroupD.EotProtnPosnRampStep -> AAACalRegn01Inin06GroupD_Dummy.EotProtnPosnRampStep  # UB:Derived from original system description
    connect CalRegn01Inin06GroupD.EotProtnRackTrvlLimrAuthyThd -> AAACalRegn01Inin06GroupD_Dummy.EotProtnRackTrvlLimrAuthyThd  # UB:Derived from original system description
    connect CalRegn01Inin06GroupD.EotProtnRackTrvlLimrAuthyThdLimd -> AAACalRegn01Inin06GroupD_Dummy.EotProtnRackTrvlLimrAuthyThdLimd  # UB:Derived from original system description
    connect CalRegn01Inin06GroupD.EotProtnRackTrvlLimrRng -> AAACalRegn01Inin06GroupD_Dummy.EotProtnRackTrvlLimrRng  # UB:Derived from original system description
    connect CalRegn01Inin06GroupD.EotProtnRackTrvlLimrRngLimd -> AAACalRegn01Inin06GroupD_Dummy.EotProtnRackTrvlLimrRngLimd  # UB:Derived from original system description
    connect CalRegn01Inin06GroupD.EotProtnRackTrvlLimrVehSpdThd -> AAACalRegn01Inin06GroupD_Dummy.EotProtnRackTrvlLimrVehSpdThd  # UB:Derived from original system description
    connect CalRegn01Inin06GroupD.EotProtnRunEotVelImpctAndSoftEndStop -> AAACalRegn01Inin06GroupD_Dummy.EotProtnRunEotVelImpctAndSoftEndStop  # UB:Derived from original system description
    connect CalRegn01Inin06GroupD.InertiaCmpVelAssiBasdDampgCoeffX -> AAACalRegn01Inin06GroupD_Dummy.InertiaCmpVelAssiBasdDampgCoeffX  # UB:Derived from original system description
    connect CalRegn01Inin06GroupD.InertiaCmpVelAssiBasdDampgRollgWhlImbRejctnOnY -> AAACalRegn01Inin06GroupD_Dummy.InertiaCmpVelAssiBasdDampgRollgWhlImbRejctnOnY  # UB:Derived from original system description
    connect CalRegn01Inin06GroupD.InertiaCmpVelAssiBasdDampgRollgY -> AAACalRegn01Inin06GroupD_Dummy.InertiaCmpVelAssiBasdDampgRollgY  # UB:Derived from original system description
    connect CalRegn01Inin06GroupD.InertiaCmpVelAssiBasdDampgStatWhlImbRejctnOnY -> AAACalRegn01Inin06GroupD_Dummy.InertiaCmpVelAssiBasdDampgStatWhlImbRejctnOnY  # UB:Derived from original system description
    connect CalRegn01Inin06GroupD.InertiaCmpVelAssiBasdDampgStatY -> AAACalRegn01Inin06GroupD_Dummy.InertiaCmpVelAssiBasdDampgStatY  # UB:Derived from original system description
    connect CalRegn01Inin06GroupD.InertiaCmpVelCmdScaY -> AAACalRegn01Inin06GroupD_Dummy.InertiaCmpVelCmdScaY  # UB:Derived from original system description
    connect CalRegn01Inin06GroupD.InertiaCmpVelDampgDecelGain -> AAACalRegn01Inin06GroupD_Dummy.InertiaCmpVelDampgDecelGain  # UB:Derived from original system description
    connect CalRegn01Inin06GroupD.InertiaCmpVelDampgDecelGainFallSlew -> AAACalRegn01Inin06GroupD_Dummy.InertiaCmpVelDampgDecelGainFallSlew  # UB:Derived from original system description
    connect CalRegn01Inin06GroupD.InertiaCmpVelDampgDecelGainRisngSlewX -> AAACalRegn01Inin06GroupD_Dummy.InertiaCmpVelDampgDecelGainRisngSlewX  # UB:Derived from original system description
    connect CalRegn01Inin06GroupD.InertiaCmpVelDampgDecelGainRisngSlewY -> AAACalRegn01Inin06GroupD_Dummy.InertiaCmpVelDampgDecelGainRisngSlewY  # UB:Derived from original system description
    connect CalRegn01Inin06GroupD.InertiaCmpVelDampgFilFrq -> AAACalRegn01Inin06GroupD_Dummy.InertiaCmpVelDampgFilFrq  # UB:Derived from original system description
    connect CalRegn01Inin06GroupD.InertiaCmpVelDampgFilFrqWhlImbRejctnOn -> AAACalRegn01Inin06GroupD_Dummy.InertiaCmpVelDampgFilFrqWhlImbRejctnOn  # UB:Derived from original system description
    connect CalRegn01Inin06GroupD.InertiaCmpVelDampgGainOffThd -> AAACalRegn01Inin06GroupD_Dummy.InertiaCmpVelDampgGainOffThd  # UB:Derived from original system description
    connect CalRegn01Inin06GroupD.InertiaCmpVelDampgGainOnThd -> AAACalRegn01Inin06GroupD_Dummy.InertiaCmpVelDampgGainOnThd  # UB:Derived from original system description
    connect CalRegn01Inin06GroupD.InertiaCmpVelDampgSpdBlndY -> AAACalRegn01Inin06GroupD_Dummy.InertiaCmpVelDampgSpdBlndY  # UB:Derived from original system description
    connect CalRegn01Inin06GroupD.InertiaCmpVelDampgWhlImbRejctnBlndX -> AAACalRegn01Inin06GroupD_Dummy.InertiaCmpVelDampgWhlImbRejctnBlndX  # UB:Derived from original system description
    connect CalRegn01Inin06GroupD.InertiaCmpVelDampgWhlImbRejctnBlndY -> AAACalRegn01Inin06GroupD_Dummy.InertiaCmpVelDampgWhlImbRejctnBlndY  # UB:Derived from original system description
    connect CalRegn01Inin06GroupD.InertiaCmpVelDecelGainEnaCal -> AAACalRegn01Inin06GroupD_Dummy.InertiaCmpVelDecelGainEnaCal  # UB:Derived from original system description
    connect CalRegn01Inin06GroupD.InertiaCmpVelModWhlImbRejctnBlndX -> AAACalRegn01Inin06GroupD_Dummy.InertiaCmpVelModWhlImbRejctnBlndX  # UB:Derived from original system description
    connect CalRegn01Inin06GroupD.InertiaCmpVelModWhlImbRejctnBlndY -> AAACalRegn01Inin06GroupD_Dummy.InertiaCmpVelModWhlImbRejctnBlndY  # UB:Derived from original system description
    connect CalRegn01Inin06GroupD.InertiaCmpVelMotInertia -> AAACalRegn01Inin06GroupD_Dummy.InertiaCmpVelMotInertia  # UB:Derived from original system description
    connect CalRegn01Inin06GroupD.InertiaCmpVelMotVelBasdOutpScagX -> AAACalRegn01Inin06GroupD_Dummy.InertiaCmpVelMotVelBasdOutpScagX  # UB:Derived from original system description
    connect CalRegn01Inin06GroupD.InertiaCmpVelMotVelBasdOutpScagY -> AAACalRegn01Inin06GroupD_Dummy.InertiaCmpVelMotVelBasdOutpScagY  # UB:Derived from original system description
    connect CalRegn01Inin06GroupD.InertiaCmpVelNotchBlndY -> AAACalRegn01Inin06GroupD_Dummy.InertiaCmpVelNotchBlndY  # UB:Derived from original system description
    connect CalRegn01Inin06GroupD.InertiaCmpVelNotchFilStruct -> AAACalRegn01Inin06GroupD_Dummy.InertiaCmpVelNotchFilStruct  # UB:Derived from original system description
    connect CalRegn01Inin06GroupD.InertiaCmpVelTqSnsrVelFilFrq -> AAACalRegn01Inin06GroupD_Dummy.InertiaCmpVelTqSnsrVelFilFrq  # UB:Derived from original system description
    connect CalRegn01Inin06GroupD.InertiaCmpVelTqSnsrVelSca -> AAACalRegn01Inin06GroupD_Dummy.InertiaCmpVelTqSnsrVelSca  # UB:Derived from original system description
    connect CalRegn02Rt00GroupD.ClsdLoopDampgEotEntrX -> AAACalRegn02Rt00GroupD_Dummy.ClsdLoopDampgEotEntrX  # UB:Derived from original system description
    connect CalRegn02Rt00GroupD.ClsdLoopDampgEotEntrY -> AAACalRegn02Rt00GroupD_Dummy.ClsdLoopDampgEotEntrY  # UB:Derived from original system description
    connect CalRegn02Rt00GroupD.ClsdLoopDampgEotExitX -> AAACalRegn02Rt00GroupD_Dummy.ClsdLoopDampgEotExitX  # UB:Derived from original system description
    connect CalRegn02Rt00GroupD.ClsdLoopDampgEotExitY -> AAACalRegn02Rt00GroupD_Dummy.ClsdLoopDampgEotExitY  # UB:Derived from original system description
    connect CalRegn02Rt00GroupD.ClsdLoopDampgPinionVelX -> AAACalRegn02Rt00GroupD_Dummy.ClsdLoopDampgPinionVelX  # UB:Derived from original system description
    connect CalRegn02Rt00GroupD.ClsdLoopDampgPinionVelY -> AAACalRegn02Rt00GroupD_Dummy.ClsdLoopDampgPinionVelY  # UB:Derived from original system description
    connect CalRegn02Rt00GroupD.ClsdLoopDampgRackFX -> AAACalRegn02Rt00GroupD_Dummy.ClsdLoopDampgRackFX  # UB:Derived from original system description
    connect CalRegn02Rt00GroupD.ClsdLoopDampgRackFY -> AAACalRegn02Rt00GroupD_Dummy.ClsdLoopDampgRackFY  # UB:Derived from original system description
    connect CalRegn02Rt00GroupD.ClsdLoopHysDeltaY -> AAACalRegn02Rt00GroupD_Dummy.ClsdLoopHysDeltaY  # UB:Derived from original system description
    connect CalRegn02Rt00GroupD.ClsdLoopHysGainY -> AAACalRegn02Rt00GroupD_Dummy.ClsdLoopHysGainY  # UB:Derived from original system description
    connect CalRegn02Rt00GroupD.ClsdLoopHysHwAgBlndFac -> AAACalRegn02Rt00GroupD_Dummy.ClsdLoopHysHwAgBlndFac  # UB:Derived from original system description
    connect CalRegn02Rt00GroupD.ClsdLoopHysHwAgQuadBlndX -> AAACalRegn02Rt00GroupD_Dummy.ClsdLoopHysHwAgQuadBlndX  # UB:Derived from original system description
    connect CalRegn02Rt00GroupD.ClsdLoopHysHwAgQuadBlndY -> AAACalRegn02Rt00GroupD_Dummy.ClsdLoopHysHwAgQuadBlndY  # UB:Derived from original system description
    connect CalRegn02Rt00GroupD.ClsdLoopHysHwAgQuadQlfrX -> AAACalRegn02Rt00GroupD_Dummy.ClsdLoopHysHwAgQuadQlfrX  # UB:Derived from original system description
    connect CalRegn02Rt00GroupD.ClsdLoopHysHwAgQuadQlfrY -> AAACalRegn02Rt00GroupD_Dummy.ClsdLoopHysHwAgQuadQlfrY  # UB:Derived from original system description
    connect CalRegn02Rt00GroupD.ClsdLoopHysHwVelQuadBlndX -> AAACalRegn02Rt00GroupD_Dummy.ClsdLoopHysHwVelQuadBlndX  # UB:Derived from original system description
    connect CalRegn02Rt00GroupD.ClsdLoopHysHwVelQuadBlndY -> AAACalRegn02Rt00GroupD_Dummy.ClsdLoopHysHwVelQuadBlndY  # UB:Derived from original system description
    connect CalRegn02Rt00GroupD.ClsdLoopHysPolarity -> AAACalRegn02Rt00GroupD_Dummy.ClsdLoopHysPolarity  # UB:Derived from original system description
    connect CalRegn02Rt00GroupD.ClsdLoopHysRackFFacX -> AAACalRegn02Rt00GroupD_Dummy.ClsdLoopHysRackFFacX  # UB:Derived from original system description
    connect CalRegn02Rt00GroupD.ClsdLoopHysRackFFacY -> AAACalRegn02Rt00GroupD_Dummy.ClsdLoopHysRackFFacY  # UB:Derived from original system description
    connect CalRegn02Rt00GroupD.ClsdLoopHysRhoY -> AAACalRegn02Rt00GroupD_Dummy.ClsdLoopHysRhoY  # UB:Derived from original system description
    connect CalRegn02Rt00GroupD.ClsdLoopHysSteerInHwAgNegLowrLim -> AAACalRegn02Rt00GroupD_Dummy.ClsdLoopHysSteerInHwAgNegLowrLim  # UB:Derived from original system description
    connect CalRegn02Rt00GroupD.ClsdLoopHysSteerInHwAgNegUpprLim -> AAACalRegn02Rt00GroupD_Dummy.ClsdLoopHysSteerInHwAgNegUpprLim  # UB:Derived from original system description
    connect CalRegn02Rt00GroupD.ClsdLoopHysSteerInHwAgPosLowrLim -> AAACalRegn02Rt00GroupD_Dummy.ClsdLoopHysSteerInHwAgPosLowrLim  # UB:Derived from original system description
    connect CalRegn02Rt00GroupD.ClsdLoopHysSteerInHwAgPosUpprLim -> AAACalRegn02Rt00GroupD_Dummy.ClsdLoopHysSteerInHwAgPosUpprLim  # UB:Derived from original system description
    connect CalRegn02Rt00GroupD.ClsdLoopHysSteerOutHwAgNegLowrLim -> AAACalRegn02Rt00GroupD_Dummy.ClsdLoopHysSteerOutHwAgNegLowrLim  # UB:Derived from original system description
    connect CalRegn02Rt00GroupD.ClsdLoopHysSteerOutHwAgNegUpprLim -> AAACalRegn02Rt00GroupD_Dummy.ClsdLoopHysSteerOutHwAgNegUpprLim  # UB:Derived from original system description
    connect CalRegn02Rt00GroupD.ClsdLoopHysSteerOutHwAgPosLowrLim -> AAACalRegn02Rt00GroupD_Dummy.ClsdLoopHysSteerOutHwAgPosLowrLim  # UB:Derived from original system description
    connect CalRegn02Rt00GroupD.ClsdLoopHysSteerOutHwAgPosUpprLim -> AAACalRegn02Rt00GroupD_Dummy.ClsdLoopHysSteerOutHwAgPosUpprLim  # UB:Derived from original system description
    connect CalRegn02Rt00GroupD.ClsdLoopHysSysFricOffsLimX -> AAACalRegn02Rt00GroupD_Dummy.ClsdLoopHysSysFricOffsLimX  # UB:Derived from original system description
    connect CalRegn02Rt00GroupD.ClsdLoopHysSysFricOffsLimY -> AAACalRegn02Rt00GroupD_Dummy.ClsdLoopHysSysFricOffsLimY  # UB:Derived from original system description
    connect CalRegn02Rt00GroupD.ClsdLoopHysSysFricScaX -> AAACalRegn02Rt00GroupD_Dummy.ClsdLoopHysSysFricScaX  # UB:Derived from original system description
    connect CalRegn02Rt00GroupD.ClsdLoopHysSysFricScaY -> AAACalRegn02Rt00GroupD_Dummy.ClsdLoopHysSysFricScaY  # UB:Derived from original system description
    connect CalRegn02Rt00GroupD.EffortRackFX -> AAACalRegn02Rt00GroupD_Dummy.EffortRackFX  # UB:Derived from original system description
    connect CalRegn02Rt00GroupD.EffortRackFY -> AAACalRegn02Rt00GroupD_Dummy.EffortRackFY  # UB:Derived from original system description
    connect CalRegn02Rt00GroupD.EffortVehSpdBilnrSeln -> AAACalRegn02Rt00GroupD_Dummy.EffortVehSpdBilnrSeln  # UB:Derived from original system description
    connect CalRegn02Rt00GroupD.ClsdLoopDampgEotEntrX -> ClsdLoopDampg.ClsdLoopDampgEotEntrX  # UB:Derived from original system description
    connect CalRegn02Rt00GroupD.ClsdLoopDampgEotEntrY -> ClsdLoopDampg.ClsdLoopDampgEotEntrY  # UB:Derived from original system description
    connect CalRegn02Rt00GroupD.ClsdLoopDampgEotExitX -> ClsdLoopDampg.ClsdLoopDampgEotExitX  # UB:Derived from original system description
    connect CalRegn02Rt00GroupD.ClsdLoopDampgEotExitY -> ClsdLoopDampg.ClsdLoopDampgEotExitY  # UB:Derived from original system description
    connect CalRegn02Rt00GroupD.ClsdLoopDampgPinionVelX -> ClsdLoopDampg.ClsdLoopDampgPinionVelX  # UB:Derived from original system description
    connect CalRegn02Rt00GroupD.ClsdLoopDampgPinionVelY -> ClsdLoopDampg.ClsdLoopDampgPinionVelY  # UB:Derived from original system description
    connect CalRegn02Rt00GroupD.ClsdLoopDampgRackFX -> ClsdLoopDampg.ClsdLoopDampgRackFX  # UB:Derived from original system description
    connect CalRegn02Rt00GroupD.ClsdLoopDampgRackFY -> ClsdLoopDampg.ClsdLoopDampgRackFY  # UB:Derived from original system description
    connect CalRegn02Rt00GroupD.ClsdLoopHysDeltaY -> ClsdLoopHys.ClsdLoopHysDeltaY  # UB:Derived from original system description
    connect CalRegn02Rt00GroupD.ClsdLoopHysGainY -> ClsdLoopHys.ClsdLoopHysGainY  # UB:Derived from original system description
    connect CalRegn02Rt00GroupD.ClsdLoopHysHwAgBlndFac -> ClsdLoopHys.ClsdLoopHysHwAgBlndFac  # UB:Derived from original system description
    connect CalRegn02Rt00GroupD.ClsdLoopHysHwAgQuadBlndX -> ClsdLoopHys.ClsdLoopHysHwAgQuadBlndX  # UB:Derived from original system description
    connect CalRegn02Rt00GroupD.ClsdLoopHysHwAgQuadBlndY -> ClsdLoopHys.ClsdLoopHysHwAgQuadBlndY  # UB:Derived from original system description
    connect CalRegn02Rt00GroupD.ClsdLoopHysHwAgQuadQlfrX -> ClsdLoopHys.ClsdLoopHysHwAgQuadQlfrX  # UB:Derived from original system description
    connect CalRegn02Rt00GroupD.ClsdLoopHysHwAgQuadQlfrY -> ClsdLoopHys.ClsdLoopHysHwAgQuadQlfrY  # UB:Derived from original system description
    connect CalRegn02Rt00GroupD.ClsdLoopHysHwVelQuadBlndX -> ClsdLoopHys.ClsdLoopHysHwVelQuadBlndX  # UB:Derived from original system description
    connect CalRegn02Rt00GroupD.ClsdLoopHysHwVelQuadBlndY -> ClsdLoopHys.ClsdLoopHysHwVelQuadBlndY  # UB:Derived from original system description
    connect CalRegn02Rt00GroupD.ClsdLoopHysPolarity -> ClsdLoopHys.ClsdLoopHysPolarity  # UB:Derived from original system description
    connect CalRegn02Rt00GroupD.ClsdLoopHysRackFFacX -> ClsdLoopHys.ClsdLoopHysRackFFacX  # UB:Derived from original system description
    connect CalRegn02Rt00GroupD.ClsdLoopHysRackFFacY -> ClsdLoopHys.ClsdLoopHysRackFFacY  # UB:Derived from original system description
    connect CalRegn02Rt00GroupD.ClsdLoopHysRhoY -> ClsdLoopHys.ClsdLoopHysRhoY  # UB:Derived from original system description
    connect CalRegn02Rt00GroupD.ClsdLoopHysSteerInHwAgNegLowrLim -> ClsdLoopHys.ClsdLoopHysSteerInHwAgNegLowrLim  # UB:Derived from original system description
    connect CalRegn02Rt00GroupD.ClsdLoopHysSteerInHwAgNegUpprLim -> ClsdLoopHys.ClsdLoopHysSteerInHwAgNegUpprLim  # UB:Derived from original system description
    connect CalRegn02Rt00GroupD.ClsdLoopHysSteerInHwAgPosLowrLim -> ClsdLoopHys.ClsdLoopHysSteerInHwAgPosLowrLim  # UB:Derived from original system description
    connect CalRegn02Rt00GroupD.ClsdLoopHysSteerInHwAgPosUpprLim -> ClsdLoopHys.ClsdLoopHysSteerInHwAgPosUpprLim  # UB:Derived from original system description
    connect CalRegn02Rt00GroupD.ClsdLoopHysSteerOutHwAgNegLowrLim -> ClsdLoopHys.ClsdLoopHysSteerOutHwAgNegLowrLim  # UB:Derived from original system description
    connect CalRegn02Rt00GroupD.ClsdLoopHysSteerOutHwAgNegUpprLim -> ClsdLoopHys.ClsdLoopHysSteerOutHwAgNegUpprLim  # UB:Derived from original system description
    connect CalRegn02Rt00GroupD.ClsdLoopHysSteerOutHwAgPosLowrLim -> ClsdLoopHys.ClsdLoopHysSteerOutHwAgPosLowrLim  # UB:Derived from original system description
    connect CalRegn02Rt00GroupD.ClsdLoopHysSteerOutHwAgPosUpprLim -> ClsdLoopHys.ClsdLoopHysSteerOutHwAgPosUpprLim  # UB:Derived from original system description
    connect CalRegn02Rt00GroupD.ClsdLoopHysSysFricOffsLimX -> ClsdLoopHys.ClsdLoopHysSysFricOffsLimX  # UB:Derived from original system description
    connect CalRegn02Rt00GroupD.ClsdLoopHysSysFricOffsLimY -> ClsdLoopHys.ClsdLoopHysSysFricOffsLimY  # UB:Derived from original system description
    connect CalRegn02Rt00GroupD.ClsdLoopHysSysFricScaX -> ClsdLoopHys.ClsdLoopHysSysFricScaX  # UB:Derived from original system description
    connect CalRegn02Rt00GroupD.ClsdLoopHysSysFricScaY -> ClsdLoopHys.ClsdLoopHysSysFricScaY  # UB:Derived from original system description
    connect CalRegn02Rt00GroupD.EffortRackFX -> Effort.EffortRackFX  # UB:Derived from original system description
    connect CalRegn02Rt00GroupD.EffortRackFY -> Effort.EffortRackFY  # UB:Derived from original system description
    connect CalRegn02Rt00GroupD.EffortVehSpdBilnrSeln -> Effort.EffortVehSpdBilnrSeln  # UB:Derived from original system description
    connect CalRegn02Rt01GroupD.ClsdLoopDampgEotEntrX -> AAACalRegn02Rt01GroupD_Dummy.ClsdLoopDampgEotEntrX  # UB:Derived from original system description
    connect CalRegn02Rt01GroupD.ClsdLoopDampgEotEntrY -> AAACalRegn02Rt01GroupD_Dummy.ClsdLoopDampgEotEntrY  # UB:Derived from original system description
    connect CalRegn02Rt01GroupD.ClsdLoopDampgEotExitX -> AAACalRegn02Rt01GroupD_Dummy.ClsdLoopDampgEotExitX  # UB:Derived from original system description
    connect CalRegn02Rt01GroupD.ClsdLoopDampgEotExitY -> AAACalRegn02Rt01GroupD_Dummy.ClsdLoopDampgEotExitY  # UB:Derived from original system description
    connect CalRegn02Rt01GroupD.ClsdLoopDampgPinionVelX -> AAACalRegn02Rt01GroupD_Dummy.ClsdLoopDampgPinionVelX  # UB:Derived from original system description
    connect CalRegn02Rt01GroupD.ClsdLoopDampgPinionVelY -> AAACalRegn02Rt01GroupD_Dummy.ClsdLoopDampgPinionVelY  # UB:Derived from original system description
    connect CalRegn02Rt01GroupD.ClsdLoopDampgRackFX -> AAACalRegn02Rt01GroupD_Dummy.ClsdLoopDampgRackFX  # UB:Derived from original system description
    connect CalRegn02Rt01GroupD.ClsdLoopDampgRackFY -> AAACalRegn02Rt01GroupD_Dummy.ClsdLoopDampgRackFY  # UB:Derived from original system description
    connect CalRegn02Rt01GroupD.ClsdLoopHysDeltaY -> AAACalRegn02Rt01GroupD_Dummy.ClsdLoopHysDeltaY  # UB:Derived from original system description
    connect CalRegn02Rt01GroupD.ClsdLoopHysGainY -> AAACalRegn02Rt01GroupD_Dummy.ClsdLoopHysGainY  # UB:Derived from original system description
    connect CalRegn02Rt01GroupD.ClsdLoopHysHwAgBlndFac -> AAACalRegn02Rt01GroupD_Dummy.ClsdLoopHysHwAgBlndFac  # UB:Derived from original system description
    connect CalRegn02Rt01GroupD.ClsdLoopHysHwAgQuadBlndX -> AAACalRegn02Rt01GroupD_Dummy.ClsdLoopHysHwAgQuadBlndX  # UB:Derived from original system description
    connect CalRegn02Rt01GroupD.ClsdLoopHysHwAgQuadBlndY -> AAACalRegn02Rt01GroupD_Dummy.ClsdLoopHysHwAgQuadBlndY  # UB:Derived from original system description
    connect CalRegn02Rt01GroupD.ClsdLoopHysHwAgQuadQlfrX -> AAACalRegn02Rt01GroupD_Dummy.ClsdLoopHysHwAgQuadQlfrX  # UB:Derived from original system description
    connect CalRegn02Rt01GroupD.ClsdLoopHysHwAgQuadQlfrY -> AAACalRegn02Rt01GroupD_Dummy.ClsdLoopHysHwAgQuadQlfrY  # UB:Derived from original system description
    connect CalRegn02Rt01GroupD.ClsdLoopHysHwVelQuadBlndX -> AAACalRegn02Rt01GroupD_Dummy.ClsdLoopHysHwVelQuadBlndX  # UB:Derived from original system description
    connect CalRegn02Rt01GroupD.ClsdLoopHysHwVelQuadBlndY -> AAACalRegn02Rt01GroupD_Dummy.ClsdLoopHysHwVelQuadBlndY  # UB:Derived from original system description
    connect CalRegn02Rt01GroupD.ClsdLoopHysPolarity -> AAACalRegn02Rt01GroupD_Dummy.ClsdLoopHysPolarity  # UB:Derived from original system description
    connect CalRegn02Rt01GroupD.ClsdLoopHysRackFFacX -> AAACalRegn02Rt01GroupD_Dummy.ClsdLoopHysRackFFacX  # UB:Derived from original system description
    connect CalRegn02Rt01GroupD.ClsdLoopHysRackFFacY -> AAACalRegn02Rt01GroupD_Dummy.ClsdLoopHysRackFFacY  # UB:Derived from original system description
    connect CalRegn02Rt01GroupD.ClsdLoopHysRhoY -> AAACalRegn02Rt01GroupD_Dummy.ClsdLoopHysRhoY  # UB:Derived from original system description
    connect CalRegn02Rt01GroupD.ClsdLoopHysSteerInHwAgNegLowrLim -> AAACalRegn02Rt01GroupD_Dummy.ClsdLoopHysSteerInHwAgNegLowrLim  # UB:Derived from original system description
    connect CalRegn02Rt01GroupD.ClsdLoopHysSteerInHwAgNegUpprLim -> AAACalRegn02Rt01GroupD_Dummy.ClsdLoopHysSteerInHwAgNegUpprLim  # UB:Derived from original system description
    connect CalRegn02Rt01GroupD.ClsdLoopHysSteerInHwAgPosLowrLim -> AAACalRegn02Rt01GroupD_Dummy.ClsdLoopHysSteerInHwAgPosLowrLim  # UB:Derived from original system description
    connect CalRegn02Rt01GroupD.ClsdLoopHysSteerInHwAgPosUpprLim -> AAACalRegn02Rt01GroupD_Dummy.ClsdLoopHysSteerInHwAgPosUpprLim  # UB:Derived from original system description
    connect CalRegn02Rt01GroupD.ClsdLoopHysSteerOutHwAgNegLowrLim -> AAACalRegn02Rt01GroupD_Dummy.ClsdLoopHysSteerOutHwAgNegLowrLim  # UB:Derived from original system description
    connect CalRegn02Rt01GroupD.ClsdLoopHysSteerOutHwAgNegUpprLim -> AAACalRegn02Rt01GroupD_Dummy.ClsdLoopHysSteerOutHwAgNegUpprLim  # UB:Derived from original system description
    connect CalRegn02Rt01GroupD.ClsdLoopHysSteerOutHwAgPosLowrLim -> AAACalRegn02Rt01GroupD_Dummy.ClsdLoopHysSteerOutHwAgPosLowrLim  # UB:Derived from original system description
    connect CalRegn02Rt01GroupD.ClsdLoopHysSteerOutHwAgPosUpprLim -> AAACalRegn02Rt01GroupD_Dummy.ClsdLoopHysSteerOutHwAgPosUpprLim  # UB:Derived from original system description
    connect CalRegn02Rt01GroupD.ClsdLoopHysSysFricOffsLimX -> AAACalRegn02Rt01GroupD_Dummy.ClsdLoopHysSysFricOffsLimX  # UB:Derived from original system description
    connect CalRegn02Rt01GroupD.ClsdLoopHysSysFricOffsLimY -> AAACalRegn02Rt01GroupD_Dummy.ClsdLoopHysSysFricOffsLimY  # UB:Derived from original system description
    connect CalRegn02Rt01GroupD.ClsdLoopHysSysFricScaX -> AAACalRegn02Rt01GroupD_Dummy.ClsdLoopHysSysFricScaX  # UB:Derived from original system description
    connect CalRegn02Rt01GroupD.ClsdLoopHysSysFricScaY -> AAACalRegn02Rt01GroupD_Dummy.ClsdLoopHysSysFricScaY  # UB:Derived from original system description
    connect CalRegn02Rt01GroupD.EffortRackFX -> AAACalRegn02Rt01GroupD_Dummy.EffortRackFX  # UB:Derived from original system description
    connect CalRegn02Rt01GroupD.EffortRackFY -> AAACalRegn02Rt01GroupD_Dummy.EffortRackFY  # UB:Derived from original system description
    connect CalRegn02Rt01GroupD.EffortVehSpdBilnrSeln -> AAACalRegn02Rt01GroupD_Dummy.EffortVehSpdBilnrSeln  # UB:Derived from original system description
    connect CalRegn02Rt02GroupD.ClsdLoopDampgEotEntrX -> AAACalRegn02Rt02GroupD_Dummy.ClsdLoopDampgEotEntrX  # UB:Derived from original system description
    connect CalRegn02Rt02GroupD.ClsdLoopDampgEotEntrY -> AAACalRegn02Rt02GroupD_Dummy.ClsdLoopDampgEotEntrY  # UB:Derived from original system description
    connect CalRegn02Rt02GroupD.ClsdLoopDampgEotExitX -> AAACalRegn02Rt02GroupD_Dummy.ClsdLoopDampgEotExitX  # UB:Derived from original system description
    connect CalRegn02Rt02GroupD.ClsdLoopDampgEotExitY -> AAACalRegn02Rt02GroupD_Dummy.ClsdLoopDampgEotExitY  # UB:Derived from original system description
    connect CalRegn02Rt02GroupD.ClsdLoopDampgPinionVelX -> AAACalRegn02Rt02GroupD_Dummy.ClsdLoopDampgPinionVelX  # UB:Derived from original system description
    connect CalRegn02Rt02GroupD.ClsdLoopDampgPinionVelY -> AAACalRegn02Rt02GroupD_Dummy.ClsdLoopDampgPinionVelY  # UB:Derived from original system description
    connect CalRegn02Rt02GroupD.ClsdLoopDampgRackFX -> AAACalRegn02Rt02GroupD_Dummy.ClsdLoopDampgRackFX  # UB:Derived from original system description
    connect CalRegn02Rt02GroupD.ClsdLoopDampgRackFY -> AAACalRegn02Rt02GroupD_Dummy.ClsdLoopDampgRackFY  # UB:Derived from original system description
    connect CalRegn02Rt02GroupD.ClsdLoopHysDeltaY -> AAACalRegn02Rt02GroupD_Dummy.ClsdLoopHysDeltaY  # UB:Derived from original system description
    connect CalRegn02Rt02GroupD.ClsdLoopHysGainY -> AAACalRegn02Rt02GroupD_Dummy.ClsdLoopHysGainY  # UB:Derived from original system description
    connect CalRegn02Rt02GroupD.ClsdLoopHysHwAgBlndFac -> AAACalRegn02Rt02GroupD_Dummy.ClsdLoopHysHwAgBlndFac  # UB:Derived from original system description
    connect CalRegn02Rt02GroupD.ClsdLoopHysHwAgQuadBlndX -> AAACalRegn02Rt02GroupD_Dummy.ClsdLoopHysHwAgQuadBlndX  # UB:Derived from original system description
    connect CalRegn02Rt02GroupD.ClsdLoopHysHwAgQuadBlndY -> AAACalRegn02Rt02GroupD_Dummy.ClsdLoopHysHwAgQuadBlndY  # UB:Derived from original system description
    connect CalRegn02Rt02GroupD.ClsdLoopHysHwAgQuadQlfrX -> AAACalRegn02Rt02GroupD_Dummy.ClsdLoopHysHwAgQuadQlfrX  # UB:Derived from original system description
    connect CalRegn02Rt02GroupD.ClsdLoopHysHwAgQuadQlfrY -> AAACalRegn02Rt02GroupD_Dummy.ClsdLoopHysHwAgQuadQlfrY  # UB:Derived from original system description
    connect CalRegn02Rt02GroupD.ClsdLoopHysHwVelQuadBlndX -> AAACalRegn02Rt02GroupD_Dummy.ClsdLoopHysHwVelQuadBlndX  # UB:Derived from original system description
    connect CalRegn02Rt02GroupD.ClsdLoopHysHwVelQuadBlndY -> AAACalRegn02Rt02GroupD_Dummy.ClsdLoopHysHwVelQuadBlndY  # UB:Derived from original system description
    connect CalRegn02Rt02GroupD.ClsdLoopHysPolarity -> AAACalRegn02Rt02GroupD_Dummy.ClsdLoopHysPolarity  # UB:Derived from original system description
    connect CalRegn02Rt02GroupD.ClsdLoopHysRackFFacX -> AAACalRegn02Rt02GroupD_Dummy.ClsdLoopHysRackFFacX  # UB:Derived from original system description
    connect CalRegn02Rt02GroupD.ClsdLoopHysRackFFacY -> AAACalRegn02Rt02GroupD_Dummy.ClsdLoopHysRackFFacY  # UB:Derived from original system description
    connect CalRegn02Rt02GroupD.ClsdLoopHysRhoY -> AAACalRegn02Rt02GroupD_Dummy.ClsdLoopHysRhoY  # UB:Derived from original system description
    connect CalRegn02Rt02GroupD.ClsdLoopHysSteerInHwAgNegLowrLim -> AAACalRegn02Rt02GroupD_Dummy.ClsdLoopHysSteerInHwAgNegLowrLim  # UB:Derived from original system description
    connect CalRegn02Rt02GroupD.ClsdLoopHysSteerInHwAgNegUpprLim -> AAACalRegn02Rt02GroupD_Dummy.ClsdLoopHysSteerInHwAgNegUpprLim  # UB:Derived from original system description
    connect CalRegn02Rt02GroupD.ClsdLoopHysSteerInHwAgPosLowrLim -> AAACalRegn02Rt02GroupD_Dummy.ClsdLoopHysSteerInHwAgPosLowrLim  # UB:Derived from original system description
    connect CalRegn02Rt02GroupD.ClsdLoopHysSteerInHwAgPosUpprLim -> AAACalRegn02Rt02GroupD_Dummy.ClsdLoopHysSteerInHwAgPosUpprLim  # UB:Derived from original system description
    connect CalRegn02Rt02GroupD.ClsdLoopHysSteerOutHwAgNegLowrLim -> AAACalRegn02Rt02GroupD_Dummy.ClsdLoopHysSteerOutHwAgNegLowrLim  # UB:Derived from original system description
    connect CalRegn02Rt02GroupD.ClsdLoopHysSteerOutHwAgNegUpprLim -> AAACalRegn02Rt02GroupD_Dummy.ClsdLoopHysSteerOutHwAgNegUpprLim  # UB:Derived from original system description
    connect CalRegn02Rt02GroupD.ClsdLoopHysSteerOutHwAgPosLowrLim -> AAACalRegn02Rt02GroupD_Dummy.ClsdLoopHysSteerOutHwAgPosLowrLim  # UB:Derived from original system description
    connect CalRegn02Rt02GroupD.ClsdLoopHysSteerOutHwAgPosUpprLim -> AAACalRegn02Rt02GroupD_Dummy.ClsdLoopHysSteerOutHwAgPosUpprLim  # UB:Derived from original system description
    connect CalRegn02Rt02GroupD.ClsdLoopHysSysFricOffsLimX -> AAACalRegn02Rt02GroupD_Dummy.ClsdLoopHysSysFricOffsLimX  # UB:Derived from original system description
    connect CalRegn02Rt02GroupD.ClsdLoopHysSysFricOffsLimY -> AAACalRegn02Rt02GroupD_Dummy.ClsdLoopHysSysFricOffsLimY  # UB:Derived from original system description
    connect CalRegn02Rt02GroupD.ClsdLoopHysSysFricScaX -> AAACalRegn02Rt02GroupD_Dummy.ClsdLoopHysSysFricScaX  # UB:Derived from original system description
    connect CalRegn02Rt02GroupD.ClsdLoopHysSysFricScaY -> AAACalRegn02Rt02GroupD_Dummy.ClsdLoopHysSysFricScaY  # UB:Derived from original system description
    connect CalRegn02Rt02GroupD.EffortRackFX -> AAACalRegn02Rt02GroupD_Dummy.EffortRackFX  # UB:Derived from original system description
    connect CalRegn02Rt02GroupD.EffortRackFY -> AAACalRegn02Rt02GroupD_Dummy.EffortRackFY  # UB:Derived from original system description
    connect CalRegn02Rt02GroupD.EffortVehSpdBilnrSeln -> AAACalRegn02Rt02GroupD_Dummy.EffortVehSpdBilnrSeln  # UB:Derived from original system description
    connect CalRegn02Rt03GroupD.ClsdLoopDampgEotEntrX -> AAACalRegn02Rt03GroupD_Dummy.ClsdLoopDampgEotEntrX  # UB:Derived from original system description
    connect CalRegn02Rt03GroupD.ClsdLoopDampgEotEntrY -> AAACalRegn02Rt03GroupD_Dummy.ClsdLoopDampgEotEntrY  # UB:Derived from original system description
    connect CalRegn02Rt03GroupD.ClsdLoopDampgEotExitX -> AAACalRegn02Rt03GroupD_Dummy.ClsdLoopDampgEotExitX  # UB:Derived from original system description
    connect CalRegn02Rt03GroupD.ClsdLoopDampgEotExitY -> AAACalRegn02Rt03GroupD_Dummy.ClsdLoopDampgEotExitY  # UB:Derived from original system description
    connect CalRegn02Rt03GroupD.ClsdLoopDampgPinionVelX -> AAACalRegn02Rt03GroupD_Dummy.ClsdLoopDampgPinionVelX  # UB:Derived from original system description
    connect CalRegn02Rt03GroupD.ClsdLoopDampgPinionVelY -> AAACalRegn02Rt03GroupD_Dummy.ClsdLoopDampgPinionVelY  # UB:Derived from original system description
    connect CalRegn02Rt03GroupD.ClsdLoopDampgRackFX -> AAACalRegn02Rt03GroupD_Dummy.ClsdLoopDampgRackFX  # UB:Derived from original system description
    connect CalRegn02Rt03GroupD.ClsdLoopDampgRackFY -> AAACalRegn02Rt03GroupD_Dummy.ClsdLoopDampgRackFY  # UB:Derived from original system description
    connect CalRegn02Rt03GroupD.ClsdLoopHysDeltaY -> AAACalRegn02Rt03GroupD_Dummy.ClsdLoopHysDeltaY  # UB:Derived from original system description
    connect CalRegn02Rt03GroupD.ClsdLoopHysGainY -> AAACalRegn02Rt03GroupD_Dummy.ClsdLoopHysGainY  # UB:Derived from original system description
    connect CalRegn02Rt03GroupD.ClsdLoopHysHwAgBlndFac -> AAACalRegn02Rt03GroupD_Dummy.ClsdLoopHysHwAgBlndFac  # UB:Derived from original system description
    connect CalRegn02Rt03GroupD.ClsdLoopHysHwAgQuadBlndX -> AAACalRegn02Rt03GroupD_Dummy.ClsdLoopHysHwAgQuadBlndX  # UB:Derived from original system description
    connect CalRegn02Rt03GroupD.ClsdLoopHysHwAgQuadBlndY -> AAACalRegn02Rt03GroupD_Dummy.ClsdLoopHysHwAgQuadBlndY  # UB:Derived from original system description
    connect CalRegn02Rt03GroupD.ClsdLoopHysHwAgQuadQlfrX -> AAACalRegn02Rt03GroupD_Dummy.ClsdLoopHysHwAgQuadQlfrX  # UB:Derived from original system description
    connect CalRegn02Rt03GroupD.ClsdLoopHysHwAgQuadQlfrY -> AAACalRegn02Rt03GroupD_Dummy.ClsdLoopHysHwAgQuadQlfrY  # UB:Derived from original system description
    connect CalRegn02Rt03GroupD.ClsdLoopHysHwVelQuadBlndX -> AAACalRegn02Rt03GroupD_Dummy.ClsdLoopHysHwVelQuadBlndX  # UB:Derived from original system description
    connect CalRegn02Rt03GroupD.ClsdLoopHysHwVelQuadBlndY -> AAACalRegn02Rt03GroupD_Dummy.ClsdLoopHysHwVelQuadBlndY  # UB:Derived from original system description
    connect CalRegn02Rt03GroupD.ClsdLoopHysPolarity -> AAACalRegn02Rt03GroupD_Dummy.ClsdLoopHysPolarity  # UB:Derived from original system description
    connect CalRegn02Rt03GroupD.ClsdLoopHysRackFFacX -> AAACalRegn02Rt03GroupD_Dummy.ClsdLoopHysRackFFacX  # UB:Derived from original system description
    connect CalRegn02Rt03GroupD.ClsdLoopHysRackFFacY -> AAACalRegn02Rt03GroupD_Dummy.ClsdLoopHysRackFFacY  # UB:Derived from original system description
    connect CalRegn02Rt03GroupD.ClsdLoopHysRhoY -> AAACalRegn02Rt03GroupD_Dummy.ClsdLoopHysRhoY  # UB:Derived from original system description
    connect CalRegn02Rt03GroupD.ClsdLoopHysSteerInHwAgNegLowrLim -> AAACalRegn02Rt03GroupD_Dummy.ClsdLoopHysSteerInHwAgNegLowrLim  # UB:Derived from original system description
    connect CalRegn02Rt03GroupD.ClsdLoopHysSteerInHwAgNegUpprLim -> AAACalRegn02Rt03GroupD_Dummy.ClsdLoopHysSteerInHwAgNegUpprLim  # UB:Derived from original system description
    connect CalRegn02Rt03GroupD.ClsdLoopHysSteerInHwAgPosLowrLim -> AAACalRegn02Rt03GroupD_Dummy.ClsdLoopHysSteerInHwAgPosLowrLim  # UB:Derived from original system description
    connect CalRegn02Rt03GroupD.ClsdLoopHysSteerInHwAgPosUpprLim -> AAACalRegn02Rt03GroupD_Dummy.ClsdLoopHysSteerInHwAgPosUpprLim  # UB:Derived from original system description
    connect CalRegn02Rt03GroupD.ClsdLoopHysSteerOutHwAgNegLowrLim -> AAACalRegn02Rt03GroupD_Dummy.ClsdLoopHysSteerOutHwAgNegLowrLim  # UB:Derived from original system description
    connect CalRegn02Rt03GroupD.ClsdLoopHysSteerOutHwAgNegUpprLim -> AAACalRegn02Rt03GroupD_Dummy.ClsdLoopHysSteerOutHwAgNegUpprLim  # UB:Derived from original system description
    connect CalRegn02Rt03GroupD.ClsdLoopHysSteerOutHwAgPosLowrLim -> AAACalRegn02Rt03GroupD_Dummy.ClsdLoopHysSteerOutHwAgPosLowrLim  # UB:Derived from original system description
    connect CalRegn02Rt03GroupD.ClsdLoopHysSteerOutHwAgPosUpprLim -> AAACalRegn02Rt03GroupD_Dummy.ClsdLoopHysSteerOutHwAgPosUpprLim  # UB:Derived from original system description
    connect CalRegn02Rt03GroupD.ClsdLoopHysSysFricOffsLimX -> AAACalRegn02Rt03GroupD_Dummy.ClsdLoopHysSysFricOffsLimX  # UB:Derived from original system description
    connect CalRegn02Rt03GroupD.ClsdLoopHysSysFricOffsLimY -> AAACalRegn02Rt03GroupD_Dummy.ClsdLoopHysSysFricOffsLimY  # UB:Derived from original system description
    connect CalRegn02Rt03GroupD.ClsdLoopHysSysFricScaX -> AAACalRegn02Rt03GroupD_Dummy.ClsdLoopHysSysFricScaX  # UB:Derived from original system description
    connect CalRegn02Rt03GroupD.ClsdLoopHysSysFricScaY -> AAACalRegn02Rt03GroupD_Dummy.ClsdLoopHysSysFricScaY  # UB:Derived from original system description
    connect CalRegn02Rt03GroupD.EffortRackFX -> AAACalRegn02Rt03GroupD_Dummy.EffortRackFX  # UB:Derived from original system description
    connect CalRegn02Rt03GroupD.EffortRackFY -> AAACalRegn02Rt03GroupD_Dummy.EffortRackFY  # UB:Derived from original system description
    connect CalRegn02Rt03GroupD.EffortVehSpdBilnrSeln -> AAACalRegn02Rt03GroupD_Dummy.EffortVehSpdBilnrSeln  # UB:Derived from original system description
    connect Coding.DataMode -> BmwSwFctDi.Coding_DataMode  # UB:Derived from original system description
    connect Coding.Data -> BmwSwFctDi.Data  # UB:Derived from original system description
    connect DiagcMgrProxyAppl10.GetNtcQlfrSts10 -> SysFricLrng.GetNtcQlfrSts  # UB:Derived from original system description
    connect DiagcMgrProxyAppl10.SetNtcSts10 -> SysFricLrng.SetNtcSts  # UB:Derived from original system description
    connect BmwSwFctDi.HwTqCmdHysBmwOvrd -> HwRefTqSum.HwTqCmdHys  # UB:Derived from original system description
    connect BmwSwFctDi.CtrldVelRtnCmdBmwOvrd -> HwRefTqSum.RtnCmd  # UB:Derived from original system description
    connect BmwSwFctDi.InertiaCmpVelCmdDiBmwOvrd -> InertiaCmpVel.InertiaCmpVelCmdDi  # UB:Derived from original system description
    connect BmwSwFctDi.PullCmpCmdDiBmwOvrd -> PullCmpActv.PullCmpCmdDi  # UB:Derived from original system description
    connect ClsdLoopHys.HwTqCmdHys -> BmwSwFctDi.HwTqCmdHys  # UB:Derived from original system description
    connect CmnMfgSrv.InertiaCmpVelCmdDi -> BmwSwFctDi.InertiaCmpVelCmdDi  # UB:Derived from original system description
    connect CmnMfgSrv.PullCmpCmdDi -> BmwSwFctDi.PullCmpCmdDi  # UB:Derived from original system description
    connect CtrldVelRtn.CtrldVelRtnCmd -> BmwSwFctDi.CtrldVelRtnCmd  # UB:Derived from original system description
  end to end protection set E2EPROTECTIONSET
    15 x end to end protection:
      endToEndProt_OFFS_QUAD_EPS:
        end-to-end-profile={category=PROFILE_01, data-ids=[229, 229, 229, 229, 229, 229, 229, 229, 229, 229, 229, 229, 229, 229, 229, 229, 229, 229, 229, 229, 229, 229, 229, 229, 229, 229, 229, 229, 229, 229, 229, 229, 229, 229, 229, 229, 229, 229, 229, 229, 229, 229, 229, 229, 229, 229, 229, 229, 229, 229, 229, 229, 229, 229, 229, 229, 229, 229, 229, 229, 229, 229, 229, 229, 229, 229, 229, 229, 229, 229, 229, 229, 229, 229, 229, 229, 229, 229, 229, 229, 229, 229, 229, 229, 229, 229, 229, 229, 229, 229, 229, 229, 229, 229, 229, 229, 229, 229, 229, 229, 229, 229, 229, 229, 229, 229, 229, 229, 229, 229, 229, 229, 229, 229, 229, 229, 229, 229, 229, 229, 229, 229, 229, 229, 229, 229, 229, 229, 229, 229, 229, 229, 229, 229, 229, 229, 229, 229, 229, 229, 229, 229, 229, 229, 229, 229, 229, 229, 229, 229, 229, 229, 229, 229, 229, 229, 229, 229, 229, 229, 229, 229, 229, 229, 229, 229, 229, 229, 229, 229, 229, 229, 229, 229, 229, 229, 229, 229, 229, 229, 229, 229, 229, 229, 229, 229, 229, 229, 229, 229, 229, 229, 229, 229, 229, 229, 229, 229, 229, 229, 229, 229, 229, 229, 229, 229, 229, 229, 229, 229, 229, 229, 229, 229, 229, 229, 229, 229, 229, 229, 229, 229, 229, 229, 229, 229], data-id-mode=0, data-length=40, max-delta-counter-init=14, crc-offset=0, counter-offset=8, data-id-nibble-offset=0}
        end-to-end-protection-i-signal-i-pdu{data-offset=0, i-signal-group=sigGroup_OFFS_QUAD_EPS, i-signal-i-pdu=OFFS_QUAD_EPS}
        end-to-end-protection-variable-prototype=receiver=BmwMsgSlot107Bas0Repn1BusFrChA.COMPOSITIONTYPE.sigGroup_OFFS_QUAD_EPS.sigGroup_OFFS_QUAD_EPS
      endToEndProt_CON_VEH:
        end-to-end-profile={category=PROFILE_01, data-ids=[197, 197, 197, 197, 197, 197, 197, 197, 197, 197, 197, 197, 197, 197, 197, 197, 197, 197, 197, 197, 197, 197, 197, 197, 197, 197, 197, 197, 197, 197, 197, 197, 197, 197, 197, 197, 197, 197, 197, 197, 197, 197, 197, 197, 197, 197, 197, 197, 197, 197, 197, 197, 197, 197, 197, 197, 197, 197, 197, 197, 197, 197, 197, 197, 197, 197, 197, 197, 197, 197, 197, 197, 197, 197, 197, 197, 197, 197, 197, 197, 197, 197, 197, 197, 197, 197, 197, 197, 197, 197, 197, 197, 197, 197, 197, 197, 197, 197, 197, 197, 197, 197, 197, 197, 197, 197, 197, 197, 197, 197, 197, 197, 197, 197, 197, 197, 197, 197, 197, 197, 197, 197, 197, 197, 197, 197, 197, 197, 197, 197, 197, 197, 197, 197, 197, 197, 197, 197, 197, 197, 197, 197, 197, 197, 197, 197, 197, 197, 197, 197, 197, 197, 197, 197, 197, 197, 197, 197, 197, 197, 197, 197, 197, 197, 197, 197, 197, 197, 197, 197, 197, 197, 197, 197, 197, 197, 197, 197, 197, 197, 197, 197, 197, 197, 197, 197, 197, 197, 197, 197, 197, 197, 197, 197, 197, 197, 197, 197, 197, 197, 197, 197, 197, 197, 197, 197, 197, 197, 197, 197, 197, 197, 197, 197, 197, 197, 197, 197, 197, 197, 197, 197, 197, 197, 197, 197], data-id-mode=0, data-length=64, max-delta-counter-init=14, crc-offset=0, counter-offset=8, data-id-nibble-offset=0}
        end-to-end-protection-i-signal-i-pdu{data-offset=0, i-signal-group=sigGroup_CON_VEH, i-signal-i-pdu=CON_VEH}
        end-to-end-protection-variable-prototype=receiver=BmwMsgSlot121Bas1Repn2BusFrChA.COMPOSITIONTYPE.sigGroup_CON_VEH.sigGroup_CON_VEH
      endToEndProt_V_VEH:
        end-to-end-profile={category=PROFILE_01, data-ids=[12, 12, 12, 12, 12, 12, 12, 12, 12, 12, 12, 12, 12, 12, 12, 12, 12, 12, 12, 12, 12, 12, 12, 12, 12, 12, 12, 12, 12, 12, 12, 12, 12, 12, 12, 12, 12, 12, 12, 12, 12, 12, 12, 12, 12, 12, 12, 12, 12, 12, 12, 12, 12, 12, 12, 12, 12, 12, 12, 12, 12, 12, 12, 12, 12, 12, 12, 12, 12, 12, 12, 12, 12, 12, 12, 12, 12, 12, 12, 12, 12, 12, 12, 12, 12, 12, 12, 12, 12, 12, 12, 12, 12, 12, 12, 12, 12, 12, 12, 12, 12, 12, 12, 12, 12, 12, 12, 12, 12, 12, 12, 12, 12, 12, 12, 12, 12, 12, 12, 12, 12, 12, 12, 12, 12, 12, 12, 12, 12, 12, 12, 12, 12, 12, 12, 12, 12, 12, 12, 12, 12, 12, 12, 12, 12, 12, 12, 12, 12, 12, 12, 12, 12, 12, 12, 12, 12, 12, 12, 12, 12, 12, 12, 12, 12, 12, 12, 12, 12, 12, 12, 12, 12, 12, 12, 12, 12, 12, 12, 12, 12, 12, 12, 12, 12, 12, 12, 12, 12, 12, 12, 12, 12, 12, 12, 12, 12, 12, 12, 12, 12, 12, 12, 12, 12, 12, 12, 12, 12, 12, 12, 12, 12, 12, 12, 12, 12, 12, 12, 12, 12, 12, 12, 12, 12, 12], data-id-mode=0, data-length=40, max-delta-counter-init=14, crc-offset=0, counter-offset=8, data-id-nibble-offset=0}
        end-to-end-protection-i-signal-i-pdu{data-offset=0, i-signal-group=sigGroup_V_VEH, i-signal-i-pdu=V_VEH}
        end-to-end-protection-variable-prototype=receiver=BmwMsgSlot55Bas3Repn4BusFrChA.COMPOSITIONTYPE.sigGroup_V_VEH.sigGroup_V_VEH
      endToEndProt_DISP_CC_EPS:
        end-to-end-profile={category=PROFILE_01, data-ids=[3148, 3148, 3148, 3148, 3148, 3148, 3148, 3148, 3148, 3148, 3148, 3148, 3148, 3148, 3148, 3148, 3148, 3148, 3148, 3148, 3148, 3148, 3148, 3148, 3148, 3148, 3148, 3148, 3148, 3148, 3148, 3148, 3148, 3148, 3148, 3148, 3148, 3148, 3148, 3148, 3148, 3148, 3148, 3148, 3148, 3148, 3148, 3148, 3148, 3148, 3148, 3148, 3148, 3148, 3148, 3148, 3148, 3148, 3148, 3148, 3148, 3148, 3148, 3148, 3148, 3148, 3148, 3148, 3148, 3148, 3148, 3148, 3148, 3148, 3148, 3148, 3148, 3148, 3148, 3148, 3148, 3148, 3148, 3148, 3148, 3148, 3148, 3148, 3148, 3148, 3148, 3148, 3148, 3148, 3148, 3148, 3148, 3148, 3148, 3148, 3148, 3148, 3148, 3148, 3148, 3148, 3148, 3148, 3148, 3148, 3148, 3148, 3148, 3148, 3148, 3148, 3148, 3148, 3148, 3148, 3148, 3148, 3148, 3148, 3148, 3148, 3148, 3148, 3148, 3148, 3148, 3148, 3148, 3148, 3148, 3148, 3148, 3148, 3148, 3148, 3148, 3148, 3148, 3148, 3148, 3148, 3148, 3148, 3148, 3148, 3148, 3148, 3148, 3148, 3148, 3148, 3148, 3148, 3148, 3148, 3148, 3148, 3148, 3148, 3148, 3148, 3148, 3148, 3148, 3148, 3148, 3148, 3148, 3148, 3148, 3148, 3148, 3148, 3148, 3148, 3148, 3148, 3148, 3148, 3148, 3148, 3148, 3148, 3148, 3148, 3148, 3148, 3148, 3148, 3148, 3148, 3148, 3148, 3148, 3148, 3148, 3148, 3148, 3148, 3148, 3148, 3148, 3148, 3148, 3148, 3148, 3148, 3148, 3148], data-id-mode=3, data-length=40, max-delta-counter-init=14, crc-offset=0, counter-offset=8, data-id-nibble-offset=12}
        end-to-end-protection-i-signal-i-pdu{data-offset=0, i-signal-group=sigGroup_DISP_CC_EPS, i-signal-i-pdu=DISP_CC_EPS}
        end-to-end-protection-variable-prototype=BmwMsgSlot274Bas2Repn4BusFrChA.COMPOSITIONTYPE.sigGroup_DISP_CC_EPS.sigGroup_DISP_CC_EPS
      endToEndProt_AVL_PO_EPS:
        end-to-end-profile={category=PROFILE_01, data-ids=[186, 186, 186, 186, 186, 186, 186, 186, 186, 186, 186, 186, 186, 186, 186, 186, 186, 186, 186, 186, 186, 186, 186, 186, 186, 186, 186, 186, 186, 186, 186, 186, 186, 186, 186, 186, 186, 186, 186, 186, 186, 186, 186, 186, 186, 186, 186, 186, 186, 186, 186, 186, 186, 186, 186, 186, 186, 186, 186, 186, 186, 186, 186, 186, 186, 186, 186, 186, 186, 186, 186, 186, 186, 186, 186, 186, 186, 186, 186, 186, 186, 186, 186, 186, 186, 186, 186, 186, 186, 186, 186, 186, 186, 186, 186, 186, 186, 186, 186, 186, 186, 186, 186, 186, 186, 186, 186, 186, 186, 186, 186, 186, 186, 186, 186, 186, 186, 186, 186, 186, 186, 186, 186, 186, 186, 186, 186, 186, 186, 186, 186, 186, 186, 186, 186, 186, 186, 186, 186, 186, 186, 186, 186, 186, 186, 186, 186, 186, 186, 186, 186, 186, 186, 186, 186, 186, 186, 186, 186, 186, 186, 186, 186, 186, 186, 186, 186, 186, 186, 186, 186, 186, 186, 186, 186, 186, 186, 186, 186, 186, 186, 186, 186, 186, 186, 186, 186, 186, 186, 186, 186, 186, 186, 186, 186, 186, 186, 186, 186, 186, 186, 186, 186, 186, 186, 186, 186, 186, 186, 186, 186, 186], data-id-mode=0, data-length=64, max-delta-counter-init=14, crc-offset=0, counter-offset=8, data-id-nibble-offset=0}
        end-to-end-protection-i-signal-i-pdu{data-offset=0, i-signal-group=sigGroup_AVL_PO_EPS, i-signal-i-pdu=AVL_PO_EPS}
        end-to-end-protection-variable-prototype=BmwMsgSlot51Bas0Repn2BusFrChA.COMPOSITIONTYPE.sigGroup_AVL_PO_EPS.sigGroup_AVL_PO_EPS
      endToEndProt_ST_EST:
        end-to-end-profile={category=PROFILE_01, data-ids=[112, 112, 112, 112, 112, 112, 112, 112, 112, 112, 112, 112, 112, 112, 112, 112, 112, 112, 112, 112, 112, 112, 112, 112, 112, 112, 112, 112, 112, 112, 112, 112, 112, 112, 112, 112, 112, 112, 112, 112, 112, 112, 112, 112, 112, 112, 112, 112, 112, 112, 112, 112, 112, 112, 112, 112, 112, 112, 112, 112, 112, 112, 112, 112, 112, 112, 112, 112, 112, 112, 112, 112, 112, 112, 112, 112, 112, 112, 112, 112, 112, 112, 112, 112, 112, 112, 112, 112, 112, 112, 112, 112, 112, 112, 112, 112, 112, 112, 112, 112, 112, 112, 112, 112, 112, 112, 112, 112, 112, 112, 112, 112, 112, 112, 112, 112, 112, 112, 112, 112, 112, 112, 112, 112, 112, 112, 112, 112, 112, 112, 112, 112, 112, 112, 112, 112, 112, 112, 112, 112, 112, 112, 112, 112, 112, 112, 112, 112, 112, 112, 112, 112, 112, 112, 112, 112, 112, 112, 112, 112, 112, 112, 112, 112, 112, 112, 112, 112, 112, 112, 112, 112, 112, 112, 112, 112, 112, 112, 112, 112, 112, 112, 112, 112, 112, 112, 112, 112, 112, 112, 112, 112, 112, 112, 112, 112, 112, 112, 112, 112, 112, 112, 112, 112, 112, 112, 112, 112, 112, 112, 112, 112, 112, 112, 112, 112, 112, 112, 112, 112, 112, 112, 112, 112, 112, 112, 112, 112, 112, 112, 112, 112, 112, 112, 112, 112, 112, 112, 112, 112, 112, 112, 112, 112, 112, 112, 112, 112, 112, 112, 112, 112, 112, 112, 112, 112, 112, 112, 112, 112, 112, 112, 112, 112, 112, 112, 112, 112, 112, 112, 112, 112, 112, 112, 112, 112, 112, 112, 112, 112, 112, 112, 112, 112, 112, 112, 112, 112, 112, 112, 112, 112, 112, 112, 112, 112, 112, 112, 112, 112], data-id-mode=0, data-length=40, max-delta-counter-init=14, crc-offset=0, counter-offset=8, data-id-nibble-offset=0}
        end-to-end-protection-i-signal-i-pdu{data-offset=0, i-signal-group=sigGroup_ST_EST, i-signal-i-pdu=ST_EST}
        end-to-end-protection-variable-prototype=BmwMsgSlot234Bas1Repn2BusFrChA.COMPOSITIONTYPE.sigGroup_ST_EST.sigGroup_ST_EST
      endToEndProt_SU_EPS:
        end-to-end-profile={category=PROFILE_01, data-ids=[131, 131, 131, 131, 131, 131, 131, 131, 131, 131, 131, 131, 131, 131, 131, 131, 131, 131, 131, 131, 131, 131, 131, 131, 131, 131, 131, 131, 131, 131, 131, 131, 131, 131, 131, 131, 131, 131, 131, 131, 131, 131, 131, 131, 131, 131, 131, 131, 131, 131, 131, 131, 131, 131, 131, 131, 131, 131, 131, 131, 131, 131, 131, 131, 131, 131, 131, 131, 131, 131, 131, 131, 131, 131, 131, 131, 131, 131, 131, 131, 131, 131, 131, 131, 131, 131, 131, 131, 131, 131, 131, 131, 131, 131, 131, 131, 131, 131, 131, 131, 131, 131, 131, 131, 131, 131, 131, 131, 131, 131, 131, 131, 131, 131, 131, 131, 131, 131, 131, 131, 131, 131, 131, 131, 131, 131, 131, 131, 131, 131, 131, 131, 131, 131, 131, 131, 131, 131, 131, 131, 131, 131, 131, 131, 131, 131, 131, 131, 131, 131, 131, 131, 131, 131, 131, 131, 131, 131, 131, 131, 131, 131, 131, 131, 131, 131, 131, 131, 131, 131, 131, 131, 131, 131, 131, 131, 131, 131, 131, 131, 131, 131, 131, 131, 131, 131, 131, 131, 131, 131, 131, 131, 131, 131, 131, 131, 131, 131, 131, 131, 131, 131, 131, 131, 131, 131, 131, 131, 131, 131, 131, 131, 131, 131, 131, 131, 131, 131, 131, 131, 131, 131, 131, 131, 131, 131, 131, 131, 131, 131, 131, 131, 131, 131, 131, 131, 131, 131, 131, 131, 131, 131, 131, 131, 131, 131, 131, 131, 131, 131, 131, 131, 131, 131, 131, 131, 131, 131, 131, 131, 131, 131, 131, 131, 131, 131, 131, 131, 131, 131, 131, 131, 131, 131, 131, 131, 131, 131, 131, 131, 131, 131, 131, 131, 131, 131, 131, 131, 131, 131, 131, 131, 131, 131, 131, 131, 131, 131, 131, 131], data-id-mode=0, data-length=64, max-delta-counter-init=14, crc-offset=56, counter-offset=52, data-id-nibble-offset=0}
        end-to-end-protection-i-signal-i-pdu{data-offset=0, i-signal-group=sigGroup_SU_EPS, i-signal-i-pdu=SU_EPS}
        end-to-end-protection-variable-prototype=BmwMsgSlot274Bas0Repn8BusFrChA.COMPOSITIONTYPE.sigGroup_SU_EPS.sigGroup_SU_EPS
      endToEndProt_ACLNY_MASSCNTR:
        end-to-end-profile={category=PROFILE_01, data-ids=[31, 31, 31, 31, 31, 31, 31, 31, 31, 31, 31, 31, 31, 31, 31, 31, 31, 31, 31, 31, 31, 31, 31, 31, 31, 31, 31, 31, 31, 31, 31, 31, 31, 31, 31, 31, 31, 31, 31, 31, 31, 31, 31, 31, 31, 31, 31, 31, 31, 31, 31, 31, 31, 31, 31, 31, 31, 31, 31, 31, 31, 31, 31, 31, 31, 31, 31, 31, 31, 31, 31, 31, 31, 31, 31, 31, 31, 31, 31, 31, 31, 31, 31, 31, 31, 31, 31, 31, 31, 31, 31, 31, 31, 31, 31, 31, 31, 31, 31, 31, 31, 31, 31, 31, 31, 31, 31, 31, 31, 31, 31, 31, 31, 31, 31, 31, 31, 31, 31, 31, 31, 31, 31, 31, 31, 31, 31, 31, 31, 31, 31, 31, 31, 31, 31, 31, 31, 31, 31, 31, 31, 31, 31, 31, 31, 31, 31, 31, 31, 31, 31, 31, 31, 31, 31, 31, 31, 31, 31, 31, 31, 31, 31, 31, 31, 31, 31, 31, 31, 31, 31, 31, 31, 31, 31, 31, 31, 31, 31, 31, 31, 31, 31, 31, 31, 31, 31, 31, 31, 31, 31, 31, 31, 31, 31, 31, 31, 31, 31, 31, 31, 31, 31, 31, 31, 31, 31, 31, 31, 31, 31, 31, 31, 31, 31, 31, 31, 31, 31, 31, 31, 31, 31, 31, 31, 31, 31, 31, 31, 31, 31, 31, 31, 31, 31, 31, 31, 31, 31, 31, 31, 31, 31, 31, 31, 31, 31, 31, 31, 31, 31, 31, 31, 31, 31, 31, 31, 31, 31, 31, 31, 31, 31, 31, 31, 31, 31, 31, 31, 31, 31, 31, 31, 31, 31, 31, 31, 31, 31, 31, 31, 31, 31, 31, 31, 31, 31, 31, 31, 31, 31, 31, 31, 31, 31, 31, 31, 31, 31, 31], data-id-mode=0, data-length=48, max-delta-counter-init=14, crc-offset=0, counter-offset=8, data-id-nibble-offset=0}
        end-to-end-protection-i-signal-i-pdu{data-offset=0, i-signal-group=sigGroup_ACLNY_MASSCNTR, i-signal-i-pdu=ACLNY_MASSCNTR}
        end-to-end-protection-variable-prototype=receiver=BmwMsgSlot55Bas0Repn2BusFrChA.COMPOSITIONTYPE.sigGroup_ACLNY_MASSCNTR.sigGroup_ACLNY_MASSCNTR
      endToEndProt_VYAW_VEH:
        end-to-end-profile={category=PROFILE_01, data-ids=[14, 14, 14, 14, 14, 14, 14, 14, 14, 14, 14, 14, 14, 14, 14, 14, 14, 14, 14, 14, 14, 14, 14, 14, 14, 14, 14, 14, 14, 14, 14, 14, 14, 14, 14, 14, 14, 14, 14, 14, 14, 14, 14, 14, 14, 14, 14, 14, 14, 14, 14, 14, 14, 14, 14, 14, 14, 14, 14, 14, 14, 14, 14, 14, 14, 14, 14, 14, 14, 14, 14, 14, 14, 14, 14, 14, 14, 14, 14, 14, 14, 14, 14, 14, 14, 14, 14, 14, 14, 14, 14, 14, 14, 14, 14, 14, 14, 14, 14, 14, 14, 14, 14, 14, 14, 14, 14, 14, 14, 14, 14, 14, 14, 14, 14, 14, 14, 14, 14, 14, 14, 14, 14, 14, 14, 14, 14, 14, 14, 14, 14, 14, 14, 14, 14, 14, 14, 14, 14, 14, 14, 14, 14, 14, 14, 14, 14, 14, 14, 14, 14, 14, 14, 14, 14, 14, 14, 14, 14, 14, 14, 14, 14, 14, 14, 14, 14, 14, 14, 14, 14, 14, 14, 14, 14, 14, 14, 14, 14, 14, 14, 14, 14, 14, 14, 14, 14, 14, 14, 14, 14, 14, 14, 14, 14, 14, 14, 14, 14, 14, 14, 14, 14, 14, 14, 14, 14, 14, 14, 14, 14, 14, 14, 14, 14, 14, 14, 14, 14, 14, 14, 14, 14, 14, 14, 14, 14, 14, 14, 14, 14, 14, 14, 14, 14, 14, 14, 14, 14, 14, 14, 14, 14, 14, 14, 14, 14, 14, 14, 14, 14, 14, 14, 14, 14, 14, 14, 14, 14, 14, 14, 14, 14, 14, 14, 14, 14, 14, 14, 14, 14, 14, 14, 14, 14, 14, 14, 14, 14, 14, 14, 14, 14, 14, 14, 14, 14, 14, 14, 14, 14, 14, 14, 14, 14, 14, 14, 14, 14, 14], data-id-mode=0, data-length=48, max-delta-counter-init=14, crc-offset=0, counter-offset=8, data-id-nibble-offset=0}
        end-to-end-protection-i-signal-i-pdu{data-offset=0, i-signal-group=sigGroup_VYAW_VEH, i-signal-i-pdu=VYAW_VEH}
        end-to-end-protection-variable-prototype=receiver=BmwMsgSlot56Bas0Repn2BusFrChA.COMPOSITIONTYPE.sigGroup_VYAW_VEH.sigGroup_VYAW_VEH
      endToEndProt_TAR_QTA_STRMOM_DV:
        end-to-end-profile={category=PROFILE_01, data-ids=[109, 109, 109, 109, 109, 109, 109, 109, 109, 109, 109, 109, 109, 109, 109, 109, 109, 109, 109, 109, 109, 109, 109, 109, 109, 109, 109, 109, 109, 109, 109, 109, 109, 109, 109, 109, 109, 109, 109, 109, 109, 109, 109, 109, 109, 109, 109, 109, 109, 109, 109, 109, 109, 109, 109, 109, 109, 109, 109, 109, 109, 109, 109, 109, 109, 109, 109, 109, 109, 109, 109, 109, 109, 109, 109, 109, 109, 109, 109, 109, 109, 109, 109, 109, 109, 109, 109, 109, 109, 109, 109, 109, 109, 109, 109, 109, 109, 109, 109, 109, 109, 109, 109, 109, 109, 109, 109, 109, 109, 109, 109, 109, 109, 109, 109, 109, 109, 109, 109, 109, 109, 109, 109, 109, 109, 109, 109, 109, 109, 109, 109, 109, 109, 109, 109, 109, 109, 109, 109, 109, 109, 109, 109, 109, 109, 109, 109, 109, 109, 109, 109, 109, 109, 109, 109, 109, 109, 109, 109, 109, 109, 109, 109, 109, 109, 109, 109, 109, 109, 109, 109, 109, 109, 109, 109, 109, 109, 109, 109, 109, 109, 109, 109, 109, 109, 109, 109, 109, 109, 109, 109, 109, 109, 109, 109, 109, 109, 109, 109, 109, 109, 109, 109, 109, 109, 109, 109, 109, 109, 109, 109, 109, 109, 109, 109, 109, 109, 109, 109, 109, 109, 109, 109, 109, 109, 109, 109, 109, 109, 109, 109, 109, 109, 109, 109, 109, 109, 109, 109, 109, 109, 109, 109, 109, 109, 109, 109, 109, 109, 109, 109, 109, 109, 109, 109, 109, 109, 109, 109, 109, 109, 109, 109, 109, 109, 109, 109, 109, 109, 109, 109, 109, 109, 109, 109, 109, 109, 109, 109, 109, 109, 109, 109, 109, 109, 109, 109, 109, 109, 109, 109, 109, 109, 109, 109, 109, 109, 109, 109, 109], data-id-mode=0, data-length=64, max-delta-counter-init=14, crc-offset=0, counter-offset=8, data-id-nibble-offset=0}
        end-to-end-protection-i-signal-i-pdu{data-offset=0, i-signal-group=sigGroup_TAR_QTA_STRMOM_DV, i-signal-i-pdu=TAR_QTA_STRMOM_DV}
        end-to-end-protection-variable-prototype=receiver=BmwMsgSlot68Bas0Repn2BusFrChA.COMPOSITIONTYPE.sigGroup_TAR_QTA_STRMOM_DV.sigGroup_TAR_QTA_STRMOM_DV
      endToEndProt_TAR_STMOM_DV_ACT:
        end-to-end-profile={category=PROFILE_01, data-ids=[179, 179, 179, 179, 179, 179, 179, 179, 179, 179, 179, 179, 179, 179, 179, 179, 179, 179, 179, 179, 179, 179, 179, 179, 179, 179, 179, 179, 179, 179, 179, 179, 179, 179, 179, 179, 179, 179, 179, 179, 179, 179, 179, 179, 179, 179, 179, 179, 179, 179, 179, 179, 179, 179, 179, 179, 179, 179, 179, 179, 179, 179, 179, 179, 179, 179, 179, 179, 179, 179, 179, 179, 179, 179, 179, 179, 179, 179, 179, 179, 179, 179, 179, 179, 179, 179, 179, 179, 179, 179, 179, 179, 179, 179, 179, 179, 179, 179, 179, 179, 179, 179, 179, 179, 179, 179, 179, 179, 179, 179, 179, 179, 179, 179, 179, 179, 179, 179, 179, 179, 179, 179, 179, 179, 179, 179, 179, 179, 179, 179, 179, 179, 179, 179, 179, 179, 179, 179, 179, 179, 179, 179, 179, 179, 179, 179, 179, 179, 179, 179, 179, 179, 179, 179, 179, 179, 179, 179, 179, 179, 179, 179, 179, 179, 179, 179, 179, 179, 179, 179, 179, 179, 179, 179, 179, 179, 179, 179, 179, 179, 179, 179, 179, 179, 179, 179, 179, 179, 179, 179, 179, 179, 179, 179, 179, 179, 179, 179, 179, 179, 179, 179, 179, 179, 179, 179, 179, 179, 179, 179, 179, 179, 179, 179, 179, 179, 179, 179, 179, 179, 179, 179, 179, 179, 179, 179, 179, 179, 179, 179, 179, 179, 179, 179, 179, 179, 179, 179, 179, 179, 179, 179, 179, 179, 179, 179, 179, 179, 179, 179, 179, 179, 179, 179, 179, 179, 179, 179, 179, 179, 179, 179, 179, 179, 179, 179, 179, 179, 179, 179, 179, 179, 179, 179, 179, 179, 179, 179, 179, 179, 179, 179, 179, 179, 179, 179, 179, 179, 179, 179, 179, 179, 179, 179, 179, 179, 179, 179, 179, 179], data-id-mode=0, data-length=64, max-delta-counter-init=14, crc-offset=0, counter-offset=8, data-id-nibble-offset=0}
        end-to-end-protection-i-signal-i-pdu{data-offset=0, i-signal-group=sigGroup_TAR_STMOM_DV_ACT, i-signal-i-pdu=TAR_STMOM_DV_ACT}
        end-to-end-protection-variable-prototype=receiver=BmwMsgSlot68Bas0Repn2BusFrChA.COMPOSITIONTYPE.sigGroup_TAR_STMOM_DV_ACT.sigGroup_TAR_STMOM_DV_ACT
      endToEndProt_DT_EST:
        end-to-end-profile={category=PROFILE_01, data-ids=[230, 230, 230, 230, 230, 230, 230, 230, 230, 230, 230, 230, 230, 230, 230, 230, 230, 230, 230, 230, 230, 230, 230, 230, 230, 230, 230, 230, 230, 230, 230, 230, 230, 230, 230, 230, 230, 230, 230, 230, 230, 230, 230, 230, 230, 230, 230, 230, 230, 230, 230, 230, 230, 230, 230, 230, 230, 230, 230, 230, 230, 230, 230, 230, 230, 230, 230, 230, 230, 230, 230, 230, 230, 230, 230, 230, 230, 230, 230, 230, 230, 230, 230, 230, 230, 230, 230, 230, 230, 230, 230, 230, 230, 230, 230, 230, 230, 230, 230, 230, 230, 230, 230, 230, 230, 230, 230, 230, 230, 230, 230, 230, 230, 230, 230, 230, 230, 230, 230, 230, 230, 230, 230, 230, 230, 230, 230, 230, 230, 230, 230, 230, 230, 230, 230, 230, 230, 230, 230, 230, 230, 230, 230, 230, 230, 230, 230, 230, 230, 230, 230, 230, 230, 230, 230, 230, 230, 230, 230, 230, 230, 230, 230, 230, 230, 230, 230, 230, 230, 230, 230, 230, 230, 230, 230, 230, 230, 230, 230, 230, 230, 230, 230, 230, 230, 230, 230, 230, 230, 230, 230, 230, 230, 230, 230, 230, 230, 230, 230, 230, 230, 230, 230, 230, 230, 230, 230, 230, 230, 230, 230, 230, 230, 230, 230, 230, 230, 230, 230, 230, 230, 230, 230, 230, 230, 230, 230, 230, 230, 230, 230, 230, 230, 230, 230, 230, 230, 230, 230, 230, 230, 230, 230, 230, 230, 230, 230, 230, 230, 230, 230, 230, 230, 230, 230, 230, 230, 230, 230, 230, 230, 230, 230, 230, 230, 230, 230, 230, 230, 230, 230, 230, 230, 230, 230, 230, 230, 230, 230, 230, 230, 230, 230, 230, 230, 230, 230, 230, 230, 230, 230, 230, 230, 230, 230, 230, 230, 230, 230, 230], data-id-mode=0, data-length=128, max-delta-counter-init=14, crc-offset=0, counter-offset=8, data-id-nibble-offset=0}
        end-to-end-protection-i-signal-i-pdu{data-offset=0, i-signal-group=sigGroup_DT_EST, i-signal-i-pdu=DT_EST}
        end-to-end-protection-variable-prototype=BmwMsgSlot49Bas1Repn2BusFrChA.COMPOSITIONTYPE.sigGroup_DT_EST.sigGroup_DT_EST
      endToEndProt_ENERG_DGR_DRDY:
        end-to-end-profile={category=PROFILE_01, data-ids=[56, 56, 56, 56, 56, 56, 56, 56, 56, 56, 56, 56, 56, 56, 56, 56, 56, 56, 56, 56, 56, 56, 56, 56, 56, 56, 56, 56, 56, 56, 56, 56, 56, 56, 56, 56, 56, 56, 56, 56, 56, 56, 56, 56, 56, 56, 56, 56, 56, 56, 56, 56, 56, 56, 56, 56, 56, 56, 56, 56, 56, 56, 56, 56, 56, 56, 56, 56, 56, 56, 56, 56, 56, 56, 56, 56, 56, 56, 56, 56, 56, 56, 56, 56, 56, 56, 56, 56, 56, 56, 56, 56, 56, 56, 56, 56, 56, 56, 56, 56, 56, 56, 56, 56, 56, 56, 56, 56, 56, 56, 56, 56, 56, 56, 56, 56, 56, 56, 56, 56, 56, 56, 56, 56, 56, 56, 56, 56, 56, 56, 56, 56, 56, 56, 56, 56, 56, 56, 56, 56, 56, 56, 56, 56, 56, 56, 56, 56, 56, 56, 56, 56, 56, 56, 56, 56, 56, 56, 56, 56, 56, 56, 56, 56, 56, 56, 56, 56, 56, 56, 56, 56, 56, 56, 56, 56, 56, 56, 56, 56, 56, 56, 56, 56, 56, 56, 56, 56, 56, 56, 56, 56, 56, 56, 56, 56, 56, 56, 56, 56, 56, 56, 56, 56, 56, 56, 56, 56, 56, 56, 56, 56, 56, 56, 56, 56, 56, 56, 56, 56, 56, 56, 56, 56, 56, 56, 56, 56, 56, 56, 56, 56, 56, 56, 56, 56, 56, 56, 56, 56, 56, 56, 56, 56, 56, 56, 56, 56, 56, 56, 56, 56, 56, 56, 56, 56, 56, 56, 56, 56, 56, 56, 56, 56, 56, 56, 56, 56, 56, 56, 56, 56, 56, 56, 56, 56, 56, 56, 56, 56, 56, 56, 56, 56, 56, 56, 56, 56, 56, 56, 56, 56, 56, 56, 56, 56, 56, 56, 56, 56], data-id-mode=0, data-length=64, max-delta-counter-init=14, crc-offset=56, counter-offset=52, data-id-nibble-offset=0}
        end-to-end-protection-i-signal-i-pdu{data-offset=0, i-signal-group=sigGroup_ENERG_DGR_DRDY, i-signal-i-pdu=ENERG_DGR_DRDY}
        end-to-end-protection-variable-prototype=receiver=BmwMsgSlot68Bas1Repn2BusFrChA.COMPOSITIONTYPE.sigGroup_ENERG_DGR_DRDY.sigGroup_ENERG_DGR_DRDY
      endToEndProt_AVL_FORC_GRD:
        end-to-end-profile={category=PROFILE_01, data-ids=[190, 190, 190, 190, 190, 190, 190, 190, 190, 190, 190, 190, 190, 190, 190, 190, 190, 190, 190, 190, 190, 190, 190, 190, 190, 190, 190, 190, 190, 190, 190, 190, 190, 190, 190, 190, 190, 190, 190, 190, 190, 190, 190, 190, 190, 190, 190, 190, 190, 190, 190, 190, 190, 190, 190, 190, 190, 190, 190, 190, 190, 190, 190, 190, 190, 190, 190, 190, 190, 190, 190, 190, 190, 190, 190, 190, 190, 190, 190, 190, 190, 190, 190, 190, 190, 190, 190, 190, 190, 190, 190, 190, 190, 190, 190, 190, 190, 190, 190, 190, 190, 190, 190, 190, 190, 190, 190, 190, 190, 190, 190, 190, 190, 190, 190, 190, 190, 190, 190, 190, 190, 190, 190, 190, 190, 190, 190, 190, 190, 190, 190, 190, 190, 190, 190, 190, 190, 190, 190, 190, 190, 190, 190, 190, 190, 190, 190, 190, 190, 190, 190, 190, 190, 190, 190, 190, 190, 190, 190, 190, 190, 190, 190, 190, 190, 190, 190, 190, 190, 190, 190, 190, 190, 190, 190, 190, 190, 190, 190, 190, 190, 190, 190, 190, 190, 190, 190, 190, 190, 190, 190, 190, 190, 190, 190, 190, 190, 190, 190, 190, 190, 190, 190, 190, 190, 190, 190, 190, 190, 190, 190, 190, 190, 190, 190, 190, 190, 190, 190, 190, 190, 190, 190, 190, 190, 190, 190, 190, 190, 190, 190, 190, 190, 190, 190, 190, 190, 190, 190, 190, 190, 190, 190, 190, 190, 190, 190, 190, 190, 190, 190, 190, 190, 190, 190, 190, 190, 190, 190, 190, 190, 190, 190, 190, 190, 190, 190, 190, 190, 190, 190, 190, 190, 190, 190, 190, 190, 190, 190, 190, 190, 190, 190, 190, 190, 190, 190, 190, 190, 190, 190, 190, 190, 190, 190, 190, 190, 190, 190, 190], data-id-mode=0, data-length=40, max-delta-counter-init=14, crc-offset=0, counter-offset=8, data-id-nibble-offset=0}
        end-to-end-protection-i-signal-i-pdu{data-offset=0, i-signal-group=sigGroup_AVL_FORC_GRD, i-signal-i-pdu=AVL_FORC_GRD}
        end-to-end-protection-variable-prototype=BmwMsgSlot49Bas0Repn2BusFrChA.COMPOSITIONTYPE.sigGroup_AVL_FORC_GRD.sigGroup_AVL_FORC_GRD
      endToEndProt_AVL_STMOM_DV_ACT:
        end-to-end-profile={category=PROFILE_01, data-ids=[108, 108, 108, 108, 108, 108, 108, 108, 108, 108, 108, 108, 108, 108, 108, 108, 108, 108, 108, 108, 108, 108, 108, 108, 108, 108, 108, 108, 108, 108, 108, 108, 108, 108, 108, 108, 108, 108, 108, 108, 108, 108, 108, 108, 108, 108, 108, 108, 108, 108, 108, 108, 108, 108, 108, 108, 108, 108, 108, 108, 108, 108, 108, 108, 108, 108, 108, 108, 108, 108, 108, 108, 108, 108, 108, 108, 108, 108, 108, 108, 108, 108, 108, 108, 108, 108, 108, 108, 108, 108, 108, 108, 108, 108, 108, 108, 108, 108, 108, 108, 108, 108, 108, 108, 108, 108, 108, 108, 108, 108, 108, 108, 108, 108, 108, 108, 108, 108, 108, 108, 108, 108, 108, 108, 108, 108, 108, 108, 108, 108, 108, 108, 108, 108, 108, 108, 108, 108, 108, 108, 108, 108, 108, 108, 108, 108, 108, 108, 108, 108, 108, 108, 108, 108, 108, 108, 108, 108, 108, 108, 108, 108, 108, 108, 108, 108, 108, 108, 108, 108, 108, 108, 108, 108, 108, 108, 108, 108, 108, 108, 108, 108, 108, 108, 108, 108, 108, 108, 108, 108, 108, 108, 108, 108, 108, 108, 108, 108, 108, 108, 108, 108, 108, 108, 108, 108, 108, 108, 108, 108, 108, 108, 108, 108, 108, 108, 108, 108, 108, 108, 108, 108, 108, 108, 108, 108, 108, 108, 108, 108, 108, 108, 108, 108, 108, 108, 108, 108, 108, 108, 108, 108, 108, 108, 108, 108, 108, 108, 108, 108, 108, 108, 108, 108, 108, 108, 108, 108, 108, 108, 108, 108, 108, 108, 108, 108, 108, 108, 108, 108, 108, 108, 108, 108, 108, 108, 108, 108, 108, 108, 108, 108, 108, 108, 108, 108, 108, 108, 108, 108, 108, 108, 108, 108, 108, 108, 108, 108, 108, 108], data-id-mode=0, data-length=32, max-delta-counter-init=14, crc-offset=0, counter-offset=8, data-id-nibble-offset=0}
        end-to-end-protection-i-signal-i-pdu{data-offset=0, i-signal-group=sigGroup_AVL_STMOM_DV_ACT, i-signal-i-pdu=AVL_STMOM_DV_ACT}
        end-to-end-protection-variable-prototype=BmwMsgSlot49Bas0Repn2BusFrChA.COMPOSITIONTYPE.sigGroup_AVL_STMOM_DV_ACT.sigGroup_AVL_STMOM_DV_ACT
  port interface mapping set PORTINTERFACEMAPPINGSET
