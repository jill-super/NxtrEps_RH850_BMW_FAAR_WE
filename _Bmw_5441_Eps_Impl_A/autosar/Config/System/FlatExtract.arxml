[part 3 of 4: package /COM/VECTOR/CFG/WORKFLOW/SYSDESC/SYNC]
AUTOSAR XML (schema 4-3-0)
package /COM/VECTOR/CFG/WORKFLOW/SYSDESC/SYNC  (continued)
  composition sw component type COMPOSITIONTYPE  (continued)
    connect CalRegn01IninOptSetA03.TEstimnAssiMechCorrLim -> AAACalRegn01IninOptSetA03_Dummy.TEstimnAssiMechCorrLim  # UB:Derived from original system description
    connect CalRegn01IninOptSetA03.TEstimnAssiMechDampgSca -> AAACalRegn01IninOptSetA03_Dummy.TEstimnAssiMechDampgSca  # UB:Derived from original system description
    connect CalRegn01IninOptSetA03.TEstimnAssiMechDftT -> AAACalRegn01IninOptSetA03_Dummy.TEstimnAssiMechDftT  # UB:Derived from original system description
    connect CalRegn01IninOptSetA03.TEstimnAssiMechLLFilCoeffA1 -> AAACalRegn01IninOptSetA03_Dummy.TEstimnAssiMechLLFilCoeffA1  # UB:Derived from original system description
    connect CalRegn01IninOptSetA03.TEstimnAssiMechLLFilCoeffB0 -> AAACalRegn01IninOptSetA03_Dummy.TEstimnAssiMechLLFilCoeffB0  # UB:Derived from original system description
    connect CalRegn01IninOptSetA03.TEstimnAssiMechLLFilCoeffB1 -> AAACalRegn01IninOptSetA03_Dummy.TEstimnAssiMechLLFilCoeffB1  # UB:Derived from original system description
    connect CalRegn01IninOptSetA03.TEstimnAssiMechSlew -> AAACalRegn01IninOptSetA03_Dummy.TEstimnAssiMechSlew  # UB:Derived from original system description
    connect CalRegn01IninOptSetA03.TEstimnCorrnTAssiMech -> AAACalRegn01IninOptSetA03_Dummy.TEstimnCorrnTAssiMech  # UB:Derived from original system description
    connect CalRegn01IninOptSetA03.TEstimnCorrnTCu -> AAACalRegn01IninOptSetA03_Dummy.TEstimnCorrnTCu  # UB:Derived from original system description
    connect CalRegn01IninOptSetA03.TEstimnCorrnTMag -> AAACalRegn01IninOptSetA03_Dummy.TEstimnCorrnTMag  # UB:Derived from original system description
    connect CalRegn01IninOptSetA03.TEstimnCorrnTSi -> AAACalRegn01IninOptSetA03_Dummy.TEstimnCorrnTSi  # UB:Derived from original system description
    connect CalRegn01IninOptSetA03.TEstimnCuAmbLpFilFrq -> AAACalRegn01IninOptSetA03_Dummy.TEstimnCuAmbLpFilFrq  # UB:Derived from original system description
    connect CalRegn01IninOptSetA03.TEstimnCuAmbLpFilFrqDualEcuFltMtgtn -> AAACalRegn01IninOptSetA03_Dummy.TEstimnCuAmbLpFilFrqDualEcuFltMtgtn  # UB:Derived from original system description
    connect CalRegn01IninOptSetA03.TEstimnCuAmbLpFilFrqFetMtgtnEna -> AAACalRegn01IninOptSetA03_Dummy.TEstimnCuAmbLpFilFrqFetMtgtnEna  # UB:Derived from original system description
    connect CalRegn01IninOptSetA03.TEstimnCuAmbMplr -> AAACalRegn01IninOptSetA03_Dummy.TEstimnCuAmbMplr  # UB:Derived from original system description
    connect CalRegn01IninOptSetA03.TEstimnCuCorrnLim -> AAACalRegn01IninOptSetA03_Dummy.TEstimnCuCorrnLim  # UB:Derived from original system description
    connect CalRegn01IninOptSetA03.TEstimnCuLLFilCoeffA1 -> AAACalRegn01IninOptSetA03_Dummy.TEstimnCuLLFilCoeffA1  # UB:Derived from original system description
    connect CalRegn01IninOptSetA03.TEstimnCuLLFilCoeffB0 -> AAACalRegn01IninOptSetA03_Dummy.TEstimnCuLLFilCoeffB0  # UB:Derived from original system description
    connect CalRegn01IninOptSetA03.TEstimnCuLLFilCoeffB1 -> AAACalRegn01IninOptSetA03_Dummy.TEstimnCuLLFilCoeffB1  # UB:Derived from original system description
    connect CalRegn01IninOptSetA03.TEstimnEngTSca -> AAACalRegn01IninOptSetA03_Dummy.TEstimnEngTSca  # UB:Derived from original system description
    connect CalRegn01IninOptSetA03.TEstimnMagAmbLpFilFrq -> AAACalRegn01IninOptSetA03_Dummy.TEstimnMagAmbLpFilFrq  # UB:Derived from original system description
    connect CalRegn01IninOptSetA03.TEstimnMagAmbLpFilFrqDualEcuFltMtgtn -> AAACalRegn01IninOptSetA03_Dummy.TEstimnMagAmbLpFilFrqDualEcuFltMtgtn  # UB:Derived from original system description
    connect CalRegn01IninOptSetA03.TEstimnMagAmbLpFilFrqFetMtgtnEna -> AAACalRegn01IninOptSetA03_Dummy.TEstimnMagAmbLpFilFrqFetMtgtnEna  # UB:Derived from original system description
    connect CalRegn01IninOptSetA03.TEstimnMagAmbMplr -> AAACalRegn01IninOptSetA03_Dummy.TEstimnMagAmbMplr  # UB:Derived from original system description
    connect CalRegn01IninOptSetA03.TEstimnMagCorrnLim -> AAACalRegn01IninOptSetA03_Dummy.TEstimnMagCorrnLim  # UB:Derived from original system description
    connect CalRegn01IninOptSetA03.TEstimnMagLLFilCoeffA1 -> AAACalRegn01IninOptSetA03_Dummy.TEstimnMagLLFilCoeffA1  # UB:Derived from original system description
    connect CalRegn01IninOptSetA03.TEstimnMagLLFilCoeffB0 -> AAACalRegn01IninOptSetA03_Dummy.TEstimnMagLLFilCoeffB0  # UB:Derived from original system description
    connect CalRegn01IninOptSetA03.TEstimnMagLLFilCoeffB1 -> AAACalRegn01IninOptSetA03_Dummy.TEstimnMagLLFilCoeffB1  # UB:Derived from original system description
    connect CalRegn01IninOptSetA03.TEstimnSiAmbLpFilFrq -> AAACalRegn01IninOptSetA03_Dummy.TEstimnSiAmbLpFilFrq  # UB:Derived from original system description
    connect CalRegn01IninOptSetA03.TEstimnSiAmbLpFilFrqDualEcuFltMtgtn -> AAACalRegn01IninOptSetA03_Dummy.TEstimnSiAmbLpFilFrqDualEcuFltMtgtn  # UB:Derived from original system description
    connect CalRegn01IninOptSetA03.TEstimnSiAmbLpFilFrqFetMtgtnEna -> AAACalRegn01IninOptSetA03_Dummy.TEstimnSiAmbLpFilFrqFetMtgtnEna  # UB:Derived from original system description
    connect CalRegn01IninOptSetA03.TEstimnSiAmbMplr -> AAACalRegn01IninOptSetA03_Dummy.TEstimnSiAmbMplr  # UB:Derived from original system description
    connect CalRegn01IninOptSetA03.TEstimnSiCorrnLim -> AAACalRegn01IninOptSetA03_Dummy.TEstimnSiCorrnLim  # UB:Derived from original system description
    connect CalRegn01IninOptSetA03.TEstimnSiLLFilCoeffA1 -> AAACalRegn01IninOptSetA03_Dummy.TEstimnSiLLFilCoeffA1  # UB:Derived from original system description
    connect CalRegn01IninOptSetA03.TEstimnSiLLFilCoeffB0 -> AAACalRegn01IninOptSetA03_Dummy.TEstimnSiLLFilCoeffB0  # UB:Derived from original system description
    connect CalRegn01IninOptSetA03.TEstimnSiLLFilCoeffB1 -> AAACalRegn01IninOptSetA03_Dummy.TEstimnSiLLFilCoeffB1  # UB:Derived from original system description
    connect CalRegn01IninOptSetA03.TEstimnTauAssiMech -> AAACalRegn01IninOptSetA03_Dummy.TEstimnTauAssiMech  # UB:Derived from original system description
    connect CalRegn01IninOptSetA03.TEstimnTauCu -> AAACalRegn01IninOptSetA03_Dummy.TEstimnTauCu  # UB:Derived from original system description
    connect CalRegn01IninOptSetA03.TEstimnTauMag -> AAACalRegn01IninOptSetA03_Dummy.TEstimnTauMag  # UB:Derived from original system description
    connect CalRegn01IninOptSetA03.TEstimnTauSi -> AAACalRegn01IninOptSetA03_Dummy.TEstimnTauSi  # UB:Derived from original system description
    connect CalRegn01IninOptSetA03.TEstimnWghtAvrgTDi -> AAACalRegn01IninOptSetA03_Dummy.TEstimnWghtAvrgTDi  # UB:Derived from original system description
    connect CalRegn01IninOptSetA03.VehSpdLimrPosMaxOffs2 -> AAACalRegn01IninOptSetA03_Dummy.VehSpdLimrPosMaxOffs2  # UB:Derived from original system description
    connect CalRegn02Rt00.BmwStReqMgrAllwToOffThd -> AAACalRegn02Rt00_Dummy.BmwStReqMgrAllwToOffThd  # UB:Derived from original system description
    connect CalRegn02Rt00.BmwStReqMgrStsDrvrActvyTqChgThd -> AAACalRegn02Rt00_Dummy.BmwStReqMgrStsDrvrActvyTqChgThd  # UB:Derived from original system description
    connect CalRegn02Rt00.BmwStReqMgrAllwToOffThd -> BmwStReqMgr.BmwStReqMgrAllwToOffThd  # UB:Derived from original system description
    connect CalRegn02Rt00.BmwStReqMgrStsDrvrActvyTqChgThd -> BmwStReqMgr.BmwStReqMgrStsDrvrActvyTqChgThd  # UB:Derived from original system description
    connect CalRegn02Rt00GroupA.BmwStReqMgrDrvrActvTmrThd -> AAACalRegn02Rt00GroupA_Dummy.BmwStReqMgrDrvrActvTmrThd  # UB:Derived from original system description
    connect CalRegn02Rt00GroupA.BmwStReqMgrHwTqThd -> AAACalRegn02Rt00GroupA_Dummy.BmwStReqMgrHwTqThd  # UB:Derived from original system description
    connect CalRegn02Rt00GroupA.BmwStReqMgrOperRampRate -> AAACalRegn02Rt00GroupA_Dummy.BmwStReqMgrOperRampRate  # UB:Derived from original system description
    connect CalRegn02Rt00GroupA.BmwStReqMgrSwtOffSpdLim -> AAACalRegn02Rt00GroupA_Dummy.BmwStReqMgrSwtOffSpdLim  # UB:Derived from original system description
    connect CalRegn02Rt00GroupA.BmwStReqMgrSysProtnRednFacThd -> AAACalRegn02Rt00GroupA_Dummy.BmwStReqMgrSysProtnRednFacThd  # UB:Derived from original system description
    connect CalRegn02Rt00GroupA.BmwStReqMgrDrvrActvTmrThd -> BmwStReqMgr.BmwStReqMgrDrvrActvTmrThd  # UB:Derived from original system description
    connect CalRegn02Rt00GroupA.BmwStReqMgrHwTqThd -> BmwStReqMgr.BmwStReqMgrHwTqThd  # UB:Derived from original system description
    connect CalRegn02Rt00GroupA.BmwStReqMgrOperRampRate -> BmwStReqMgr.BmwStReqMgrOperRampRate  # UB:Derived from original system description
    connect CalRegn02Rt00GroupA.BmwStReqMgrSwtOffSpdLim -> BmwStReqMgr.BmwStReqMgrSwtOffSpdLim  # UB:Derived from original system description
    connect CalRegn02Rt00GroupA.BmwStReqMgrSysProtnRednFacThd -> BmwStReqMgr.BmwStReqMgrSysProtnRednFacThd  # UB:Derived from original system description
    connect CalRegn02Rt00GroupC.CtrldVelRtnDampgX -> AAACalRegn02Rt00GroupC_Dummy.CtrldVelRtnDampgX  # UB:Derived from original system description
    connect CalRegn02Rt00GroupC.CtrldVelRtnDampgY -> AAACalRegn02Rt00GroupC_Dummy.CtrldVelRtnDampgY  # UB:Derived from original system description
    connect CalRegn02Rt00GroupC.CtrldVelRtnDesVelScaX -> AAACalRegn02Rt00GroupC_Dummy.CtrldVelRtnDesVelScaX  # UB:Derived from original system description
    connect CalRegn02Rt00GroupC.CtrldVelRtnDesVelScaY -> AAACalRegn02Rt00GroupC_Dummy.CtrldVelRtnDesVelScaY  # UB:Derived from original system description
    connect CalRegn02Rt00GroupC.CtrldVelRtnDesVelX -> AAACalRegn02Rt00GroupC_Dummy.CtrldVelRtnDesVelX  # UB:Derived from original system description
    connect CalRegn02Rt00GroupC.CtrldVelRtnDesVelY -> AAACalRegn02Rt00GroupC_Dummy.CtrldVelRtnDesVelY  # UB:Derived from original system description
    connect CalRegn02Rt00GroupC.CtrldVelRtnHwPosnScaX -> AAACalRegn02Rt00GroupC_Dummy.CtrldVelRtnHwPosnScaX  # UB:Derived from original system description
    connect CalRegn02Rt00GroupC.CtrldVelRtnHwPosnScaY -> AAACalRegn02Rt00GroupC_Dummy.CtrldVelRtnHwPosnScaY  # UB:Derived from original system description
    connect CalRegn02Rt00GroupC.CtrldVelRtnHwTqSca1X -> AAACalRegn02Rt00GroupC_Dummy.CtrldVelRtnHwTqSca1X  # UB:Derived from original system description
    connect CalRegn02Rt00GroupC.CtrldVelRtnHwTqSca1Y -> AAACalRegn02Rt00GroupC_Dummy.CtrldVelRtnHwTqSca1Y  # UB:Derived from original system description
    connect CalRegn02Rt00GroupC.CtrldVelRtnHwTqSca2X -> AAACalRegn02Rt00GroupC_Dummy.CtrldVelRtnHwTqSca2X  # UB:Derived from original system description
    connect CalRegn02Rt00GroupC.CtrldVelRtnHwTqSca2Y -> AAACalRegn02Rt00GroupC_Dummy.CtrldVelRtnHwTqSca2Y  # UB:Derived from original system description
    connect CalRegn02Rt00GroupC.CtrldVelRtnIntglGain -> AAACalRegn02Rt00GroupC_Dummy.CtrldVelRtnIntglGain  # UB:Derived from original system description
    connect CalRegn02Rt00GroupC.CtrldVelRtnPinionTqScaX -> AAACalRegn02Rt00GroupC_Dummy.CtrldVelRtnPinionTqScaX  # UB:Derived from original system description
    connect CalRegn02Rt00GroupC.CtrldVelRtnPinionTqScaY -> AAACalRegn02Rt00GroupC_Dummy.CtrldVelRtnPinionTqScaY  # UB:Derived from original system description
    connect CalRegn02Rt00GroupC.CtrldVelRtnPropGain -> AAACalRegn02Rt00GroupC_Dummy.CtrldVelRtnPropGain  # UB:Derived from original system description
    connect CalRegn02Rt00GroupC.CtrldVelRtnTqGrdtScaX -> AAACalRegn02Rt00GroupC_Dummy.CtrldVelRtnTqGrdtScaX  # UB:Derived from original system description
    connect CalRegn02Rt00GroupC.CtrldVelRtnTqGrdtScaY -> AAACalRegn02Rt00GroupC_Dummy.CtrldVelRtnTqGrdtScaY  # UB:Derived from original system description
    connect CalRegn02Rt00GroupC.CtrldVelRtnVehSpdScaBilnrSeln -> AAACalRegn02Rt00GroupC_Dummy.CtrldVelRtnVehSpdScaBilnrSeln  # UB:Derived from original system description
    connect CalRegn02Rt00GroupC.CtrldVelRtnVelErrScaBilnrSeln -> AAACalRegn02Rt00GroupC_Dummy.CtrldVelRtnVelErrScaBilnrSeln  # UB:Derived from original system description
    connect CalRegn02Rt00GroupC.CtrldVelRtnVelErrScaEna -> AAACalRegn02Rt00GroupC_Dummy.CtrldVelRtnVelErrScaEna  # UB:Derived from original system description
    connect CalRegn02Rt00GroupC.CtrldVelRtnVelErrScaX -> AAACalRegn02Rt00GroupC_Dummy.CtrldVelRtnVelErrScaX  # UB:Derived from original system description
    connect CalRegn02Rt00GroupC.CtrldVelRtnVelErrScaY -> AAACalRegn02Rt00GroupC_Dummy.CtrldVelRtnVelErrScaY  # UB:Derived from original system description
    connect CalRegn02Rt00GroupC.CtrldVelRtnVelErrVehSpdScaY -> AAACalRegn02Rt00GroupC_Dummy.CtrldVelRtnVelErrVehSpdScaY  # UB:Derived from original system description
    connect CalRegn02Rt00GroupC.CtrldVelRtnVelSpdTbl -> AAACalRegn02Rt00GroupC_Dummy.CtrldVelRtnVelSpdTbl  # UB:Derived from original system description
    connect CalRegn02Rt00GroupC.CtrldVelRtnDampgX -> CtrldVelRtn.CtrldVelRtnDampgX  # UB:Derived from original system description
    connect CalRegn02Rt00GroupC.CtrldVelRtnDampgY -> CtrldVelRtn.CtrldVelRtnDampgY  # UB:Derived from original system description
    connect CalRegn02Rt00GroupC.CtrldVelRtnDesVelScaX -> CtrldVelRtn.CtrldVelRtnDesVelScaX  # UB:Derived from original system description
    connect CalRegn02Rt00GroupC.CtrldVelRtnDesVelScaY -> CtrldVelRtn.CtrldVelRtnDesVelScaY  # UB:Derived from original system description
    connect CalRegn02Rt00GroupC.CtrldVelRtnDesVelX -> CtrldVelRtn.CtrldVelRtnDesVelX  # UB:Derived from original system description
    connect CalRegn02Rt00GroupC.CtrldVelRtnDesVelY -> CtrldVelRtn.CtrldVelRtnDesVelY  # UB:Derived from original system description
    connect CalRegn02Rt00GroupC.CtrldVelRtnHwPosnScaX -> CtrldVelRtn.CtrldVelRtnHwPosnScaX  # UB:Derived from original system description
    connect CalRegn02Rt00GroupC.CtrldVelRtnHwPosnScaY -> CtrldVelRtn.CtrldVelRtnHwPosnScaY  # UB:Derived from original system description
    connect CalRegn02Rt00GroupC.CtrldVelRtnHwTqSca1X -> CtrldVelRtn.CtrldVelRtnHwTqSca1X  # UB:Derived from original system description
    connect CalRegn02Rt00GroupC.CtrldVelRtnHwTqSca1Y -> CtrldVelRtn.CtrldVelRtnHwTqSca1Y  # UB:Derived from original system description
    connect CalRegn02Rt00GroupC.CtrldVelRtnHwTqSca2X -> CtrldVelRtn.CtrldVelRtnHwTqSca2X  # UB:Derived from original system description
    connect CalRegn02Rt00GroupC.CtrldVelRtnHwTqSca2Y -> CtrldVelRtn.CtrldVelRtnHwTqSca2Y  # UB:Derived from original system description
    connect CalRegn02Rt00GroupC.CtrldVelRtnIntglGain -> CtrldVelRtn.CtrldVelRtnIntglGain  # UB:Derived from original system description
    connect CalRegn02Rt00GroupC.CtrldVelRtnPinionTqScaX -> CtrldVelRtn.CtrldVelRtnPinionTqScaX  # UB:Derived from original system description
    connect CalRegn02Rt00GroupC.CtrldVelRtnPinionTqScaY -> CtrldVelRtn.CtrldVelRtnPinionTqScaY  # UB:Derived from original system description
    connect CalRegn02Rt00GroupC.CtrldVelRtnPropGain -> CtrldVelRtn.CtrldVelRtnPropGain  # UB:Derived from original system description
    connect CalRegn02Rt00GroupC.CtrldVelRtnTqGrdtScaX -> CtrldVelRtn.CtrldVelRtnTqGrdtScaX  # UB:Derived from original system description
    connect CalRegn02Rt00GroupC.CtrldVelRtnTqGrdtScaY -> CtrldVelRtn.CtrldVelRtnTqGrdtScaY  # UB:Derived from original system description
    connect CalRegn02Rt00GroupC.CtrldVelRtnVehSpdScaBilnrSeln -> CtrldVelRtn.CtrldVelRtnVehSpdScaBilnrSeln  # UB:Derived from original system description
    connect CalRegn02Rt00GroupC.CtrldVelRtnVelErrScaBilnrSeln -> CtrldVelRtn.CtrldVelRtnVelErrScaBilnrSeln  # UB:Derived from original system description
    connect CalRegn02Rt00GroupC.CtrldVelRtnVelErrScaEna -> CtrldVelRtn.CtrldVelRtnVelErrScaEna  # UB:Derived from original system description
    connect CalRegn02Rt00GroupC.CtrldVelRtnVelErrScaX -> CtrldVelRtn.CtrldVelRtnVelErrScaX  # UB:Derived from original system description
    connect CalRegn02Rt00GroupC.CtrldVelRtnVelErrScaY -> CtrldVelRtn.CtrldVelRtnVelErrScaY  # UB:Derived from original system description
    connect CalRegn02Rt00GroupC.CtrldVelRtnVelErrVehSpdScaY -> CtrldVelRtn.CtrldVelRtnVelErrVehSpdScaY  # UB:Derived from original system description
    connect CalRegn02Rt00GroupC.CtrldVelRtnVelSpdTbl -> CtrldVelRtn.CtrldVelRtnVelSpdTbl  # UB:Derived from original system description
    connect CalRegn02Rt01.BmwStReqMgrAllwToOffThd -> AAACalRegn02Rt01_Dummy.BmwStReqMgrAllwToOffThd  # UB:Derived from original system description
    connect CalRegn02Rt01.BmwStReqMgrStsDrvrActvyTqChgThd -> AAACalRegn02Rt01_Dummy.BmwStReqMgrStsDrvrActvyTqChgThd  # UB:Derived from original system description
    connect CalRegn02Rt01GroupA.BmwStReqMgrDrvrActvTmrThd -> AAACalRegn02Rt01GroupA_Dummy.BmwStReqMgrDrvrActvTmrThd  # UB:Derived from original system description
    connect CalRegn02Rt01GroupA.BmwStReqMgrHwTqThd -> AAACalRegn02Rt01GroupA_Dummy.BmwStReqMgrHwTqThd  # UB:Derived from original system description
    connect CalRegn02Rt01GroupA.BmwStReqMgrOperRampRate -> AAACalRegn02Rt01GroupA_Dummy.BmwStReqMgrOperRampRate  # UB:Derived from original system description
    connect CalRegn02Rt01GroupA.BmwStReqMgrSwtOffSpdLim -> AAACalRegn02Rt01GroupA_Dummy.BmwStReqMgrSwtOffSpdLim  # UB:Derived from original system description
    connect CalRegn02Rt01GroupA.BmwStReqMgrSysProtnRednFacThd -> AAACalRegn02Rt01GroupA_Dummy.BmwStReqMgrSysProtnRednFacThd  # UB:Derived from original system description
    connect CalRegn02Rt01GroupC.CtrldVelRtnDampgX -> AAACalRegn02Rt01GroupC_Dummy.CtrldVelRtnDampgX  # UB:Derived from original system description
    connect CalRegn02Rt01GroupC.CtrldVelRtnDampgY -> AAACalRegn02Rt01GroupC_Dummy.CtrldVelRtnDampgY  # UB:Derived from original system description
    connect CalRegn02Rt01GroupC.CtrldVelRtnDesVelScaX -> AAACalRegn02Rt01GroupC_Dummy.CtrldVelRtnDesVelScaX  # UB:Derived from original system description
    connect CalRegn02Rt01GroupC.CtrldVelRtnDesVelScaY -> AAACalRegn02Rt01GroupC_Dummy.CtrldVelRtnDesVelScaY  # UB:Derived from original system description
    connect CalRegn02Rt01GroupC.CtrldVelRtnDesVelX -> AAACalRegn02Rt01GroupC_Dummy.CtrldVelRtnDesVelX  # UB:Derived from original system description
    connect CalRegn02Rt01GroupC.CtrldVelRtnDesVelY -> AAACalRegn02Rt01GroupC_Dummy.CtrldVelRtnDesVelY  # UB:Derived from original system description
    connect CalRegn02Rt01GroupC.CtrldVelRtnHwPosnScaX -> AAACalRegn02Rt01GroupC_Dummy.CtrldVelRtnHwPosnScaX  # UB:Derived from original system description
    connect CalRegn02Rt01GroupC.CtrldVelRtnHwPosnScaY -> AAACalRegn02Rt01GroupC_Dummy.CtrldVelRtnHwPosnScaY  # UB:Derived from original system description
    connect CalRegn02Rt01GroupC.CtrldVelRtnHwTqSca1X -> AAACalRegn02Rt01GroupC_Dummy.CtrldVelRtnHwTqSca1X  # UB:Derived from original system description
    connect CalRegn02Rt01GroupC.CtrldVelRtnHwTqSca1Y -> AAACalRegn02Rt01GroupC_Dummy.CtrldVelRtnHwTqSca1Y  # UB:Derived from original system description
    connect CalRegn02Rt01GroupC.CtrldVelRtnHwTqSca2X -> AAACalRegn02Rt01GroupC_Dummy.CtrldVelRtnHwTqSca2X  # UB:Derived from original system description
    connect CalRegn02Rt01GroupC.CtrldVelRtnHwTqSca2Y -> AAACalRegn02Rt01GroupC_Dummy.CtrldVelRtnHwTqSca2Y  # UB:Derived from original system description
    connect CalRegn02Rt01GroupC.CtrldVelRtnIntglGain -> AAACalRegn02Rt01GroupC_Dummy.CtrldVelRtnIntglGain  # UB:Derived from original system description
    connect CalRegn02Rt01GroupC.CtrldVelRtnPinionTqScaX -> AAACalRegn02Rt01GroupC_Dummy.CtrldVelRtnPinionTqScaX  # UB:Derived from original system description
    connect CalRegn02Rt01GroupC.CtrldVelRtnPinionTqScaY -> AAACalRegn02Rt01GroupC_Dummy.CtrldVelRtnPinionTqScaY  # UB:Derived from original system description
    connect CalRegn02Rt01GroupC.CtrldVelRtnPropGain -> AAACalRegn02Rt01GroupC_Dummy.CtrldVelRtnPropGain  # UB:Derived from original system description
    connect CalRegn02Rt01GroupC.CtrldVelRtnTqGrdtScaX -> AAACalRegn02Rt01GroupC_Dummy.CtrldVelRtnTqGrdtScaX  # UB:Derived from original system description
    connect CalRegn02Rt01GroupC.CtrldVelRtnTqGrdtScaY -> AAACalRegn02Rt01GroupC_Dummy.CtrldVelRtnTqGrdtScaY  # UB:Derived from original system description
    connect CalRegn02Rt01GroupC.CtrldVelRtnVehSpdScaBilnrSeln -> AAACalRegn02Rt01GroupC_Dummy.CtrldVelRtnVehSpdScaBilnrSeln  # UB:Derived from original system description
    connect CalRegn02Rt01GroupC.CtrldVelRtnVelErrScaBilnrSeln -> AAACalRegn02Rt01GroupC_Dummy.CtrldVelRtnVelErrScaBilnrSeln  # UB:Derived from original system description
    connect CalRegn02Rt01GroupC.CtrldVelRtnVelErrScaEna -> AAACalRegn02Rt01GroupC_Dummy.CtrldVelRtnVelErrScaEna  # UB:Derived from original system description
    connect CalRegn02Rt01GroupC.CtrldVelRtnVelErrScaX -> AAACalRegn02Rt01GroupC_Dummy.CtrldVelRtnVelErrScaX  # UB:Derived from original system description
    connect CalRegn02Rt01GroupC.CtrldVelRtnVelErrScaY -> AAACalRegn02Rt01GroupC_Dummy.CtrldVelRtnVelErrScaY  # UB:Derived from original system description
    connect CalRegn02Rt01GroupC.CtrldVelRtnVelErrVehSpdScaY -> AAACalRegn02Rt01GroupC_Dummy.CtrldVelRtnVelErrVehSpdScaY  # UB:Derived from original system description
    connect CalRegn02Rt01GroupC.CtrldVelRtnVelSpdTbl -> AAACalRegn02Rt01GroupC_Dummy.CtrldVelRtnVelSpdTbl  # UB:Derived from original system description
    connect CalRegn02Rt02.BmwStReqMgrAllwToOffThd -> AAACalRegn02Rt02_Dummy.BmwStReqMgrAllwToOffThd  # UB:Derived from original system description
    connect CalRegn02Rt02.BmwStReqMgrStsDrvrActvyTqChgThd -> AAACalRegn02Rt02_Dummy.BmwStReqMgrStsDrvrActvyTqChgThd  # UB:Derived from original system description
    connect CalRegn02Rt02GroupA.BmwStReqMgrDrvrActvTmrThd -> AAACalRegn02Rt02GroupA_Dummy.BmwStReqMgrDrvrActvTmrThd  # UB:Derived from original system description
    connect CalRegn02Rt02GroupA.BmwStReqMgrHwTqThd -> AAACalRegn02Rt02GroupA_Dummy.BmwStReqMgrHwTqThd  # UB:Derived from original system description
    connect CalRegn02Rt02GroupA.BmwStReqMgrOperRampRate -> AAACalRegn02Rt02GroupA_Dummy.BmwStReqMgrOperRampRate  # UB:Derived from original system description
    connect CalRegn02Rt02GroupA.BmwStReqMgrSwtOffSpdLim -> AAACalRegn02Rt02GroupA_Dummy.BmwStReqMgrSwtOffSpdLim  # UB:Derived from original system description
    connect CalRegn02Rt02GroupA.BmwStReqMgrSysProtnRednFacThd -> AAACalRegn02Rt02GroupA_Dummy.BmwStReqMgrSysProtnRednFacThd  # UB:Derived from original system description
    connect CalRegn02Rt02GroupC.CtrldVelRtnDampgX -> AAACalRegn02Rt02GroupC_Dummy.CtrldVelRtnDampgX  # UB:Derived from original system description
    connect CalRegn02Rt02GroupC.CtrldVelRtnDampgY -> AAACalRegn02Rt02GroupC_Dummy.CtrldVelRtnDampgY  # UB:Derived from original system description
    connect CalRegn02Rt02GroupC.CtrldVelRtnDesVelScaX -> AAACalRegn02Rt02GroupC_Dummy.CtrldVelRtnDesVelScaX  # UB:Derived from original system description
    connect CalRegn02Rt02GroupC.CtrldVelRtnDesVelScaY -> AAACalRegn02Rt02GroupC_Dummy.CtrldVelRtnDesVelScaY  # UB:Derived from original system description
    connect CalRegn02Rt02GroupC.CtrldVelRtnDesVelX -> AAACalRegn02Rt02GroupC_Dummy.CtrldVelRtnDesVelX  # UB:Derived from original system description
    connect CalRegn02Rt02GroupC.CtrldVelRtnDesVelY -> AAACalRegn02Rt02GroupC_Dummy.CtrldVelRtnDesVelY  # UB:Derived from original system description
    connect CalRegn02Rt02GroupC.CtrldVelRtnHwPosnScaX -> AAACalRegn02Rt02GroupC_Dummy.CtrldVelRtnHwPosnScaX  # UB:Derived from original system description
    connect CalRegn02Rt02GroupC.CtrldVelRtnHwPosnScaY -> AAACalRegn02Rt02GroupC_Dummy.CtrldVelRtnHwPosnScaY  # UB:Derived from original system description
    connect CalRegn02Rt02GroupC.CtrldVelRtnHwTqSca1X -> AAACalRegn02Rt02GroupC_Dummy.CtrldVelRtnHwTqSca1X  # UB:Derived from original system description
    connect CalRegn02Rt02GroupC.CtrldVelRtnHwTqSca1Y -> AAACalRegn02Rt02GroupC_Dummy.CtrldVelRtnHwTqSca1Y  # UB:Derived from original system description
    connect CalRegn02Rt02GroupC.CtrldVelRtnHwTqSca2X -> AAACalRegn02Rt02GroupC_Dummy.CtrldVelRtnHwTqSca2X  # UB:Derived from original system description
    connect CalRegn02Rt02GroupC.CtrldVelRtnHwTqSca2Y -> AAACalRegn02Rt02GroupC_Dummy.CtrldVelRtnHwTqSca2Y  # UB:Derived from original system description
    connect CalRegn02Rt02GroupC.CtrldVelRtnIntglGain -> AAACalRegn02Rt02GroupC_Dummy.CtrldVelRtnIntglGain  # UB:Derived from original system description
    connect CalRegn02Rt02GroupC.CtrldVelRtnPinionTqScaX -> AAACalRegn02Rt02GroupC_Dummy.CtrldVelRtnPinionTqScaX  # UB:Derived from original system description
    connect CalRegn02Rt02GroupC.CtrldVelRtnPinionTqScaY -> AAACalRegn02Rt02GroupC_Dummy.CtrldVelRtnPinionTqScaY  # UB:Derived from original system description
    connect CalRegn02Rt02GroupC.CtrldVelRtnPropGain -> AAACalRegn02Rt02GroupC_Dummy.CtrldVelRtnPropGain  # UB:Derived from original system description
    connect CalRegn02Rt02GroupC.CtrldVelRtnTqGrdtScaX -> AAACalRegn02Rt02GroupC_Dummy.CtrldVelRtnTqGrdtScaX  # UB:Derived from original system description
    connect CalRegn02Rt02GroupC.CtrldVelRtnTqGrdtScaY -> AAACalRegn02Rt02GroupC_Dummy.CtrldVelRtnTqGrdtScaY  # UB:Derived from original system description
    connect CalRegn02Rt02GroupC.CtrldVelRtnVehSpdScaBilnrSeln -> AAACalRegn02Rt02GroupC_Dummy.CtrldVelRtnVehSpdScaBilnrSeln  # UB:Derived from original system description
    connect CalRegn02Rt02GroupC.CtrldVelRtnVelErrScaBilnrSeln -> AAACalRegn02Rt02GroupC_Dummy.CtrldVelRtnVelErrScaBilnrSeln  # UB:Derived from original system description
    connect CalRegn02Rt02GroupC.CtrldVelRtnVelErrScaEna -> AAACalRegn02Rt02GroupC_Dummy.CtrldVelRtnVelErrScaEna  # UB:Derived from original system description
    connect CalRegn02Rt02GroupC.CtrldVelRtnVelErrScaX -> AAACalRegn02Rt02GroupC_Dummy.CtrldVelRtnVelErrScaX  # UB:Derived from original system description
    connect CalRegn02Rt02GroupC.CtrldVelRtnVelErrScaY -> AAACalRegn02Rt02GroupC_Dummy.CtrldVelRtnVelErrScaY  # UB:Derived from original system description
    connect CalRegn02Rt02GroupC.CtrldVelRtnVelErrVehSpdScaY -> AAACalRegn02Rt02GroupC_Dummy.CtrldVelRtnVelErrVehSpdScaY  # UB:Derived from original system description
    connect CalRegn02Rt02GroupC.CtrldVelRtnVelSpdTbl -> AAACalRegn02Rt02GroupC_Dummy.CtrldVelRtnVelSpdTbl  # UB:Derived from original system description
    connect CalRegn02Rt03.BmwStReqMgrAllwToOffThd -> AAACalRegn02Rt03_Dummy.BmwStReqMgrAllwToOffThd  # UB:Derived from original system description
    connect CalRegn02Rt03.BmwStReqMgrStsDrvrActvyTqChgThd -> AAACalRegn02Rt03_Dummy.BmwStReqMgrStsDrvrActvyTqChgThd  # UB:Derived from original system description
    connect CalRegn02Rt03GroupA.BmwStReqMgrDrvrActvTmrThd -> AAACalRegn02Rt03GroupA_Dummy.BmwStReqMgrDrvrActvTmrThd  # UB:Derived from original system description
    connect CalRegn02Rt03GroupA.BmwStReqMgrHwTqThd -> AAACalRegn02Rt03GroupA_Dummy.BmwStReqMgrHwTqThd  # UB:Derived from original system description
    connect CalRegn02Rt03GroupA.BmwStReqMgrOperRampRate -> AAACalRegn02Rt03GroupA_Dummy.BmwStReqMgrOperRampRate  # UB:Derived from original system description
    connect CalRegn02Rt03GroupA.BmwStReqMgrSwtOffSpdLim -> AAACalRegn02Rt03GroupA_Dummy.BmwStReqMgrSwtOffSpdLim  # UB:Derived from original system description
    connect CalRegn02Rt03GroupA.BmwStReqMgrSysProtnRednFacThd -> AAACalRegn02Rt03GroupA_Dummy.BmwStReqMgrSysProtnRednFacThd  # UB:Derived from original system description
    connect CalRegn02Rt03GroupC.CtrldVelRtnDampgX -> AAACalRegn02Rt03GroupC_Dummy.CtrldVelRtnDampgX  # UB:Derived from original system description
    connect CalRegn02Rt03GroupC.CtrldVelRtnDampgY -> AAACalRegn02Rt03GroupC_Dummy.CtrldVelRtnDampgY  # UB:Derived from original system description
    connect CalRegn02Rt03GroupC.CtrldVelRtnDesVelScaX -> AAACalRegn02Rt03GroupC_Dummy.CtrldVelRtnDesVelScaX  # UB:Derived from original system description
    connect CalRegn02Rt03GroupC.CtrldVelRtnDesVelScaY -> AAACalRegn02Rt03GroupC_Dummy.CtrldVelRtnDesVelScaY  # UB:Derived from original system description
    connect CalRegn02Rt03GroupC.CtrldVelRtnDesVelX -> AAACalRegn02Rt03GroupC_Dummy.CtrldVelRtnDesVelX  # UB:Derived from original system description
    connect CalRegn02Rt03GroupC.CtrldVelRtnDesVelY -> AAACalRegn02Rt03GroupC_Dummy.CtrldVelRtnDesVelY  # UB:Derived from original system description
    connect CalRegn02Rt03GroupC.CtrldVelRtnHwPosnScaX -> AAACalRegn02Rt03GroupC_Dummy.CtrldVelRtnHwPosnScaX  # UB:Derived from original system description
    connect CalRegn02Rt03GroupC.CtrldVelRtnHwPosnScaY -> AAACalRegn02Rt03GroupC_Dummy.CtrldVelRtnHwPosnScaY  # UB:Derived from original system description
    connect CalRegn02Rt03GroupC.CtrldVelRtnHwTqSca1X -> AAACalRegn02Rt03GroupC_Dummy.CtrldVelRtnHwTqSca1X  # UB:Derived from original system description
    connect CalRegn02Rt03GroupC.CtrldVelRtnHwTqSca1Y -> AAACalRegn02Rt03GroupC_Dummy.CtrldVelRtnHwTqSca1Y  # UB:Derived from original system description
    connect CalRegn02Rt03GroupC.CtrldVelRtnHwTqSca2X -> AAACalRegn02Rt03GroupC_Dummy.CtrldVelRtnHwTqSca2X  # UB:Derived from original system description
    connect CalRegn02Rt03GroupC.CtrldVelRtnHwTqSca2Y -> AAACalRegn02Rt03GroupC_Dummy.CtrldVelRtnHwTqSca2Y  # UB:Derived from original system description
    connect CalRegn02Rt03GroupC.CtrldVelRtnIntglGain -> AAACalRegn02Rt03GroupC_Dummy.CtrldVelRtnIntglGain  # UB:Derived from original system description
    connect CalRegn02Rt03GroupC.CtrldVelRtnPinionTqScaX -> AAACalRegn02Rt03GroupC_Dummy.CtrldVelRtnPinionTqScaX  # UB:Derived from original system description
    connect CalRegn02Rt03GroupC.CtrldVelRtnPinionTqScaY -> AAACalRegn02Rt03GroupC_Dummy.CtrldVelRtnPinionTqScaY  # UB:Derived from original system description
    connect CalRegn02Rt03GroupC.CtrldVelRtnPropGain -> AAACalRegn02Rt03GroupC_Dummy.CtrldVelRtnPropGain  # UB:Derived from original system description
    connect CalRegn02Rt03GroupC.CtrldVelRtnTqGrdtScaX -> AAACalRegn02Rt03GroupC_Dummy.CtrldVelRtnTqGrdtScaX  # UB:Derived from original system description
    connect CalRegn02Rt03GroupC.CtrldVelRtnTqGrdtScaY -> AAACalRegn02Rt03GroupC_Dummy.CtrldVelRtnTqGrdtScaY  # UB:Derived from original system description
    connect CalRegn02Rt03GroupC.CtrldVelRtnVehSpdScaBilnrSeln -> AAACalRegn02Rt03GroupC_Dummy.CtrldVelRtnVehSpdScaBilnrSeln  # UB:Derived from original system description
    connect CalRegn02Rt03GroupC.CtrldVelRtnVelErrScaBilnrSeln -> AAACalRegn02Rt03GroupC_Dummy.CtrldVelRtnVelErrScaBilnrSeln  # UB:Derived from original system description
    connect CalRegn02Rt03GroupC.CtrldVelRtnVelErrScaEna -> AAACalRegn02Rt03GroupC_Dummy.CtrldVelRtnVelErrScaEna  # UB:Derived from original system description
    connect CalRegn02Rt03GroupC.CtrldVelRtnVelErrScaX -> AAACalRegn02Rt03GroupC_Dummy.CtrldVelRtnVelErrScaX  # UB:Derived from original system description
    connect CalRegn02Rt03GroupC.CtrldVelRtnVelErrScaY -> AAACalRegn02Rt03GroupC_Dummy.CtrldVelRtnVelErrScaY  # UB:Derived from original system description
    connect CalRegn02Rt03GroupC.CtrldVelRtnVelErrVehSpdScaY -> AAACalRegn02Rt03GroupC_Dummy.CtrldVelRtnVelErrVehSpdScaY  # UB:Derived from original system description
    connect CalRegn02Rt03GroupC.CtrldVelRtnVelSpdTbl -> AAACalRegn02Rt03GroupC_Dummy.CtrldVelRtnVelSpdTbl  # UB:Derived from original system description
    connect TunSelnMngt.ActvIninOptSetAIdx -> CDD_XcpIf.ActvIninOptSetAIdx  # UB:Derived from original system description
    connect BmwTunSetHndlr.DesIninOptSetAIdx -> TunSelnMngt.DesIninOptSetAIdx  # UB:Derived from original system description
    connect BattVltg.BrdgVltg -> BmwMsgSlot315Bas0Repn1BusFrChA.BrdgVltg  # UB:Derived from original system description
    connect BmwMsgSlot121Bas1Repn2BusFrChA.BmwVehCdn -> BmwMsgSlot315Bas0Repn1BusFrChA.BmwVehCdn  # UB:Derived from original system description
    connect BmwVehSpd.VehSpd -> BmwMsgSlot315Bas0Repn1BusFrChA.VehSpd  # UB:Derived from original system description
    connect CDD_MotCtrlMgr.HwTq4RawAdc -> BmwMsgSlot315Bas0Repn1BusFrChA.HwTq4RawAdc  # UB:Derived from original system description
    connect CDD_MotCtrlMgr.HwTq5RawAdc -> BmwMsgSlot315Bas0Repn1BusFrChA.HwTq5RawAdc  # UB:Derived from original system description
    connect CDD_MotVel.MotVelMrf -> BmwMsgSlot315Bas0Repn1BusFrChA.MotVelMrf  # UB:Derived from original system description
    connect EcuTMeas.EcuTFild -> BmwMsgSlot315Bas0Repn1BusFrChA.EcuTFild  # UB:Derived from original system description
    connect MotCurrPeakEstimn.MotCurrPeakEstimdFild -> BmwMsgSlot315Bas0Repn1BusFrChA.MotCurrPeakEstimdFild  # UB:Derived from original system description
    connect PwrLimr.MotTqCmdPwrLimd -> BmwMsgSlot315Bas0Repn1BusFrChA.MotTqCmdPwrLimd  # UB:Derived from original system description
    connect SysStMod.SysSt -> BmwMsgSlot315Bas0Repn1BusFrChA.SysSt  # UB:Derived from original system description
    connect TEstimn.MotFetT -> BmwMsgSlot315Bas0Repn1BusFrChA.MotFetT  # UB:Derived from original system description
    connect TEstimn.MotMagT -> BmwMsgSlot315Bas0Repn1BusFrChA.MotMagT  # UB:Derived from original system description
    connect TEstimn.MotWidgT -> BmwMsgSlot315Bas0Repn1BusFrChA.MotWidgT  # UB:Derived from original system description
    delegate BmwMsgSlot315Bas0Repn1BusFrChA.BATT_VLTG_EPS <-> outer port BATT_VLTG_EPS  # UB:Derived from original system description
    delegate BmwMsgSlot315Bas0Repn1BusFrChA.DBG_EPS_BS_MOD_58_BYTE_ID2 <-> outer port DBG_EPS_BS_MOD_58_BYTE_ID2  # UB:Derived from original system description
    delegate BmwMsgSlot315Bas0Repn1BusFrChA.ECU_TEMP_EPS <-> outer port ECU_TEMP_EPS  # UB:Derived from original system description
    delegate BmwMsgSlot315Bas0Repn1BusFrChA.ESTIMD_PEAK_MOT_CURR_EPS <-> outer port ESTIMD_PEAK_MOT_CURR_EPS  # UB:Derived from original system description
    delegate BmwMsgSlot315Bas0Repn1BusFrChA.MOT_FET_TEMP_EPS <-> outer port MOT_FET_TEMP_EPS  # UB:Derived from original system description
    delegate BmwMsgSlot315Bas0Repn1BusFrChA.MOT_MAG_TEMP_EPS <-> outer port MOT_MAG_TEMP_EPS  # UB:Derived from original system description
    delegate BmwMsgSlot315Bas0Repn1BusFrChA.MOT_TQ_CMD_EPS <-> outer port MOT_TQ_CMD_EPS  # UB:Derived from original system description
    delegate BmwMsgSlot315Bas0Repn1BusFrChA.MOT_TQ_CMD_LIMD_EPS <-> outer port MOT_TQ_CMD_LIMD_EPS  # UB:Derived from original system description
    delegate BmwMsgSlot315Bas0Repn1BusFrChA.MOT_VEL_EPS <-> outer port MOT_VEL_EPS  # UB:Derived from original system description
    delegate BmwMsgSlot315Bas0Repn1BusFrChA.MOT_WIDG_TEMP_EPS <-> outer port MOT_WIDG_TEMP_EPS  # UB:Derived from original system description
    delegate BmwMsgSlot315Bas0Repn1BusFrChA.PRIM_HW_TQ_SNSR_VLTG_EPS <-> outer port PRIM_HW_TQ_SNSR_VLTG_EPS  # UB:Derived from original system description
    delegate BmwMsgSlot315Bas0Repn1BusFrChA.SECDRY_HW_TQ_SNSR_VLTG_EPS <-> outer port SECDRY_HW_TQ_SNSR_VLTG_EPS  # UB:Derived from original system description
    delegate BmwMsgSlot315Bas0Repn1BusFrChA.ST_CON_VEH_EPS <-> outer port ST_CON_VEH_EPS  # UB:Derived from original system description
    delegate BmwMsgSlot315Bas0Repn1BusFrChA.SYS_ST_EPS <-> outer port SYS_ST_EPS  # UB:Derived from original system description
    delegate BmwMsgSlot315Bas0Repn1BusFrChA.VEH_SPD_EPS <-> outer port VEH_SPD_EPS  # UB:Derived from original system description
    connect BattVltg.BrdgVltg -> BmwDiagcSrvHndlg.BrdgVltg  # UB:Derived from original system description
    connect BmwDrvgDynStMac.DrvgDynIfSt -> BmwDiagcSrvHndlg.DrvgDynIfSt  # UB:Derived from original system description
    connect BmwHwAgArbnAndEotPosn.BmwPinionAg -> BmwDiagcSrvHndlg.BmwPinionAg  # UB:Derived from original system description
    connect BmwMsgSlot121Bas1Repn2BusFrChA.BmwBasPtlNetCtrl -> BmwDiagcSrvHndlg.BmwBasPtlNetCtrl  # UB:Derived from original system description
    connect BmwMsgSlot121Bas1Repn2BusFrChA.BmwVehCdn -> BmwDiagcSrvHndlg.BmwVehCdn  # UB:Derived from original system description
    connect BmwMsgSlot276Bas4Repn8BusFrChA.BmwOdomDst -> BmwDiagcSrvHndlg.BmwOdomDst  # UB:Derived from original system description
    connect BmwMsgSlot276Bas4Repn8BusFrChA.BmwOdomDstVld -> BmwDiagcSrvHndlg.BmwOdomDstVld  # UB:Derived from original system description
    connect DiagcMgrProxyAppl10.GetNtcActv10 -> BmwDiagcSrvHndlg.GetNtcActv  # UB:Derived from original system description
    connect EcuTMeas.EcuTFild -> BmwDiagcSrvHndlg.EcuTFild  # UB:Derived from original system description
    connect HwTqCorrln.HwTqIdptSig -> BmwDiagcSrvHndlg.HwTqIdptSig  # UB:Derived from original system description
    connect LrndRackCentr.RackCentrCmpl -> BmwDiagcSrvHndlg.RackCentrCmpl  # UB:Derived from original system description
    connect LrndRackCentr.RackCentrMotAgVld -> BmwDiagcSrvHndlg.RackCentrMotAgVld  # UB:Derived from original system description
    connect MotTqCmdSca.MotTqCmdMrfScad -> BmwDiagcSrvHndlg.MotTqCmdMrfScad  # UB:Derived from original system description
    connect BmwDiagcSrvHndlg.CSDataServices_DID_500C_PscmSts -> DemMaster_0.CBReadData_DID_500C_PscmSts
    connect BmwDiagcSrvHndlg.CSDataServices_DID_500E_HwTq -> DemMaster_0.CBReadData_DID_500E_HwTq
    connect BmwDiagcSrvHndlg.CSDataServices_DID_500F_MotTq -> DemMaster_0.CBReadData_DID_500F_MotTq
    connect BmwDiagcSrvHndlg.CSDataServices_DID_1700_KmStand -> DemMaster_0.CBReadData_DID_1700_KmStand
    connect BmwDiagcSrvHndlg.CSDataServices_DID_1750_FUwBn -> DemMaster_0.CBReadData_DID_1750_FUwBn
    connect BmwDiagcSrvHndlg.CSDataServices_DID_2805_Aussentemperatur -> DemMaster_0.CBReadData_DID_2805_Aussentemperatur
    connect BmwDiagcSrvHndlg.CSDataServices_DID_2866_Betriebsspannung -> DemMaster_0.CBReadData_DID_2866_Betriebsspannung
    connect BmwDiagcSrvHndlg.CSDataServices_DID_2867_Fahrzeuggeschwindigkeit -> DemMaster_0.CBReadData_DID_2867_Fahrzeuggeschwindigkeit
    connect BmwDiagcSrvHndlg.CSDataServices_DID_5003_HwAg -> DemMaster_0.CBReadData_DID_5003_HwAg
    connect BmwDiagcSrvHndlg.DataServices_DID_250B_ReadSwRevision -> Dcm.DataServices_DID_250B_ReadSwRevision
    connect BmwDiagcSrvHndlg.DataServices_DID_1000_Pruefstempel -> Dcm.DataServices_DID_1000_Pruefstempel
    connect BmwDiagcSrvHndlg.DataServices_DID_2502_ProgCounter -> Dcm.DataServices_DID_2502_ProgrammingCounter
    connect BmwDiagcSrvHndlg.DataServices_DID_2503_ProgrammingCounterMaxValue -> Dcm.DataServices_DID_2503_ProgrammingCounterMaxValue
    connect BmwDiagcSrvHndlg.DataServices_DID_2540_MileKmEeprom -> Dcm.DataServices_DID_2540_MileKmEeprom
    connect BmwDiagcSrvHndlg.DataServices_DID_DB3C_StatusFzgBordnetz -> Dcm.DataServices_DID_DB3C_StatusFzgBordnetz
    connect BmwDiagcSrvHndlg.DataServices_DID_DB99_EpsMomentensensor -> Dcm.DataServices_DID_DB99_EpsMomentensensor
    connect BmwDiagcSrvHndlg.DataServices_DID_DC77_EpsZahnstangenmitte -> Dcm.DataServices_DID_DC77_EpsZahnstangenmitte
    connect BmwDiagcSrvHndlg.RoutineServices_EpsInitialisierungService_Routine -> Dcm.RoutineServices_EpsInitialisierungService_Routine
    connect BmwDiagcSrvHndlg.RoutineServices_EpsPendeln_Routine -> Dcm.RoutineServices_EpsPendeln_Routine
    connect BmwDiagcSrvHndlg.RoutineServices_EpsVerfahren_Routine -> Dcm.RoutineServices_EpsVerfahren_Routine
    connect NvMProxy.PSProxy_Rte_NvmBlock_BmwDiagcSrvHndlg_MilesKmEeprom -> BmwDiagcSrvHndlg.MilesKmEeprom
    connect NvMProxy.PSProxy_Rte_NvmBlock_BmwDiagcSrvHndlg_ProgCntr -> BmwDiagcSrvHndlg.ProgCntr
    connect NvMProxy.PSProxy_Rte_NvmBlock_BmwDiagcSrvHndlg_ProgCntrMaxVal -> BmwDiagcSrvHndlg.ProgCntrMaxVal
    connect NvMProxy.PSProxy_Rte_NvmBlock_BmwDiagcSrvHndlg_TestStamp -> BmwDiagcSrvHndlg.TestStamp
    connect CDD_MotAg0Meas.MotAg0TurnCntr -> BmwHwAgArbnAndEotPosn.MotAgTurnCntr  # UB:Derived from original system description
    connect HwTqTrakgCtrl.MotTqCmdTrakgCtrl -> BmwMsgSlot51Bas0Repn2BusFrChA.BmwTarMotTq  # UB:Derived from original system description
    connect BmwTunSetHndlr.MotVrntRead -> ProgMfgSrv.MotVrntRead  # UB:Derived from original system description
    connect BmwTunSetHndlr.MotVrntWr -> ProgMfgSrv.MotVrntWr  # UB:Derived from original system description
    connect NvMProxy.PSProxy_Rte_NvmBlock_BmwTunSetHndlr_NvmBmwDesIninOptSetAIdx -> BmwTunSetHndlr.BmwDesIninOptSetAIdx
    connect BattVltg.BrdgVltg -> BmwSplyCurrLim.BrdgVltg  # UB:Derived from original system description
    connect BmwHaptcFb.HaptcFbSt -> BmwMsgSlot234Bas1Repn2BusFrChA.HaptcFbSt  # UB:Derived from original system description
    connect BmwHaptcFb.HwOscnEna -> TqOscn.HwOscnEna  # UB:Derived from original system description
    connect BmwHaptcFb.HwOscnFallRampRate -> TqOscn.HwOscnFallRampRate  # UB:Derived from original system description
    connect BmwHaptcFb.HwOscnFrq -> TqOscn.HwOscnFrq  # UB:Derived from original system description
    connect BmwHaptcFb.HwOscnMotAmp -> TqOscn.HwOscnMotAmp  # UB:Derived from original system description
    connect BmwHaptcFb.HwOscnRisngRampRate -> TqOscn.HwOscnRisngRampRate  # UB:Derived from original system description
    connect BmwMsgSlot269Bas2Repn4BusFrChA.BmwHaptcFbIntenNr -> BmwHaptcFb.BmwHaptcFbIntenNr  # UB:Derived from original system description
    connect BmwMsgSlot269Bas2Repn4BusFrChA.BmwHaptcFbIntenNrVld -> BmwHaptcFb.BmwHaptcFbIntenNrVld  # UB:Derived from original system description
    connect BmwMsgSlot269Bas2Repn4BusFrChA.BmwHaptcFbPatNr -> BmwHaptcFb.BmwHaptcFbPatNr  # UB:Derived from original system description
    connect BmwMsgSlot269Bas2Repn4BusFrChA.BmwHaptcFbPatNrVld -> BmwHaptcFb.BmwHaptcFbPatNrVld  # UB:Derived from original system description
    connect BmwSplyCurrLim.SplyCurrLim -> PwrLimr.SplyCurrLim  # UB:Derived from original system description
    connect BmwStReqMgr.StsSteerAssi -> BmwHaptcFb.StsSteerAssi  # UB:Derived from original system description
    connect BmwVehSpd.VehSpd -> BmwHaptcFb.VehSpd  # UB:Derived from original system description
    connect BmwVehSpd.VehSpdVld -> BmwHaptcFb.VehSpdVld  # UB:Derived from original system description
    connect BmwVehSpd.VehSpd -> BmwSplyCurrLim.VehSpd  # UB:Derived from original system description
    connect CDD_NxtrTi.GetRefTmr100MicroSec32bit -> BmwHaptcFb.GetRefTmr100MicroSec32bit  # UB:Derived from original system description
    connect CDD_NxtrTi.GetTiSpan100MicroSec32bit -> BmwHaptcFb.GetTiSpan100MicroSec32bit  # UB:Derived from original system description
    connect DiagcMgr.DiagcStsNonRcvrlReqDiFltPrsnt -> BmwHaptcFb.DiagcStsNonRcvrlReqDiFltPrsnt  # UB:Derived from original system description
    connect DiagcMgrProxyAppl9.SetNtcSts9 -> BmwSplyCurrLim.SetNtcSts  # UB:Derived from original system description
    connect DutyCycThermProtn.ThermRednFac -> BmwHaptcFb.ThermRednFac  # UB:Derived from original system description
    connect DutyCycThermProtn.ThermRednFac -> BmwStReqMgr.ThermRednFac  # UB:Derived from original system description
    connect HwTqArbn.HwTq -> BmwHaptcFb.HwTq  # UB:Derived from original system description
    connect NxtrCalIds.NxtrCalIdsCalDevlpRd -> CmnMfgSrv.NxtrCalIdsCalDevlpRd  # UB:Derived from original system description
    connect NxtrCalIds.NxtrCalIdsCalRelRd -> CmnMfgSrv.NxtrCalIdsCalRelRd  # UB:Derived from original system description
    connect PwrLimr.PwrLimrRednFac -> BmwStReqMgr.PwrLimrRednFac  # UB:Derived from original system description
    connect TqOscn.HwOscnActv -> BmwHaptcFb.HwOscnActv  # UB:Derived from original system description
    connect TqOscn.HwOscnDcThdExcdd -> BmwHaptcFb.HwOscnDcThdExcdd  # UB:Derived from original system description
    connect BmwMsgSlot68Bas1Repn2BusFrChA.BmwMaxCurrLimr -> BmwSplyCurrLim.BmwMaxCurrLimr  # UB:Derived from original system description
    connect BmwMsgSlot68Bas1Repn2BusFrChA.BmwMaxCurrLimrSts -> BmwSplyCurrLim.BmwMaxCurrLimrSts  # UB:Derived from original system description
    connect CDD_HwTq4Meas.HwTq4Qlfr -> BmwMsgSlot49Bas0Repn2BusFrChA.HwTq4Qlfr  # UB:Derived from original system description
    connect CDD_HwTq5Meas.HwTq5Qlfr -> BmwMsgSlot49Bas0Repn2BusFrChA.HwTq5Qlfr  # UB:Derived from original system description
    connect EpsStEstimn.RackFEstimd -> BmwMsgSlot49Bas0Repn2BusFrChA.RackFEstimd  # UB:Derived from original system description
    connect HwTqArbn.HwTq -> BmwMsgSlot49Bas0Repn2BusFrChA.HwTq  # UB:Derived from original system description
    connect BmwMsgSlot55Bas3Repn4BusFrChA.BmwCogVehSpdQlfr -> BmwVehSpd.BmwCogVehSpdQlfr  # UB:Derived from original system description
    connect BmwMsgSlot55Bas3Repn4BusFrChA.BmwCogVehSpdQlfrVld -> BmwVehSpd.BmwCogVehSpdQlfrVld  # UB:Derived from original system description
    connect CalRegn01Cmn.BmwVehSpdBmwSecurVehSpdStsSigValVldDurnTiVal -> BmwVehSpd.BmwVehSpdBmwSecurVehSpdStsSigValVldDurnTiVal  # UB:Derived from original system description
    connect CalRegn01Cmn.BmwVehSpdNearStillSubVehSpd -> BmwVehSpd.BmwVehSpdNearStillSubVehSpd  # UB:Derived from original system description
    connect CalRegn01Cmn.BmwVehSpdRunngSubVehSpd -> BmwVehSpd.BmwVehSpdRunngSubVehSpd  # UB:Derived from original system description
    connect CalRegn01Cmn.BmwVehSpdSecurVehSpdInvldRateLim -> BmwVehSpd.BmwVehSpdSecurVehSpdInvldRateLim  # UB:Derived from original system description
    connect CalRegn01Cmn.BmwVehSpdSecurVehSpdVldRateLim -> BmwVehSpd.BmwVehSpdSecurVehSpdVldRateLim  # UB:Derived from original system description
    connect CDD_NxtrTi.GetRefTmr100MicroSec32bit -> BmwVehSpd.GetRefTmr100MicroSec32bit  # UB:Derived from original system description
    connect CDD_NxtrTi.GetTiSpan100MicroSec32bit -> BmwVehSpd.GetTiSpan100MicroSec32bit  # UB:Derived from original system description
    connect BmwVehSpd.BmwSecurVehSpdSts -> BmwHwAgArbnAndEotPosn.BmwVehSpdSts  # UB:Derived from original system description
    connect BmwVehSpd.BmwSecurVehSpdSts -> BmwStReqMgr.BmwVehSpdSts  # UB:Derived from original system description
    connect CalRegn01Cmn.NxtrCalIdsCal0DevlpAuthor -> NxtrCalIds.NxtrCalIdsCal0DevlpAuthor  # UB:Derived from original system description
    connect CalRegn01Cmn.NxtrCalIdsCal0DevlpDesc -> NxtrCalIds.NxtrCalIdsCal0DevlpDescr  # UB:Derived from original system description
    connect CalRegn01Cmn.NxtrCalIdsCal0DevlpRelNr -> NxtrCalIds.NxtrCalIdsCal0DevlpRelNr  # UB:Derived from original system description
    connect CalRegn01Cmn.NxtrCalIdsCal0DevlpRelSt -> NxtrCalIds.NxtrCalIdsCal0DevlpRelSt  # UB:Derived from original system description
    connect CalRegn01Cmn.NxtrCalIdsCal0DevlpTiStamp -> NxtrCalIds.NxtrCalIdsCal0DevlpTiStamp  # UB:Derived from original system description
    connect CalRegn01Cmn.NxtrCalIdsCal0DevlpVers -> NxtrCalIds.NxtrCalIdsCal0DevlpVers  # UB:Derived from original system description
    connect CalRegn01Cmn.NxtrCalIdsCal1DevlpAuthor -> NxtrCalIds.NxtrCalIdsCal1DevlpAuthor  # UB:Derived from original system description
    connect CalRegn01Cmn.NxtrCalIdsCal1DevlpDesc -> NxtrCalIds.NxtrCalIdsCal1DevlpDescr  # UB:Derived from original system description
    connect CalRegn01Cmn.NxtrCalIdsCal1DevlpRelNr -> NxtrCalIds.NxtrCalIdsCal1DevlpRelNr  # UB:Derived from original system description
    connect CalRegn01Cmn.NxtrCalIdsCal1DevlpRelSt -> NxtrCalIds.NxtrCalIdsCal1DevlpRelSt  # UB:Derived from original system description
    connect CalRegn01Cmn.NxtrCalIdsCal1DevlpTiStamp -> NxtrCalIds.NxtrCalIdsCal1DevlpTiStamp  # UB:Derived from original system description
    connect CalRegn01Cmn.NxtrCalIdsCal1DevlpVers -> NxtrCalIds.NxtrCalIdsCal1DevlpVers  # UB:Derived from original system description
    connect CalRegn01Cmn.NxtrCalIdsCal2DevlpAuthor -> NxtrCalIds.NxtrCalIdsCal2DevlpAuthor  # UB:Derived from original system description
    connect CalRegn01Cmn.NxtrCalIdsCal2DevlpDesc -> NxtrCalIds.NxtrCalIdsCal2DevlpDescr  # UB:Derived from original system description
    connect CalRegn01Cmn.NxtrCalIdsCal2DevlpRelNr -> NxtrCalIds.NxtrCalIdsCal2DevlpRelNr  # UB:Derived from original system description
    connect CalRegn01Cmn.NxtrCalIdsCal2DevlpRelSt -> NxtrCalIds.NxtrCalIdsCal2DevlpRelSt  # UB:Derived from original system description
    connect CalRegn01Cmn.NxtrCalIdsCal2DevlpTiStamp -> NxtrCalIds.NxtrCalIdsCal2DevlpTiStamp  # UB:Derived from original system description
    connect CalRegn01Cmn.NxtrCalIdsCal2DevlpVers -> NxtrCalIds.NxtrCalIdsCal2DevlpVers  # UB:Derived from original system description
    connect DiagcMgr.ReadSnpshtData -> CmnMfgSrv.ReadExtdSnpshtData  # UB:Derived from original system description
    connect MotTqTranlDampg.MotTqCmdCrfDampd -> LrndRackCentr.MotTqCmd  # UB:Derived from original system description
    connect BmwHwAgArbnAndEotPosn.BmwPinionAgQlfr -> BmwDiagcSrvHndlg.BmwPinionAgQlfr  # UB:Derived from original system description
    connect BmwHwAgArbnAndEotPosn.BmwPinionAgQlfr -> BmwMsgSlot51Bas0Repn2BusFrChA.BmwPinionAgQlfr  # UB:Derived from original system description
    connect BmwHwAgArbnAndEotPosn.BmwPinionAgQlfr -> BmwVehSpd.BmwPinionAgQlfr  # UB:Derived from original system description
    connect BmwHwAgArbnAndEotPosn.OffsCmpdPinionAg -> CtrldVelRtn.HwAg  # UB:Derived from original system description
    connect BmwHwAgArbnAndEotPosn.AlgndPinionAg -> LrndRackCentr.HwAg  # UB:Derived from original system description
    connect BmwMsgSlot107Bas0Repn1BusFrChA.BmwQuadOffsSts -> BmwHwAgArbnAndEotPosn.BmwQuadOffsSts  # UB:Derived from original system description
    connect BmwMsgSlot108Bas0Repn2BusFrChA.BmwPinionAgOffs -> BmwHwAgArbnAndEotPosn.BmwPinionAgOffs  # UB:Derived from original system description
    connect BmwMsgSlot108Bas0Repn2BusFrChA.BmwPinionAgOffsSts -> BmwHwAgArbnAndEotPosn.BmwPinionAgOffsSts  # UB:Derived from original system description
    connect CalRegn01Cmn.BmwHwAgArbnAndEotPosnBmwPinionAgOffsLim -> BmwHwAgArbnAndEotPosn.BmwHwAgArbnAndEotPosnBmwPinionAgOffsLim  # UB:Derived from original system description
    connect CalRegn01Cmn.BmwHwAgArbnAndEotPosnBmwPinionAgOffsRateLim -> BmwHwAgArbnAndEotPosn.BmwHwAgArbnAndEotPosnBmwPinionAgOffsRateLim  # UB:Derived from original system description
    connect CalRegn01Cmn.BmwHwAgArbnAndEotPosnMinVehSpdReqdVldAbsPos -> BmwHwAgArbnAndEotPosn.BmwHwAgArbnAndEotPosnMinVehSpdReqdVldAbsPos  # UB:Derived from original system description
    connect CalRegn01Cmn.BmwHwAgArbnAndEotPosnMotPosnDegArbdBlnd -> BmwHwAgArbnAndEotPosn.BmwHwAgArbnAndEotPosnMotPosnDegArbdBlnd  # UB:Derived from original system description
    connect CalRegn01Cmn.BmwHwAgArbnAndEotPosnOffsAuthy -> BmwHwAgArbnAndEotPosn.BmwHwAgArbnAndEotPosnOffsAuthy  # UB:Derived from original system description
    connect CalRegn01Cmn.BmwHwAgArbnAndEotPosnOffsCorrnAuthy -> BmwHwAgArbnAndEotPosn.BmwHwAgArbnAndEotPosnOffsCorrnAuthy  # UB:Derived from original system description
    connect CalRegn01Cmn.BmwHwAgArbnAndEotPosnPinionAgFltTmrThd -> BmwHwAgArbnAndEotPosn.BmwHwAgArbnAndEotPosnPinionAgFltTmrThd  # UB:Derived from original system description
    connect CalRegn01Cmn.BmwHwAgArbnAndEotPosnSysPolarityAssi -> BmwHwAgArbnAndEotPosn.BmwHwAgArbnAndEotPosnSysPolarityAssi  # UB:Derived from original system description
    connect CalRegn01Cmn.BmwHwAgArbnAndEotPosnTmpCmpdAuthy -> BmwHwAgArbnAndEotPosn.BmwHwAgArbnAndEotPosnTmpCmpdAuthy  # UB:Derived from original system description
    connect CalRegn01Cmn.BmwHwAgArbnAndEotPosnTurnCntrAuthy -> BmwHwAgArbnAndEotPosn.BmwHwAgArbnAndEotPosnTurnCntrAuthy  # UB:Derived from original system description
    connect CalRegn01Cmn.BmwHwAgArbnAndEotPosnTurnCntrCorrlnStsTmrThd -> BmwHwAgArbnAndEotPosn.BmwHwAgArbnAndEotPosnTurnCntrCorrlnStsTmrThd  # UB:Derived from original system description
    connect DiagcMgrProxyAppl10.GetNtcQlfrSts10 -> BmwHwAgArbnAndEotPosn.GetNtcQlfrSts  # UB:Derived from original system description
    connect TurnCntrCorrln.TurnCntrCorrlnSts -> BmwHwAgArbnAndEotPosn.TurnCntrCorrlnSts  # UB:Derived from original system description
    connect CalRegn01CmnGroupB.BmwDrvgDynStMacAssiLvlThd -> BmwDrvgDynStMac.BmwDrvgDynStMacAssiLvlThd  # UB:Derived from original system description
    connect CalRegn01CmnGroupB.BmwDrvgDynStMacDampgCmdScaDft -> BmwDrvgDynStMac.BmwDrvgDynStMacDampgCmdScaDft  # UB:Derived from original system description
    connect CalRegn01CmnGroupB.BmwDrvgDynStMacEffortCmdScaDft -> BmwDrvgDynStMac.BmwDrvgDynStMacEffortCmdScaDft  # UB:Derived from original system description
    connect CalRegn01CmnGroupB.BmwDrvgDynStMacErrIfTmrThd -> BmwDrvgDynStMac.BmwDrvgDynStMacErrIfTmrThd  # UB:Derived from original system description
    connect CalRegn01CmnGroupB.BmwDrvgDynStMacMotTqCmdOvrlActvtThd -> BmwDrvgDynStMac.BmwDrvgDynStMacMotTqCmdOvrlActvtThd  # UB:Derived from original system description
    connect CalRegn01CmnGroupB.BmwDrvgDynStMacMotTqCmdOvrlDeactvtThd -> BmwDrvgDynStMac.BmwDrvgDynStMacMotTqCmdOvrlDeactvtThd  # UB:Derived from original system description
    connect CalRegn01CmnGroupB.BmwDrvgDynStMacRtnCmdScaDft -> BmwDrvgDynStMac.BmwDrvgDynStMacRtnCmdScaDft  # UB:Derived from original system description
    connect CalRegn01CmnGroupB.BmwDrvgDynStMacVehCdnTmrThd -> BmwDrvgDynStMac.BmwDrvgDynStMacVehCdnTmrThd  # UB:Derived from original system description
    connect CalRegn01CmnGroupB.BmwHwTqOvrlArbnCmdErrThd -> BmwHwTqOvrlArbn.BmwHwTqOvrlArbnCmdErrThd  # UB:Derived from original system description
    connect CalRegn01CmnGroupB.BmwHwTqOvrlArbnHwTqThdY -> BmwHwTqOvrlArbn.BmwHwTqOvrlArbnHwTqThdY  # UB:Derived from original system description
    connect CalRegn01CmnGroupB.BmwHwTqOvrlArbnOutpTqCmdLim -> BmwHwTqOvrlArbn.BmwHwTqOvrlArbnOutpTqCmdLim  # UB:Derived from original system description
    connect CalRegn01CmnGroupB.BmwHwTqOvrlArbnRampRate -> BmwHwTqOvrlArbn.BmwHwTqOvrlArbnRampRate  # UB:Derived from original system description
    connect CalRegn01CmnGroupB.BmwHwTqOvrlArbnRefTiThd -> BmwHwTqOvrlArbn.BmwHwTqOvrlArbnRefTiThd  # UB:Derived from original system description
    connect CalRegn01CmnGroupB.BmwHwTqOvrlArbnVehSpdX -> BmwHwTqOvrlArbn.BmwHwTqOvrlArbnVehSpdX  # UB:Derived from original system description
    connect CalRegn01CmnGroupB.BmwMotTqOvrlArbnBmwNearStillVehSpdStsRefTiThd -> BmwMotTqOvrlArbn.BmwMotTqOvrlArbnBmwNearStillVehSpdStsRefTiThd  # UB:Derived from original system description
    connect CalRegn01CmnGroupB.BmwMotTqOvrlArbnMfgModCmdRefTiThd -> BmwMotTqOvrlArbn.BmwMotTqOvrlArbnMfgModCmdRefTiThd  # UB:Derived from original system description
    connect CalRegn01CmnGroupB.BmwMotTqOvrlArbnMfgModCmdThd -> BmwMotTqOvrlArbn.BmwMotTqOvrlArbnMfgModCmdThd  # UB:Derived from original system description
    connect CalRegn01CmnGroupB.BmwMotTqOvrlArbnMfgModVehSpdThd -> BmwMotTqOvrlArbn.BmwMotTqOvrlArbnMfgModVehSpdThd  # UB:Derived from original system description
    connect CalRegn01CmnGroupB.BmwMotTqOvrlArbnVehSpdRefTiThd -> BmwMotTqOvrlArbn.BmwMotTqOvrlArbnVehSpdRefTiThd  # UB:Derived from original system description
    connect CalRegn01CmnGroupB.BmwTqOvrlCdngAndDrvgDynFacActvDampgSlewRate -> BmwTqOvrlCdngAndDrvgDynFac.BmwTqOvrlCdngAndDrvgDynFacActvDampgSlewRate  # UB:Derived from original system description
    connect CalRegn01CmnGroupB.BmwTqOvrlCdngAndDrvgDynFacActvEffortSlewRate -> BmwTqOvrlCdngAndDrvgDynFac.BmwTqOvrlCdngAndDrvgDynFacActvEffortSlewRate  # UB:Derived from original system description
    connect CalRegn01CmnGroupB.BmwTqOvrlCdngAndDrvgDynFacActvRtnSlewRate -> BmwTqOvrlCdngAndDrvgDynFac.BmwTqOvrlCdngAndDrvgDynFacActvRtnSlewRate  # UB:Derived from original system description
    connect CalRegn01CmnGroupB.BmwTqOvrlCdngAndDrvgDynFacDampgScaLoLimX -> BmwTqOvrlCdngAndDrvgDynFac.BmwTqOvrlCdngAndDrvgDynFacDampgScaLoLimX  # UB:Derived from original system description
    connect CalRegn01CmnGroupB.BmwTqOvrlCdngAndDrvgDynFacDampgScaLoLimY -> BmwTqOvrlCdngAndDrvgDynFac.BmwTqOvrlCdngAndDrvgDynFacDampgScaLoLimY  # UB:Derived from original system description
    connect CalRegn01CmnGroupB.BmwTqOvrlCdngAndDrvgDynFacEffortScaHiLimX -> BmwTqOvrlCdngAndDrvgDynFac.BmwTqOvrlCdngAndDrvgDynFacEffortScaHiLimX  # UB:Derived from original system description
    connect CalRegn01CmnGroupB.BmwTqOvrlCdngAndDrvgDynFacEffortScaHiLimY -> BmwTqOvrlCdngAndDrvgDynFac.BmwTqOvrlCdngAndDrvgDynFacEffortScaHiLimY  # UB:Derived from original system description
    connect CalRegn01CmnGroupB.BmwTqOvrlCdngAndDrvgDynFacInactvDampgSlewRate -> BmwTqOvrlCdngAndDrvgDynFac.BmwTqOvrlCdngAndDrvgDynFacInactvDampgSlewRate  # UB:Derived from original system description
    connect CalRegn01CmnGroupB.BmwTqOvrlCdngAndDrvgDynFacInactvEffortSlewRate -> BmwTqOvrlCdngAndDrvgDynFac.BmwTqOvrlCdngAndDrvgDynFacInactvEffortSlewRate  # UB:Derived from original system description
    connect CalRegn01CmnGroupB.BmwTqOvrlCdngAndDrvgDynFacInactvRtnSlewRate -> BmwTqOvrlCdngAndDrvgDynFac.BmwTqOvrlCdngAndDrvgDynFacInactvRtnSlewRate  # UB:Derived from original system description
    connect CalRegn01CmnGroupB.BmwTqOvrlCdngAndDrvgDynFacOutpTqOvrlSlew -> BmwTqOvrlCdngAndDrvgDynFac.BmwTqOvrlCdngAndDrvgDynFacOutpTqOvrlSlew  # UB:Derived from original system description
    connect CalRegn01CmnGroupB.BmwTqOvrlCdngAndDrvgDynFacReqdRtnCmdScaLoLim -> BmwTqOvrlCdngAndDrvgDynFac.BmwTqOvrlCdngAndDrvgDynFacReqdRtnCmdScaLoLim  # UB:Derived from original system description
    connect CalRegn01CmnGroupB.BmwTqOvrlCdngAndDrvgDynFacTarSteerTqDrvrActrLpFilFrq -> BmwTqOvrlCdngAndDrvgDynFac.BmwTqOvrlCdngAndDrvgDynFacTarSteerTqDrvrActrLpFilFrq  # UB:Derived from original system description
    connect CalRegn01CmnGroupB.BmwTqOvrlCdngAndDrvgDynFacTarSteerTqDrvrActrMaxY -> BmwTqOvrlCdngAndDrvgDynFac.BmwTqOvrlCdngAndDrvgDynFacTarSteerTqDrvrActrMaxY  # UB:Derived from original system description
    connect CalRegn01CmnGroupB.BmwTqOvrlCdngAndDrvgDynFacTarSteerTqDrvrActrSpdX -> BmwTqOvrlCdngAndDrvgDynFac.BmwTqOvrlCdngAndDrvgDynFacTarSteerTqDrvrActrSpdX  # UB:Derived from original system description
    connect CalRegn01CmnGroupB.BmwTrfcJamAssiDampgBasDampgX -> BmwTrfcJamAssiDampg.BmwTrfcJamAssiDampgBasDampgX  # UB:Derived from original system description
    connect CalRegn01CmnGroupB.BmwTrfcJamAssiDampgBasDampgY -> BmwTrfcJamAssiDampg.BmwTrfcJamAssiDampgBasDampgY  # UB:Derived from original system description
    connect CalRegn01CmnGroupB.BmwTrfcJamAssiDampgLimdDampgX -> BmwTrfcJamAssiDampg.BmwTrfcJamAssiDampgLimdDampgX  # UB:Derived from original system description
    connect CalRegn01CmnGroupB.BmwTrfcJamAssiDampgLimdDampgY -> BmwTrfcJamAssiDampg.BmwTrfcJamAssiDampgLimdDampgY  # UB:Derived from original system description
    connect CalRegn01CmnGroupB.BmwTrfcJamAssiDampgLimExcddFltRefTiThd -> BmwTrfcJamAssiDampg.BmwTrfcJamAssiDampgLimExcddFltRefTiThd  # UB:Derived from original system description
    connect CalRegn01CmnGroupB.BmwTrfcJamAssiDampgRatThd -> BmwTrfcJamAssiDampg.BmwTrfcJamAssiDampgRatThd  # UB:Derived from original system description
    connect CalRegn01CmnGroupB.BmwTrfcJamAssiDampgSlewRateDwnActv -> BmwTrfcJamAssiDampg.BmwTrfcJamAssiDampgSlewRateDwnActv  # UB:Derived from original system description
    connect CalRegn01CmnGroupB.BmwTrfcJamAssiDampgSlewRateDwnInactv -> BmwTrfcJamAssiDampg.BmwTrfcJamAssiDampgSlewRateDwnInactv  # UB:Derived from original system description
    connect CalRegn01CmnGroupB.BmwTrfcJamAssiDampgSlewRateDwnInvld -> BmwTrfcJamAssiDampg.BmwTrfcJamAssiDampgSlewRateDwnInvld  # UB:Derived from original system description
    connect CalRegn01CmnGroupB.BmwTrfcJamAssiDampgSlewRateUp -> BmwTrfcJamAssiDampg.BmwTrfcJamAssiDampgSlewRateUp  # UB:Derived from original system description
    connect CalRegn01Cmn.BmwTunSetHndlrNrOfMotVrnt -> BmwTunSetHndlr.BmwTunSetHndlrNrOfMotVrnt  # UB:Derived from original system description
    connect CalRegn01Cmn.BmwTunSetHndlrNrOfTunSet -> BmwTunSetHndlr.BmwTunSetHndlrNrOfTunSet  # UB:Derived from original system description
    connect CalRegn01Cmn.PwrLimrSplyCurrLimTblX -> PwrLimr.PwrLimrSplyCurrLimTblX  # UB:Derived from original system description
    connect CalRegn01Cmn.PwrLimrSplyCurrLimTblY -> PwrLimr.PwrLimrSplyCurrLimTblY  # UB:Derived from original system description
    connect CalRegn01CmnGroupB.BmwHaptcFbAmpAndIntenHwTqTblX -> BmwHaptcFb.BmwHaptcFbAmpAndIntenHwTqTblX  # UB:Derived from original system description
    connect CalRegn01CmnGroupB.BmwHaptcFbAmpBilnrSeln -> BmwHaptcFb.BmwHaptcFbAmpBilnrSeln  # UB:Derived from original system description
    connect CalRegn01CmnGroupB.BmwHaptcFbAmpSelnTblY -> BmwHaptcFb.BmwHaptcFbAmpSelnTblY  # UB:Derived from original system description
    connect CalRegn01CmnGroupB.BmwHaptcFbEpsDegradedFltThd -> BmwHaptcFb.BmwHaptcFbEpsDegradedFltThd  # UB:Derived from original system description
    connect CalRegn01CmnGroupB.BmwHaptcFbFrqBilnrSeln -> BmwHaptcFb.BmwHaptcFbFrqBilnrSeln  # UB:Derived from original system description
    connect CalRegn01CmnGroupB.BmwHaptcFbFrqSelnTblY -> BmwHaptcFb.BmwHaptcFbFrqSelnTblY  # UB:Derived from original system description
    connect CalRegn01CmnGroupB.BmwHaptcFbHwTqFrqTblY -> BmwHaptcFb.BmwHaptcFbHwTqFrqTblY  # UB:Derived from original system description
    connect CalRegn01CmnGroupB.BmwHaptcFbIntenSelnTblX -> BmwHaptcFb.BmwHaptcFbIntenSelnTblX  # UB:Derived from original system description
    connect CalRegn01CmnGroupB.BmwHaptcFbMotTqAmpTblY -> BmwHaptcFb.BmwHaptcFbMotTqAmpTblY  # UB:Derived from original system description
    connect CalRegn01CmnGroupB.BmwHaptcFbPatActvTiTblY -> BmwHaptcFb.BmwHaptcFbPatActvTiTblY  # UB:Derived from original system description
    connect CalRegn01CmnGroupB.BmwHaptcFbPatPasTiTblY -> BmwHaptcFb.BmwHaptcFbPatPasTiTblY  # UB:Derived from original system description
    connect CalRegn01CmnGroupB.BmwHaptcFbPatRisngSlewTblY -> BmwHaptcFb.BmwHaptcFbPatRisngSlewTblY  # UB:Derived from original system description
    connect CalRegn01CmnGroupB.BmwSplyCurrLimBmwMaxCurrLimMax -> BmwSplyCurrLim.BmwSplyCurrLimBmwMaxCurrLimMax  # UB:Derived from original system description
    connect CalRegn01CmnGroupB.BmwSplyCurrLimBmwMaxCurrLimMin -> BmwSplyCurrLim.BmwSplyCurrLimBmwMaxCurrLimMin  # UB:Derived from original system description
    connect CalRegn01CmnGroupB.BmwSplyCurrLimBmwMaxCurrLimrGrdt -> BmwSplyCurrLim.BmwSplyCurrLimBmwMaxCurrLimrGrdt  # UB:Derived from original system description
    connect CalRegn01CmnGroupB.BmwSplyCurrLimDegradedVltgMaxCurrX -> BmwSplyCurrLim.BmwSplyCurrLimDegradedVltgMaxCurrX  # UB:Derived from original system description
    connect CalRegn01CmnGroupB.BmwSplyCurrLimDegradedVltgMaxCurrY -> BmwSplyCurrLim.BmwSplyCurrLimDegradedVltgMaxCurrY  # UB:Derived from original system description
    connect CalRegn01CmnGroupB.BmwSplyCurrLimEpsCpbyOffs -> BmwSplyCurrLim.BmwSplyCurrLimEpsCpbyOffs  # UB:Derived from original system description
    connect CalRegn01CmnGroupB.BmwSplyCurrLimEpsMaxGrdt -> BmwSplyCurrLim.BmwSplyCurrLimEpsMaxGrdt  # UB:Derived from original system description
    connect CalRegn01CmnGroupB.BmwSplyCurrLimEpsMinGrdt -> BmwSplyCurrLim.BmwSplyCurrLimEpsMinGrdt  # UB:Derived from original system description
    connect CalRegn01CmnGroupB.BmwSplyCurrLimMaxCurrLim -> BmwSplyCurrLim.BmwSplyCurrLimMaxCurrLim  # UB:Derived from original system description
    connect CalRegn01CmnGroupB.BmwSplyCurrLimNormVltgMaxCurrX -> BmwSplyCurrLim.BmwSplyCurrLimNormVltgMaxCurrX  # UB:Derived from original system description
    connect CalRegn01CmnGroupB.BmwSplyCurrLimNormVltgMaxCurrY -> BmwSplyCurrLim.BmwSplyCurrLimNormVltgMaxCurrY  # UB:Derived from original system description
    connect CalRegn01CmnGroupB.BmwSplyCurrLimRemCtrlPrkgLim -> BmwSplyCurrLim.BmwSplyCurrLimRemCtrlPrkgLim  # UB:Derived from original system description
    connect CalRegn01CmnGroupB.BmwSplyCurrLimVehSpdDptCurrLimX -> BmwSplyCurrLim.BmwSplyCurrLimVehSpdDptCurrLimX  # UB:Derived from original system description
    connect CalRegn01CmnGroupB.BmwSplyCurrLimVehSpdDptCurrLimY -> BmwSplyCurrLim.BmwSplyCurrLimVehSpdDptCurrLimY  # UB:Derived from original system description
    connect CalRegn01CmnGroupB.BmwSplyCurrLimVltgDptCurrGrdtDecX -> BmwSplyCurrLim.BmwSplyCurrLimVltgDptCurrGrdtDecX  # UB:Derived from original system description
    connect CalRegn01CmnGroupB.BmwSplyCurrLimVltgDptCurrGrdtDecY -> BmwSplyCurrLim.BmwSplyCurrLimVltgDptCurrGrdtDecY  # UB:Derived from original system description
    connect CalRegn01CmnGroupB.BmwSplyCurrLimVltgDptCurrGrdtIncX -> BmwSplyCurrLim.BmwSplyCurrLimVltgDptCurrGrdtIncX  # UB:Derived from original system description
    connect CalRegn01CmnGroupB.BmwSplyCurrLimVltgDptCurrGrdtIncY -> BmwSplyCurrLim.BmwSplyCurrLimVltgDptCurrGrdtIncY  # UB:Derived from original system description
    connect CalRegn01CmnGroupB.BmwSplyCurrLimVltgDptCurrLimFltThd -> BmwSplyCurrLim.BmwSplyCurrLimVltgDptCurrLimFltThd  # UB:Derived from original system description
    connect CalRegn01CmnGroupB.BmwSplyCurrLimVrntMaxCurr -> BmwSplyCurrLim.BmwSplyCurrLimVrntMaxCurr  # UB:Derived from original system description
    connect BmwMsgSlot107Bas0Repn1BusFrChA.BmwQuadOffsStsVld -> BmwHwAgArbnAndEotPosn.BmwQuadOffsStsVld  # UB:Derived from original system description
    connect BmwMsgSlot107Bas0Repn1BusFrChA.BmwQuadRtrOffsVld -> BmwHwAgArbnAndEotPosn.BmwQuadRotorOffsVld  # UB:Derived from original system description
    connect BmwHwAgArbnAndEotPosn.PinionAg -> BmwPwrPrkgDampg.PinionAg  # UB:Derived from original system description
    connect BmwHwAgArbnAndEotPosn.PinionAgConf -> BmwPwrPrkgDampg.PinionAgConf  # UB:Derived from original system description
    connect BmwHwAgArbnAndEotPosn.PinionAg -> EotProtn.HwAg  # UB:Derived from original system description
    connect BmwHwAgArbnAndEotPosn.PinionAg -> PullCmpActv.HwAg  # UB:Derived from original system description
    connect BmwHwAgArbnAndEotPosn.PinionAgConf -> PullCmpActv.PinionAgConf  # UB:Derived from original system description
    connect BmwPwrPrkgDampg.DampgCmdPwrPrkg -> HwRefTqSum.HwTqCmdDampg  # UB:Derived from original system description
    connect BmwVehSpd.VehSpd -> BmwPwrPrkgDampg.VehSpd  # UB:Derived from original system description
    connect BmwVehSpd.VehSpd -> InertiaCmpVel.VehSpd  # UB:Derived from original system description
    connect BmwVehSpd.VehSpd -> PullCmpActv.VehSpd  # UB:Derived from original system description
    connect BmwVehSpd.VehSpdVld -> PullCmpActv.VehSpdVld  # UB:Derived from original system description
    connect CalRegn01Cmn.BmwMotTqOvrlArbnPullCmpCmdLim -> BmwMotTqOvrlArbn.BmwMotTqOvrlArbnPullCmpCmdLim  # UB:Derived from original system description
    connect CalRegn01Cmn.SysGlbPrmTorsBarStfn -> InertiaCmpVel.SysGlbPrmTorsBarStfn  # UB:Derived from original system description
    connect CalRegn01CmnGroupA.BmwPwrPrkgDampgMinPinionAgConf -> BmwPwrPrkgDampg.BmwPwrPrkgDampgMinPinionAgConf  # UB:Derived from original system description
    connect CalRegn01IninOptSetA00.SysGlbPrmSysTqRat -> PullCmpActv.SysGlbPrmSysTqRat  # UB:Derived from original system description
    connect CalRegn02Rt00GroupA.BmwPwrPrkgDampgBasPwrPrkgDampgY -> AAACalRegn02Rt00GroupA_Dummy.BmwPwrPrkgDampgBasPwrPrkgDampgY  # UB:Derived from original system description
    connect CalRegn02Rt00GroupA.BmwPwrPrkgDampgHwVelTblX -> AAACalRegn02Rt00GroupA_Dummy.BmwPwrPrkgDampgHwVelTblX  # UB:Derived from original system description
    connect CalRegn02Rt00GroupA.BmwPwrPrkgDampgPinionAgSelnTbl -> AAACalRegn02Rt00GroupA_Dummy.BmwPwrPrkgDampgPinionAgSelnTbl  # UB:Derived from original system description
    connect CalRegn02Rt00GroupA.BmwPwrPrkgDampgVehSpdLnrSelnX -> AAACalRegn02Rt00GroupA_Dummy.BmwPwrPrkgDampgVehSpdLnrSelnX  # UB:Derived from original system description
    connect CalRegn02Rt00GroupA.BmwPwrPrkgDampgVehSpdScaFacY -> AAACalRegn02Rt00GroupA_Dummy.BmwPwrPrkgDampgVehSpdScaFacY  # UB:Derived from original system description
    connect CalRegn02Rt00GroupA.BmwPwrPrkgDampgBasPwrPrkgDampgY -> BmwPwrPrkgDampg.BmwPwrPrkgDampgBasPwrPrkgDampgY  # UB:Derived from original system description
    connect CalRegn02Rt00GroupA.BmwPwrPrkgDampgHwVelTblX -> BmwPwrPrkgDampg.BmwPwrPrkgDampgHwVelTblX  # UB:Derived from original system description
    connect CalRegn02Rt00GroupA.BmwPwrPrkgDampgPinionAgSelnTbl -> BmwPwrPrkgDampg.BmwPwrPrkgDampgPinionAgSelnTbl  # UB:Derived from original system description
    connect CalRegn02Rt00GroupA.BmwPwrPrkgDampgVehSpdLnrSelnX -> BmwPwrPrkgDampg.BmwPwrPrkgDampgVehSpdLnrSelnX  # UB:Derived from original system description
    connect CalRegn02Rt00GroupA.BmwPwrPrkgDampgVehSpdScaFacY -> BmwPwrPrkgDampg.BmwPwrPrkgDampgVehSpdScaFacY  # UB:Derived from original system description
    connect CalRegn02Rt01GroupA.BmwPwrPrkgDampgBasPwrPrkgDampgY -> AAACalRegn02Rt01GroupA_Dummy.BmwPwrPrkgDampgBasPwrPrkgDampgY  # UB:Derived from original system description
    connect CalRegn02Rt01GroupA.BmwPwrPrkgDampgHwVelTblX -> AAACalRegn02Rt01GroupA_Dummy.BmwPwrPrkgDampgHwVelTblX  # UB:Derived from original system description
    connect CalRegn02Rt01GroupA.BmwPwrPrkgDampgPinionAgSelnTbl -> AAACalRegn02Rt01GroupA_Dummy.BmwPwrPrkgDampgPinionAgSelnTbl  # UB:Derived from original system description
    connect CalRegn02Rt01GroupA.BmwPwrPrkgDampgVehSpdLnrSelnX -> AAACalRegn02Rt01GroupA_Dummy.BmwPwrPrkgDampgVehSpdLnrSelnX  # UB:Derived from original system description
    connect CalRegn02Rt01GroupA.BmwPwrPrkgDampgVehSpdScaFacY -> AAACalRegn02Rt01GroupA_Dummy.BmwPwrPrkgDampgVehSpdScaFacY  # UB:Derived from original system description
    connect CalRegn02Rt02GroupA.BmwPwrPrkgDampgBasPwrPrkgDampgY -> AAACalRegn02Rt02GroupA_Dummy.BmwPwrPrkgDampgBasPwrPrkgDampgY  # UB:Derived from original system description
    connect CalRegn02Rt02GroupA.BmwPwrPrkgDampgHwVelTblX -> AAACalRegn02Rt02GroupA_Dummy.BmwPwrPrkgDampgHwVelTblX  # UB:Derived from original system description
    connect CalRegn02Rt02GroupA.BmwPwrPrkgDampgPinionAgSelnTbl -> AAACalRegn02Rt02GroupA_Dummy.BmwPwrPrkgDampgPinionAgSelnTbl  # UB:Derived from original system description
    connect CalRegn02Rt02GroupA.BmwPwrPrkgDampgVehSpdLnrSelnX -> AAACalRegn02Rt02GroupA_Dummy.BmwPwrPrkgDampgVehSpdLnrSelnX  # UB:Derived from original system description
    connect CalRegn02Rt02GroupA.BmwPwrPrkgDampgVehSpdScaFacY -> AAACalRegn02Rt02GroupA_Dummy.BmwPwrPrkgDampgVehSpdScaFacY  # UB:Derived from original system description
    connect CalRegn02Rt03GroupA.BmwPwrPrkgDampgBasPwrPrkgDampgY -> AAACalRegn02Rt03GroupA_Dummy.BmwPwrPrkgDampgBasPwrPrkgDampgY  # UB:Derived from original system description
    connect CalRegn02Rt03GroupA.BmwPwrPrkgDampgHwVelTblX -> AAACalRegn02Rt03GroupA_Dummy.BmwPwrPrkgDampgHwVelTblX  # UB:Derived from original system description
    connect CalRegn02Rt03GroupA.BmwPwrPrkgDampgPinionAgSelnTbl -> AAACalRegn02Rt03GroupA_Dummy.BmwPwrPrkgDampgPinionAgSelnTbl  # UB:Derived from original system description
    connect CalRegn02Rt03GroupA.BmwPwrPrkgDampgVehSpdLnrSelnX -> AAACalRegn02Rt03GroupA_Dummy.BmwPwrPrkgDampgVehSpdLnrSelnX  # UB:Derived from original system description
    connect CalRegn02Rt03GroupA.BmwPwrPrkgDampgVehSpdScaFacY -> AAACalRegn02Rt03GroupA_Dummy.BmwPwrPrkgDampgVehSpdScaFacY  # UB:Derived from original system description
    connect CDD_MotVel.MotVelCrf -> InertiaCmpVel.MotVelCrf  # UB:Derived from original system description
    connect CDD_NxtrTi.GetRefTmr100MicroSec32bit -> PullCmpActv.GetRefTmr100MicroSec32bit  # UB:Derived from original system description
    connect CDD_NxtrTi.GetTiSpan100MicroSec32bit -> PullCmpActv.GetTiSpan100MicroSec32bit  # UB:Derived from original system description
    connect ClsdLoopDampg.HwTqCmdDampg -> BmwPwrPrkgDampg.DampgCmdBas  # UB:Derived from original system description
    connect CmnMfgSrv.PullCmpLrngDi -> PullCmpActv.PullCmpLrngDi  # UB:Derived from original system description
    connect FltInj.FltInj_f32 -> InertiaCmpVel.FltInj_f32  # UB:Derived from original system description
    connect FltInj.FltInj_f32 -> PullCmpActv.FltInj_f32  # UB:Derived from original system description
    connect HwTqArbn.HwTq -> InertiaCmpVel.HwTq  # UB:Derived from original system description
    connect HwTqArbn.HwTq -> PullCmpActv.HwTq  # UB:Derived from original system description
    connect LimrCdng.SysMotTqCmdScaCdnd -> BmwSplyCurrLim.SysMotTqCmdSca  # UB:Derived from original system description
    connect MotTqTranlDampg.MotTqCmdCrfDampd -> SysFricLrng.MotTqCmdCrf  # UB:Derived from original system description
    connect PullCmpActv.PullCmpCmd -> BmwMotTqOvrlArbn.PullCmpCmd  # UB:Derived from original system description
    connect PullCmpActv.GetPullCmpPrm -> CmnMfgSrv.GetPullCmpPrm  # UB:Derived from original system description
    connect PullCmpActv.RstPullCmp -> CmnMfgSrv.RstPullCmp  # UB:Derived from original system description
    connect PullCmpActv.SetPullCmpLongTerm -> CmnMfgSrv.SetPullCmpLongTerm  # UB:Derived from original system description
    connect PullCmpActv.SetPullCmpShoTerm -> CmnMfgSrv.SetPullCmpShoTerm  # UB:Derived from original system description
    connect SysFricLrng.SysFricOffs -> ClsdLoopHys.SysFricOffs  # UB:Derived from original system description
    connect SysKineAndEff.HwVel -> BmwPwrPrkgDampg.HwVel  # UB:Derived from original system description
    connect SysKineAndEff.HwVel -> PullCmpActv.HwVel  # UB:Derived from original system description
    connect VehSigCdng.VehLgtA -> InertiaCmpVel.VehLgtA  # UB:Derived from original system description
    connect VehSigCdng.VehLgtA -> PullCmpActv.VehLatA  # UB:Derived from original system description
    connect NvMProxy.PSProxy_Rte_NvmBlock_PullCmpActv_PullCmpLongTerm -> PullCmpActv.PullCmpLongTerm
    connect CalRegn01Cmn.CmnMfgSrvSecuAcsAtmptTiOut -> CmnMfgSrv.CmnMfgSrvSecuAcsAtmptTiOut  # UB:Derived from original system description
    connect CalRegn01Cmn.CmnMfgSrvSecuAcsMaxNrAtmpt -> CmnMfgSrv.CmnMfgSrvSecuAcsMaxNrAtmpt  # UB:Derived from original system description
    connect BmwSwFctDi.HaptcFbEna -> BmwHaptcFb.HaptcFbEna  # UB:Derived from original system description
    connect BmwSwFctDi.HwTqOvrlCmdEna -> BmwHwTqOvrlArbn.HwTqOvrlCmdEna  # UB:Derived from original system description
    connect BmwSwFctDi.DampgCmdPwrPrkgEna -> BmwPwrPrkgDampg.DampgCmdPwrPrkgEna  # UB:Derived from original system description
    connect BmwSwFctDi.MaxCurrAtHiSpd -> BmwSplyCurrLim.MaxCurrAtHiSpd  # UB:Derived from original system description
    connect BmwSwFctDi.MaxCurrAtLoSpd -> BmwSplyCurrLim.MaxCurrAtLoSpd  # UB:Derived from original system description
    connect BmwSwFctDi.BmwOutpTqOvrlCmdEna -> BmwTqOvrlCdngAndDrvgDynFac.BmwOutpTqOvrlCmdEna  # UB:Derived from original system description
    connect BmwSwFctDi.DrvgDynFacEna -> BmwTqOvrlCdngAndDrvgDynFac.DrvgDynFacEna  # UB:Derived from original system description
    connect BmwSwFctDi.TrfcJamAssiCmdEna -> BmwTrfcJamAssiDampg.TrfcJamAssiCmdEna  # UB:Derived from original system description
    connect BmwSwFctDi.TunSetHndlrEna -> BmwTunSetHndlr.TunSetHndlrEna  # UB:Derived from original system description
    connect BmwSwFctDi.FricLrngCustEna -> SysFricLrng.FricLrngCustEna  # UB:Derived from original system description
    connect CalRegn01CmnGroupA.BmwSwFctDiBmwActvRtnOvrd -> BmwSwFctDi.BmwSwFctDiBmwActvRtnOvrd  # UB:Derived from original system description
    connect CalRegn01CmnGroupA.BmwSwFctDiBmwEngStrtStopOvrd -> BmwSwFctDi.BmwSwFctDiBmwEngStrtStopOvrd  # UB:Derived from original system description
    connect CalRegn01CmnGroupA.BmwSwFctDiBmwEpsOscnOvrd -> BmwSwFctDi.BmwSwFctDiBmwEpsOscnOvrd  # UB:Derived from original system description
    connect CalRegn01CmnGroupA.BmwSwFctDiBmwFricCmpOvrd -> BmwSwFctDi.BmwSwFctDiBmwFricCmpOvrd  # UB:Derived from original system description
    connect CalRegn01CmnGroupA.BmwSwFctDiBmwGearInertiaCmpOvrd -> BmwSwFctDi.BmwSwFctDiBmwGearInertiaCmpOvrd  # UB:Derived from original system description
    connect CalRegn01CmnGroupA.BmwSwFctDiBmwHwInertiaCmpOvrd -> BmwSwFctDi.BmwSwFctDiBmwHwInertiaCmpOvrd  # UB:Derived from original system description
    connect CalRegn01CmnGroupA.BmwSwFctDiBmwHysActvInflOvrd -> BmwSwFctDi.BmwSwFctDiBmwHysActvInflOvrd  # UB:Derived from original system description
    connect CalRegn01CmnGroupA.BmwSwFctDiBmwIfNegDampgOvrd -> BmwSwFctDi.BmwSwFctDiBmwIfNegDampgOvrd  # UB:Derived from original system description
    connect CalRegn01CmnGroupA.BmwSwFctDiBmwIfNegFacOvrd -> BmwSwFctDi.BmwSwFctDiBmwIfNegFacOvrd  # UB:Derived from original system description
    connect CalRegn01CmnGroupA.BmwSwFctDiBmwIfNegHwTqOvrd -> BmwSwFctDi.BmwSwFctDiBmwIfNegHwTqOvrd  # UB:Derived from original system description
    connect CalRegn01CmnGroupA.BmwSwFctDiBmwIfNegMotTqOvrd -> BmwSwFctDi.BmwSwFctDiBmwIfNegMotTqOvrd  # UB:Derived from original system description
    connect CalRegn01CmnGroupA.BmwSwFctDiBmwLrnSwtOvrd -> BmwSwFctDi.BmwSwFctDiBmwLrnSwtOvrd  # UB:Derived from original system description
    connect CalRegn01CmnGroupA.BmwSwFctDiBmwPrkgPwrDampgOvrd -> BmwSwFctDi.BmwSwFctDiBmwPrkgPwrDampgOvrd  # UB:Derived from original system description
    connect CalRegn01CmnGroupA.BmwSwFctDiBmwPullCmpOvrd -> BmwSwFctDi.BmwSwFctDiBmwPullCmpOvrd  # UB:Derived from original system description
    connect CalRegn01CmnGroupA.BmwSwFctDiCodingOvrd -> BmwSwFctDi.BmwSwFctDiCodingOvrd  # UB:Derived from original system description
    connect CalRegn01CmnGroupA.BmwSwFctDiMaxCurrAtHiSpdOvrd -> BmwSwFctDi.BmwSwFctDiMaxCurrAtHiSpdOvrd  # UB:Derived from original system description
    connect CalRegn01CmnGroupA.BmwSwFctDiMaxCurrAtLoSpdOvrd -> BmwSwFctDi.BmwSwFctDiMaxCurrAtLoSpdOvrd  # UB:Derived from original system description
    connect CalRegn01Inin00.BmwHwAgArbnAndEotPosnKineIntegrityDiagcMaxRackLim -> AAACalRegn01Inin00_Dummy.BmwHwAgArbnAndEotPosnKineIntegrityDiagcMaxRackLim  # UB:Derived from original system description
    connect CalRegn01Inin00.EffortScaBlndX -> AAACalRegn01Inin00_Dummy.EffortScaBlndX  # UB:Derived from original system description
    connect CalRegn01Inin00.EffortScaBlndY -> AAACalRegn01Inin00_Dummy.EffortScaBlndY  # UB:Derived from original system description
    connect CalRegn01Inin00.EffortScaRackFThd -> AAACalRegn01Inin00_Dummy.EffortScaRackFThd  # UB:Derived from original system description
    connect CalRegn01Inin00.PosnTrakgServoArbnFltMtgtnLpFilCutOffFrq -> AAACalRegn01Inin00_Dummy.PosnTrakgServoArbnFltMtgtnLpFilCutOffFrq  # UB:Derived from original system description
    connect CalRegn01Inin00.PullCmpActvHwTqFilFrqLrngEna -> AAACalRegn01Inin00_Dummy.PullCmpActvHwTqFilFrqLrngEna  # UB:Derived from original system description
    connect CalRegn01Inin00.PullCmpActvYawRateFilFrq -> AAACalRegn01Inin00_Dummy.PullCmpActvYawRateFilFrq  # UB:Derived from original system description
    connect CalRegn01Inin00.SysFricLrngAvrgFricFrq -> AAACalRegn01Inin00_Dummy.SysFricLrngAvrgFricFrq  # UB:Derived from original system description
    connect CalRegn01Inin00.SysFricLrngBasLineEolFric -> AAACalRegn01Inin00_Dummy.SysFricLrngBasLineEolFric  # UB:Derived from original system description
    connect CalRegn01Inin00.SysFricLrngBasLineFric -> AAACalRegn01Inin00_Dummy.SysFricLrngBasLineFric  # UB:Derived from original system description
    connect CalRegn01Inin00.SysFricLrngBasLineHys -> AAACalRegn01Inin00_Dummy.SysFricLrngBasLineHys  # UB:Derived from original system description
    connect CalRegn01Inin00.SysFricLrngBasLineRngCntr -> AAACalRegn01Inin00_Dummy.SysFricLrngBasLineRngCntr  # UB:Derived from original system description
    connect CalRegn01Inin00.SysFricLrngDataPrepLpFilFrq -> AAACalRegn01Inin00_Dummy.SysFricLrngDataPrepLpFilFrq  # UB:Derived from original system description
    connect CalRegn01Inin00.SysFricLrngDebStep -> AAACalRegn01Inin00_Dummy.SysFricLrngDebStep  # UB:Derived from original system description
    connect CalRegn01Inin00.SysFricLrngEolFricDifHiLim -> AAACalRegn01Inin00_Dummy.SysFricLrngEolFricDifHiLim  # UB:Derived from original system description
    connect CalRegn01Inin00.SysFricLrngEolFricDifLoLim -> AAACalRegn01Inin00_Dummy.SysFricLrngEolFricDifLoLim  # UB:Derived from original system description
    connect CalRegn01Inin00.SysFricLrngEolFricDifScagFac -> AAACalRegn01Inin00_Dummy.SysFricLrngEolFricDifScagFac  # UB:Derived from original system description
    connect CalRegn01Inin00.SysFricLrngFricChgWght -> AAACalRegn01Inin00_Dummy.SysFricLrngFricChgWght  # UB:Derived from original system description
    connect CalRegn01Inin00.SysFricLrngFricDiagcThd -> AAACalRegn01Inin00_Dummy.SysFricLrngFricDiagcThd  # UB:Derived from original system description
    connect CalRegn01Inin00.SysFricLrngFricHysHwAgPt -> AAACalRegn01Inin00_Dummy.SysFricLrngFricHysHwAgPt  # UB:Derived from original system description
    connect CalRegn01Inin00.SysFricLrngFricOffs -> AAACalRegn01Inin00_Dummy.SysFricLrngFricOffs  # UB:Derived from original system description
    connect CalRegn01Inin00.SysFricLrngFricOffsHiLim -> AAACalRegn01Inin00_Dummy.SysFricLrngFricOffsHiLim  # UB:Derived from original system description
    connect CalRegn01Inin00.SysFricLrngFricOffsLoLim -> AAACalRegn01Inin00_Dummy.SysFricLrngFricOffsLoLim  # UB:Derived from original system description
    connect CalRegn01Inin00.SysFricLrngFricOffsLpFilFrq -> AAACalRegn01Inin00_Dummy.SysFricLrngFricOffsLpFilFrq  # UB:Derived from original system description
    connect CalRegn01Inin00.SysFricLrngGain -> AAACalRegn01Inin00_Dummy.SysFricLrngGain  # UB:Derived from original system description
    connect CalRegn01Inin00.SysFricLrngHiFricDebStep -> AAACalRegn01Inin00_Dummy.SysFricLrngHiFricDebStep  # UB:Derived from original system description
    connect CalRegn01Inin00.SysFricLrngHiFricDiagcThd -> AAACalRegn01Inin00_Dummy.SysFricLrngHiFricDiagcThd  # UB:Derived from original system description
    connect CalRegn01Inin00.SysFricLrngHwPosnAuthyThd -> AAACalRegn01Inin00_Dummy.SysFricLrngHwPosnAuthyThd  # UB:Derived from original system description
    connect CalRegn01Inin00.SysFricLrngHwVelConstrLim -> AAACalRegn01Inin00_Dummy.SysFricLrngHwVelConstrLim  # UB:Derived from original system description
    connect CalRegn01Inin00.SysFricLrngHwVelHiLim -> AAACalRegn01Inin00_Dummy.SysFricLrngHwVelHiLim  # UB:Derived from original system description
    connect CalRegn01Inin00.SysFricLrngHwVelLoLim -> AAACalRegn01Inin00_Dummy.SysFricLrngHwVelLoLim  # UB:Derived from original system description
    connect CalRegn01Inin00.SysFricLrngIgnCycFricChgLim -> AAACalRegn01Inin00_Dummy.SysFricLrngIgnCycFricChgLim  # UB:Derived from original system description
    connect CalRegn01Inin00.SysFricLrngIgnCycFricOffs -> AAACalRegn01Inin00_Dummy.SysFricLrngIgnCycFricOffs  # UB:Derived from original system description
    connect CalRegn01Inin00.SysFricLrngIvsTrsmRatX -> AAACalRegn01Inin00_Dummy.SysFricLrngIvsTrsmRatX  # UB:Derived from original system description
    connect CalRegn01Inin00.SysFricLrngIvsTrsmRatY -> AAACalRegn01Inin00_Dummy.SysFricLrngIvsTrsmRatY  # UB:Derived from original system description
    connect CalRegn01Inin00.SysFricLrngLatAHiLim -> AAACalRegn01Inin00_Dummy.SysFricLrngLatAHiLim  # UB:Derived from original system description
    connect CalRegn01Inin00.SysFricLrngLatALoLim -> AAACalRegn01Inin00_Dummy.SysFricLrngLatALoLim  # UB:Derived from original system description
    connect CalRegn01Inin00.SysFricLrngMaskVehSpd -> AAACalRegn01Inin00_Dummy.SysFricLrngMaskVehSpd  # UB:Derived from original system description
    connect CalRegn01Inin00.SysFricLrngRngCntrThd -> AAACalRegn01Inin00_Dummy.SysFricLrngRngCntrThd  # UB:Derived from original system description
    connect CalRegn01Inin00.SysFricLrngThd -> AAACalRegn01Inin00_Dummy.SysFricLrngThd  # UB:Derived from original system description
    connect CalRegn01Inin00.SysFricLrngTHiLim -> AAACalRegn01Inin00_Dummy.SysFricLrngTHiLim  # UB:Derived from original system description
    connect CalRegn01Inin00.SysFricLrngTLoLim -> AAACalRegn01Inin00_Dummy.SysFricLrngTLoLim  # UB:Derived from original system description
    connect CalRegn01Inin00.SysFricLrngVehSpd -> AAACalRegn01Inin00_Dummy.SysFricLrngVehSpd  # UB:Derived from original system description
    connect CalRegn01Inin00.SysGlbPrmSysKineRat -> AAACalRegn01Inin00_Dummy.SysGlbPrmSysKineRat  # UB:Derived from original system description
    connect CalRegn01Inin00.SysGlbPrmVehSpdBilnrSeln -> AAACalRegn01Inin00_Dummy.SysGlbPrmVehSpdBilnrSeln  # UB:Derived from original system description
    connect CalRegn01Inin00.SysKineAndEffMotAgToRackPosRatScaY -> AAACalRegn01Inin00_Dummy.SysKineAndEffMotAgToRackPosRatScaY  # UB:Derived from original system description
    connect CalRegn01Inin00.SysKineAndEffPinionAgToRackPosRatScaY -> AAACalRegn01Inin00_Dummy.SysKineAndEffPinionAgToRackPosRatScaY  # UB:Derived from original system description
    connect CalRegn01Inin00.SysKineAndEffPinionToRackEffScaY -> AAACalRegn01Inin00_Dummy.SysKineAndEffPinionToRackEffScaY  # UB:Derived from original system description
    connect CalRegn01Inin00.SysKineAndEffRoadWhlFromRackPosScaY -> AAACalRegn01Inin00_Dummy.SysKineAndEffRoadWhlFromRackPosScaY  # UB:Derived from original system description
    connect CalRegn01Inin00.SysKineAndEffSteerArmLenFromRackPosScaY -> AAACalRegn01Inin00_Dummy.SysKineAndEffSteerArmLenFromRackPosScaY  # UB:Derived from original system description
    connect CalRegn01Inin00.TunSelnAuthyVehSpdX -> AAACalRegn01Inin00_Dummy.TunSelnAuthyVehSpdX  # UB:Derived from original system description
    connect CalRegn01Inin00.SysGlbPrmVehSpdBilnrSeln -> BmwHaptcFb.SysGlbPrmVehSpdBilnrSeln  # UB:Derived from original system description
    connect CalRegn01Inin00.BmwHwAgArbnAndEotPosnKineIntegrityDiagcMaxRackLim -> BmwHwAgArbnAndEotPosn.BmwHwAgArbnAndEotPosnKineIntegrityDiagcMaxRackLim  # UB:Derived from original system description
    connect CalRegn01Inin00.SysGlbPrmSysKineRat -> BmwHwAgArbnAndEotPosn.SysGlbPrmSysKineRat  # UB:Derived from original system description
    connect CalRegn01Inin00.SysGlbPrmVehSpdBilnrSeln -> BmwTqOvrlCdngAndDrvgDynFac.SysGlbPrmVehSpdBilnrSeln  # UB:Derived from original system description
    connect CalRegn01Inin00.SysGlbPrmVehSpdBilnrSeln -> BmwTrfcJamAssiDampg.SysGlbPrmVehSpdBilnrSeln  # UB:Derived from original system description
    connect CalRegn01Inin00.SysGlbPrmSysKineRat -> CDD_MotAgCmp.SysGlbPrmSysKineRat  # UB:Derived from original system description
    connect CalRegn01Inin00.SysGlbPrmVehSpdBilnrSeln -> ClsdLoopDampg.SysGlbPrmVehSpdBilnrSeln  # UB:Derived from original system description
    connect CalRegn01Inin00.SysGlbPrmVehSpdBilnrSeln -> ClsdLoopHys.SysGlbPrmVehSpdBilnrSeln  # UB:Derived from original system description
    connect CalRegn01Inin00.EffortScaBlndX -> Effort.EffortScaBlndX  # UB:Derived from original system description
    connect CalRegn01Inin00.EffortScaBlndY -> Effort.EffortScaBlndY  # UB:Derived from original system description
    connect CalRegn01Inin00.EffortScaRackFThd -> Effort.EffortScaRackFThd  # UB:Derived from original system description
    connect CalRegn01Inin00.SysGlbPrmVehSpdBilnrSeln -> FalbckAssi.SysGlbPrmVehSpdBilnrSeln  # UB:Derived from original system description
    connect CalRegn01Inin00.SysGlbPrmSysKineRat -> InertiaCmpVel.SysGlbPrmSysKineRat  # UB:Derived from original system description
    connect CalRegn01Inin00.SysGlbPrmVehSpdBilnrSeln -> InertiaCmpVel.SysGlbPrmVehSpdBilnrSeln  # UB:Derived from original system description
    connect CalRegn01Inin00.SysGlbPrmSysKineRat -> LrndRackCentr.SysGlbPrmSysKineRat  # UB:Derived from original system description
    connect CalRegn01Inin00.SysGlbPrmSysKineRat -> LrnPinionCentr.SysGlbPrmSysKineRat  # UB:Derived from original system description
    connect CalRegn01Inin00.PosnTrakgServoArbnFltMtgtnLpFilCutOffFrq -> PosnTrakgServo.PosnTrakgServoArbnFltMtgtnLpFilCutOffFrq  # UB:Derived from original system description
    connect CalRegn01Inin00.SysGlbPrmSysKineRat -> PosnTrakgServo.SysGlbPrmSysKineRat  # UB:Derived from original system description
    connect CalRegn01Inin00.PullCmpActvHwTqFilFrqLrngEna -> PullCmpActv.PullCmpActvHwTqFilFrqLrngEna  # UB:Derived from original system description
    connect CalRegn01Inin00.PullCmpActvYawRateFilFrq -> PullCmpActv.PullCmpActvYawRateFilFrq  # UB:Derived from original system description
    connect CalRegn01Inin00.SysFricLrngAvrgFricFrq -> SysFricLrng.SysFricLrngAvrgFricFrq  # UB:Derived from original system description
    connect CalRegn01Inin00.SysFricLrngBasLineEolFric -> SysFricLrng.SysFricLrngBasLineEolFric  # UB:Derived from original system description
    connect CalRegn01Inin00.SysFricLrngBasLineFric -> SysFricLrng.SysFricLrngBasLineFric  # UB:Derived from original system description
    connect CalRegn01Inin00.SysFricLrngBasLineHys -> SysFricLrng.SysFricLrngBasLineHys  # UB:Derived from original system description
    connect CalRegn01Inin00.SysFricLrngBasLineRngCntr -> SysFricLrng.SysFricLrngBasLineRngCntr  # UB:Derived from original system description
    connect CalRegn01Inin00.SysFricLrngDataPrepLpFilFrq -> SysFricLrng.SysFricLrngDataPrepLpFilFrq  # UB:Derived from original system description
    connect CalRegn01Inin00.SysFricLrngDebStep -> SysFricLrng.SysFricLrngDebStep  # UB:Derived from original system description
    connect CalRegn01Inin00.SysFricLrngEolFricDifHiLim -> SysFricLrng.SysFricLrngEolFricDifHiLim  # UB:Derived from original system description
    connect CalRegn01Inin00.SysFricLrngEolFricDifLoLim -> SysFricLrng.SysFricLrngEolFricDifLoLim  # UB:Derived from original system description
    connect CalRegn01Inin00.SysFricLrngEolFricDifScagFac -> SysFricLrng.SysFricLrngEolFricDifScagFac  # UB:Derived from original system description
    connect CalRegn01Inin00.SysFricLrngFricChgWght -> SysFricLrng.SysFricLrngFricChgWght  # UB:Derived from original system description
    connect CalRegn01Inin00.SysFricLrngFricDiagcThd -> SysFricLrng.SysFricLrngFricDiagcThd  # UB:Derived from original system description
    connect CalRegn01Inin00.SysFricLrngFricHysHwAgPt -> SysFricLrng.SysFricLrngFricHysHwAgPt  # UB:Derived from original system description
    connect CalRegn01Inin00.SysFricLrngFricOffs -> SysFricLrng.SysFricLrngFricOffs  # UB:Derived from original system description
    connect CalRegn01Inin00.SysFricLrngFricOffsHiLim -> SysFricLrng.SysFricLrngFricOffsHiLim  # UB:Derived from original system description
    connect CalRegn01Inin00.SysFricLrngFricOffsLoLim -> SysFricLrng.SysFricLrngFricOffsLoLim  # UB:Derived from original system description
    connect CalRegn01Inin00.SysFricLrngFricOffsLpFilFrq -> SysFricLrng.SysFricLrngFricOffsLpFilFrq  # UB:Derived from original system description
    connect CalRegn01Inin00.SysFricLrngGain -> SysFricLrng.SysFricLrngGain  # UB:Derived from original system description
    connect CalRegn01Inin00.SysFricLrngHiFricDebStep -> SysFricLrng.SysFricLrngHiFricDebStep  # UB:Derived from original system description
    connect CalRegn01Inin00.SysFricLrngHiFricDiagcThd -> SysFricLrng.SysFricLrngHiFricDiagcThd  # UB:Derived from original system description
    connect CalRegn01Inin00.SysFricLrngHwPosnAuthyThd -> SysFricLrng.SysFricLrngHwPosnAuthyThd  # UB:Derived from original system description
    connect CalRegn01Inin00.SysFricLrngHwVelConstrLim -> SysFricLrng.SysFricLrngHwVelConstrLim  # UB:Derived from original system description
    connect CalRegn01Inin00.SysFricLrngHwVelHiLim -> SysFricLrng.SysFricLrngHwVelHiLim  # UB:Derived from original system description
    connect CalRegn01Inin00.SysFricLrngHwVelLoLim -> SysFricLrng.SysFricLrngHwVelLoLim  # UB:Derived from original system description
    connect CalRegn01Inin00.SysFricLrngIgnCycFricChgLim -> SysFricLrng.SysFricLrngIgnCycFricChgLim  # UB:Derived from original system description
    connect CalRegn01Inin00.SysFricLrngIgnCycFricOffs -> SysFricLrng.SysFricLrngIgnCycFricOffs  # UB:Derived from original system description
    connect CalRegn01Inin00.SysFricLrngIvsTrsmRatX -> SysFricLrng.SysFricLrngIvsTrsmRatX  # UB:Derived from original system description
    connect CalRegn01Inin00.SysFricLrngIvsTrsmRatY -> SysFricLrng.SysFricLrngIvsTrsmRatY  # UB:Derived from original system description
    connect CalRegn01Inin00.SysFricLrngLatAHiLim -> SysFricLrng.SysFricLrngLatAHiLim  # UB:Derived from original system description
    connect CalRegn01Inin00.SysFricLrngLatALoLim -> SysFricLrng.SysFricLrngLatALoLim  # UB:Derived from original system description
    connect CalRegn01Inin00.SysFricLrngMaskVehSpd -> SysFricLrng.SysFricLrngMaskVehSpd  # UB:Derived from original system description
    connect CalRegn01Inin00.SysFricLrngRngCntrThd -> SysFricLrng.SysFricLrngRngCntrThd  # UB:Derived from original system description
    connect CalRegn01Inin00.SysFricLrngThd -> SysFricLrng.SysFricLrngThd  # UB:Derived from original system description
    connect CalRegn01Inin00.SysFricLrngTHiLim -> SysFricLrng.SysFricLrngTHiLim  # UB:Derived from original system description
    connect CalRegn01Inin00.SysFricLrngTLoLim -> SysFricLrng.SysFricLrngTLoLim  # UB:Derived from original system description
    connect CalRegn01Inin00.SysFricLrngVehSpd -> SysFricLrng.SysFricLrngVehSpd  # UB:Derived from original system description
    connect CalRegn01Inin00.SysKineAndEffMotAgToRackPosRatScaY -> SysKineAndEff.SysKineAndEffMotAgToRackPosRatScaY  # UB:Derived from original system description
    connect CalRegn01Inin00.SysKineAndEffPinionAgToRackPosRatScaY -> SysKineAndEff.SysKineAndEffPinionAgToRackPosRatScaY  # UB:Derived from original system description
    connect CalRegn01Inin00.SysKineAndEffPinionToRackEffScaY -> SysKineAndEff.SysKineAndEffPinionToRackEffScaY  # UB:Derived from original system description
    connect CalRegn01Inin00.SysKineAndEffRoadWhlFromRackPosScaY -> SysKineAndEff.SysKineAndEffRoadWhlFromRackPosScaY  # UB:Derived from original system description
    connect CalRegn01Inin00.SysKineAndEffSteerArmLenFromRackPosScaY -> SysKineAndEff.SysKineAndEffSteerArmLenFromRackPosScaY  # UB:Derived from original system description
    connect CalRegn01Inin00.TunSelnAuthyVehSpdX -> TunSelnAuthy.TunSelnAuthyVehSpdX  # UB:Derived from original system description
    connect CalRegn01Inin00GroupA.BmwHwAgArbnAndEotPosnEotCcwMax -> AAACalRegn01Inin00GroupA_Dummy.BmwHwAgArbnAndEotPosnEotCcwMax  # UB:Derived from original system description
    connect CalRegn01Inin00GroupA.BmwHwAgArbnAndEotPosnEotCcwMin -> AAACalRegn01Inin00GroupA_Dummy.BmwHwAgArbnAndEotPosnEotCcwMin  # UB:Derived from original system description
    connect CalRegn01Inin00GroupA.BmwHwAgArbnAndEotPosnEotCwMax -> AAACalRegn01Inin00GroupA_Dummy.BmwHwAgArbnAndEotPosnEotCwMax  # UB:Derived from original system description
    connect CalRegn01Inin00GroupA.BmwHwAgArbnAndEotPosnEotCwMin -> AAACalRegn01Inin00GroupA_Dummy.BmwHwAgArbnAndEotPosnEotCwMin  # UB:Derived from original system description
    connect CalRegn01Inin00GroupA.BmwPwrPrkgDampgDiScadDampg -> AAACalRegn01Inin00GroupA_Dummy.BmwPwrPrkgDampgDiScadDampg  # UB:Derived from original system description
    connect CalRegn01Inin00GroupA.BmwPwrPrkgDampgMaxRate -> AAACalRegn01Inin00GroupA_Dummy.BmwPwrPrkgDampgMaxRate  # UB:Derived from original system description
    connect CalRegn01Inin00GroupA.EpsStEstimnMtrxA -> AAACalRegn01Inin00GroupA_Dummy.EpsStEstimnMtrxA  # UB:Derived from original system description
    connect CalRegn01Inin00GroupA.EpsStEstimnMtrxB -> AAACalRegn01Inin00GroupA_Dummy.EpsStEstimnMtrxB  # UB:Derived from original system description
    connect CalRegn01Inin00GroupA.EpsStEstimnMtrxC -> AAACalRegn01Inin00GroupA_Dummy.EpsStEstimnMtrxC  # UB:Derived from original system description
    connect CalRegn01Inin00GroupA.EpsStEstimnMtrxD -> AAACalRegn01Inin00GroupA_Dummy.EpsStEstimnMtrxD  # UB:Derived from original system description
    connect CalRegn01Inin00GroupA.HwTqTrakgCtrlFbGain{1..5} -> AAACalRegn01Inin00GroupA_Dummy.HwTqTrakgCtrlFbGain{1..5}  # UB:Derived from original system description
    connect CalRegn01Inin00GroupA.HwTqTrakgCtrlFfGainScaY -> AAACalRegn01Inin00GroupA_Dummy.HwTqTrakgCtrlFfGainScaY  # UB:Derived from original system description
    connect CalRegn01Inin00GroupA.HwTqTrakgCtrlVehSpdScaX -> AAACalRegn01Inin00GroupA_Dummy.HwTqTrakgCtrlVehSpdScaX  # UB:Derived from original system description
    connect CalRegn01Inin00GroupA.PosnTrakgServoEnaBlndFacTblX -> AAACalRegn01Inin00GroupA_Dummy.PosnTrakgServoEnaBlndFacTblX  # UB:Derived from original system description
    connect CalRegn01Inin00GroupA.PosnTrakgServoEnaBlndFacTblY -> AAACalRegn01Inin00GroupA_Dummy.PosnTrakgServoEnaBlndFacTblY  # UB:Derived from original system description
    connect CalRegn01Inin00GroupA.PosnTrakgServoGainArbnFltMtgtn -> AAACalRegn01Inin00GroupA_Dummy.PosnTrakgServoGainArbnFltMtgtn  # UB:Derived from original system description
    connect CalRegn01Inin00GroupA.PullCmpActvCmpLrnTiDecShoTerm -> AAACalRegn01Inin00GroupA_Dummy.PullCmpActvCmpLrnTiDecShoTerm  # UB:Derived from original system description
    connect CalRegn01Inin00GroupA.PullCmpActvCmpLrnTiIncShoTerm -> AAACalRegn01Inin00GroupA_Dummy.PullCmpActvCmpLrnTiIncShoTerm  # UB:Derived from original system description
    connect CalRegn01Inin00GroupA.PullCmpActvCmpLrnTiLongTerm -> AAACalRegn01Inin00GroupA_Dummy.PullCmpActvCmpLrnTiLongTerm  # UB:Derived from original system description
    connect CalRegn01Inin00GroupA.PullCmpActvCmpShoTermRstHwAgThd -> AAACalRegn01Inin00GroupA_Dummy.PullCmpActvCmpShoTermRstHwAgThd  # UB:Derived from original system description
    connect CalRegn01Inin00GroupA.PullCmpActvCmpShoTermRstHwTqThd -> AAACalRegn01Inin00GroupA_Dummy.PullCmpActvCmpShoTermRstHwTqThd  # UB:Derived from original system description
    connect CalRegn01Inin00GroupA.PullCmpActvCmpShoTermRstLatAThd -> AAACalRegn01Inin00GroupA_Dummy.PullCmpActvCmpShoTermRstLatAThd  # UB:Derived from original system description
    connect CalRegn01Inin00GroupA.PullCmpActvCmpShoTermRstYawRateThd -> AAACalRegn01Inin00GroupA_Dummy.PullCmpActvCmpShoTermRstYawRateThd  # UB:Derived from original system description
    connect CalRegn01Inin00GroupA.PullCmpActvEna -> AAACalRegn01Inin00GroupA_Dummy.PullCmpActvEna  # UB:Derived from original system description
    connect CalRegn01Inin00GroupA.PullCmpActvHwTqFilFrqLongTerm -> AAACalRegn01Inin00GroupA_Dummy.PullCmpActvHwTqFilFrqLongTerm  # UB:Derived from original system description
    connect CalRegn01Inin00GroupA.PullCmpActvHwTqFilFrqShoTerm -> AAACalRegn01Inin00GroupA_Dummy.PullCmpActvHwTqFilFrqShoTerm  # UB:Derived from original system description
    connect CalRegn01Inin00GroupA.PullCmpActvLongTermLim -> AAACalRegn01Inin00GroupA_Dummy.PullCmpActvLongTermLim  # UB:Derived from original system description
    connect CalRegn01Inin00GroupA.PullCmpActvLrngEnaAgConfMinMgn -> AAACalRegn01Inin00GroupA_Dummy.PullCmpActvLrngEnaAgConfMinMgn  # UB:Derived from original system description
    connect CalRegn01Inin00GroupA.PullCmpActvLrngEnaHwAgMaxMgn -> AAACalRegn01Inin00GroupA_Dummy.PullCmpActvLrngEnaHwAgMaxMgn  # UB:Derived from original system description
    connect CalRegn01Inin00GroupA.PullCmpActvLrngEnaHwTqMaxMgn -> AAACalRegn01Inin00GroupA_Dummy.PullCmpActvLrngEnaHwTqMaxMgn  # UB:Derived from original system description
    connect CalRegn01Inin00GroupA.PullCmpActvLrngEnaHwVelMaxMgn -> AAACalRegn01Inin00GroupA_Dummy.PullCmpActvLrngEnaHwVelMaxMgn  # UB:Derived from original system description
    connect CalRegn01Inin00GroupA.PullCmpActvLrngEnaLatAMaxMgn -> AAACalRegn01Inin00GroupA_Dummy.PullCmpActvLrngEnaLatAMaxMgn  # UB:Derived from original system description
    connect CalRegn01Inin00GroupA.PullCmpActvLrngEnaTiThd -> AAACalRegn01Inin00GroupA_Dummy.PullCmpActvLrngEnaTiThd  # UB:Derived from original system description
    connect CalRegn01Inin00GroupA.PullCmpActvLrngEnaVehSpdMaxMgn -> AAACalRegn01Inin00GroupA_Dummy.PullCmpActvLrngEnaVehSpdMaxMgn  # UB:Derived from original system description
    connect CalRegn01Inin00GroupA.PullCmpActvLrngEnaVehSpdMinMgn -> AAACalRegn01Inin00GroupA_Dummy.PullCmpActvLrngEnaVehSpdMinMgn  # UB:Derived from original system description
    connect CalRegn01Inin00GroupA.PullCmpActvLrngEnaVehSpdRateMaxMgn -> AAACalRegn01Inin00GroupA_Dummy.PullCmpActvLrngEnaVehSpdRateMaxMgn  # UB:Derived from original system description
    connect CalRegn01Inin00GroupA.PullCmpActvLrngEnaYawRateMaxMgn -> AAACalRegn01Inin00GroupA_Dummy.PullCmpActvLrngEnaYawRateMaxMgn  # UB:Derived from original system description
    connect CalRegn01Inin00GroupA.PullCmpActvOpstSignTiShoTerm -> AAACalRegn01Inin00GroupA_Dummy.PullCmpActvOpstSignTiShoTerm  # UB:Derived from original system description
    connect CalRegn01Inin00GroupA.PullCmpActvOutpMaxRate -> AAACalRegn01Inin00GroupA_Dummy.PullCmpActvOutpMaxRate  # UB:Derived from original system description
    connect CalRegn01Inin00GroupA.PullCmpActvPullCmpShoTermLim -> AAACalRegn01Inin00GroupA_Dummy.PullCmpActvPullCmpShoTermLim  # UB:Derived from original system description
    connect CalRegn01Inin00GroupA.PullCmpActvPullCmpTotLim -> AAACalRegn01Inin00GroupA_Dummy.PullCmpActvPullCmpTotLim  # UB:Derived from original system description
    connect CalRegn01Inin00GroupA.PullCmpActvPullErrLimLongTerm -> AAACalRegn01Inin00GroupA_Dummy.PullCmpActvPullErrLimLongTerm  # UB:Derived from original system description
    connect CalRegn01Inin00GroupA.PullCmpActvPullErrMgnThd -> AAACalRegn01Inin00GroupA_Dummy.PullCmpActvPullErrMgnThd  # UB:Derived from original system description
    connect CalRegn01Inin00GroupA.PullCmpActvPullErrShoTermLim -> AAACalRegn01Inin00GroupA_Dummy.PullCmpActvPullErrShoTermLim  # UB:Derived from original system description
    connect CalRegn01Inin00GroupA.PullCmpActvShoTermRampTi -> AAACalRegn01Inin00GroupA_Dummy.PullCmpActvShoTermRampTi  # UB:Derived from original system description
    connect CalRegn01Inin00GroupA.PullCmpActvVehSpdScaTblX -> AAACalRegn01Inin00GroupA_Dummy.PullCmpActvVehSpdScaTblX  # UB:Derived from original system description
    connect CalRegn01Inin00GroupA.PullCmpActvVehSpdScaTblY -> AAACalRegn01Inin00GroupA_Dummy.PullCmpActvVehSpdScaTblY  # UB:Derived from original system description
    connect CalRegn01Inin00GroupA.BmwHwAgArbnAndEotPosnEotCcwMax -> BmwHwAgArbnAndEotPosn.BmwHwAgArbnAndEotPosnEotCcwMax  # UB:Derived from original system description
    connect CalRegn01Inin00GroupA.BmwHwAgArbnAndEotPosnEotCcwMin -> BmwHwAgArbnAndEotPosn.BmwHwAgArbnAndEotPosnEotCcwMin  # UB:Derived from original system description
    connect CalRegn01Inin00GroupA.BmwHwAgArbnAndEotPosnEotCwMax -> BmwHwAgArbnAndEotPosn.BmwHwAgArbnAndEotPosnEotCwMax  # UB:Derived from original system description
    connect CalRegn01Inin00GroupA.BmwHwAgArbnAndEotPosnEotCwMin -> BmwHwAgArbnAndEotPosn.BmwHwAgArbnAndEotPosnEotCwMin  # UB:Derived from original system description
    connect CalRegn01Inin00GroupA.BmwPwrPrkgDampgDiScadDampg -> BmwPwrPrkgDampg.BmwPwrPrkgDampgDiScadDampg  # UB:Derived from original system description
    connect CalRegn01Inin00GroupA.BmwPwrPrkgDampgMaxRate -> BmwPwrPrkgDampg.BmwPwrPrkgDampgMaxRate  # UB:Derived from original system description
    connect CalRegn01Inin00GroupA.EpsStEstimnMtrxA -> EpsStEstimn.EpsStEstimnMtrxA  # UB:Derived from original system description
    connect CalRegn01Inin00GroupA.EpsStEstimnMtrxB -> EpsStEstimn.EpsStEstimnMtrxB  # UB:Derived from original system description
    connect CalRegn01Inin00GroupA.EpsStEstimnMtrxC -> EpsStEstimn.EpsStEstimnMtrxC  # UB:Derived from original system description
    connect CalRegn01Inin00GroupA.EpsStEstimnMtrxD -> EpsStEstimn.EpsStEstimnMtrxD  # UB:Derived from original system description
    connect CalRegn01Inin00GroupA.HwTqTrakgCtrlFbGain{1..5} -> HwTqTrakgCtrl.HwTqTrakgCtrlFbGain{1..5}  # UB:Derived from original system description
    connect CalRegn01Inin00GroupA.HwTqTrakgCtrlFfGainScaY -> HwTqTrakgCtrl.HwTqTrakgCtrlFfGainScaY  # UB:Derived from original system description
    connect CalRegn01Inin00GroupA.HwTqTrakgCtrlVehSpdScaX -> HwTqTrakgCtrl.HwTqTrakgCtrlVehSpdScaX  # UB:Derived from original system description
    connect CalRegn01Inin00GroupA.PosnTrakgServoEnaBlndFacTblX -> PosnTrakgServo.PosnTrakgServoEnaBlndFacTblX  # UB:Derived from original system description
    connect CalRegn01Inin00GroupA.PosnTrakgServoEnaBlndFacTblY -> PosnTrakgServo.PosnTrakgServoEnaBlndFacTblY  # UB:Derived from original system description
    connect CalRegn01Inin00GroupA.PosnTrakgServoGainArbnFltMtgtn -> PosnTrakgServo.PosnTrakgServoGainArbnFltMtgtn  # UB:Derived from original system description
    connect CalRegn01Inin00GroupA.PullCmpActvCmpLrnTiDecShoTerm -> PullCmpActv.PullCmpActvCmpLrnTiDecShoTerm  # UB:Derived from original system description
    connect CalRegn01Inin00GroupA.PullCmpActvCmpLrnTiIncShoTerm -> PullCmpActv.PullCmpActvCmpLrnTiIncShoTerm  # UB:Derived from original system description
    connect CalRegn01Inin00GroupA.PullCmpActvCmpLrnTiLongTerm -> PullCmpActv.PullCmpActvCmpLrnTiLongTerm  # UB:Derived from original system description
    connect CalRegn01Inin00GroupA.PullCmpActvCmpShoTermRstHwAgThd -> PullCmpActv.PullCmpActvCmpShoTermRstHwAgThd  # UB:Derived from original system description
    connect CalRegn01Inin00GroupA.PullCmpActvCmpShoTermRstHwTqThd -> PullCmpActv.PullCmpActvCmpShoTermRstHwTqThd  # UB:Derived from original system description
    connect CalRegn01Inin00GroupA.PullCmpActvCmpShoTermRstLatAThd -> PullCmpActv.PullCmpActvCmpShoTermRstLatAThd  # UB:Derived from original system description
    connect CalRegn01Inin00GroupA.PullCmpActvCmpShoTermRstYawRateThd -> PullCmpActv.PullCmpActvCmpShoTermRstYawRateThd  # UB:Derived from original system description
    connect CalRegn01Inin00GroupA.PullCmpActvEna -> PullCmpActv.PullCmpActvEna  # UB:Derived from original system description
    connect CalRegn01Inin00GroupA.PullCmpActvHwTqFilFrqLongTerm -> PullCmpActv.PullCmpActvHwTqFilFrqLongTerm  # UB:Derived from original system description
    connect CalRegn01Inin00GroupA.PullCmpActvHwTqFilFrqShoTerm -> PullCmpActv.PullCmpActvHwTqFilFrqShoTerm  # UB:Derived from original system description
    connect CalRegn01Inin00GroupA.PullCmpActvLongTermLim -> PullCmpActv.PullCmpActvLongTermLim  # UB:Derived from original system description
    connect CalRegn01Inin00GroupA.PullCmpActvLrngEnaAgConfMinMgn -> PullCmpActv.PullCmpActvLrngEnaAgConfMinMgn  # UB:Derived from original system description
    connect CalRegn01Inin00GroupA.PullCmpActvLrngEnaHwAgMaxMgn -> PullCmpActv.PullCmpActvLrngEnaHwAgMaxMgn  # UB:Derived from original system description
    connect CalRegn01Inin00GroupA.PullCmpActvLrngEnaHwTqMaxMgn -> PullCmpActv.PullCmpActvLrngEnaHwTqMaxMgn  # UB:Derived from original system description
    connect CalRegn01Inin00GroupA.PullCmpActvLrngEnaHwVelMaxMgn -> PullCmpActv.PullCmpActvLrngEnaHwVelMaxMgn  # UB:Derived from original system description
    connect CalRegn01Inin00GroupA.PullCmpActvLrngEnaLatAMaxMgn -> PullCmpActv.PullCmpActvLrngEnaLatAMaxMgn  # UB:Derived from original system description
    connect CalRegn01Inin00GroupA.PullCmpActvLrngEnaTiThd -> PullCmpActv.PullCmpActvLrngEnaTiThd  # UB:Derived from original system description
    connect CalRegn01Inin00GroupA.PullCmpActvLrngEnaVehSpdMaxMgn -> PullCmpActv.PullCmpActvLrngEnaVehSpdMaxMgn  # UB:Derived from original system description
    connect CalRegn01Inin00GroupA.PullCmpActvLrngEnaVehSpdMinMgn -> PullCmpActv.PullCmpActvLrngEnaVehSpdMinMgn  # UB:Derived from original system description
    connect CalRegn01Inin00GroupA.PullCmpActvLrngEnaVehSpdRateMaxMgn -> PullCmpActv.PullCmpActvLrngEnaVehSpdRateMaxMgn  # UB:Derived from original system description
    connect CalRegn01Inin00GroupA.PullCmpActvLrngEnaYawRateMaxMgn -> PullCmpActv.PullCmpActvLrngEnaYawRateMaxMgn  # UB:Derived from original system description
    connect CalRegn01Inin00GroupA.PullCmpActvOpstSignTiShoTerm -> PullCmpActv.PullCmpActvOpstSignTiShoTerm  # UB:Derived from original system description
    connect CalRegn01Inin00GroupA.PullCmpActvOutpMaxRate -> PullCmpActv.PullCmpActvOutpMaxRate  # UB:Derived from original system description
    connect CalRegn01Inin00GroupA.PullCmpActvPullCmpShoTermLim -> PullCmpActv.PullCmpActvPullCmpShoTermLim  # UB:Derived from original system description
    connect CalRegn01Inin00GroupA.PullCmpActvPullCmpTotLim -> PullCmpActv.PullCmpActvPullCmpTotLim  # UB:Derived from original system description
    connect CalRegn01Inin00GroupA.PullCmpActvPullErrLimLongTerm -> PullCmpActv.PullCmpActvPullErrLimLongTerm  # UB:Derived from original system description
    connect CalRegn01Inin00GroupA.PullCmpActvPullErrMgnThd -> PullCmpActv.PullCmpActvPullErrMgnThd  # UB:Derived from original system description
    connect CalRegn01Inin00GroupA.PullCmpActvPullErrShoTermLim -> PullCmpActv.PullCmpActvPullErrShoTermLim  # UB:Derived from original system description
    connect CalRegn01Inin00GroupA.PullCmpActvShoTermRampTi -> PullCmpActv.PullCmpActvShoTermRampTi  # UB:Derived from original system description
    connect CalRegn01Inin00GroupA.PullCmpActvVehSpdScaTblX -> PullCmpActv.PullCmpActvVehSpdScaTblX  # UB:Derived from original system description
    connect CalRegn01Inin00GroupA.PullCmpActvVehSpdScaTblY -> PullCmpActv.PullCmpActvVehSpdScaTblY  # UB:Derived from original system description
    connect CalRegn01Inin00GroupC.CtrldVelRtnDesVelLpFilFrq -> AAACalRegn01Inin00GroupC_Dummy.CtrldVelRtnDesVelLpFilFrq  # UB:Derived from original system description
    connect CalRegn01Inin00GroupC.CtrldVelRtnHwTqLpFilFrq -> AAACalRegn01Inin00GroupC_Dummy.CtrldVelRtnHwTqLpFilFrq  # UB:Derived from original system description
    connect CalRegn01Inin00GroupC.CtrldVelRtnHwTqScaSelnSlewHiLim -> AAACalRegn01Inin00GroupC_Dummy.CtrldVelRtnHwTqScaSelnSlewHiLim  # UB:Derived from original system description
    connect CalRegn01Inin00GroupC.CtrldVelRtnHwTqScaSelnSlewLoLim -> AAACalRegn01Inin00GroupC_Dummy.CtrldVelRtnHwTqScaSelnSlewLoLim  # UB:Derived from original system description
    connect CalRegn01Inin00GroupC.CtrldVelRtnHwTqScaSelnTqThd -> AAACalRegn01Inin00GroupC_Dummy.CtrldVelRtnHwTqScaSelnTqThd  # UB:Derived from original system description
    connect CalRegn01Inin00GroupC.CtrldVelRtnHwTqScaSelnVelThd -> AAACalRegn01Inin00GroupC_Dummy.CtrldVelRtnHwTqScaSelnVelThd  # UB:Derived from original system description
    connect CalRegn01Inin00GroupC.CtrldVelRtnIntgrLimY -> AAACalRegn01Inin00GroupC_Dummy.CtrldVelRtnIntgrLimY  # UB:Derived from original system description
    connect CalRegn01Inin00GroupC.CtrldVelRtnOffsSlewThd -> AAACalRegn01Inin00GroupC_Dummy.CtrldVelRtnOffsSlewThd  # UB:Derived from original system description
    connect CalRegn01Inin00GroupC.CtrldVelRtnOffsThd -> AAACalRegn01Inin00GroupC_Dummy.CtrldVelRtnOffsThd  # UB:Derived from original system description
    connect CalRegn01Inin00GroupC.CtrldVelRtnScaLpFilFrq -> AAACalRegn01Inin00GroupC_Dummy.CtrldVelRtnScaLpFilFrq  # UB:Derived from original system description
    connect CalRegn01Inin00GroupC.FalbckAssiAssiX -> AAACalRegn01Inin00GroupC_Dummy.FalbckAssiAssiX  # UB:Derived from original system description
    connect CalRegn01Inin00GroupC.FalbckAssiAssiY -> AAACalRegn01Inin00GroupC_Dummy.FalbckAssiAssiY  # UB:Derived from original system description
    connect CalRegn01Inin00GroupC.FalbckAssiNotchFil -> AAACalRegn01Inin00GroupC_Dummy.FalbckAssiNotchFil  # UB:Derived from original system description
    connect CalRegn01Inin00GroupC.GlbLimrBndX -> AAACalRegn01Inin00GroupC_Dummy.GlbLimrBndX  # UB:Derived from original system description
    connect CalRegn01Inin00GroupC.GlbLimrBndY -> AAACalRegn01Inin00GroupC_Dummy.GlbLimrBndY  # UB:Derived from original system description
    connect CalRegn01Inin00GroupC.GlbLimrNotchFilStruct -> AAACalRegn01Inin00GroupC_Dummy.GlbLimrNotchFilStruct  # UB:Derived from original system description
    connect CalRegn01Inin00GroupC.GlbLimrVehSpdBilnrSeln -> AAACalRegn01Inin00GroupC_Dummy.GlbLimrVehSpdBilnrSeln  # UB:Derived from original system description
    connect CalRegn01Inin00GroupC.CtrldVelRtnDesVelLpFilFrq -> CtrldVelRtn.CtrldVelRtnDesVelLpFilFrq  # UB:Derived from original system description
    connect CalRegn01Inin00GroupC.CtrldVelRtnHwTqLpFilFrq -> CtrldVelRtn.CtrldVelRtnHwTqLpFilFrq  # UB:Derived from original system description
    connect CalRegn01Inin00GroupC.CtrldVelRtnHwTqScaSelnSlewHiLim -> CtrldVelRtn.CtrldVelRtnHwTqScaSelnSlewHiLim  # UB:Derived from original system description
    connect CalRegn01Inin00GroupC.CtrldVelRtnHwTqScaSelnSlewLoLim -> CtrldVelRtn.CtrldVelRtnHwTqScaSelnSlewLoLim  # UB:Derived from original system description
    connect CalRegn01Inin00GroupC.CtrldVelRtnHwTqScaSelnTqThd -> CtrldVelRtn.CtrldVelRtnHwTqScaSelnTqThd  # UB:Derived from original system description
    connect CalRegn01Inin00GroupC.CtrldVelRtnHwTqScaSelnVelThd -> CtrldVelRtn.CtrldVelRtnHwTqScaSelnVelThd  # UB:Derived from original system description
    connect CalRegn01Inin00GroupC.CtrldVelRtnIntgrLimY -> CtrldVelRtn.CtrldVelRtnIntgrLimY  # UB:Derived from original system description
    connect CalRegn01Inin00GroupC.CtrldVelRtnOffsSlewThd -> CtrldVelRtn.CtrldVelRtnOffsSlewThd  # UB:Derived from original system description
    connect CalRegn01Inin00GroupC.CtrldVelRtnOffsThd -> CtrldVelRtn.CtrldVelRtnOffsThd  # UB:Derived from original system description
    connect CalRegn01Inin00GroupC.CtrldVelRtnScaLpFilFrq -> CtrldVelRtn.CtrldVelRtnScaLpFilFrq  # UB:Derived from original system description
    connect CalRegn01Inin00GroupC.FalbckAssiAssiX -> FalbckAssi.FalbckAssiAssiX  # UB:Derived from original system description
    connect CalRegn01Inin00GroupC.FalbckAssiAssiY -> FalbckAssi.FalbckAssiAssiY  # UB:Derived from original system description
    connect CalRegn01Inin00GroupC.FalbckAssiNotchFil -> FalbckAssi.FalbckAssiNotchFil  # UB:Derived from original system description
    connect CalRegn01Inin00GroupC.GlbLimrBndX -> GlbLimr.GlbLimrBndX  # UB:Derived from original system description
    connect CalRegn01Inin00GroupC.GlbLimrBndY -> GlbLimr.GlbLimrBndY  # UB:Derived from original system description
    connect CalRegn01Inin00GroupC.GlbLimrNotchFilStruct -> GlbLimr.GlbLimrNotchFilStruct  # UB:Derived from original system description
    connect CalRegn01Inin00GroupC.GlbLimrVehSpdBilnrSeln -> GlbLimr.GlbLimrVehSpdBilnrSeln  # UB:Derived from original system description
    connect CalRegn01Inin00GroupD.EotProtnDampgVehSpdTbl -> AAACalRegn01Inin00GroupD_Dummy.EotProtnDampgVehSpdTbl  # UB:Derived from original system description
    connect CalRegn01Inin00GroupD.EotProtnDeltaTqThd -> AAACalRegn01Inin00GroupD_Dummy.EotProtnDeltaTqThd  # UB:Derived from original system description
    connect CalRegn01Inin00GroupD.EotProtnEntrGainAuthyThd -> AAACalRegn01Inin00GroupD_Dummy.EotProtnEntrGainAuthyThd  # UB:Derived from original system description
    connect CalRegn01Inin00GroupD.EotProtnEntrGainVehSpdTbl -> AAACalRegn01Inin00GroupD_Dummy.EotProtnEntrGainVehSpdTbl  # UB:Derived from original system description
    connect CalRegn01Inin00GroupD.EotProtnEntrGainX -> AAACalRegn01Inin00GroupD_Dummy.EotProtnEntrGainX  # UB:Derived from original system description
    connect CalRegn01Inin00GroupD.EotProtnEntrGainY -> AAACalRegn01Inin00GroupD_Dummy.EotProtnEntrGainY  # UB:Derived from original system description
    connect CalRegn01Inin00GroupD.EotProtnEntrStLpFilFrq -> AAACalRegn01Inin00GroupD_Dummy.EotProtnEntrStLpFilFrq  # UB:Derived from original system description
    connect CalRegn01Inin00GroupD.EotProtnExitDampgY -> AAACalRegn01Inin00GroupD_Dummy.EotProtnExitDampgY  # UB:Derived from original system description
    connect CalRegn01Inin00GroupD.EotProtnExitStLpFilFrq -> AAACalRegn01Inin00GroupD_Dummy.EotProtnExitStLpFilFrq  # UB:Derived from original system description
    connect CalRegn01Inin00GroupD.EotProtnHwDegDampgX -> AAACalRegn01Inin00GroupD_Dummy.EotProtnHwDegDampgX  # UB:Derived from original system description
    connect CalRegn01Inin00GroupD.EotProtnHwTqLpFilFrq -> AAACalRegn01Inin00GroupD_Dummy.EotProtnHwTqLpFilFrq  # UB:Derived from original system description
    connect CalRegn01Inin00GroupD.EotProtnHwTqScaX -> AAACalRegn01Inin00GroupD_Dummy.EotProtnHwTqScaX  # UB:Derived from original system description
    connect CalRegn01Inin00GroupD.EotProtnLoAuthyEntrGainY -> AAACalRegn01Inin00GroupD_Dummy.EotProtnLoAuthyEntrGainY  # UB:Derived from original system description
    connect CalRegn01Inin00GroupD.EotProtnMotSpdIncptSca -> AAACalRegn01Inin00GroupD_Dummy.EotProtnMotSpdIncptSca  # UB:Derived from original system description
    connect CalRegn01Inin00GroupD.EotProtnMotSpdIncptX -> AAACalRegn01Inin00GroupD_Dummy.EotProtnMotSpdIncptX  # UB:Derived from original system description
    connect CalRegn01Inin00GroupD.EotProtnMotSpdIncptY -> AAACalRegn01Inin00GroupD_Dummy.EotProtnMotSpdIncptY  # UB:Derived from original system description
    connect CalRegn01Inin00GroupD.EotProtnMotVelGain -> AAACalRegn01Inin00GroupD_Dummy.EotProtnMotVelGain  # UB:Derived from original system description
    connect CalRegn01Inin00GroupD.EotProtnNormDampgY -> AAACalRegn01Inin00GroupD_Dummy.EotProtnNormDampgY  # UB:Derived from original system description
    connect CalRegn01Inin00GroupD.EotProtnPosnRampStep -> AAACalRegn01Inin00GroupD_Dummy.EotProtnPosnRampStep  # UB:Derived from original system description
    connect CalRegn01Inin00GroupD.EotProtnRackTrvlLimrAuthyThd -> AAACalRegn01Inin00GroupD_Dummy.EotProtnRackTrvlLimrAuthyThd  # UB:Derived from original system description
    connect CalRegn01Inin00GroupD.EotProtnRackTrvlLimrAuthyThdLimd -> AAACalRegn01Inin00GroupD_Dummy.EotProtnRackTrvlLimrAuthyThdLimd  # UB:Derived from original system description
    connect CalRegn01Inin00GroupD.EotProtnRackTrvlLimrRng -> AAACalRegn01Inin00GroupD_Dummy.EotProtnRackTrvlLimrRng  # UB:Derived from original system description
    connect CalRegn01Inin00GroupD.EotProtnRackTrvlLimrRngLimd -> AAACalRegn01Inin00GroupD_Dummy.EotProtnRackTrvlLimrRngLimd  # UB:Derived from original system description
    connect CalRegn01Inin00GroupD.EotProtnRackTrvlLimrVehSpdThd -> AAACalRegn01Inin00GroupD_Dummy.EotProtnRackTrvlLimrVehSpdThd  # UB:Derived from original system description
    connect CalRegn01Inin00GroupD.EotProtnRunEotVelImpctAndSoftEndStop -> AAACalRegn01Inin00GroupD_Dummy.EotProtnRunEotVelImpctAndSoftEndStop  # UB:Derived from original system description
    connect CalRegn01Inin00GroupD.InertiaCmpVelAssiBasdDampgCoeffX -> AAACalRegn01Inin00GroupD_Dummy.InertiaCmpVelAssiBasdDampgCoeffX  # UB:Derived from original system description
    connect CalRegn01Inin00GroupD.InertiaCmpVelAssiBasdDampgRollgWhlImbRejctnOnY -> AAACalRegn01Inin00GroupD_Dummy.InertiaCmpVelAssiBasdDampgRollgWhlImbRejctnOnY  # UB:Derived from original system description
    connect CalRegn01Inin00GroupD.InertiaCmpVelAssiBasdDampgRollgY -> AAACalRegn01Inin00GroupD_Dummy.InertiaCmpVelAssiBasdDampgRollgY  # UB:Derived from original system description
    connect CalRegn01Inin00GroupD.InertiaCmpVelAssiBasdDampgStatWhlImbRejctnOnY -> AAACalRegn01Inin00GroupD_Dummy.InertiaCmpVelAssiBasdDampgStatWhlImbRejctnOnY  # UB:Derived from original system description
    connect CalRegn01Inin00GroupD.InertiaCmpVelAssiBasdDampgStatY -> AAACalRegn01Inin00GroupD_Dummy.InertiaCmpVelAssiBasdDampgStatY  # UB:Derived from original system description
    connect CalRegn01Inin00GroupD.InertiaCmpVelCmdScaY -> AAACalRegn01Inin00GroupD_Dummy.InertiaCmpVelCmdScaY  # UB:Derived from original system description
    connect CalRegn01Inin00GroupD.InertiaCmpVelDampgDecelGain -> AAACalRegn01Inin00GroupD_Dummy.InertiaCmpVelDampgDecelGain  # UB:Derived from original system description
    connect CalRegn01Inin00GroupD.InertiaCmpVelDampgDecelGainFallSlew -> AAACalRegn01Inin00GroupD_Dummy.InertiaCmpVelDampgDecelGainFallSlew  # UB:Derived from original system description
    connect CalRegn01Inin00GroupD.InertiaCmpVelDampgDecelGainRisngSlewX -> AAACalRegn01Inin00GroupD_Dummy.InertiaCmpVelDampgDecelGainRisngSlewX  # UB:Derived from original system description
    connect CalRegn01Inin00GroupD.InertiaCmpVelDampgDecelGainRisngSlewY -> AAACalRegn01Inin00GroupD_Dummy.InertiaCmpVelDampgDecelGainRisngSlewY  # UB:Derived from original system description
    connect CalRegn01Inin00GroupD.InertiaCmpVelDampgFilFrq -> AAACalRegn01Inin00GroupD_Dummy.InertiaCmpVelDampgFilFrq  # UB:Derived from original system description
    connect CalRegn01Inin00GroupD.InertiaCmpVelDampgFilFrqWhlImbRejctnOn -> AAACalRegn01Inin00GroupD_Dummy.InertiaCmpVelDampgFilFrqWhlImbRejctnOn  # UB:Derived from original system description
    connect CalRegn01Inin00GroupD.InertiaCmpVelDampgGainOffThd -> AAACalRegn01Inin00GroupD_Dummy.InertiaCmpVelDampgGainOffThd  # UB:Derived from original system description
    connect CalRegn01Inin00GroupD.InertiaCmpVelDampgGainOnThd -> AAACalRegn01Inin00GroupD_Dummy.InertiaCmpVelDampgGainOnThd  # UB:Derived from original system description
    connect CalRegn01Inin00GroupD.InertiaCmpVelDampgSpdBlndY -> AAACalRegn01Inin00GroupD_Dummy.InertiaCmpVelDampgSpdBlndY  # UB:Derived from original system description
    connect CalRegn01Inin00GroupD.InertiaCmpVelDampgWhlImbRejctnBlndX -> AAACalRegn01Inin00GroupD_Dummy.InertiaCmpVelDampgWhlImbRejctnBlndX  # UB:Derived from original system description
    connect CalRegn01Inin00GroupD.InertiaCmpVelDampgWhlImbRejctnBlndY -> AAACalRegn01Inin00GroupD_Dummy.InertiaCmpVelDampgWhlImbRejctnBlndY  # UB:Derived from original system description
    connect CalRegn01Inin00GroupD.InertiaCmpVelDecelGainEnaCal -> AAACalRegn01Inin00GroupD_Dummy.InertiaCmpVelDecelGainEnaCal  # UB:Derived from original system description
    connect CalRegn01Inin00GroupD.InertiaCmpVelModWhlImbRejctnBlndX -> AAACalRegn01Inin00GroupD_Dummy.InertiaCmpVelModWhlImbRejctnBlndX  # UB:Derived from original system description
    connect CalRegn01Inin00GroupD.InertiaCmpVelModWhlImbRejctnBlndY -> AAACalRegn01Inin00GroupD_Dummy.InertiaCmpVelModWhlImbRejctnBlndY  # UB:Derived from original system description
    connect CalRegn01Inin00GroupD.InertiaCmpVelMotInertia -> AAACalRegn01Inin00GroupD_Dummy.InertiaCmpVelMotInertia  # UB:Derived from original system description
    connect CalRegn01Inin00GroupD.InertiaCmpVelMotVelBasdOutpScagX -> AAACalRegn01Inin00GroupD_Dummy.InertiaCmpVelMotVelBasdOutpScagX  # UB:Derived from original system description
    connect CalRegn01Inin00GroupD.InertiaCmpVelMotVelBasdOutpScagY -> AAACalRegn01Inin00GroupD_Dummy.InertiaCmpVelMotVelBasdOutpScagY  # UB:Derived from original system description
    connect CalRegn01Inin00GroupD.InertiaCmpVelNotchBlndY -> AAACalRegn01Inin00GroupD_Dummy.InertiaCmpVelNotchBlndY  # UB:Derived from original system description
    connect CalRegn01Inin00GroupD.InertiaCmpVelNotchFilStruct -> AAACalRegn01Inin00GroupD_Dummy.InertiaCmpVelNotchFilStruct  # UB:Derived from original system description
    connect CalRegn01Inin00GroupD.InertiaCmpVelTqSnsrVelFilFrq -> AAACalRegn01Inin00GroupD_Dummy.InertiaCmpVelTqSnsrVelFilFrq  # UB:Derived from original system description
    connect CalRegn01Inin00GroupD.InertiaCmpVelTqSnsrVelSca -> AAACalRegn01Inin00GroupD_Dummy.InertiaCmpVelTqSnsrVelSca  # UB:Derived from original system description
    connect CalRegn01Inin00GroupD.EotProtnDampgVehSpdTbl -> EotProtn.EotProtnDampgVehSpdTbl  # UB:Derived from original system description
    connect CalRegn01Inin00GroupD.EotProtnDeltaTqThd -> EotProtn.EotProtnDeltaTqThd  # UB:Derived from original system description
    connect CalRegn01Inin00GroupD.EotProtnEntrGainAuthyThd -> EotProtn.EotProtnEntrGainAuthyThd  # UB:Derived from original system description
    connect CalRegn01Inin00GroupD.EotProtnEntrGainVehSpdTbl -> EotProtn.EotProtnEntrGainVehSpdTbl  # UB:Derived from original system description
    connect CalRegn01Inin00GroupD.EotProtnEntrGainX -> EotProtn.EotProtnEntrGainX  # UB:Derived from original system description
    connect CalRegn01Inin00GroupD.EotProtnEntrGainY -> EotProtn.EotProtnEntrGainY  # UB:Derived from original system description
    connect CalRegn01Inin00GroupD.EotProtnEntrStLpFilFrq -> EotProtn.EotProtnEntrStLpFilFrq  # UB:Derived from original system description
    connect CalRegn01Inin00GroupD.EotProtnExitDampgY -> EotProtn.EotProtnExitDampgY  # UB:Derived from original system description
    connect CalRegn01Inin00GroupD.EotProtnExitStLpFilFrq -> EotProtn.EotProtnExitStLpFilFrq  # UB:Derived from original system description
    connect CalRegn01Inin00GroupD.EotProtnHwDegDampgX -> EotProtn.EotProtnHwDegDampgX  # UB:Derived from original system description
    connect CalRegn01Inin00GroupD.EotProtnHwTqLpFilFrq -> EotProtn.EotProtnHwTqLpFilFrq  # UB:Derived from original system description
    connect CalRegn01Inin00GroupD.EotProtnHwTqScaX -> EotProtn.EotProtnHwTqScaX  # UB:Derived from original system description
    connect CalRegn01Inin00GroupD.EotProtnLoAuthyEntrGainY -> EotProtn.EotProtnLoAuthyEntrGainY  # UB:Derived from original system description
    connect CalRegn01Inin00GroupD.EotProtnMotSpdIncptSca -> EotProtn.EotProtnMotSpdIncptSca  # UB:Derived from original system description
    connect CalRegn01Inin00GroupD.EotProtnMotSpdIncptX -> EotProtn.EotProtnMotSpdIncptX  # UB:Derived from original system description
    connect CalRegn01Inin00GroupD.EotProtnMotSpdIncptY -> EotProtn.EotProtnMotSpdIncptY  # UB:Derived from original system description
    connect CalRegn01Inin00GroupD.EotProtnMotVelGain -> EotProtn.EotProtnMotVelGain  # UB:Derived from original system description
    connect CalRegn01Inin00GroupD.EotProtnNormDampgY -> EotProtn.EotProtnNormDampgY  # UB:Derived from original system description
    connect CalRegn01Inin00GroupD.EotProtnPosnRampStep -> EotProtn.EotProtnPosnRampStep  # UB:Derived from original system description
    connect CalRegn01Inin00GroupD.EotProtnRackTrvlLimrAuthyThd -> EotProtn.EotProtnRackTrvlLimrAuthyThd  # UB:Derived from original system description
    connect CalRegn01Inin00GroupD.EotProtnRackTrvlLimrAuthyThdLimd -> EotProtn.EotProtnRackTrvlLimrAuthyThdLimd  # UB:Derived from original system description
    connect CalRegn01Inin00GroupD.EotProtnRackTrvlLimrRng -> EotProtn.EotProtnRackTrvlLimrRng  # UB:Derived from original system description
    connect CalRegn01Inin00GroupD.EotProtnRackTrvlLimrRngLimd -> EotProtn.EotProtnRackTrvlLimrRngLimd  # UB:Derived from original system description
    connect CalRegn01Inin00GroupD.EotProtnRackTrvlLimrVehSpdThd -> EotProtn.EotProtnRackTrvlLimrVehSpdThd  # UB:Derived from original system description
    connect CalRegn01Inin00GroupD.EotProtnRunEotVelImpctAndSoftEndStop -> EotProtn.EotProtnRunEotVelImpctAndSoftEndStop  # UB:Derived from original system description
    connect CalRegn01Inin00GroupD.InertiaCmpVelAssiBasdDampgCoeffX -> InertiaCmpVel.InertiaCmpVelAssiBasdDampgCoeffX  # UB:Derived from original system description
    connect CalRegn01Inin00GroupD.InertiaCmpVelAssiBasdDampgRollgWhlImbRejctnOnY -> InertiaCmpVel.InertiaCmpVelAssiBasdDampgRollgWhlImbRejctnOnY  # UB:Derived from original system description
    connect CalRegn01Inin00GroupD.InertiaCmpVelAssiBasdDampgRollgY -> InertiaCmpVel.InertiaCmpVelAssiBasdDampgRollgY  # UB:Derived from original system description
    connect CalRegn01Inin00GroupD.InertiaCmpVelAssiBasdDampgStatWhlImbRejctnOnY -> InertiaCmpVel.InertiaCmpVelAssiBasdDampgStatWhlImbRejctnOnY  # UB:Derived from original system description
    connect CalRegn01Inin00GroupD.InertiaCmpVelAssiBasdDampgStatY -> InertiaCmpVel.InertiaCmpVelAssiBasdDampgStatY  # UB:Derived from original system description
    connect CalRegn01Inin00GroupD.InertiaCmpVelCmdScaY -> InertiaCmpVel.InertiaCmpVelCmdScaY  # UB:Derived from original system description
    connect CalRegn01Inin00GroupD.InertiaCmpVelDampgDecelGain -> InertiaCmpVel.InertiaCmpVelDampgDecelGain  # UB:Derived from original system description
    connect CalRegn01Inin00GroupD.InertiaCmpVelDampgDecelGainFallSlew -> InertiaCmpVel.InertiaCmpVelDampgDecelGainFallSlew  # UB:Derived from original system description
    connect CalRegn01Inin00GroupD.InertiaCmpVelDampgDecelGainRisngSlewX -> InertiaCmpVel.InertiaCmpVelDampgDecelGainRisngSlewX  # UB:Derived from original system description
    connect CalRegn01Inin00GroupD.InertiaCmpVelDampgDecelGainRisngSlewY -> InertiaCmpVel.InertiaCmpVelDampgDecelGainRisngSlewY  # UB:Derived from original system description
    connect CalRegn01Inin00GroupD.InertiaCmpVelDampgFilFrq -> InertiaCmpVel.InertiaCmpVelDampgFilFrq  # UB:Derived from original system description
    connect CalRegn01Inin00GroupD.InertiaCmpVelDampgFilFrqWhlImbRejctnOn -> InertiaCmpVel.InertiaCmpVelDampgFilFrqWhlImbRejctnOn  # UB:Derived from original system description
    connect CalRegn01Inin00GroupD.InertiaCmpVelDampgGainOffThd -> InertiaCmpVel.InertiaCmpVelDampgGainOffThd  # UB:Derived from original system description
    connect CalRegn01Inin00GroupD.InertiaCmpVelDampgGainOnThd -> InertiaCmpVel.InertiaCmpVelDampgGainOnThd  # UB:Derived from original system description
    connect CalRegn01Inin00GroupD.InertiaCmpVelDampgSpdBlndY -> InertiaCmpVel.InertiaCmpVelDampgSpdBlndY  # UB:Derived from original system description
    connect CalRegn01Inin00GroupD.InertiaCmpVelDampgWhlImbRejctnBlndX -> InertiaCmpVel.InertiaCmpVelDampgWhlImbRejctnBlndX  # UB:Derived from original system description
    connect CalRegn01Inin00GroupD.InertiaCmpVelDampgWhlImbRejctnBlndY -> InertiaCmpVel.InertiaCmpVelDampgWhlImbRejctnBlndY  # UB:Derived from original system description
    connect CalRegn01Inin00GroupD.InertiaCmpVelDecelGainEnaCal -> InertiaCmpVel.InertiaCmpVelDecelGainEnaCal  # UB:Derived from original system description
    connect CalRegn01Inin00GroupD.InertiaCmpVelModWhlImbRejctnBlndX -> InertiaCmpVel.InertiaCmpVelModWhlImbRejctnBlndX  # UB:Derived from original system description
    connect CalRegn01Inin00GroupD.InertiaCmpVelModWhlImbRejctnBlndY -> InertiaCmpVel.InertiaCmpVelModWhlImbRejctnBlndY  # UB:Derived from original system description
    connect CalRegn01Inin00GroupD.InertiaCmpVelMotInertia -> InertiaCmpVel.InertiaCmpVelMotInertia  # UB:Derived from original system description
    connect CalRegn01Inin00GroupD.InertiaCmpVelMotVelBasdOutpScagX -> InertiaCmpVel.InertiaCmpVelMotVelBasdOutpScagX  # UB:Derived from original system description
    connect CalRegn01Inin00GroupD.InertiaCmpVelMotVelBasdOutpScagY -> InertiaCmpVel.InertiaCmpVelMotVelBasdOutpScagY  # UB:Derived from original system description
    connect CalRegn01Inin00GroupD.InertiaCmpVelNotchBlndY -> InertiaCmpVel.InertiaCmpVelNotchBlndY  # UB:Derived from original system description
    connect CalRegn01Inin00GroupD.InertiaCmpVelNotchFilStruct -> InertiaCmpVel.InertiaCmpVelNotchFilStruct  # UB:Derived from original system description
    connect CalRegn01Inin00GroupD.InertiaCmpVelTqSnsrVelFilFrq -> InertiaCmpVel.InertiaCmpVelTqSnsrVelFilFrq  # UB:Derived from original system description
    connect CalRegn01Inin00GroupD.InertiaCmpVelTqSnsrVelSca -> InertiaCmpVel.InertiaCmpVelTqSnsrVelSca  # UB:Derived from original system description
    connect CalRegn01Inin01.BmwHwAgArbnAndEotPosnKineIntegrityDiagcMaxRackLim -> AAACalRegn01Inin01_Dummy.BmwHwAgArbnAndEotPosnKineIntegrityDiagcMaxRackLim  # UB:Derived from original system description
    connect CalRegn01Inin01.EffortScaBlndX -> AAACalRegn01Inin01_Dummy.EffortScaBlndX  # UB:Derived from original system description
    connect CalRegn01Inin01.EffortScaBlndY -> AAACalRegn01Inin01_Dummy.EffortScaBlndY  # UB:Derived from original system description
    connect CalRegn01Inin01.EffortScaRackFThd -> AAACalRegn01Inin01_Dummy.EffortScaRackFThd  # UB:Derived from original system description
    connect CalRegn01Inin01.PosnTrakgServoArbnFltMtgtnLpFilCutOffFrq -> AAACalRegn01Inin01_Dummy.PosnTrakgServoArbnFltMtgtnLpFilCutOffFrq  # UB:Derived from original system description
    connect CalRegn01Inin01.PullCmpActvHwTqFilFrqLrngEna -> AAACalRegn01Inin01_Dummy.PullCmpActvHwTqFilFrqLrngEna  # UB:Derived from original system description
    connect CalRegn01Inin01.PullCmpActvYawRateFilFrq -> AAACalRegn01Inin01_Dummy.PullCmpActvYawRateFilFrq  # UB:Derived from original system description
    connect CalRegn01Inin01.SysFricLrngAvrgFricFrq -> AAACalRegn01Inin01_Dummy.SysFricLrngAvrgFricFrq  # UB:Derived from original system description
    connect CalRegn01Inin01.SysFricLrngBasLineEolFric -> AAACalRegn01Inin01_Dummy.SysFricLrngBasLineEolFric  # UB:Derived from original system description
    connect CalRegn01Inin01.SysFricLrngBasLineFric -> AAACalRegn01Inin01_Dummy.SysFricLrngBasLineFric  # UB:Derived from original system description
    connect CalRegn01Inin01.SysFricLrngBasLineHys -> AAACalRegn01Inin01_Dummy.SysFricLrngBasLineHys  # UB:Derived from original system description
    connect CalRegn01Inin01.SysFricLrngBasLineRngCntr -> AAACalRegn01Inin01_Dummy.SysFricLrngBasLineRngCntr  # UB:Derived from original system description
    connect CalRegn01Inin01.SysFricLrngDataPrepLpFilFrq -> AAACalRegn01Inin01_Dummy.SysFricLrngDataPrepLpFilFrq  # UB:Derived from original system description
    connect CalRegn01Inin01.SysFricLrngDebStep -> AAACalRegn01Inin01_Dummy.SysFricLrngDebStep  # UB:Derived from original system description
    connect CalRegn01Inin01.SysFricLrngEolFricDifHiLim -> AAACalRegn01Inin01_Dummy.SysFricLrngEolFricDifHiLim  # UB:Derived from original system description
    connect CalRegn01Inin01.SysFricLrngEolFricDifLoLim -> AAACalRegn01Inin01_Dummy.SysFricLrngEolFricDifLoLim  # UB:Derived from original system description
    connect CalRegn01Inin01.SysFricLrngEolFricDifScagFac -> AAACalRegn01Inin01_Dummy.SysFricLrngEolFricDifScagFac  # UB:Derived from original system description
    connect CalRegn01Inin01.SysFricLrngFricChgWght -> AAACalRegn01Inin01_Dummy.SysFricLrngFricChgWght  # UB:Derived from original system description
    connect CalRegn01Inin01.SysFricLrngFricDiagcThd -> AAACalRegn01Inin01_Dummy.SysFricLrngFricDiagcThd  # UB:Derived from original system description
    connect CalRegn01Inin01.SysFricLrngFricHysHwAgPt -> AAACalRegn01Inin01_Dummy.SysFricLrngFricHysHwAgPt  # UB:Derived from original system description
    connect CalRegn01Inin01.SysFricLrngFricOffs -> AAACalRegn01Inin01_Dummy.SysFricLrngFricOffs  # UB:Derived from original system description
    connect CalRegn01Inin01.SysFricLrngFricOffsHiLim -> AAACalRegn01Inin01_Dummy.SysFricLrngFricOffsHiLim  # UB:Derived from original system description
    connect CalRegn01Inin01.SysFricLrngFricOffsLoLim -> AAACalRegn01Inin01_Dummy.SysFricLrngFricOffsLoLim  # UB:Derived from original system description
    connect CalRegn01Inin01.SysFricLrngFricOffsLpFilFrq -> AAACalRegn01Inin01_Dummy.SysFricLrngFricOffsLpFilFrq  # UB:Derived from original system description
    connect CalRegn01Inin01.SysFricLrngGain -> AAACalRegn01Inin01_Dummy.SysFricLrngGain  # UB:Derived from original system description
    connect CalRegn01Inin01.SysFricLrngHiFricDebStep -> AAACalRegn01Inin01_Dummy.SysFricLrngHiFricDebStep  # UB:Derived from original system description
    connect CalRegn01Inin01.SysFricLrngHiFricDiagcThd -> AAACalRegn01Inin01_Dummy.SysFricLrngHiFricDiagcThd  # UB:Derived from original system description
    connect CalRegn01Inin01.SysFricLrngHwPosnAuthyThd -> AAACalRegn01Inin01_Dummy.SysFricLrngHwPosnAuthyThd  # UB:Derived from original system description
    connect CalRegn01Inin01.SysFricLrngHwVelConstrLim -> AAACalRegn01Inin01_Dummy.SysFricLrngHwVelConstrLim  # UB:Derived from original system description
    connect CalRegn01Inin01.SysFricLrngHwVelHiLim -> AAACalRegn01Inin01_Dummy.SysFricLrngHwVelHiLim  # UB:Derived from original system description
    connect CalRegn01Inin01.SysFricLrngHwVelLoLim -> AAACalRegn01Inin01_Dummy.SysFricLrngHwVelLoLim  # UB:Derived from original system description
    connect CalRegn01Inin01.SysFricLrngIgnCycFricChgLim -> AAACalRegn01Inin01_Dummy.SysFricLrngIgnCycFricChgLim  # UB:Derived from original system description
    connect CalRegn01Inin01.SysFricLrngIgnCycFricOffs -> AAACalRegn01Inin01_Dummy.SysFricLrngIgnCycFricOffs  # UB:Derived from original system description
    connect CalRegn01Inin01.SysFricLrngIvsTrsmRatX -> AAACalRegn01Inin01_Dummy.SysFricLrngIvsTrsmRatX  # UB:Derived from original system description
    connect CalRegn01Inin01.SysFricLrngIvsTrsmRatY -> AAACalRegn01Inin01_Dummy.SysFricLrngIvsTrsmRatY  # UB:Derived from original system description
    connect CalRegn01Inin01.SysFricLrngLatAHiLim -> AAACalRegn01Inin01_Dummy.SysFricLrngLatAHiLim  # UB:Derived from original system description
    connect CalRegn01Inin01.SysFricLrngLatALoLim -> AAACalRegn01Inin01_Dummy.SysFricLrngLatALoLim  # UB:Derived from original system description
    connect CalRegn01Inin01.SysFricLrngMaskVehSpd -> AAACalRegn01Inin01_Dummy.SysFricLrngMaskVehSpd  # UB:Derived from original system description
    connect CalRegn01Inin01.SysFricLrngRngCntrThd -> AAACalRegn01Inin01_Dummy.SysFricLrngRngCntrThd  # UB:Derived from original system description
    connect CalRegn01Inin01.SysFricLrngThd -> AAACalRegn01Inin01_Dummy.SysFricLrngThd  # UB:Derived from original system description
    connect CalRegn01Inin01.SysFricLrngTHiLim -> AAACalRegn01Inin01_Dummy.SysFricLrngTHiLim  # UB:Derived from original system description
    connect CalRegn01Inin01.SysFricLrngTLoLim -> AAACalRegn01Inin01_Dummy.SysFricLrngTLoLim  # UB:Derived from original system description
    connect CalRegn01Inin01.SysFricLrngVehSpd -> AAACalRegn01Inin01_Dummy.SysFricLrngVehSpd  # UB:Derived from original system description
    connect CalRegn01Inin01.SysGlbPrmSysKineRat -> AAACalRegn01Inin01_Dummy.SysGlbPrmSysKineRat  # UB:Derived from original system description
    connect CalRegn01Inin01.SysGlbPrmVehSpdBilnrSeln -> AAACalRegn01Inin01_Dummy.SysGlbPrmVehSpdBilnrSeln  # UB:Derived from original system description
    connect CalRegn01Inin01.SysKineAndEffMotAgToRackPosRatScaY -> AAACalRegn01Inin01_Dummy.SysKineAndEffMotAgToRackPosRatScaY  # UB:Derived from original system description
    connect CalRegn01Inin01.SysKineAndEffPinionAgToRackPosRatScaY -> AAACalRegn01Inin01_Dummy.SysKineAndEffPinionAgToRackPosRatScaY  # UB:Derived from original system description
    connect CalRegn01Inin01.SysKineAndEffPinionToRackEffScaY -> AAACalRegn01Inin01_Dummy.SysKineAndEffPinionToRackEffScaY  # UB:Derived from original system description
    connect CalRegn01Inin01.SysKineAndEffRoadWhlFromRackPosScaY -> AAACalRegn01Inin01_Dummy.SysKineAndEffRoadWhlFromRackPosScaY  # UB:Derived from original system description
    connect CalRegn01Inin01.SysKineAndEffSteerArmLenFromRackPosScaY -> AAACalRegn01Inin01_Dummy.SysKineAndEffSteerArmLenFromRackPosScaY  # UB:Derived from original system description
    connect CalRegn01Inin01.TunSelnAuthyVehSpdX -> AAACalRegn01Inin01_Dummy.TunSelnAuthyVehSpdX  # UB:Derived from original system description
    connect CalRegn01Inin01GroupA.BmwHwAgArbnAndEotPosnEotCcwMax -> AAACalRegn01Inin01GroupA_Dummy.BmwHwAgArbnAndEotPosnEotCcwMax  # UB:Derived from original system description
    connect CalRegn01Inin01GroupA.BmwHwAgArbnAndEotPosnEotCcwMin -> AAACalRegn01Inin01GroupA_Dummy.BmwHwAgArbnAndEotPosnEotCcwMin  # UB:Derived from original system description
    connect CalRegn01Inin01GroupA.BmwHwAgArbnAndEotPosnEotCwMax -> AAACalRegn01Inin01GroupA_Dummy.BmwHwAgArbnAndEotPosnEotCwMax  # UB:Derived from original system description
    connect CalRegn01Inin01GroupA.BmwHwAgArbnAndEotPosnEotCwMin -> AAACalRegn01Inin01GroupA_Dummy.BmwHwAgArbnAndEotPosnEotCwMin  # UB:Derived from original system description
    connect CalRegn01Inin01GroupA.BmwPwrPrkgDampgDiScadDampg -> AAACalRegn01Inin01GroupA_Dummy.BmwPwrPrkgDampgDiScadDampg  # UB:Derived from original system description
    connect CalRegn01Inin01GroupA.BmwPwrPrkgDampgMaxRate -> AAACalRegn01Inin01GroupA_Dummy.BmwPwrPrkgDampgMaxRate  # UB:Derived from original system description
    connect CalRegn01Inin01GroupA.EpsStEstimnMtrxA -> AAACalRegn01Inin01GroupA_Dummy.EpsStEstimnMtrxA  # UB:Derived from original system description
    connect CalRegn01Inin01GroupA.EpsStEstimnMtrxB -> AAACalRegn01Inin01GroupA_Dummy.EpsStEstimnMtrxB  # UB:Derived from original system description
    connect CalRegn01Inin01GroupA.EpsStEstimnMtrxC -> AAACalRegn01Inin01GroupA_Dummy.EpsStEstimnMtrxC  # UB:Derived from original system description
    connect CalRegn01Inin01GroupA.EpsStEstimnMtrxD -> AAACalRegn01Inin01GroupA_Dummy.EpsStEstimnMtrxD  # UB:Derived from original system description
    connect CalRegn01Inin01GroupA.HwTqTrakgCtrlFbGain{1..5} -> AAACalRegn01Inin01GroupA_Dummy.HwTqTrakgCtrlFbGain{1..5}  # UB:Derived from original system description
    connect CalRegn01Inin01GroupA.HwTqTrakgCtrlFfGainScaY -> AAACalRegn01Inin01GroupA_Dummy.HwTqTrakgCtrlFfGainScaY  # UB:Derived from original system description
    connect CalRegn01Inin01GroupA.HwTqTrakgCtrlVehSpdScaX -> AAACalRegn01Inin01GroupA_Dummy.HwTqTrakgCtrlVehSpdScaX  # UB:Derived from original system description
    connect CalRegn01Inin01GroupA.PosnTrakgServoEnaBlndFacTblX -> AAACalRegn01Inin01GroupA_Dummy.PosnTrakgServoEnaBlndFacTblX  # UB:Derived from original system description
    connect CalRegn01Inin01GroupA.PosnTrakgServoEnaBlndFacTblY -> AAACalRegn01Inin01GroupA_Dummy.PosnTrakgServoEnaBlndFacTblY  # UB:Derived from original system description
    connect CalRegn01Inin01GroupA.PosnTrakgServoGainArbnFltMtgtn -> AAACalRegn01Inin01GroupA_Dummy.PosnTrakgServoGainArbnFltMtgtn  # UB:Derived from original system description
    connect CalRegn01Inin01GroupA.PullCmpActvCmpLrnTiDecShoTerm -> AAACalRegn01Inin01GroupA_Dummy.PullCmpActvCmpLrnTiDecShoTerm  # UB:Derived from original system description
    connect CalRegn01Inin01GroupA.PullCmpActvCmpLrnTiIncShoTerm -> AAACalRegn01Inin01GroupA_Dummy.PullCmpActvCmpLrnTiIncShoTerm  # UB:Derived from original system description
    connect CalRegn01Inin01GroupA.PullCmpActvCmpLrnTiLongTerm -> AAACalRegn01Inin01GroupA_Dummy.PullCmpActvCmpLrnTiLongTerm  # UB:Derived from original system description
    connect CalRegn01Inin01GroupA.PullCmpActvCmpShoTermRstHwAgThd -> AAACalRegn01Inin01GroupA_Dummy.PullCmpActvCmpShoTermRstHwAgThd  # UB:Derived from original system description
    connect CalRegn01Inin01GroupA.PullCmpActvCmpShoTermRstHwTqThd -> AAACalRegn01Inin01GroupA_Dummy.PullCmpActvCmpShoTermRstHwTqThd  # UB:Derived from original system description
    connect CalRegn01Inin01GroupA.PullCmpActvCmpShoTermRstLatAThd -> AAACalRegn01Inin01GroupA_Dummy.PullCmpActvCmpShoTermRstLatAThd  # UB:Derived from original system description
    connect CalRegn01Inin01GroupA.PullCmpActvCmpShoTermRstYawRateThd -> AAACalRegn01Inin01GroupA_Dummy.PullCmpActvCmpShoTermRstYawRateThd  # UB:Derived from original system description
    connect CalRegn01Inin01GroupA.PullCmpActvEna -> AAACalRegn01Inin01GroupA_Dummy.PullCmpActvEna  # UB:Derived from original system description
    connect CalRegn01Inin01GroupA.PullCmpActvHwTqFilFrqLongTerm -> AAACalRegn01Inin01GroupA_Dummy.PullCmpActvHwTqFilFrqLongTerm  # UB:Derived from original system description
    connect CalRegn01Inin01GroupA.PullCmpActvHwTqFilFrqShoTerm -> AAACalRegn01Inin01GroupA_Dummy.PullCmpActvHwTqFilFrqShoTerm  # UB:Derived from original system description
    connect CalRegn01Inin01GroupA.PullCmpActvLongTermLim -> AAACalRegn01Inin01GroupA_Dummy.PullCmpActvLongTermLim  # UB:Derived from original system description
    connect CalRegn01Inin01GroupA.PullCmpActvLrngEnaAgConfMinMgn -> AAACalRegn01Inin01GroupA_Dummy.PullCmpActvLrngEnaAgConfMinMgn  # UB:Derived from original system description
    connect CalRegn01Inin01GroupA.PullCmpActvLrngEnaHwAgMaxMgn -> AAACalRegn01Inin01GroupA_Dummy.PullCmpActvLrngEnaHwAgMaxMgn  # UB:Derived from original system description
    connect CalRegn01Inin01GroupA.PullCmpActvLrngEnaHwTqMaxMgn -> AAACalRegn01Inin01GroupA_Dummy.PullCmpActvLrngEnaHwTqMaxMgn  # UB:Derived from original system description
    connect CalRegn01Inin01GroupA.PullCmpActvLrngEnaHwVelMaxMgn -> AAACalRegn01Inin01GroupA_Dummy.PullCmpActvLrngEnaHwVelMaxMgn  # UB:Derived from original system description
    connect CalRegn01Inin01GroupA.PullCmpActvLrngEnaLatAMaxMgn -> AAACalRegn01Inin01GroupA_Dummy.PullCmpActvLrngEnaLatAMaxMgn  # UB:Derived from original system description
    connect CalRegn01Inin01GroupA.PullCmpActvLrngEnaTiThd -> AAACalRegn01Inin01GroupA_Dummy.PullCmpActvLrngEnaTiThd  # UB:Derived from original system description
    connect CalRegn01Inin01GroupA.PullCmpActvLrngEnaVehSpdMaxMgn -> AAACalRegn01Inin01GroupA_Dummy.PullCmpActvLrngEnaVehSpdMaxMgn  # UB:Derived from original system description
    connect CalRegn01Inin01GroupA.PullCmpActvLrngEnaVehSpdMinMgn -> AAACalRegn01Inin01GroupA_Dummy.PullCmpActvLrngEnaVehSpdMinMgn  # UB:Derived from original system description
    connect CalRegn01Inin01GroupA.PullCmpActvLrngEnaVehSpdRateMaxMgn -> AAACalRegn01Inin01GroupA_Dummy.PullCmpActvLrngEnaVehSpdRateMaxMgn  # UB:Derived from original system description
    connect CalRegn01Inin01GroupA.PullCmpActvLrngEnaYawRateMaxMgn -> AAACalRegn01Inin01GroupA_Dummy.PullCmpActvLrngEnaYawRateMaxMgn  # UB:Derived from original system description
    connect CalRegn01Inin01GroupA.PullCmpActvOpstSignTiShoTerm -> AAACalRegn01Inin01GroupA_Dummy.PullCmpActvOpstSignTiShoTerm  # UB:Derived from original system description
    connect CalRegn01Inin01GroupA.PullCmpActvOutpMaxRate -> AAACalRegn01Inin01GroupA_Dummy.PullCmpActvOutpMaxRate  # UB:Derived from original system description
    connect CalRegn01Inin01GroupA.PullCmpActvPullCmpShoTermLim -> AAACalRegn01Inin01GroupA_Dummy.PullCmpActvPullCmpShoTermLim  # UB:Derived from original system description
    connect CalRegn01Inin01GroupA.PullCmpActvPullCmpTotLim -> AAACalRegn01Inin01GroupA_Dummy.PullCmpActvPullCmpTotLim  # UB:Derived from original system description
    connect CalRegn01Inin01GroupA.PullCmpActvPullErrLimLongTerm -> AAACalRegn01Inin01GroupA_Dummy.PullCmpActvPullErrLimLongTerm  # UB:Derived from original system description
    connect CalRegn01Inin01GroupA.PullCmpActvPullErrMgnThd -> AAACalRegn01Inin01GroupA_Dummy.PullCmpActvPullErrMgnThd  # UB:Derived from original system description
    connect CalRegn01Inin01GroupA.PullCmpActvPullErrShoTermLim -> AAACalRegn01Inin01GroupA_Dummy.PullCmpActvPullErrShoTermLim  # UB:Derived from original system description
    connect CalRegn01Inin01GroupA.PullCmpActvShoTermRampTi -> AAACalRegn01Inin01GroupA_Dummy.PullCmpActvShoTermRampTi  # UB:Derived from original system description
    connect CalRegn01Inin01GroupA.PullCmpActvVehSpdScaTblX -> AAACalRegn01Inin01GroupA_Dummy.PullCmpActvVehSpdScaTblX  # UB:Derived from original system description
    connect CalRegn01Inin01GroupA.PullCmpActvVehSpdScaTblY -> AAACalRegn01Inin01GroupA_Dummy.PullCmpActvVehSpdScaTblY  # UB:Derived from original system description
    connect CalRegn01Inin01GroupC.CtrldVelRtnDesVelLpFilFrq -> AAACalRegn01Inin01GroupC_Dummy.CtrldVelRtnDesVelLpFilFrq  # UB:Derived from original system description
    connect CalRegn01Inin01GroupC.CtrldVelRtnHwTqLpFilFrq -> AAACalRegn01Inin01GroupC_Dummy.CtrldVelRtnHwTqLpFilFrq  # UB:Derived from original system description
    connect CalRegn01Inin01GroupC.CtrldVelRtnHwTqScaSelnSlewHiLim -> AAACalRegn01Inin01GroupC_Dummy.CtrldVelRtnHwTqScaSelnSlewHiLim  # UB:Derived from original system description
    connect CalRegn01Inin01GroupC.CtrldVelRtnHwTqScaSelnSlewLoLim -> AAACalRegn01Inin01GroupC_Dummy.CtrldVelRtnHwTqScaSelnSlewLoLim  # UB:Derived from original system description
    connect CalRegn01Inin01GroupC.CtrldVelRtnHwTqScaSelnTqThd -> AAACalRegn01Inin01GroupC_Dummy.CtrldVelRtnHwTqScaSelnTqThd  # UB:Derived from original system description
    connect CalRegn01Inin01GroupC.CtrldVelRtnHwTqScaSelnVelThd -> AAACalRegn01Inin01GroupC_Dummy.CtrldVelRtnHwTqScaSelnVelThd  # UB:Derived from original system description
    connect CalRegn01Inin01GroupC.CtrldVelRtnIntgrLimY -> AAACalRegn01Inin01GroupC_Dummy.CtrldVelRtnIntgrLimY  # UB:Derived from original system description
    connect CalRegn01Inin01GroupC.CtrldVelRtnOffsSlewThd -> AAACalRegn01Inin01GroupC_Dummy.CtrldVelRtnOffsSlewThd  # UB:Derived from original system description
    connect CalRegn01Inin01GroupC.CtrldVelRtnOffsThd -> AAACalRegn01Inin01GroupC_Dummy.CtrldVelRtnOffsThd  # UB:Derived from original system description
    connect CalRegn01Inin01GroupC.CtrldVelRtnScaLpFilFrq -> AAACalRegn01Inin01GroupC_Dummy.CtrldVelRtnScaLpFilFrq  # UB:Derived from original system description
    connect CalRegn01Inin01GroupC.FalbckAssiAssiX -> AAACalRegn01Inin01GroupC_Dummy.FalbckAssiAssiX  # UB:Derived from original system description
    connect CalRegn01Inin01GroupC.FalbckAssiAssiY -> AAACalRegn01Inin01GroupC_Dummy.FalbckAssiAssiY  # UB:Derived from original system description
    connect CalRegn01Inin01GroupC.FalbckAssiNotchFil -> AAACalRegn01Inin01GroupC_Dummy.FalbckAssiNotchFil  # UB:Derived from original system description
    connect CalRegn01Inin01GroupC.GlbLimrBndX -> AAACalRegn01Inin01GroupC_Dummy.GlbLimrBndX  # UB:Derived from original system description
    connect CalRegn01Inin01GroupC.GlbLimrBndY -> AAACalRegn01Inin01GroupC_Dummy.GlbLimrBndY  # UB:Derived from original system description
    connect CalRegn01Inin01GroupC.GlbLimrNotchFilStruct -> AAACalRegn01Inin01GroupC_Dummy.GlbLimrNotchFilStruct  # UB:Derived from original system description
    connect CalRegn01Inin01GroupC.GlbLimrVehSpdBilnrSeln -> AAACalRegn01Inin01GroupC_Dummy.GlbLimrVehSpdBilnrSeln  # UB:Derived from original system description
    connect CalRegn01Inin01GroupD.EotProtnDampgVehSpdTbl -> AAACalRegn01Inin01GroupD_Dummy.EotProtnDampgVehSpdTbl  # UB:Derived from original system description
    connect CalRegn01Inin01GroupD.EotProtnDeltaTqThd -> AAACalRegn01Inin01GroupD_Dummy.EotProtnDeltaTqThd  # UB:Derived from original system description
    connect CalRegn01Inin01GroupD.EotProtnEntrGainAuthyThd -> AAACalRegn01Inin01GroupD_Dummy.EotProtnEntrGainAuthyThd  # UB:Derived from original system description
    connect CalRegn01Inin01GroupD.EotProtnEntrGainVehSpdTbl -> AAACalRegn01Inin01GroupD_Dummy.EotProtnEntrGainVehSpdTbl  # UB:Derived from original system description
    connect CalRegn01Inin01GroupD.EotProtnEntrGainX -> AAACalRegn01Inin01GroupD_Dummy.EotProtnEntrGainX  # UB:Derived from original system description
    connect CalRegn01Inin01GroupD.EotProtnEntrGainY -> AAACalRegn01Inin01GroupD_Dummy.EotProtnEntrGainY  # UB:Derived from original system description
    connect CalRegn01Inin01GroupD.EotProtnEntrStLpFilFrq -> AAACalRegn01Inin01GroupD_Dummy.EotProtnEntrStLpFilFrq  # UB:Derived from original system description
    connect CalRegn01Inin01GroupD.EotProtnExitDampgY -> AAACalRegn01Inin01GroupD_Dummy.EotProtnExitDampgY  # UB:Derived from original system description
    connect CalRegn01Inin01GroupD.EotProtnExitStLpFilFrq -> AAACalRegn01Inin01GroupD_Dummy.EotProtnExitStLpFilFrq  # UB:Derived from original system description
    connect CalRegn01Inin01GroupD.EotProtnHwDegDampgX -> AAACalRegn01Inin01GroupD_Dummy.EotProtnHwDegDampgX  # UB:Derived from original system description
    connect CalRegn01Inin01GroupD.EotProtnHwTqLpFilFrq -> AAACalRegn01Inin01GroupD_Dummy.EotProtnHwTqLpFilFrq  # UB:Derived from original system description
    connect CalRegn01Inin01GroupD.EotProtnHwTqScaX -> AAACalRegn01Inin01GroupD_Dummy.EotProtnHwTqScaX  # UB:Derived from original system description
    connect CalRegn01Inin01GroupD.EotProtnLoAuthyEntrGainY -> AAACalRegn01Inin01GroupD_Dummy.EotProtnLoAuthyEntrGainY  # UB:Derived from original system description
    connect CalRegn01Inin01GroupD.EotProtnMotSpdIncptSca -> AAACalRegn01Inin01GroupD_Dummy.EotProtnMotSpdIncptSca  # UB:Derived from original system description
    connect CalRegn01Inin01GroupD.EotProtnMotSpdIncptX -> AAACalRegn01Inin01GroupD_Dummy.EotProtnMotSpdIncptX  # UB:Derived from original system description
    connect CalRegn01Inin01GroupD.EotProtnMotSpdIncptY -> AAACalRegn01Inin01GroupD_Dummy.EotProtnMotSpdIncptY  # UB:Derived from original system description
    connect CalRegn01Inin01GroupD.EotProtnMotVelGain -> AAACalRegn01Inin01GroupD_Dummy.EotProtnMotVelGain  # UB:Derived from original system description
    connect CalRegn01Inin01GroupD.EotProtnNormDampgY -> AAACalRegn01Inin01GroupD_Dummy.EotProtnNormDampgY  # UB:Derived from original system description
    connect CalRegn01Inin01GroupD.EotProtnPosnRampStep -> AAACalRegn01Inin01GroupD_Dummy.EotProtnPosnRampStep  # UB:Derived from original system description
    connect CalRegn01Inin01GroupD.EotProtnRackTrvlLimrAuthyThd -> AAACalRegn01Inin01GroupD_Dummy.EotProtnRackTrvlLimrAuthyThd  # UB:Derived from original system description
    connect CalRegn01Inin01GroupD.EotProtnRackTrvlLimrAuthyThdLimd -> AAACalRegn01Inin01GroupD_Dummy.EotProtnRackTrvlLimrAuthyThdLimd  # UB:Derived from original system description
    connect CalRegn01Inin01GroupD.EotProtnRackTrvlLimrRng -> AAACalRegn01Inin01GroupD_Dummy.EotProtnRackTrvlLimrRng  # UB:Derived from original system description
    connect CalRegn01Inin01GroupD.EotProtnRackTrvlLimrRngLimd -> AAACalRegn01Inin01GroupD_Dummy.EotProtnRackTrvlLimrRngLimd  # UB:Derived from original system description
    connect CalRegn01Inin01GroupD.EotProtnRackTrvlLimrVehSpdThd -> AAACalRegn01Inin01GroupD_Dummy.EotProtnRackTrvlLimrVehSpdThd  # UB:Derived from original system description
    connect CalRegn01Inin01GroupD.EotProtnRunEotVelImpctAndSoftEndStop -> AAACalRegn01Inin01GroupD_Dummy.EotProtnRunEotVelImpctAndSoftEndStop  # UB:Derived from original system description
    connect CalRegn01Inin01GroupD.InertiaCmpVelAssiBasdDampgCoeffX -> AAACalRegn01Inin01GroupD_Dummy.InertiaCmpVelAssiBasdDampgCoeffX  # UB:Derived from original system description
    connect CalRegn01Inin01GroupD.InertiaCmpVelAssiBasdDampgRollgWhlImbRejctnOnY -> AAACalRegn01Inin01GroupD_Dummy.InertiaCmpVelAssiBasdDampgRollgWhlImbRejctnOnY  # UB:Derived from original system description
    connect CalRegn01Inin01GroupD.InertiaCmpVelAssiBasdDampgRollgY -> AAACalRegn01Inin01GroupD_Dummy.InertiaCmpVelAssiBasdDampgRollgY  # UB:Derived from original system description
    connect CalRegn01Inin01GroupD.InertiaCmpVelAssiBasdDampgStatWhlImbRejctnOnY -> AAACalRegn01Inin01GroupD_Dummy.InertiaCmpVelAssiBasdDampgStatWhlImbRejctnOnY  # UB:Derived from original system description
    connect CalRegn01Inin01GroupD.InertiaCmpVelAssiBasdDampgStatY -> AAACalRegn01Inin01GroupD_Dummy.InertiaCmpVelAssiBasdDampgStatY  # UB:Derived from original system description
    connect CalRegn01Inin01GroupD.InertiaCmpVelCmdScaY -> AAACalRegn01Inin01GroupD_Dummy.InertiaCmpVelCmdScaY  # UB:Derived from original system description
    connect CalRegn01Inin01GroupD.InertiaCmpVelDampgDecelGain -> AAACalRegn01Inin01GroupD_Dummy.InertiaCmpVelDampgDecelGain  # UB:Derived from original system description
    connect CalRegn01Inin01GroupD.InertiaCmpVelDampgDecelGainFallSlew -> AAACalRegn01Inin01GroupD_Dummy.InertiaCmpVelDampgDecelGainFallSlew  # UB:Derived from original system description
    connect CalRegn01Inin01GroupD.InertiaCmpVelDampgDecelGainRisngSlewX -> AAACalRegn01Inin01GroupD_Dummy.InertiaCmpVelDampgDecelGainRisngSlewX  # UB:Derived from original system description
    connect CalRegn01Inin01GroupD.InertiaCmpVelDampgDecelGainRisngSlewY -> AAACalRegn01Inin01GroupD_Dummy.InertiaCmpVelDampgDecelGainRisngSlewY  # UB:Derived from original system description
    connect CalRegn01Inin01GroupD.InertiaCmpVelDampgFilFrq -> AAACalRegn01Inin01GroupD_Dummy.InertiaCmpVelDampgFilFrq  # UB:Derived from original system description
    connect CalRegn01Inin01GroupD.InertiaCmpVelDampgFilFrqWhlImbRejctnOn -> AAACalRegn01Inin01GroupD_Dummy.InertiaCmpVelDampgFilFrqWhlImbRejctnOn  # UB:Derived from original system description
    connect CalRegn01Inin01GroupD.InertiaCmpVelDampgGainOffThd -> AAACalRegn01Inin01GroupD_Dummy.InertiaCmpVelDampgGainOffThd  # UB:Derived from original system description
    connect CalRegn01Inin01GroupD.InertiaCmpVelDampgGainOnThd -> AAACalRegn01Inin01GroupD_Dummy.InertiaCmpVelDampgGainOnThd  # UB:Derived from original system description
    connect CalRegn01Inin01GroupD.InertiaCmpVelDampgSpdBlndY -> AAACalRegn01Inin01GroupD_Dummy.InertiaCmpVelDampgSpdBlndY  # UB:Derived from original system description
    connect CalRegn01Inin01GroupD.InertiaCmpVelDampgWhlImbRejctnBlndX -> AAACalRegn01Inin01GroupD_Dummy.InertiaCmpVelDampgWhlImbRejctnBlndX  # UB:Derived from original system description
    connect CalRegn01Inin01GroupD.InertiaCmpVelDampgWhlImbRejctnBlndY -> AAACalRegn01Inin01GroupD_Dummy.InertiaCmpVelDampgWhlImbRejctnBlndY  # UB:Derived from original system description
    connect CalRegn01Inin01GroupD.InertiaCmpVelDecelGainEnaCal -> AAACalRegn01Inin01GroupD_Dummy.InertiaCmpVelDecelGainEnaCal  # UB:Derived from original system description
    connect CalRegn01Inin01GroupD.InertiaCmpVelModWhlImbRejctnBlndX -> AAACalRegn01Inin01GroupD_Dummy.InertiaCmpVelModWhlImbRejctnBlndX  # UB:Derived from original system description
    connect CalRegn01Inin01GroupD.InertiaCmpVelModWhlImbRejctnBlndY -> AAACalRegn01Inin01GroupD_Dummy.InertiaCmpVelModWhlImbRejctnBlndY  # UB:Derived from original system description
    connect CalRegn01Inin01GroupD.InertiaCmpVelMotInertia -> AAACalRegn01Inin01GroupD_Dummy.InertiaCmpVelMotInertia  # UB:Derived from original system description
    connect CalRegn01Inin01GroupD.InertiaCmpVelMotVelBasdOutpScagX -> AAACalRegn01Inin01GroupD_Dummy.InertiaCmpVelMotVelBasdOutpScagX  # UB:Derived from original system description
    connect CalRegn01Inin01GroupD.InertiaCmpVelMotVelBasdOutpScagY -> AAACalRegn01Inin01GroupD_Dummy.InertiaCmpVelMotVelBasdOutpScagY  # UB:Derived from original system description
    connect CalRegn01Inin01GroupD.InertiaCmpVelNotchBlndY -> AAACalRegn01Inin01GroupD_Dummy.InertiaCmpVelNotchBlndY  # UB:Derived from original system description
    connect CalRegn01Inin01GroupD.InertiaCmpVelNotchFilStruct -> AAACalRegn01Inin01GroupD_Dummy.InertiaCmpVelNotchFilStruct  # UB:Derived from original system description
    connect CalRegn01Inin01GroupD.InertiaCmpVelTqSnsrVelFilFrq -> AAACalRegn01Inin01GroupD_Dummy.InertiaCmpVelTqSnsrVelFilFrq  # UB:Derived from original system description
    connect CalRegn01Inin01GroupD.InertiaCmpVelTqSnsrVelSca -> AAACalRegn01Inin01GroupD_Dummy.InertiaCmpVelTqSnsrVelSca  # UB:Derived from original system description
    connect CalRegn01Inin02.BmwHwAgArbnAndEotPosnKineIntegrityDiagcMaxRackLim -> AAACalRegn01Inin02_Dummy.BmwHwAgArbnAndEotPosnKineIntegrityDiagcMaxRackLim  # UB:Derived from original system description
    connect CalRegn01Inin02.EffortScaBlndX -> AAACalRegn01Inin02_Dummy.EffortScaBlndX  # UB:Derived from original system description
    connect CalRegn01Inin02.EffortScaBlndY -> AAACalRegn01Inin02_Dummy.EffortScaBlndY  # UB:Derived from original system description
    connect CalRegn01Inin02.EffortScaRackFThd -> AAACalRegn01Inin02_Dummy.EffortScaRackFThd  # UB:Derived from original system description
    connect CalRegn01Inin02.PosnTrakgServoArbnFltMtgtnLpFilCutOffFrq -> AAACalRegn01Inin02_Dummy.PosnTrakgServoArbnFltMtgtnLpFilCutOffFrq  # UB:Derived from original system description
    connect CalRegn01Inin02.PullCmpActvHwTqFilFrqLrngEna -> AAACalRegn01Inin02_Dummy.PullCmpActvHwTqFilFrqLrngEna  # UB:Derived from original system description
    connect CalRegn01Inin02.PullCmpActvYawRateFilFrq -> AAACalRegn01Inin02_Dummy.PullCmpActvYawRateFilFrq  # UB:Derived from original system description
    connect CalRegn01Inin02.SysFricLrngAvrgFricFrq -> AAACalRegn01Inin02_Dummy.SysFricLrngAvrgFricFrq  # UB:Derived from original system description
    connect CalRegn01Inin02.SysFricLrngBasLineEolFric -> AAACalRegn01Inin02_Dummy.SysFricLrngBasLineEolFric  # UB:Derived from original system description
    connect CalRegn01Inin02.SysFricLrngBasLineFric -> AAACalRegn01Inin02_Dummy.SysFricLrngBasLineFric  # UB:Derived from original system description
    connect CalRegn01Inin02.SysFricLrngBasLineHys -> AAACalRegn01Inin02_Dummy.SysFricLrngBasLineHys  # UB:Derived from original system description
    connect CalRegn01Inin02.SysFricLrngBasLineRngCntr -> AAACalRegn01Inin02_Dummy.SysFricLrngBasLineRngCntr  # UB:Derived from original system description
    connect CalRegn01Inin02.SysFricLrngDataPrepLpFilFrq -> AAACalRegn01Inin02_Dummy.SysFricLrngDataPrepLpFilFrq  # UB:Derived from original system description
    connect CalRegn01Inin02.SysFricLrngDebStep -> AAACalRegn01Inin02_Dummy.SysFricLrngDebStep  # UB:Derived from original system description
    connect CalRegn01Inin02.SysFricLrngEolFricDifHiLim -> AAACalRegn01Inin02_Dummy.SysFricLrngEolFricDifHiLim  # UB:Derived from original system description
    connect CalRegn01Inin02.SysFricLrngEolFricDifLoLim -> AAACalRegn01Inin02_Dummy.SysFricLrngEolFricDifLoLim  # UB:Derived from original system description
    connect CalRegn01Inin02.SysFricLrngEolFricDifScagFac -> AAACalRegn01Inin02_Dummy.SysFricLrngEolFricDifScagFac  # UB:Derived from original system description
    connect CalRegn01Inin02.SysFricLrngFricChgWght -> AAACalRegn01Inin02_Dummy.SysFricLrngFricChgWght  # UB:Derived from original system description
    connect CalRegn01Inin02.SysFricLrngFricDiagcThd -> AAACalRegn01Inin02_Dummy.SysFricLrngFricDiagcThd  # UB:Derived from original system description
    connect CalRegn01Inin02.SysFricLrngFricHysHwAgPt -> AAACalRegn01Inin02_Dummy.SysFricLrngFricHysHwAgPt  # UB:Derived from original system description
    connect CalRegn01Inin02.SysFricLrngFricOffs -> AAACalRegn01Inin02_Dummy.SysFricLrngFricOffs  # UB:Derived from original system description
    connect CalRegn01Inin02.SysFricLrngFricOffsHiLim -> AAACalRegn01Inin02_Dummy.SysFricLrngFricOffsHiLim  # UB:Derived from original system description
    connect CalRegn01Inin02.SysFricLrngFricOffsLoLim -> AAACalRegn01Inin02_Dummy.SysFricLrngFricOffsLoLim  # UB:Derived from original system description
    connect CalRegn01Inin02.SysFricLrngFricOffsLpFilFrq -> AAACalRegn01Inin02_Dummy.SysFricLrngFricOffsLpFilFrq  # UB:Derived from original system description
    connect CalRegn01Inin02.SysFricLrngGain -> AAACalRegn01Inin02_Dummy.SysFricLrngGain  # UB:Derived from original system description
    connect CalRegn01Inin02.SysFricLrngHiFricDebStep -> AAACalRegn01Inin02_Dummy.SysFricLrngHiFricDebStep  # UB:Derived from original system description
    connect CalRegn01Inin02.SysFricLrngHiFricDiagcThd -> AAACalRegn01Inin02_Dummy.SysFricLrngHiFricDiagcThd  # UB:Derived from original system description
    connect CalRegn01Inin02.SysFricLrngHwPosnAuthyThd -> AAACalRegn01Inin02_Dummy.SysFricLrngHwPosnAuthyThd  # UB:Derived from original system description
    connect CalRegn01Inin02.SysFricLrngHwVelConstrLim -> AAACalRegn01Inin02_Dummy.SysFricLrngHwVelConstrLim  # UB:Derived from original system description
    connect CalRegn01Inin02.SysFricLrngHwVelHiLim -> AAACalRegn01Inin02_Dummy.SysFricLrngHwVelHiLim  # UB:Derived from original system description
    connect CalRegn01Inin02.SysFricLrngHwVelLoLim -> AAACalRegn01Inin02_Dummy.SysFricLrngHwVelLoLim  # UB:Derived from original system description
    connect CalRegn01Inin02.SysFricLrngIgnCycFricChgLim -> AAACalRegn01Inin02_Dummy.SysFricLrngIgnCycFricChgLim  # UB:Derived from original system description
    connect CalRegn01Inin02.SysFricLrngIgnCycFricOffs -> AAACalRegn01Inin02_Dummy.SysFricLrngIgnCycFricOffs  # UB:Derived from original system description
    connect CalRegn01Inin02.SysFricLrngIvsTrsmRatX -> AAACalRegn01Inin02_Dummy.SysFricLrngIvsTrsmRatX  # UB:Derived from original system description
    connect CalRegn01Inin02.SysFricLrngIvsTrsmRatY -> AAACalRegn01Inin02_Dummy.SysFricLrngIvsTrsmRatY  # UB:Derived from original system description
    connect CalRegn01Inin02.SysFricLrngLatAHiLim -> AAACalRegn01Inin02_Dummy.SysFricLrngLatAHiLim  # UB:Derived from original system description
    connect CalRegn01Inin02.SysFricLrngLatALoLim -> AAACalRegn01Inin02_Dummy.SysFricLrngLatALoLim  # UB:Derived from original system description
    connect CalRegn01Inin02.SysFricLrngMaskVehSpd -> AAACalRegn01Inin02_Dummy.SysFricLrngMaskVehSpd  # UB:Derived from original system description
    connect CalRegn01Inin02.SysFricLrngRngCntrThd -> AAACalRegn01Inin02_Dummy.SysFricLrngRngCntrThd  # UB:Derived from original system description
    connect CalRegn01Inin02.SysFricLrngThd -> AAACalRegn01Inin02_Dummy.SysFricLrngThd  # UB:Derived from original system description
    connect CalRegn01Inin02.SysFricLrngTHiLim -> AAACalRegn01Inin02_Dummy.SysFricLrngTHiLim  # UB:Derived from original system description
    connect CalRegn01Inin02.SysFricLrngTLoLim -> AAACalRegn01Inin02_Dummy.SysFricLrngTLoLim  # UB:Derived from original system description
    connect CalRegn01Inin02.SysFricLrngVehSpd -> AAACalRegn01Inin02_Dummy.SysFricLrngVehSpd  # UB:Derived from original system description
    connect CalRegn01Inin02.SysGlbPrmSysKineRat -> AAACalRegn01Inin02_Dummy.SysGlbPrmSysKineRat  # UB:Derived from original system description
    connect CalRegn01Inin02.SysGlbPrmVehSpdBilnrSeln -> AAACalRegn01Inin02_Dummy.SysGlbPrmVehSpdBilnrSeln  # UB:Derived from original system description
    connect CalRegn01Inin02.SysKineAndEffMotAgToRackPosRatScaY -> AAACalRegn01Inin02_Dummy.SysKineAndEffMotAgToRackPosRatScaY  # UB:Derived from original system description
    connect CalRegn01Inin02.SysKineAndEffPinionAgToRackPosRatScaY -> AAACalRegn01Inin02_Dummy.SysKineAndEffPinionAgToRackPosRatScaY  # UB:Derived from original system description
    connect CalRegn01Inin02.SysKineAndEffPinionToRackEffScaY -> AAACalRegn01Inin02_Dummy.SysKineAndEffPinionToRackEffScaY  # UB:Derived from original system description
    connect CalRegn01Inin02.SysKineAndEffRoadWhlFromRackPosScaY -> AAACalRegn01Inin02_Dummy.SysKineAndEffRoadWhlFromRackPosScaY  # UB:Derived from original system description
    connect CalRegn01Inin02.SysKineAndEffSteerArmLenFromRackPosScaY -> AAACalRegn01Inin02_Dummy.SysKineAndEffSteerArmLenFromRackPosScaY  # UB:Derived from original system description
    connect CalRegn01Inin02.TunSelnAuthyVehSpdX -> AAACalRegn01Inin02_Dummy.TunSelnAuthyVehSpdX  # UB:Derived from original system description
    connect CalRegn01Inin02GroupA.BmwHwAgArbnAndEotPosnEotCcwMax -> AAACalRegn01Inin02GroupA_Dummy.BmwHwAgArbnAndEotPosnEotCcwMax  # UB:Derived from original system description
    connect CalRegn01Inin02GroupA.BmwHwAgArbnAndEotPosnEotCcwMin -> AAACalRegn01Inin02GroupA_Dummy.BmwHwAgArbnAndEotPosnEotCcwMin  # UB:Derived from original system description
    connect CalRegn01Inin02GroupA.BmwHwAgArbnAndEotPosnEotCwMax -> AAACalRegn01Inin02GroupA_Dummy.BmwHwAgArbnAndEotPosnEotCwMax  # UB:Derived from original system description
    connect CalRegn01Inin02GroupA.BmwHwAgArbnAndEotPosnEotCwMin -> AAACalRegn01Inin02GroupA_Dummy.BmwHwAgArbnAndEotPosnEotCwMin  # UB:Derived from original system description
    connect CalRegn01Inin02GroupA.BmwPwrPrkgDampgDiScadDampg -> AAACalRegn01Inin02GroupA_Dummy.BmwPwrPrkgDampgDiScadDampg  # UB:Derived from original system description
    connect CalRegn01Inin02GroupA.BmwPwrPrkgDampgMaxRate -> AAACalRegn01Inin02GroupA_Dummy.BmwPwrPrkgDampgMaxRate  # UB:Derived from original system description
    connect CalRegn01Inin02GroupA.EpsStEstimnMtrxA -> AAACalRegn01Inin02GroupA_Dummy.EpsStEstimnMtrxA  # UB:Derived from original system description
    connect CalRegn01Inin02GroupA.EpsStEstimnMtrxB -> AAACalRegn01Inin02GroupA_Dummy.EpsStEstimnMtrxB  # UB:Derived from original system description
    connect CalRegn01Inin02GroupA.EpsStEstimnMtrxC -> AAACalRegn01Inin02GroupA_Dummy.EpsStEstimnMtrxC  # UB:Derived from original system description
    connect CalRegn01Inin02GroupA.EpsStEstimnMtrxD -> AAACalRegn01Inin02GroupA_Dummy.EpsStEstimnMtrxD  # UB:Derived from original system description
    connect CalRegn01Inin02GroupA.HwTqTrakgCtrlFbGain{1..5} -> AAACalRegn01Inin02GroupA_Dummy.HwTqTrakgCtrlFbGain{1..5}  # UB:Derived from original system description
    connect CalRegn01Inin02GroupA.HwTqTrakgCtrlFfGainScaY -> AAACalRegn01Inin02GroupA_Dummy.HwTqTrakgCtrlFfGainScaY  # UB:Derived from original system description
    connect CalRegn01Inin02GroupA.HwTqTrakgCtrlVehSpdScaX -> AAACalRegn01Inin02GroupA_Dummy.HwTqTrakgCtrlVehSpdScaX  # UB:Derived from original system description
    connect CalRegn01Inin02GroupA.PosnTrakgServoEnaBlndFacTblX -> AAACalRegn01Inin02GroupA_Dummy.PosnTrakgServoEnaBlndFacTblX  # UB:Derived from original system description
    connect CalRegn01Inin02GroupA.PosnTrakgServoEnaBlndFacTblY -> AAACalRegn01Inin02GroupA_Dummy.PosnTrakgServoEnaBlndFacTblY  # UB:Derived from original system description
    connect CalRegn01Inin02GroupA.PosnTrakgServoGainArbnFltMtgtn -> AAACalRegn01Inin02GroupA_Dummy.PosnTrakgServoGainArbnFltMtgtn  # UB:Derived from original system description
    connect CalRegn01Inin02GroupA.PullCmpActvCmpLrnTiDecShoTerm -> AAACalRegn01Inin02GroupA_Dummy.PullCmpActvCmpLrnTiDecShoTerm  # UB:Derived from original system description
    connect CalRegn01Inin02GroupA.PullCmpActvCmpLrnTiIncShoTerm -> AAACalRegn01Inin02GroupA_Dummy.PullCmpActvCmpLrnTiIncShoTerm  # UB:Derived from original system description
    connect CalRegn01Inin02GroupA.PullCmpActvCmpLrnTiLongTerm -> AAACalRegn01Inin02GroupA_Dummy.PullCmpActvCmpLrnTiLongTerm  # UB:Derived from original system description
    connect CalRegn01Inin02GroupA.PullCmpActvCmpShoTermRstHwAgThd -> AAACalRegn01Inin02GroupA_Dummy.PullCmpActvCmpShoTermRstHwAgThd  # UB:Derived from original system description
    connect CalRegn01Inin02GroupA.PullCmpActvCmpShoTermRstHwTqThd -> AAACalRegn01Inin02GroupA_Dummy.PullCmpActvCmpShoTermRstHwTqThd  # UB:Derived from original system description
    connect CalRegn01Inin02GroupA.PullCmpActvCmpShoTermRstLatAThd -> AAACalRegn01Inin02GroupA_Dummy.PullCmpActvCmpShoTermRstLatAThd  # UB:Derived from original system description
    connect CalRegn01Inin02GroupA.PullCmpActvCmpShoTermRstYawRateThd -> AAACalRegn01Inin02GroupA_Dummy.PullCmpActvCmpShoTermRstYawRateThd  # UB:Derived from original system description
    connect CalRegn01Inin02GroupA.PullCmpActvEna -> AAACalRegn01Inin02GroupA_Dummy.PullCmpActvEna  # UB:Derived from original system description
    connect CalRegn01Inin02GroupA.PullCmpActvHwTqFilFrqLongTerm -> AAACalRegn01Inin02GroupA_Dummy.PullCmpActvHwTqFilFrqLongTerm  # UB:Derived from original system description
    connect CalRegn01Inin02GroupA.PullCmpActvHwTqFilFrqShoTerm -> AAACalRegn01Inin02GroupA_Dummy.PullCmpActvHwTqFilFrqShoTerm  # UB:Derived from original system description
    connect CalRegn01Inin02GroupA.PullCmpActvLongTermLim -> AAACalRegn01Inin02GroupA_Dummy.PullCmpActvLongTermLim  # UB:Derived from original system description
    connect CalRegn01Inin02GroupA.PullCmpActvLrngEnaAgConfMinMgn -> AAACalRegn01Inin02GroupA_Dummy.PullCmpActvLrngEnaAgConfMinMgn  # UB:Derived from original system description
    connect CalRegn01Inin02GroupA.PullCmpActvLrngEnaHwAgMaxMgn -> AAACalRegn01Inin02GroupA_Dummy.PullCmpActvLrngEnaHwAgMaxMgn  # UB:Derived from original system description
    connect CalRegn01Inin02GroupA.PullCmpActvLrngEnaHwTqMaxMgn -> AAACalRegn01Inin02GroupA_Dummy.PullCmpActvLrngEnaHwTqMaxMgn  # UB:Derived from original system description
    connect CalRegn01Inin02GroupA.PullCmpActvLrngEnaHwVelMaxMgn -> AAACalRegn01Inin02GroupA_Dummy.PullCmpActvLrngEnaHwVelMaxMgn  # UB:Derived from original system description
    connect CalRegn01Inin02GroupA.PullCmpActvLrngEnaLatAMaxMgn -> AAACalRegn01Inin02GroupA_Dummy.PullCmpActvLrngEnaLatAMaxMgn  # UB:Derived from original system description
    connect CalRegn01Inin02GroupA.PullCmpActvLrngEnaTiThd -> AAACalRegn01Inin02GroupA_Dummy.PullCmpActvLrngEnaTiThd  # UB:Derived from original system description
    connect CalRegn01Inin02GroupA.PullCmpActvLrngEnaVehSpdMaxMgn -> AAACalRegn01Inin02GroupA_Dummy.PullCmpActvLrngEnaVehSpdMaxMgn  # UB:Derived from original system description
    connect CalRegn01Inin02GroupA.PullCmpActvLrngEnaVehSpdMinMgn -> AAACalRegn01Inin02GroupA_Dummy.PullCmpActvLrngEnaVehSpdMinMgn  # UB:Derived from original system description
    connect CalRegn01Inin02GroupA.PullCmpActvLrngEnaVehSpdRateMaxMgn -> AAACalRegn01Inin02GroupA_Dummy.PullCmpActvLrngEnaVehSpdRateMaxMgn  # UB:Derived from original system description
    connect CalRegn01Inin02GroupA.PullCmpActvLrngEnaYawRateMaxMgn -> AAACalRegn01Inin02GroupA_Dummy.PullCmpActvLrngEnaYawRateMaxMgn  # UB:Derived from original system description
    connect CalRegn01Inin02GroupA.PullCmpActvOpstSignTiShoTerm -> AAACalRegn01Inin02GroupA_Dummy.PullCmpActvOpstSignTiShoTerm  # UB:Derived from original system description
    connect CalRegn01Inin02GroupA.PullCmpActvOutpMaxRate -> AAACalRegn01Inin02GroupA_Dummy.PullCmpActvOutpMaxRate  # UB:Derived from original system description
    connect CalRegn01Inin02GroupA.PullCmpActvPullCmpShoTermLim -> AAACalRegn01Inin02GroupA_Dummy.PullCmpActvPullCmpShoTermLim  # UB:Derived from original system description
    connect CalRegn01Inin02GroupA.PullCmpActvPullCmpTotLim -> AAACalRegn01Inin02GroupA_Dummy.PullCmpActvPullCmpTotLim  # UB:Derived from original system description
    connect CalRegn01Inin02GroupA.PullCmpActvPullErrLimLongTerm -> AAACalRegn01Inin02GroupA_Dummy.PullCmpActvPullErrLimLongTerm  # UB:Derived from original system description
    connect CalRegn01Inin02GroupA.PullCmpActvPullErrMgnThd -> AAACalRegn01Inin02GroupA_Dummy.PullCmpActvPullErrMgnThd  # UB:Derived from original system description
    connect CalRegn01Inin02GroupA.PullCmpActvPullErrShoTermLim -> AAACalRegn01Inin02GroupA_Dummy.PullCmpActvPullErrShoTermLim  # UB:Derived from original system description
    connect CalRegn01Inin02GroupA.PullCmpActvShoTermRampTi -> AAACalRegn01Inin02GroupA_Dummy.PullCmpActvShoTermRampTi  # UB:Derived from original system description
    connect CalRegn01Inin02GroupA.PullCmpActvVehSpdScaTblX -> AAACalRegn01Inin02GroupA_Dummy.PullCmpActvVehSpdScaTblX  # UB:Derived from original system description
    connect CalRegn01Inin02GroupA.PullCmpActvVehSpdScaTblY -> AAACalRegn01Inin02GroupA_Dummy.PullCmpActvVehSpdScaTblY  # UB:Derived from original system description
    connect CalRegn01Inin02GroupC.CtrldVelRtnDesVelLpFilFrq -> AAACalRegn01Inin02GroupC_Dummy.CtrldVelRtnDesVelLpFilFrq  # UB:Derived from original system description
    connect CalRegn01Inin02GroupC.CtrldVelRtnHwTqLpFilFrq -> AAACalRegn01Inin02GroupC_Dummy.CtrldVelRtnHwTqLpFilFrq  # UB:Derived from original system description
    connect CalRegn01Inin02GroupC.CtrldVelRtnHwTqScaSelnSlewHiLim -> AAACalRegn01Inin02GroupC_Dummy.CtrldVelRtnHwTqScaSelnSlewHiLim  # UB:Derived from original system description
    connect CalRegn01Inin02GroupC.CtrldVelRtnHwTqScaSelnSlewLoLim -> AAACalRegn01Inin02GroupC_Dummy.CtrldVelRtnHwTqScaSelnSlewLoLim  # UB:Derived from original system description
    connect CalRegn01Inin02GroupC.CtrldVelRtnHwTqScaSelnTqThd -> AAACalRegn01Inin02GroupC_Dummy.CtrldVelRtnHwTqScaSelnTqThd  # UB:Derived from original system description
    connect CalRegn01Inin02GroupC.CtrldVelRtnHwTqScaSelnVelThd -> AAACalRegn01Inin02GroupC_Dummy.CtrldVelRtnHwTqScaSelnVelThd  # UB:Derived from original system description
    connect CalRegn01Inin02GroupC.CtrldVelRtnIntgrLimY -> AAACalRegn01Inin02GroupC_Dummy.CtrldVelRtnIntgrLimY  # UB:Derived from original system description
    connect CalRegn01Inin02GroupC.CtrldVelRtnOffsSlewThd -> AAACalRegn01Inin02GroupC_Dummy.CtrldVelRtnOffsSlewThd  # UB:Derived from original system description
    connect CalRegn01Inin02GroupC.CtrldVelRtnOffsThd -> AAACalRegn01Inin02GroupC_Dummy.CtrldVelRtnOffsThd  # UB:Derived from original system description
    connect CalRegn01Inin02GroupC.CtrldVelRtnScaLpFilFrq -> AAACalRegn01Inin02GroupC_Dummy.CtrldVelRtnScaLpFilFrq  # UB:Derived from original system description
    connect CalRegn01Inin02GroupC.FalbckAssiAssiX -> AAACalRegn01Inin02GroupC_Dummy.FalbckAssiAssiX  # UB:Derived from original system description
    connect CalRegn01Inin02GroupC.FalbckAssiAssiY -> AAACalRegn01Inin02GroupC_Dummy.FalbckAssiAssiY  # UB:Derived from original system description
    connect CalRegn01Inin02GroupC.FalbckAssiNotchFil -> AAACalRegn01Inin02GroupC_Dummy.FalbckAssiNotchFil  # UB:Derived from original system description
    connect CalRegn01Inin02GroupC.GlbLimrBndX -> AAACalRegn01Inin02GroupC_Dummy.GlbLimrBndX  # UB:Derived from original system description
    connect CalRegn01Inin02GroupC.GlbLimrBndY -> AAACalRegn01Inin02GroupC_Dummy.GlbLimrBndY  # UB:Derived from original system description
    connect CalRegn01Inin02GroupC.GlbLimrNotchFilStruct -> AAACalRegn01Inin02GroupC_Dummy.GlbLimrNotchFilStruct  # UB:Derived from original system description
    connect CalRegn01Inin02GroupC.GlbLimrVehSpdBilnrSeln -> AAACalRegn01Inin02GroupC_Dummy.GlbLimrVehSpdBilnrSeln  # UB:Derived from original system description
    connect CalRegn01Inin02GroupD.EotProtnDampgVehSpdTbl -> AAACalRegn01Inin02GroupD_Dummy.EotProtnDampgVehSpdTbl  # UB:Derived from original system description
    connect CalRegn01Inin02GroupD.EotProtnDeltaTqThd -> AAACalRegn01Inin02GroupD_Dummy.EotProtnDeltaTqThd  # UB:Derived from original system description
    connect CalRegn01Inin02GroupD.EotProtnEntrGainAuthyThd -> AAACalRegn01Inin02GroupD_Dummy.EotProtnEntrGainAuthyThd  # UB:Derived from original system description
    connect CalRegn01Inin02GroupD.EotProtnEntrGainVehSpdTbl -> AAACalRegn01Inin02GroupD_Dummy.EotProtnEntrGainVehSpdTbl  # UB:Derived from original system description
    connect CalRegn01Inin02GroupD.EotProtnEntrGainX -> AAACalRegn01Inin02GroupD_Dummy.EotProtnEntrGainX  # UB:Derived from original system description
    connect CalRegn01Inin02GroupD.EotProtnEntrGainY -> AAACalRegn01Inin02GroupD_Dummy.EotProtnEntrGainY  # UB:Derived from original system description
    connect CalRegn01Inin02GroupD.EotProtnEntrStLpFilFrq -> AAACalRegn01Inin02GroupD_Dummy.EotProtnEntrStLpFilFrq  # UB:Derived from original system description
    connect CalRegn01Inin02GroupD.EotProtnExitDampgY -> AAACalRegn01Inin02GroupD_Dummy.EotProtnExitDampgY  # UB:Derived from original system description
    connect CalRegn01Inin02GroupD.EotProtnExitStLpFilFrq -> AAACalRegn01Inin02GroupD_Dummy.EotProtnExitStLpFilFrq  # UB:Derived from original system description
    connect CalRegn01Inin02GroupD.EotProtnHwDegDampgX -> AAACalRegn01Inin02GroupD_Dummy.EotProtnHwDegDampgX  # UB:Derived from original system description
    connect CalRegn01Inin02GroupD.EotProtnHwTqLpFilFrq -> AAACalRegn01Inin02GroupD_Dummy.EotProtnHwTqLpFilFrq  # UB:Derived from original system description
    connect CalRegn01Inin02GroupD.EotProtnHwTqScaX -> AAACalRegn01Inin02GroupD_Dummy.EotProtnHwTqScaX  # UB:Derived from original system description
    connect CalRegn01Inin02GroupD.EotProtnLoAuthyEntrGainY -> AAACalRegn01Inin02GroupD_Dummy.EotProtnLoAuthyEntrGainY  # UB:Derived from original system description
