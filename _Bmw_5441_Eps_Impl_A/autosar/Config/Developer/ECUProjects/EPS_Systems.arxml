[part 2 of 3: package /BMW/SystemComposition]
AUTOSAR XML (schema 4-2-2)
package /BMW/SystemComposition  (continued)
  composition sw component type SystemComponent  (continued)
    connect CalRegn01Inin03GroupD.EotProtnEntrGainVehSpdTbl -> AAACalRegn01Inin03GroupD_Dummy.EotProtnEntrGainVehSpdTbl
    connect CalRegn01Inin03GroupD.EotProtnEntrGainX -> AAACalRegn01Inin03GroupD_Dummy.EotProtnEntrGainX
    connect CalRegn01Inin03GroupD.EotProtnEntrGainY -> AAACalRegn01Inin03GroupD_Dummy.EotProtnEntrGainY
    connect CalRegn01Inin03GroupD.EotProtnEntrStLpFilFrq -> AAACalRegn01Inin03GroupD_Dummy.EotProtnEntrStLpFilFrq
    connect CalRegn01Inin03GroupD.EotProtnExitDampgY -> AAACalRegn01Inin03GroupD_Dummy.EotProtnExitDampgY
    connect CalRegn01Inin03GroupD.EotProtnExitStLpFilFrq -> AAACalRegn01Inin03GroupD_Dummy.EotProtnExitStLpFilFrq
    connect CalRegn01Inin03GroupD.EotProtnHwDegDampgX -> AAACalRegn01Inin03GroupD_Dummy.EotProtnHwDegDampgX
    connect CalRegn01Inin03GroupD.EotProtnHwTqLpFilFrq -> AAACalRegn01Inin03GroupD_Dummy.EotProtnHwTqLpFilFrq
    connect CalRegn01Inin03GroupD.EotProtnHwTqScaX -> AAACalRegn01Inin03GroupD_Dummy.EotProtnHwTqScaX
    connect CalRegn01Inin03GroupD.EotProtnLoAuthyEntrGainY -> AAACalRegn01Inin03GroupD_Dummy.EotProtnLoAuthyEntrGainY
    connect CalRegn01Inin03GroupD.EotProtnMotSpdIncptSca -> AAACalRegn01Inin03GroupD_Dummy.EotProtnMotSpdIncptSca
    connect CalRegn01Inin03GroupD.EotProtnMotSpdIncptX -> AAACalRegn01Inin03GroupD_Dummy.EotProtnMotSpdIncptX
    connect CalRegn01Inin03GroupD.EotProtnMotSpdIncptY -> AAACalRegn01Inin03GroupD_Dummy.EotProtnMotSpdIncptY
    connect CalRegn01Inin03GroupD.EotProtnMotVelGain -> AAACalRegn01Inin03GroupD_Dummy.EotProtnMotVelGain
    connect CalRegn01Inin03GroupD.EotProtnNormDampgY -> AAACalRegn01Inin03GroupD_Dummy.EotProtnNormDampgY
    connect CalRegn01Inin03GroupD.EotProtnPosnRampStep -> AAACalRegn01Inin03GroupD_Dummy.EotProtnPosnRampStep
    connect CalRegn01Inin03GroupD.EotProtnRackTrvlLimrAuthyThd -> AAACalRegn01Inin03GroupD_Dummy.EotProtnRackTrvlLimrAuthyThd
    connect CalRegn01Inin03GroupD.EotProtnRackTrvlLimrAuthyThdLimd -> AAACalRegn01Inin03GroupD_Dummy.EotProtnRackTrvlLimrAuthyThdLimd
    connect CalRegn01Inin03GroupD.EotProtnRackTrvlLimrRng -> AAACalRegn01Inin03GroupD_Dummy.EotProtnRackTrvlLimrRng
    connect CalRegn01Inin03GroupD.EotProtnRackTrvlLimrRngLimd -> AAACalRegn01Inin03GroupD_Dummy.EotProtnRackTrvlLimrRngLimd
    connect CalRegn01Inin03GroupD.EotProtnRackTrvlLimrVehSpdThd -> AAACalRegn01Inin03GroupD_Dummy.EotProtnRackTrvlLimrVehSpdThd
    connect CalRegn01Inin03GroupD.EotProtnRunEotVelImpctAndSoftEndStop -> AAACalRegn01Inin03GroupD_Dummy.EotProtnRunEotVelImpctAndSoftEndStop
    connect CalRegn01Inin03GroupD.InertiaCmpVelAssiBasdDampgCoeffX -> AAACalRegn01Inin03GroupD_Dummy.InertiaCmpVelAssiBasdDampgCoeffX
    connect CalRegn01Inin03GroupD.InertiaCmpVelAssiBasdDampgRollgWhlImbRejctnOnY -> AAACalRegn01Inin03GroupD_Dummy.InertiaCmpVelAssiBasdDampgRollgWhlImbRejctnOnY
    connect CalRegn01Inin03GroupD.InertiaCmpVelAssiBasdDampgRollgY -> AAACalRegn01Inin03GroupD_Dummy.InertiaCmpVelAssiBasdDampgRollgY
    connect CalRegn01Inin03GroupD.InertiaCmpVelAssiBasdDampgStatWhlImbRejctnOnY -> AAACalRegn01Inin03GroupD_Dummy.InertiaCmpVelAssiBasdDampgStatWhlImbRejctnOnY
    connect CalRegn01Inin03GroupD.InertiaCmpVelAssiBasdDampgStatY -> AAACalRegn01Inin03GroupD_Dummy.InertiaCmpVelAssiBasdDampgStatY
    connect CalRegn01Inin03GroupD.InertiaCmpVelCmdScaY -> AAACalRegn01Inin03GroupD_Dummy.InertiaCmpVelCmdScaY
    connect CalRegn01Inin03GroupD.InertiaCmpVelDampgDecelGain -> AAACalRegn01Inin03GroupD_Dummy.InertiaCmpVelDampgDecelGain
    connect CalRegn01Inin03GroupD.InertiaCmpVelDampgDecelGainFallSlew -> AAACalRegn01Inin03GroupD_Dummy.InertiaCmpVelDampgDecelGainFallSlew
    connect CalRegn01Inin03GroupD.InertiaCmpVelDampgDecelGainRisngSlewX -> AAACalRegn01Inin03GroupD_Dummy.InertiaCmpVelDampgDecelGainRisngSlewX
    connect CalRegn01Inin03GroupD.InertiaCmpVelDampgDecelGainRisngSlewY -> AAACalRegn01Inin03GroupD_Dummy.InertiaCmpVelDampgDecelGainRisngSlewY
    connect CalRegn01Inin03GroupD.InertiaCmpVelDampgFilFrq -> AAACalRegn01Inin03GroupD_Dummy.InertiaCmpVelDampgFilFrq
    connect CalRegn01Inin03GroupD.InertiaCmpVelDampgFilFrqWhlImbRejctnOn -> AAACalRegn01Inin03GroupD_Dummy.InertiaCmpVelDampgFilFrqWhlImbRejctnOn
    connect CalRegn01Inin03GroupD.InertiaCmpVelDampgGainOffThd -> AAACalRegn01Inin03GroupD_Dummy.InertiaCmpVelDampgGainOffThd
    connect CalRegn01Inin03GroupD.InertiaCmpVelDampgGainOnThd -> AAACalRegn01Inin03GroupD_Dummy.InertiaCmpVelDampgGainOnThd
    connect CalRegn01Inin03GroupD.InertiaCmpVelDampgSpdBlndY -> AAACalRegn01Inin03GroupD_Dummy.InertiaCmpVelDampgSpdBlndY
    connect CalRegn01Inin03GroupD.InertiaCmpVelDampgWhlImbRejctnBlndX -> AAACalRegn01Inin03GroupD_Dummy.InertiaCmpVelDampgWhlImbRejctnBlndX
    connect CalRegn01Inin03GroupD.InertiaCmpVelDampgWhlImbRejctnBlndY -> AAACalRegn01Inin03GroupD_Dummy.InertiaCmpVelDampgWhlImbRejctnBlndY
    connect CalRegn01Inin03GroupD.InertiaCmpVelDecelGainEnaCal -> AAACalRegn01Inin03GroupD_Dummy.InertiaCmpVelDecelGainEnaCal
    connect CalRegn01Inin03GroupD.InertiaCmpVelModWhlImbRejctnBlndX -> AAACalRegn01Inin03GroupD_Dummy.InertiaCmpVelModWhlImbRejctnBlndX
    connect CalRegn01Inin03GroupD.InertiaCmpVelModWhlImbRejctnBlndY -> AAACalRegn01Inin03GroupD_Dummy.InertiaCmpVelModWhlImbRejctnBlndY
    connect CalRegn01Inin03GroupD.InertiaCmpVelMotInertia -> AAACalRegn01Inin03GroupD_Dummy.InertiaCmpVelMotInertia
    connect CalRegn01Inin03GroupD.InertiaCmpVelMotVelBasdOutpScagX -> AAACalRegn01Inin03GroupD_Dummy.InertiaCmpVelMotVelBasdOutpScagX
    connect CalRegn01Inin03GroupD.InertiaCmpVelMotVelBasdOutpScagY -> AAACalRegn01Inin03GroupD_Dummy.InertiaCmpVelMotVelBasdOutpScagY
    connect CalRegn01Inin03GroupD.InertiaCmpVelNotchBlndY -> AAACalRegn01Inin03GroupD_Dummy.InertiaCmpVelNotchBlndY
    connect CalRegn01Inin03GroupD.InertiaCmpVelNotchFilStruct -> AAACalRegn01Inin03GroupD_Dummy.InertiaCmpVelNotchFilStruct
    connect CalRegn01Inin03GroupD.InertiaCmpVelTqSnsrVelFilFrq -> AAACalRegn01Inin03GroupD_Dummy.InertiaCmpVelTqSnsrVelFilFrq
    connect CalRegn01Inin03GroupD.InertiaCmpVelTqSnsrVelSca -> AAACalRegn01Inin03GroupD_Dummy.InertiaCmpVelTqSnsrVelSca
    connect CalRegn01Inin04.BmwHwAgArbnAndEotPosnKineIntegrityDiagcMaxRackLim -> AAACalRegn01Inin04_Dummy.BmwHwAgArbnAndEotPosnKineIntegrityDiagcMaxRackLim
    connect CalRegn01Inin04.EffortScaBlndX -> AAACalRegn01Inin04_Dummy.EffortScaBlndX
    connect CalRegn01Inin04.EffortScaBlndY -> AAACalRegn01Inin04_Dummy.EffortScaBlndY
    connect CalRegn01Inin04.EffortScaRackFThd -> AAACalRegn01Inin04_Dummy.EffortScaRackFThd
    connect CalRegn01Inin04.PosnTrakgServoArbnFltMtgtnLpFilCutOffFrq -> AAACalRegn01Inin04_Dummy.PosnTrakgServoArbnFltMtgtnLpFilCutOffFrq
    connect CalRegn01Inin04.PullCmpActvHwTqFilFrqLrngEna -> AAACalRegn01Inin04_Dummy.PullCmpActvHwTqFilFrqLrngEna
    connect CalRegn01Inin04.PullCmpActvYawRateFilFrq -> AAACalRegn01Inin04_Dummy.PullCmpActvYawRateFilFrq
    connect CalRegn01Inin04.SysFricLrngAvrgFricFrq -> AAACalRegn01Inin04_Dummy.SysFricLrngAvrgFricFrq
    connect CalRegn01Inin04.SysFricLrngBasLineEolFric -> AAACalRegn01Inin04_Dummy.SysFricLrngBasLineEolFric
    connect CalRegn01Inin04.SysFricLrngBasLineFric -> AAACalRegn01Inin04_Dummy.SysFricLrngBasLineFric
    connect CalRegn01Inin04.SysFricLrngBasLineHys -> AAACalRegn01Inin04_Dummy.SysFricLrngBasLineHys
    connect CalRegn01Inin04.SysFricLrngBasLineRngCntr -> AAACalRegn01Inin04_Dummy.SysFricLrngBasLineRngCntr
    connect CalRegn01Inin04.SysFricLrngDataPrepLpFilFrq -> AAACalRegn01Inin04_Dummy.SysFricLrngDataPrepLpFilFrq
    connect CalRegn01Inin04.SysFricLrngDebStep -> AAACalRegn01Inin04_Dummy.SysFricLrngDebStep
    connect CalRegn01Inin04.SysFricLrngEolFricDifHiLim -> AAACalRegn01Inin04_Dummy.SysFricLrngEolFricDifHiLim
    connect CalRegn01Inin04.SysFricLrngEolFricDifLoLim -> AAACalRegn01Inin04_Dummy.SysFricLrngEolFricDifLoLim
    connect CalRegn01Inin04.SysFricLrngEolFricDifScagFac -> AAACalRegn01Inin04_Dummy.SysFricLrngEolFricDifScagFac
    connect CalRegn01Inin04.SysFricLrngFricChgWght -> AAACalRegn01Inin04_Dummy.SysFricLrngFricChgWght
    connect CalRegn01Inin04.SysFricLrngFricDiagcThd -> AAACalRegn01Inin04_Dummy.SysFricLrngFricDiagcThd
    connect CalRegn01Inin04.SysFricLrngFricHysHwAgPt -> AAACalRegn01Inin04_Dummy.SysFricLrngFricHysHwAgPt
    connect CalRegn01Inin04.SysFricLrngFricOffs -> AAACalRegn01Inin04_Dummy.SysFricLrngFricOffs
    connect CalRegn01Inin04.SysFricLrngFricOffsHiLim -> AAACalRegn01Inin04_Dummy.SysFricLrngFricOffsHiLim
    connect CalRegn01Inin04.SysFricLrngFricOffsLoLim -> AAACalRegn01Inin04_Dummy.SysFricLrngFricOffsLoLim
    connect CalRegn01Inin04.SysFricLrngFricOffsLpFilFrq -> AAACalRegn01Inin04_Dummy.SysFricLrngFricOffsLpFilFrq
    connect CalRegn01Inin04.SysFricLrngGain -> AAACalRegn01Inin04_Dummy.SysFricLrngGain
    connect CalRegn01Inin04.SysFricLrngHiFricDebStep -> AAACalRegn01Inin04_Dummy.SysFricLrngHiFricDebStep
    connect CalRegn01Inin04.SysFricLrngHiFricDiagcThd -> AAACalRegn01Inin04_Dummy.SysFricLrngHiFricDiagcThd
    connect CalRegn01Inin04.SysFricLrngHwPosnAuthyThd -> AAACalRegn01Inin04_Dummy.SysFricLrngHwPosnAuthyThd
    connect CalRegn01Inin04.SysFricLrngHwVelConstrLim -> AAACalRegn01Inin04_Dummy.SysFricLrngHwVelConstrLim
    connect CalRegn01Inin04.SysFricLrngHwVelHiLim -> AAACalRegn01Inin04_Dummy.SysFricLrngHwVelHiLim
    connect CalRegn01Inin04.SysFricLrngHwVelLoLim -> AAACalRegn01Inin04_Dummy.SysFricLrngHwVelLoLim
    connect CalRegn01Inin04.SysFricLrngIgnCycFricChgLim -> AAACalRegn01Inin04_Dummy.SysFricLrngIgnCycFricChgLim
    connect CalRegn01Inin04.SysFricLrngIgnCycFricOffs -> AAACalRegn01Inin04_Dummy.SysFricLrngIgnCycFricOffs
    connect CalRegn01Inin04.SysFricLrngIvsTrsmRatX -> AAACalRegn01Inin04_Dummy.SysFricLrngIvsTrsmRatX
    connect CalRegn01Inin04.SysFricLrngIvsTrsmRatY -> AAACalRegn01Inin04_Dummy.SysFricLrngIvsTrsmRatY
    connect CalRegn01Inin04.SysFricLrngLatAHiLim -> AAACalRegn01Inin04_Dummy.SysFricLrngLatAHiLim
    connect CalRegn01Inin04.SysFricLrngLatALoLim -> AAACalRegn01Inin04_Dummy.SysFricLrngLatALoLim
    connect CalRegn01Inin04.SysFricLrngMaskVehSpd -> AAACalRegn01Inin04_Dummy.SysFricLrngMaskVehSpd
    connect CalRegn01Inin04.SysFricLrngRngCntrThd -> AAACalRegn01Inin04_Dummy.SysFricLrngRngCntrThd
    connect CalRegn01Inin04.SysFricLrngThd -> AAACalRegn01Inin04_Dummy.SysFricLrngThd
    connect CalRegn01Inin04.SysFricLrngTHiLim -> AAACalRegn01Inin04_Dummy.SysFricLrngTHiLim
    connect CalRegn01Inin04.SysFricLrngTLoLim -> AAACalRegn01Inin04_Dummy.SysFricLrngTLoLim
    connect CalRegn01Inin04.SysFricLrngVehSpd -> AAACalRegn01Inin04_Dummy.SysFricLrngVehSpd
    connect CalRegn01Inin04.SysGlbPrmSysKineRat -> AAACalRegn01Inin04_Dummy.SysGlbPrmSysKineRat
    connect CalRegn01Inin04.SysGlbPrmVehSpdBilnrSeln -> AAACalRegn01Inin04_Dummy.SysGlbPrmVehSpdBilnrSeln
    connect CalRegn01Inin04.SysKineAndEffMotAgToRackPosRatScaY -> AAACalRegn01Inin04_Dummy.SysKineAndEffMotAgToRackPosRatScaY
    connect CalRegn01Inin04.SysKineAndEffPinionAgToRackPosRatScaY -> AAACalRegn01Inin04_Dummy.SysKineAndEffPinionAgToRackPosRatScaY
    connect CalRegn01Inin04.SysKineAndEffPinionToRackEffScaY -> AAACalRegn01Inin04_Dummy.SysKineAndEffPinionToRackEffScaY
    connect CalRegn01Inin04.SysKineAndEffRoadWhlFromRackPosScaY -> AAACalRegn01Inin04_Dummy.SysKineAndEffRoadWhlFromRackPosScaY
    connect CalRegn01Inin04.SysKineAndEffSteerArmLenFromRackPosScaY -> AAACalRegn01Inin04_Dummy.SysKineAndEffSteerArmLenFromRackPosScaY
    connect CalRegn01Inin04.TunSelnAuthyVehSpdX -> AAACalRegn01Inin04_Dummy.TunSelnAuthyVehSpdX
    connect CalRegn01Inin04GroupA.BmwHwAgArbnAndEotPosnEotCcwMax -> AAACalRegn01Inin04GroupA_Dummy.BmwHwAgArbnAndEotPosnEotCcwMax
    connect CalRegn01Inin04GroupA.BmwHwAgArbnAndEotPosnEotCcwMin -> AAACalRegn01Inin04GroupA_Dummy.BmwHwAgArbnAndEotPosnEotCcwMin
    connect CalRegn01Inin04GroupA.BmwHwAgArbnAndEotPosnEotCwMax -> AAACalRegn01Inin04GroupA_Dummy.BmwHwAgArbnAndEotPosnEotCwMax
    connect CalRegn01Inin04GroupA.BmwHwAgArbnAndEotPosnEotCwMin -> AAACalRegn01Inin04GroupA_Dummy.BmwHwAgArbnAndEotPosnEotCwMin
    connect CalRegn01Inin04GroupA.BmwPwrPrkgDampgDiScadDampg -> AAACalRegn01Inin04GroupA_Dummy.BmwPwrPrkgDampgDiScadDampg
    connect CalRegn01Inin04GroupA.BmwPwrPrkgDampgMaxRate -> AAACalRegn01Inin04GroupA_Dummy.BmwPwrPrkgDampgMaxRate
    connect CalRegn01Inin04GroupA.EpsStEstimnMtrxA -> AAACalRegn01Inin04GroupA_Dummy.EpsStEstimnMtrxA
    connect CalRegn01Inin04GroupA.EpsStEstimnMtrxB -> AAACalRegn01Inin04GroupA_Dummy.EpsStEstimnMtrxB
    connect CalRegn01Inin04GroupA.EpsStEstimnMtrxC -> AAACalRegn01Inin04GroupA_Dummy.EpsStEstimnMtrxC
    connect CalRegn01Inin04GroupA.EpsStEstimnMtrxD -> AAACalRegn01Inin04GroupA_Dummy.EpsStEstimnMtrxD
    connect CalRegn01Inin04GroupA.HwTqTrakgCtrlFbGain{1..5} -> AAACalRegn01Inin04GroupA_Dummy.HwTqTrakgCtrlFbGain{1..5}
    connect CalRegn01Inin04GroupA.HwTqTrakgCtrlFfGainScaY -> AAACalRegn01Inin04GroupA_Dummy.HwTqTrakgCtrlFfGainScaY
    connect CalRegn01Inin04GroupA.HwTqTrakgCtrlVehSpdScaX -> AAACalRegn01Inin04GroupA_Dummy.HwTqTrakgCtrlVehSpdScaX
    connect CalRegn01Inin04GroupA.PosnTrakgServoEnaBlndFacTblX -> AAACalRegn01Inin04GroupA_Dummy.PosnTrakgServoEnaBlndFacTblX
    connect CalRegn01Inin04GroupA.PosnTrakgServoEnaBlndFacTblY -> AAACalRegn01Inin04GroupA_Dummy.PosnTrakgServoEnaBlndFacTblY
    connect CalRegn01Inin04GroupA.PosnTrakgServoGainArbnFltMtgtn -> AAACalRegn01Inin04GroupA_Dummy.PosnTrakgServoGainArbnFltMtgtn
    connect CalRegn01Inin04GroupA.PullCmpActvCmpLrnTiDecShoTerm -> AAACalRegn01Inin04GroupA_Dummy.PullCmpActvCmpLrnTiDecShoTerm
    connect CalRegn01Inin04GroupA.PullCmpActvCmpLrnTiIncShoTerm -> AAACalRegn01Inin04GroupA_Dummy.PullCmpActvCmpLrnTiIncShoTerm
    connect CalRegn01Inin04GroupA.PullCmpActvCmpLrnTiLongTerm -> AAACalRegn01Inin04GroupA_Dummy.PullCmpActvCmpLrnTiLongTerm
    connect CalRegn01Inin04GroupA.PullCmpActvCmpShoTermRstHwAgThd -> AAACalRegn01Inin04GroupA_Dummy.PullCmpActvCmpShoTermRstHwAgThd
    connect CalRegn01Inin04GroupA.PullCmpActvCmpShoTermRstHwTqThd -> AAACalRegn01Inin04GroupA_Dummy.PullCmpActvCmpShoTermRstHwTqThd
    connect CalRegn01Inin04GroupA.PullCmpActvCmpShoTermRstLatAThd -> AAACalRegn01Inin04GroupA_Dummy.PullCmpActvCmpShoTermRstLatAThd
    connect CalRegn01Inin04GroupA.PullCmpActvCmpShoTermRstYawRateThd -> AAACalRegn01Inin04GroupA_Dummy.PullCmpActvCmpShoTermRstYawRateThd
    connect CalRegn01Inin04GroupA.PullCmpActvEna -> AAACalRegn01Inin04GroupA_Dummy.PullCmpActvEna
    connect CalRegn01Inin04GroupA.PullCmpActvHwTqFilFrqLongTerm -> AAACalRegn01Inin04GroupA_Dummy.PullCmpActvHwTqFilFrqLongTerm
    connect CalRegn01Inin04GroupA.PullCmpActvHwTqFilFrqShoTerm -> AAACalRegn01Inin04GroupA_Dummy.PullCmpActvHwTqFilFrqShoTerm
    connect CalRegn01Inin04GroupA.PullCmpActvLongTermLim -> AAACalRegn01Inin04GroupA_Dummy.PullCmpActvLongTermLim
    connect CalRegn01Inin04GroupA.PullCmpActvLrngEnaAgConfMinMgn -> AAACalRegn01Inin04GroupA_Dummy.PullCmpActvLrngEnaAgConfMinMgn
    connect CalRegn01Inin04GroupA.PullCmpActvLrngEnaHwAgMaxMgn -> AAACalRegn01Inin04GroupA_Dummy.PullCmpActvLrngEnaHwAgMaxMgn
    connect CalRegn01Inin04GroupA.PullCmpActvLrngEnaHwTqMaxMgn -> AAACalRegn01Inin04GroupA_Dummy.PullCmpActvLrngEnaHwTqMaxMgn
    connect CalRegn01Inin04GroupA.PullCmpActvLrngEnaHwVelMaxMgn -> AAACalRegn01Inin04GroupA_Dummy.PullCmpActvLrngEnaHwVelMaxMgn
    connect CalRegn01Inin04GroupA.PullCmpActvLrngEnaLatAMaxMgn -> AAACalRegn01Inin04GroupA_Dummy.PullCmpActvLrngEnaLatAMaxMgn
    connect CalRegn01Inin04GroupA.PullCmpActvLrngEnaTiThd -> AAACalRegn01Inin04GroupA_Dummy.PullCmpActvLrngEnaTiThd
    connect CalRegn01Inin04GroupA.PullCmpActvLrngEnaVehSpdMaxMgn -> AAACalRegn01Inin04GroupA_Dummy.PullCmpActvLrngEnaVehSpdMaxMgn
    connect CalRegn01Inin04GroupA.PullCmpActvLrngEnaVehSpdMinMgn -> AAACalRegn01Inin04GroupA_Dummy.PullCmpActvLrngEnaVehSpdMinMgn
    connect CalRegn01Inin04GroupA.PullCmpActvLrngEnaVehSpdRateMaxMgn -> AAACalRegn01Inin04GroupA_Dummy.PullCmpActvLrngEnaVehSpdRateMaxMgn
    connect CalRegn01Inin04GroupA.PullCmpActvLrngEnaYawRateMaxMgn -> AAACalRegn01Inin04GroupA_Dummy.PullCmpActvLrngEnaYawRateMaxMgn
    connect CalRegn01Inin04GroupA.PullCmpActvOpstSignTiShoTerm -> AAACalRegn01Inin04GroupA_Dummy.PullCmpActvOpstSignTiShoTerm
    connect CalRegn01Inin04GroupA.PullCmpActvOutpMaxRate -> AAACalRegn01Inin04GroupA_Dummy.PullCmpActvOutpMaxRate
    connect CalRegn01Inin04GroupA.PullCmpActvPullCmpShoTermLim -> AAACalRegn01Inin04GroupA_Dummy.PullCmpActvPullCmpShoTermLim
    connect CalRegn01Inin04GroupA.PullCmpActvPullCmpTotLim -> AAACalRegn01Inin04GroupA_Dummy.PullCmpActvPullCmpTotLim
    connect CalRegn01Inin04GroupA.PullCmpActvPullErrLimLongTerm -> AAACalRegn01Inin04GroupA_Dummy.PullCmpActvPullErrLimLongTerm
    connect CalRegn01Inin04GroupA.PullCmpActvPullErrMgnThd -> AAACalRegn01Inin04GroupA_Dummy.PullCmpActvPullErrMgnThd
    connect CalRegn01Inin04GroupA.PullCmpActvPullErrShoTermLim -> AAACalRegn01Inin04GroupA_Dummy.PullCmpActvPullErrShoTermLim
    connect CalRegn01Inin04GroupA.PullCmpActvShoTermRampTi -> AAACalRegn01Inin04GroupA_Dummy.PullCmpActvShoTermRampTi
    connect CalRegn01Inin04GroupA.PullCmpActvVehSpdScaTblX -> AAACalRegn01Inin04GroupA_Dummy.PullCmpActvVehSpdScaTblX
    connect CalRegn01Inin04GroupA.PullCmpActvVehSpdScaTblY -> AAACalRegn01Inin04GroupA_Dummy.PullCmpActvVehSpdScaTblY
    connect CalRegn01Inin04GroupC.CtrldVelRtnDesVelLpFilFrq -> AAACalRegn01Inin04GroupC_Dummy.CtrldVelRtnDesVelLpFilFrq
    connect CalRegn01Inin04GroupC.CtrldVelRtnHwTqLpFilFrq -> AAACalRegn01Inin04GroupC_Dummy.CtrldVelRtnHwTqLpFilFrq
    connect CalRegn01Inin04GroupC.CtrldVelRtnHwTqScaSelnSlewHiLim -> AAACalRegn01Inin04GroupC_Dummy.CtrldVelRtnHwTqScaSelnSlewHiLim
    connect CalRegn01Inin04GroupC.CtrldVelRtnHwTqScaSelnSlewLoLim -> AAACalRegn01Inin04GroupC_Dummy.CtrldVelRtnHwTqScaSelnSlewLoLim
    connect CalRegn01Inin04GroupC.CtrldVelRtnHwTqScaSelnTqThd -> AAACalRegn01Inin04GroupC_Dummy.CtrldVelRtnHwTqScaSelnTqThd
    connect CalRegn01Inin04GroupC.CtrldVelRtnHwTqScaSelnVelThd -> AAACalRegn01Inin04GroupC_Dummy.CtrldVelRtnHwTqScaSelnVelThd
    connect CalRegn01Inin04GroupC.CtrldVelRtnIntgrLimY -> AAACalRegn01Inin04GroupC_Dummy.CtrldVelRtnIntgrLimY
    connect CalRegn01Inin04GroupC.CtrldVelRtnOffsSlewThd -> AAACalRegn01Inin04GroupC_Dummy.CtrldVelRtnOffsSlewThd
    connect CalRegn01Inin04GroupC.CtrldVelRtnOffsThd -> AAACalRegn01Inin04GroupC_Dummy.CtrldVelRtnOffsThd
    connect CalRegn01Inin04GroupC.CtrldVelRtnScaLpFilFrq -> AAACalRegn01Inin04GroupC_Dummy.CtrldVelRtnScaLpFilFrq
    connect CalRegn01Inin04GroupC.FalbckAssiAssiX -> AAACalRegn01Inin04GroupC_Dummy.FalbckAssiAssiX
    connect CalRegn01Inin04GroupC.FalbckAssiAssiY -> AAACalRegn01Inin04GroupC_Dummy.FalbckAssiAssiY
    connect CalRegn01Inin04GroupC.FalbckAssiNotchFil -> AAACalRegn01Inin04GroupC_Dummy.FalbckAssiNotchFil
    connect CalRegn01Inin04GroupC.GlbLimrBndX -> AAACalRegn01Inin04GroupC_Dummy.GlbLimrBndX
    connect CalRegn01Inin04GroupC.GlbLimrBndY -> AAACalRegn01Inin04GroupC_Dummy.GlbLimrBndY
    connect CalRegn01Inin04GroupC.GlbLimrNotchFilStruct -> AAACalRegn01Inin04GroupC_Dummy.GlbLimrNotchFilStruct
    connect CalRegn01Inin04GroupC.GlbLimrVehSpdBilnrSeln -> AAACalRegn01Inin04GroupC_Dummy.GlbLimrVehSpdBilnrSeln
    connect CalRegn01Inin04GroupD.EotProtnDampgVehSpdTbl -> AAACalRegn01Inin04GroupD_Dummy.EotProtnDampgVehSpdTbl
    connect CalRegn01Inin04GroupD.EotProtnDeltaTqThd -> AAACalRegn01Inin04GroupD_Dummy.EotProtnDeltaTqThd
    connect CalRegn01Inin04GroupD.EotProtnEntrGainAuthyThd -> AAACalRegn01Inin04GroupD_Dummy.EotProtnEntrGainAuthyThd
    connect CalRegn01Inin04GroupD.EotProtnEntrGainVehSpdTbl -> AAACalRegn01Inin04GroupD_Dummy.EotProtnEntrGainVehSpdTbl
    connect CalRegn01Inin04GroupD.EotProtnEntrGainX -> AAACalRegn01Inin04GroupD_Dummy.EotProtnEntrGainX
    connect CalRegn01Inin04GroupD.EotProtnEntrGainY -> AAACalRegn01Inin04GroupD_Dummy.EotProtnEntrGainY
    connect CalRegn01Inin04GroupD.EotProtnEntrStLpFilFrq -> AAACalRegn01Inin04GroupD_Dummy.EotProtnEntrStLpFilFrq
    connect CalRegn01Inin04GroupD.EotProtnExitDampgY -> AAACalRegn01Inin04GroupD_Dummy.EotProtnExitDampgY
    connect CalRegn01Inin04GroupD.EotProtnExitStLpFilFrq -> AAACalRegn01Inin04GroupD_Dummy.EotProtnExitStLpFilFrq
    connect CalRegn01Inin04GroupD.EotProtnHwDegDampgX -> AAACalRegn01Inin04GroupD_Dummy.EotProtnHwDegDampgX
    connect CalRegn01Inin04GroupD.EotProtnHwTqLpFilFrq -> AAACalRegn01Inin04GroupD_Dummy.EotProtnHwTqLpFilFrq
    connect CalRegn01Inin04GroupD.EotProtnHwTqScaX -> AAACalRegn01Inin04GroupD_Dummy.EotProtnHwTqScaX
    connect CalRegn01Inin04GroupD.EotProtnLoAuthyEntrGainY -> AAACalRegn01Inin04GroupD_Dummy.EotProtnLoAuthyEntrGainY
    connect CalRegn01Inin04GroupD.EotProtnMotSpdIncptSca -> AAACalRegn01Inin04GroupD_Dummy.EotProtnMotSpdIncptSca
    connect CalRegn01Inin04GroupD.EotProtnMotSpdIncptX -> AAACalRegn01Inin04GroupD_Dummy.EotProtnMotSpdIncptX
    connect CalRegn01Inin04GroupD.EotProtnMotSpdIncptY -> AAACalRegn01Inin04GroupD_Dummy.EotProtnMotSpdIncptY
    connect CalRegn01Inin04GroupD.EotProtnMotVelGain -> AAACalRegn01Inin04GroupD_Dummy.EotProtnMotVelGain
    connect CalRegn01Inin04GroupD.EotProtnNormDampgY -> AAACalRegn01Inin04GroupD_Dummy.EotProtnNormDampgY
    connect CalRegn01Inin04GroupD.EotProtnPosnRampStep -> AAACalRegn01Inin04GroupD_Dummy.EotProtnPosnRampStep
    connect CalRegn01Inin04GroupD.EotProtnRackTrvlLimrAuthyThd -> AAACalRegn01Inin04GroupD_Dummy.EotProtnRackTrvlLimrAuthyThd
    connect CalRegn01Inin04GroupD.EotProtnRackTrvlLimrAuthyThdLimd -> AAACalRegn01Inin04GroupD_Dummy.EotProtnRackTrvlLimrAuthyThdLimd
    connect CalRegn01Inin04GroupD.EotProtnRackTrvlLimrRng -> AAACalRegn01Inin04GroupD_Dummy.EotProtnRackTrvlLimrRng
    connect CalRegn01Inin04GroupD.EotProtnRackTrvlLimrRngLimd -> AAACalRegn01Inin04GroupD_Dummy.EotProtnRackTrvlLimrRngLimd
    connect CalRegn01Inin04GroupD.EotProtnRackTrvlLimrVehSpdThd -> AAACalRegn01Inin04GroupD_Dummy.EotProtnRackTrvlLimrVehSpdThd
    connect CalRegn01Inin04GroupD.EotProtnRunEotVelImpctAndSoftEndStop -> AAACalRegn01Inin04GroupD_Dummy.EotProtnRunEotVelImpctAndSoftEndStop
    connect CalRegn01Inin04GroupD.InertiaCmpVelAssiBasdDampgCoeffX -> AAACalRegn01Inin04GroupD_Dummy.InertiaCmpVelAssiBasdDampgCoeffX
    connect CalRegn01Inin04GroupD.InertiaCmpVelAssiBasdDampgRollgWhlImbRejctnOnY -> AAACalRegn01Inin04GroupD_Dummy.InertiaCmpVelAssiBasdDampgRollgWhlImbRejctnOnY
    connect CalRegn01Inin04GroupD.InertiaCmpVelAssiBasdDampgRollgY -> AAACalRegn01Inin04GroupD_Dummy.InertiaCmpVelAssiBasdDampgRollgY
    connect CalRegn01Inin04GroupD.InertiaCmpVelAssiBasdDampgStatWhlImbRejctnOnY -> AAACalRegn01Inin04GroupD_Dummy.InertiaCmpVelAssiBasdDampgStatWhlImbRejctnOnY
    connect CalRegn01Inin04GroupD.InertiaCmpVelAssiBasdDampgStatY -> AAACalRegn01Inin04GroupD_Dummy.InertiaCmpVelAssiBasdDampgStatY
    connect CalRegn01Inin04GroupD.InertiaCmpVelCmdScaY -> AAACalRegn01Inin04GroupD_Dummy.InertiaCmpVelCmdScaY
    connect CalRegn01Inin04GroupD.InertiaCmpVelDampgDecelGain -> AAACalRegn01Inin04GroupD_Dummy.InertiaCmpVelDampgDecelGain
    connect CalRegn01Inin04GroupD.InertiaCmpVelDampgDecelGainFallSlew -> AAACalRegn01Inin04GroupD_Dummy.InertiaCmpVelDampgDecelGainFallSlew
    connect CalRegn01Inin04GroupD.InertiaCmpVelDampgDecelGainRisngSlewX -> AAACalRegn01Inin04GroupD_Dummy.InertiaCmpVelDampgDecelGainRisngSlewX
    connect CalRegn01Inin04GroupD.InertiaCmpVelDampgDecelGainRisngSlewY -> AAACalRegn01Inin04GroupD_Dummy.InertiaCmpVelDampgDecelGainRisngSlewY
    connect CalRegn01Inin04GroupD.InertiaCmpVelDampgFilFrq -> AAACalRegn01Inin04GroupD_Dummy.InertiaCmpVelDampgFilFrq
    connect CalRegn01Inin04GroupD.InertiaCmpVelDampgFilFrqWhlImbRejctnOn -> AAACalRegn01Inin04GroupD_Dummy.InertiaCmpVelDampgFilFrqWhlImbRejctnOn
    connect CalRegn01Inin04GroupD.InertiaCmpVelDampgGainOffThd -> AAACalRegn01Inin04GroupD_Dummy.InertiaCmpVelDampgGainOffThd
    connect CalRegn01Inin04GroupD.InertiaCmpVelDampgGainOnThd -> AAACalRegn01Inin04GroupD_Dummy.InertiaCmpVelDampgGainOnThd
    connect CalRegn01Inin04GroupD.InertiaCmpVelDampgSpdBlndY -> AAACalRegn01Inin04GroupD_Dummy.InertiaCmpVelDampgSpdBlndY
    connect CalRegn01Inin04GroupD.InertiaCmpVelDampgWhlImbRejctnBlndX -> AAACalRegn01Inin04GroupD_Dummy.InertiaCmpVelDampgWhlImbRejctnBlndX
    connect CalRegn01Inin04GroupD.InertiaCmpVelDampgWhlImbRejctnBlndY -> AAACalRegn01Inin04GroupD_Dummy.InertiaCmpVelDampgWhlImbRejctnBlndY
    connect CalRegn01Inin04GroupD.InertiaCmpVelDecelGainEnaCal -> AAACalRegn01Inin04GroupD_Dummy.InertiaCmpVelDecelGainEnaCal
    connect CalRegn01Inin04GroupD.InertiaCmpVelModWhlImbRejctnBlndX -> AAACalRegn01Inin04GroupD_Dummy.InertiaCmpVelModWhlImbRejctnBlndX
    connect CalRegn01Inin04GroupD.InertiaCmpVelModWhlImbRejctnBlndY -> AAACalRegn01Inin04GroupD_Dummy.InertiaCmpVelModWhlImbRejctnBlndY
    connect CalRegn01Inin04GroupD.InertiaCmpVelMotInertia -> AAACalRegn01Inin04GroupD_Dummy.InertiaCmpVelMotInertia
    connect CalRegn01Inin04GroupD.InertiaCmpVelMotVelBasdOutpScagX -> AAACalRegn01Inin04GroupD_Dummy.InertiaCmpVelMotVelBasdOutpScagX
    connect CalRegn01Inin04GroupD.InertiaCmpVelMotVelBasdOutpScagY -> AAACalRegn01Inin04GroupD_Dummy.InertiaCmpVelMotVelBasdOutpScagY
    connect CalRegn01Inin04GroupD.InertiaCmpVelNotchBlndY -> AAACalRegn01Inin04GroupD_Dummy.InertiaCmpVelNotchBlndY
    connect CalRegn01Inin04GroupD.InertiaCmpVelNotchFilStruct -> AAACalRegn01Inin04GroupD_Dummy.InertiaCmpVelNotchFilStruct
    connect CalRegn01Inin04GroupD.InertiaCmpVelTqSnsrVelFilFrq -> AAACalRegn01Inin04GroupD_Dummy.InertiaCmpVelTqSnsrVelFilFrq
    connect CalRegn01Inin04GroupD.InertiaCmpVelTqSnsrVelSca -> AAACalRegn01Inin04GroupD_Dummy.InertiaCmpVelTqSnsrVelSca
    connect CalRegn01Inin05.BmwHwAgArbnAndEotPosnKineIntegrityDiagcMaxRackLim -> AAACalRegn01Inin05_Dummy.BmwHwAgArbnAndEotPosnKineIntegrityDiagcMaxRackLim
    connect CalRegn01Inin05.EffortScaBlndX -> AAACalRegn01Inin05_Dummy.EffortScaBlndX
    connect CalRegn01Inin05.EffortScaBlndY -> AAACalRegn01Inin05_Dummy.EffortScaBlndY
    connect CalRegn01Inin05.EffortScaRackFThd -> AAACalRegn01Inin05_Dummy.EffortScaRackFThd
    connect CalRegn01Inin05.PosnTrakgServoArbnFltMtgtnLpFilCutOffFrq -> AAACalRegn01Inin05_Dummy.PosnTrakgServoArbnFltMtgtnLpFilCutOffFrq
    connect CalRegn01Inin05.PullCmpActvHwTqFilFrqLrngEna -> AAACalRegn01Inin05_Dummy.PullCmpActvHwTqFilFrqLrngEna
    connect CalRegn01Inin05.PullCmpActvYawRateFilFrq -> AAACalRegn01Inin05_Dummy.PullCmpActvYawRateFilFrq
    connect CalRegn01Inin05.SysFricLrngAvrgFricFrq -> AAACalRegn01Inin05_Dummy.SysFricLrngAvrgFricFrq
    connect CalRegn01Inin05.SysFricLrngBasLineEolFric -> AAACalRegn01Inin05_Dummy.SysFricLrngBasLineEolFric
    connect CalRegn01Inin05.SysFricLrngBasLineFric -> AAACalRegn01Inin05_Dummy.SysFricLrngBasLineFric
    connect CalRegn01Inin05.SysFricLrngBasLineHys -> AAACalRegn01Inin05_Dummy.SysFricLrngBasLineHys
    connect CalRegn01Inin05.SysFricLrngBasLineRngCntr -> AAACalRegn01Inin05_Dummy.SysFricLrngBasLineRngCntr
    connect CalRegn01Inin05.SysFricLrngDataPrepLpFilFrq -> AAACalRegn01Inin05_Dummy.SysFricLrngDataPrepLpFilFrq
    connect CalRegn01Inin05.SysFricLrngDebStep -> AAACalRegn01Inin05_Dummy.SysFricLrngDebStep
    connect CalRegn01Inin05.SysFricLrngEolFricDifHiLim -> AAACalRegn01Inin05_Dummy.SysFricLrngEolFricDifHiLim
    connect CalRegn01Inin05.SysFricLrngEolFricDifLoLim -> AAACalRegn01Inin05_Dummy.SysFricLrngEolFricDifLoLim
    connect CalRegn01Inin05.SysFricLrngEolFricDifScagFac -> AAACalRegn01Inin05_Dummy.SysFricLrngEolFricDifScagFac
    connect CalRegn01Inin05.SysFricLrngFricChgWght -> AAACalRegn01Inin05_Dummy.SysFricLrngFricChgWght
    connect CalRegn01Inin05.SysFricLrngFricDiagcThd -> AAACalRegn01Inin05_Dummy.SysFricLrngFricDiagcThd
    connect CalRegn01Inin05.SysFricLrngFricHysHwAgPt -> AAACalRegn01Inin05_Dummy.SysFricLrngFricHysHwAgPt
    connect CalRegn01Inin05.SysFricLrngFricOffs -> AAACalRegn01Inin05_Dummy.SysFricLrngFricOffs
    connect CalRegn01Inin05.SysFricLrngFricOffsHiLim -> AAACalRegn01Inin05_Dummy.SysFricLrngFricOffsHiLim
    connect CalRegn01Inin05.SysFricLrngFricOffsLoLim -> AAACalRegn01Inin05_Dummy.SysFricLrngFricOffsLoLim
    connect CalRegn01Inin05.SysFricLrngFricOffsLpFilFrq -> AAACalRegn01Inin05_Dummy.SysFricLrngFricOffsLpFilFrq
    connect CalRegn01Inin05.SysFricLrngGain -> AAACalRegn01Inin05_Dummy.SysFricLrngGain
    connect CalRegn01Inin05.SysFricLrngHiFricDebStep -> AAACalRegn01Inin05_Dummy.SysFricLrngHiFricDebStep
    connect CalRegn01Inin05.SysFricLrngHiFricDiagcThd -> AAACalRegn01Inin05_Dummy.SysFricLrngHiFricDiagcThd
    connect CalRegn01Inin05.SysFricLrngHwPosnAuthyThd -> AAACalRegn01Inin05_Dummy.SysFricLrngHwPosnAuthyThd
    connect CalRegn01Inin05.SysFricLrngHwVelConstrLim -> AAACalRegn01Inin05_Dummy.SysFricLrngHwVelConstrLim
    connect CalRegn01Inin05.SysFricLrngHwVelHiLim -> AAACalRegn01Inin05_Dummy.SysFricLrngHwVelHiLim
    connect CalRegn01Inin05.SysFricLrngHwVelLoLim -> AAACalRegn01Inin05_Dummy.SysFricLrngHwVelLoLim
    connect CalRegn01Inin05.SysFricLrngIgnCycFricChgLim -> AAACalRegn01Inin05_Dummy.SysFricLrngIgnCycFricChgLim
    connect CalRegn01Inin05.SysFricLrngIgnCycFricOffs -> AAACalRegn01Inin05_Dummy.SysFricLrngIgnCycFricOffs
    connect CalRegn01Inin05.SysFricLrngIvsTrsmRatX -> AAACalRegn01Inin05_Dummy.SysFricLrngIvsTrsmRatX
    connect CalRegn01Inin05.SysFricLrngIvsTrsmRatY -> AAACalRegn01Inin05_Dummy.SysFricLrngIvsTrsmRatY
    connect CalRegn01Inin05.SysFricLrngLatAHiLim -> AAACalRegn01Inin05_Dummy.SysFricLrngLatAHiLim
    connect CalRegn01Inin05.SysFricLrngLatALoLim -> AAACalRegn01Inin05_Dummy.SysFricLrngLatALoLim
    connect CalRegn01Inin05.SysFricLrngMaskVehSpd -> AAACalRegn01Inin05_Dummy.SysFricLrngMaskVehSpd
    connect CalRegn01Inin05.SysFricLrngRngCntrThd -> AAACalRegn01Inin05_Dummy.SysFricLrngRngCntrThd
    connect CalRegn01Inin05.SysFricLrngThd -> AAACalRegn01Inin05_Dummy.SysFricLrngThd
    connect CalRegn01Inin05.SysFricLrngTHiLim -> AAACalRegn01Inin05_Dummy.SysFricLrngTHiLim
    connect CalRegn01Inin05.SysFricLrngTLoLim -> AAACalRegn01Inin05_Dummy.SysFricLrngTLoLim
    connect CalRegn01Inin05.SysFricLrngVehSpd -> AAACalRegn01Inin05_Dummy.SysFricLrngVehSpd
    connect CalRegn01Inin05.SysGlbPrmSysKineRat -> AAACalRegn01Inin05_Dummy.SysGlbPrmSysKineRat
    connect CalRegn01Inin05.SysGlbPrmVehSpdBilnrSeln -> AAACalRegn01Inin05_Dummy.SysGlbPrmVehSpdBilnrSeln
    connect CalRegn01Inin05.SysKineAndEffMotAgToRackPosRatScaY -> AAACalRegn01Inin05_Dummy.SysKineAndEffMotAgToRackPosRatScaY
    connect CalRegn01Inin05.SysKineAndEffPinionAgToRackPosRatScaY -> AAACalRegn01Inin05_Dummy.SysKineAndEffPinionAgToRackPosRatScaY
    connect CalRegn01Inin05.SysKineAndEffPinionToRackEffScaY -> AAACalRegn01Inin05_Dummy.SysKineAndEffPinionToRackEffScaY
    connect CalRegn01Inin05.SysKineAndEffRoadWhlFromRackPosScaY -> AAACalRegn01Inin05_Dummy.SysKineAndEffRoadWhlFromRackPosScaY
    connect CalRegn01Inin05.SysKineAndEffSteerArmLenFromRackPosScaY -> AAACalRegn01Inin05_Dummy.SysKineAndEffSteerArmLenFromRackPosScaY
    connect CalRegn01Inin05.TunSelnAuthyVehSpdX -> AAACalRegn01Inin05_Dummy.TunSelnAuthyVehSpdX
    connect CalRegn01Inin05GroupA.BmwHwAgArbnAndEotPosnEotCcwMax -> AAACalRegn01Inin05GroupA_Dummy.BmwHwAgArbnAndEotPosnEotCcwMax
    connect CalRegn01Inin05GroupA.BmwHwAgArbnAndEotPosnEotCcwMin -> AAACalRegn01Inin05GroupA_Dummy.BmwHwAgArbnAndEotPosnEotCcwMin
    connect CalRegn01Inin05GroupA.BmwHwAgArbnAndEotPosnEotCwMax -> AAACalRegn01Inin05GroupA_Dummy.BmwHwAgArbnAndEotPosnEotCwMax
    connect CalRegn01Inin05GroupA.BmwHwAgArbnAndEotPosnEotCwMin -> AAACalRegn01Inin05GroupA_Dummy.BmwHwAgArbnAndEotPosnEotCwMin
    connect CalRegn01Inin05GroupA.BmwPwrPrkgDampgDiScadDampg -> AAACalRegn01Inin05GroupA_Dummy.BmwPwrPrkgDampgDiScadDampg
    connect CalRegn01Inin05GroupA.BmwPwrPrkgDampgMaxRate -> AAACalRegn01Inin05GroupA_Dummy.BmwPwrPrkgDampgMaxRate
    connect CalRegn01Inin05GroupA.EpsStEstimnMtrxA -> AAACalRegn01Inin05GroupA_Dummy.EpsStEstimnMtrxA
    connect CalRegn01Inin05GroupA.EpsStEstimnMtrxB -> AAACalRegn01Inin05GroupA_Dummy.EpsStEstimnMtrxB
    connect CalRegn01Inin05GroupA.EpsStEstimnMtrxC -> AAACalRegn01Inin05GroupA_Dummy.EpsStEstimnMtrxC
    connect CalRegn01Inin05GroupA.EpsStEstimnMtrxD -> AAACalRegn01Inin05GroupA_Dummy.EpsStEstimnMtrxD
    connect CalRegn01Inin05GroupA.HwTqTrakgCtrlFbGain{1..5} -> AAACalRegn01Inin05GroupA_Dummy.HwTqTrakgCtrlFbGain{1..5}
    connect CalRegn01Inin05GroupA.HwTqTrakgCtrlFfGainScaY -> AAACalRegn01Inin05GroupA_Dummy.HwTqTrakgCtrlFfGainScaY
    connect CalRegn01Inin05GroupA.HwTqTrakgCtrlVehSpdScaX -> AAACalRegn01Inin05GroupA_Dummy.HwTqTrakgCtrlVehSpdScaX
    connect CalRegn01Inin05GroupA.PosnTrakgServoEnaBlndFacTblX -> AAACalRegn01Inin05GroupA_Dummy.PosnTrakgServoEnaBlndFacTblX
    connect CalRegn01Inin05GroupA.PosnTrakgServoEnaBlndFacTblY -> AAACalRegn01Inin05GroupA_Dummy.PosnTrakgServoEnaBlndFacTblY
    connect CalRegn01Inin05GroupA.PosnTrakgServoGainArbnFltMtgtn -> AAACalRegn01Inin05GroupA_Dummy.PosnTrakgServoGainArbnFltMtgtn
    connect CalRegn01Inin05GroupA.PullCmpActvCmpLrnTiDecShoTerm -> AAACalRegn01Inin05GroupA_Dummy.PullCmpActvCmpLrnTiDecShoTerm
    connect CalRegn01Inin05GroupA.PullCmpActvCmpLrnTiIncShoTerm -> AAACalRegn01Inin05GroupA_Dummy.PullCmpActvCmpLrnTiIncShoTerm
    connect CalRegn01Inin05GroupA.PullCmpActvCmpLrnTiLongTerm -> AAACalRegn01Inin05GroupA_Dummy.PullCmpActvCmpLrnTiLongTerm
    connect CalRegn01Inin05GroupA.PullCmpActvCmpShoTermRstHwAgThd -> AAACalRegn01Inin05GroupA_Dummy.PullCmpActvCmpShoTermRstHwAgThd
    connect CalRegn01Inin05GroupA.PullCmpActvCmpShoTermRstHwTqThd -> AAACalRegn01Inin05GroupA_Dummy.PullCmpActvCmpShoTermRstHwTqThd
    connect CalRegn01Inin05GroupA.PullCmpActvCmpShoTermRstLatAThd -> AAACalRegn01Inin05GroupA_Dummy.PullCmpActvCmpShoTermRstLatAThd
    connect CalRegn01Inin05GroupA.PullCmpActvCmpShoTermRstYawRateThd -> AAACalRegn01Inin05GroupA_Dummy.PullCmpActvCmpShoTermRstYawRateThd
    connect CalRegn01Inin05GroupA.PullCmpActvEna -> AAACalRegn01Inin05GroupA_Dummy.PullCmpActvEna
    connect CalRegn01Inin05GroupA.PullCmpActvHwTqFilFrqLongTerm -> AAACalRegn01Inin05GroupA_Dummy.PullCmpActvHwTqFilFrqLongTerm
    connect CalRegn01Inin05GroupA.PullCmpActvHwTqFilFrqShoTerm -> AAACalRegn01Inin05GroupA_Dummy.PullCmpActvHwTqFilFrqShoTerm
    connect CalRegn01Inin05GroupA.PullCmpActvLongTermLim -> AAACalRegn01Inin05GroupA_Dummy.PullCmpActvLongTermLim
    connect CalRegn01Inin05GroupA.PullCmpActvLrngEnaAgConfMinMgn -> AAACalRegn01Inin05GroupA_Dummy.PullCmpActvLrngEnaAgConfMinMgn
    connect CalRegn01Inin05GroupA.PullCmpActvLrngEnaHwAgMaxMgn -> AAACalRegn01Inin05GroupA_Dummy.PullCmpActvLrngEnaHwAgMaxMgn
    connect CalRegn01Inin05GroupA.PullCmpActvLrngEnaHwTqMaxMgn -> AAACalRegn01Inin05GroupA_Dummy.PullCmpActvLrngEnaHwTqMaxMgn
    connect CalRegn01Inin05GroupA.PullCmpActvLrngEnaHwVelMaxMgn -> AAACalRegn01Inin05GroupA_Dummy.PullCmpActvLrngEnaHwVelMaxMgn
    connect CalRegn01Inin05GroupA.PullCmpActvLrngEnaLatAMaxMgn -> AAACalRegn01Inin05GroupA_Dummy.PullCmpActvLrngEnaLatAMaxMgn
    connect CalRegn01Inin05GroupA.PullCmpActvLrngEnaTiThd -> AAACalRegn01Inin05GroupA_Dummy.PullCmpActvLrngEnaTiThd
    connect CalRegn01Inin05GroupA.PullCmpActvLrngEnaVehSpdMaxMgn -> AAACalRegn01Inin05GroupA_Dummy.PullCmpActvLrngEnaVehSpdMaxMgn
    connect CalRegn01Inin05GroupA.PullCmpActvLrngEnaVehSpdMinMgn -> AAACalRegn01Inin05GroupA_Dummy.PullCmpActvLrngEnaVehSpdMinMgn
    connect CalRegn01Inin05GroupA.PullCmpActvLrngEnaVehSpdRateMaxMgn -> AAACalRegn01Inin05GroupA_Dummy.PullCmpActvLrngEnaVehSpdRateMaxMgn
    connect CalRegn01Inin05GroupA.PullCmpActvLrngEnaYawRateMaxMgn -> AAACalRegn01Inin05GroupA_Dummy.PullCmpActvLrngEnaYawRateMaxMgn
    connect CalRegn01Inin05GroupA.PullCmpActvOpstSignTiShoTerm -> AAACalRegn01Inin05GroupA_Dummy.PullCmpActvOpstSignTiShoTerm
    connect CalRegn01Inin05GroupA.PullCmpActvOutpMaxRate -> AAACalRegn01Inin05GroupA_Dummy.PullCmpActvOutpMaxRate
    connect CalRegn01Inin05GroupA.PullCmpActvPullCmpShoTermLim -> AAACalRegn01Inin05GroupA_Dummy.PullCmpActvPullCmpShoTermLim
    connect CalRegn01Inin05GroupA.PullCmpActvPullCmpTotLim -> AAACalRegn01Inin05GroupA_Dummy.PullCmpActvPullCmpTotLim
    connect CalRegn01Inin05GroupA.PullCmpActvPullErrLimLongTerm -> AAACalRegn01Inin05GroupA_Dummy.PullCmpActvPullErrLimLongTerm
    connect CalRegn01Inin05GroupA.PullCmpActvPullErrMgnThd -> AAACalRegn01Inin05GroupA_Dummy.PullCmpActvPullErrMgnThd
    connect CalRegn01Inin05GroupA.PullCmpActvPullErrShoTermLim -> AAACalRegn01Inin05GroupA_Dummy.PullCmpActvPullErrShoTermLim
    connect CalRegn01Inin05GroupA.PullCmpActvShoTermRampTi -> AAACalRegn01Inin05GroupA_Dummy.PullCmpActvShoTermRampTi
    connect CalRegn01Inin05GroupA.PullCmpActvVehSpdScaTblX -> AAACalRegn01Inin05GroupA_Dummy.PullCmpActvVehSpdScaTblX
    connect CalRegn01Inin05GroupA.PullCmpActvVehSpdScaTblY -> AAACalRegn01Inin05GroupA_Dummy.PullCmpActvVehSpdScaTblY
    connect CalRegn01Inin05GroupC.CtrldVelRtnDesVelLpFilFrq -> AAACalRegn01Inin05GroupC_Dummy.CtrldVelRtnDesVelLpFilFrq
    connect CalRegn01Inin05GroupC.CtrldVelRtnHwTqLpFilFrq -> AAACalRegn01Inin05GroupC_Dummy.CtrldVelRtnHwTqLpFilFrq
    connect CalRegn01Inin05GroupC.CtrldVelRtnHwTqScaSelnSlewHiLim -> AAACalRegn01Inin05GroupC_Dummy.CtrldVelRtnHwTqScaSelnSlewHiLim
    connect CalRegn01Inin05GroupC.CtrldVelRtnHwTqScaSelnSlewLoLim -> AAACalRegn01Inin05GroupC_Dummy.CtrldVelRtnHwTqScaSelnSlewLoLim
    connect CalRegn01Inin05GroupC.CtrldVelRtnHwTqScaSelnTqThd -> AAACalRegn01Inin05GroupC_Dummy.CtrldVelRtnHwTqScaSelnTqThd
    connect CalRegn01Inin05GroupC.CtrldVelRtnHwTqScaSelnVelThd -> AAACalRegn01Inin05GroupC_Dummy.CtrldVelRtnHwTqScaSelnVelThd
    connect CalRegn01Inin05GroupC.CtrldVelRtnIntgrLimY -> AAACalRegn01Inin05GroupC_Dummy.CtrldVelRtnIntgrLimY
    connect CalRegn01Inin05GroupC.CtrldVelRtnOffsSlewThd -> AAACalRegn01Inin05GroupC_Dummy.CtrldVelRtnOffsSlewThd
    connect CalRegn01Inin05GroupC.CtrldVelRtnOffsThd -> AAACalRegn01Inin05GroupC_Dummy.CtrldVelRtnOffsThd
    connect CalRegn01Inin05GroupC.CtrldVelRtnScaLpFilFrq -> AAACalRegn01Inin05GroupC_Dummy.CtrldVelRtnScaLpFilFrq
    connect CalRegn01Inin05GroupC.FalbckAssiAssiX -> AAACalRegn01Inin05GroupC_Dummy.FalbckAssiAssiX
    connect CalRegn01Inin05GroupC.FalbckAssiAssiY -> AAACalRegn01Inin05GroupC_Dummy.FalbckAssiAssiY
    connect CalRegn01Inin05GroupC.FalbckAssiNotchFil -> AAACalRegn01Inin05GroupC_Dummy.FalbckAssiNotchFil
    connect CalRegn01Inin05GroupC.GlbLimrBndX -> AAACalRegn01Inin05GroupC_Dummy.GlbLimrBndX
    connect CalRegn01Inin05GroupC.GlbLimrBndY -> AAACalRegn01Inin05GroupC_Dummy.GlbLimrBndY
    connect CalRegn01Inin05GroupC.GlbLimrNotchFilStruct -> AAACalRegn01Inin05GroupC_Dummy.GlbLimrNotchFilStruct
    connect CalRegn01Inin05GroupC.GlbLimrVehSpdBilnrSeln -> AAACalRegn01Inin05GroupC_Dummy.GlbLimrVehSpdBilnrSeln
    connect CalRegn01Inin05GroupD.EotProtnDampgVehSpdTbl -> AAACalRegn01Inin05GroupD_Dummy.EotProtnDampgVehSpdTbl
    connect CalRegn01Inin05GroupD.EotProtnDeltaTqThd -> AAACalRegn01Inin05GroupD_Dummy.EotProtnDeltaTqThd
    connect CalRegn01Inin05GroupD.EotProtnEntrGainAuthyThd -> AAACalRegn01Inin05GroupD_Dummy.EotProtnEntrGainAuthyThd
    connect CalRegn01Inin05GroupD.EotProtnEntrGainVehSpdTbl -> AAACalRegn01Inin05GroupD_Dummy.EotProtnEntrGainVehSpdTbl
    connect CalRegn01Inin05GroupD.EotProtnEntrGainX -> AAACalRegn01Inin05GroupD_Dummy.EotProtnEntrGainX
    connect CalRegn01Inin05GroupD.EotProtnEntrGainY -> AAACalRegn01Inin05GroupD_Dummy.EotProtnEntrGainY
    connect CalRegn01Inin05GroupD.EotProtnEntrStLpFilFrq -> AAACalRegn01Inin05GroupD_Dummy.EotProtnEntrStLpFilFrq
    connect CalRegn01Inin05GroupD.EotProtnExitDampgY -> AAACalRegn01Inin05GroupD_Dummy.EotProtnExitDampgY
    connect CalRegn01Inin05GroupD.EotProtnExitStLpFilFrq -> AAACalRegn01Inin05GroupD_Dummy.EotProtnExitStLpFilFrq
    connect CalRegn01Inin05GroupD.EotProtnHwDegDampgX -> AAACalRegn01Inin05GroupD_Dummy.EotProtnHwDegDampgX
    connect CalRegn01Inin05GroupD.EotProtnHwTqLpFilFrq -> AAACalRegn01Inin05GroupD_Dummy.EotProtnHwTqLpFilFrq
    connect CalRegn01Inin05GroupD.EotProtnHwTqScaX -> AAACalRegn01Inin05GroupD_Dummy.EotProtnHwTqScaX
    connect CalRegn01Inin05GroupD.EotProtnLoAuthyEntrGainY -> AAACalRegn01Inin05GroupD_Dummy.EotProtnLoAuthyEntrGainY
    connect CalRegn01Inin05GroupD.EotProtnMotSpdIncptSca -> AAACalRegn01Inin05GroupD_Dummy.EotProtnMotSpdIncptSca
    connect CalRegn01Inin05GroupD.EotProtnMotSpdIncptX -> AAACalRegn01Inin05GroupD_Dummy.EotProtnMotSpdIncptX
    connect CalRegn01Inin05GroupD.EotProtnMotSpdIncptY -> AAACalRegn01Inin05GroupD_Dummy.EotProtnMotSpdIncptY
    connect CalRegn01Inin05GroupD.EotProtnMotVelGain -> AAACalRegn01Inin05GroupD_Dummy.EotProtnMotVelGain
    connect CalRegn01Inin05GroupD.EotProtnNormDampgY -> AAACalRegn01Inin05GroupD_Dummy.EotProtnNormDampgY
    connect CalRegn01Inin05GroupD.EotProtnPosnRampStep -> AAACalRegn01Inin05GroupD_Dummy.EotProtnPosnRampStep
    connect CalRegn01Inin05GroupD.EotProtnRackTrvlLimrAuthyThd -> AAACalRegn01Inin05GroupD_Dummy.EotProtnRackTrvlLimrAuthyThd
    connect CalRegn01Inin05GroupD.EotProtnRackTrvlLimrAuthyThdLimd -> AAACalRegn01Inin05GroupD_Dummy.EotProtnRackTrvlLimrAuthyThdLimd
    connect CalRegn01Inin05GroupD.EotProtnRackTrvlLimrRng -> AAACalRegn01Inin05GroupD_Dummy.EotProtnRackTrvlLimrRng
    connect CalRegn01Inin05GroupD.EotProtnRackTrvlLimrRngLimd -> AAACalRegn01Inin05GroupD_Dummy.EotProtnRackTrvlLimrRngLimd
    connect CalRegn01Inin05GroupD.EotProtnRackTrvlLimrVehSpdThd -> AAACalRegn01Inin05GroupD_Dummy.EotProtnRackTrvlLimrVehSpdThd
    connect CalRegn01Inin05GroupD.EotProtnRunEotVelImpctAndSoftEndStop -> AAACalRegn01Inin05GroupD_Dummy.EotProtnRunEotVelImpctAndSoftEndStop
    connect CalRegn01Inin05GroupD.InertiaCmpVelAssiBasdDampgCoeffX -> AAACalRegn01Inin05GroupD_Dummy.InertiaCmpVelAssiBasdDampgCoeffX
    connect CalRegn01Inin05GroupD.InertiaCmpVelAssiBasdDampgRollgWhlImbRejctnOnY -> AAACalRegn01Inin05GroupD_Dummy.InertiaCmpVelAssiBasdDampgRollgWhlImbRejctnOnY
    connect CalRegn01Inin05GroupD.InertiaCmpVelAssiBasdDampgRollgY -> AAACalRegn01Inin05GroupD_Dummy.InertiaCmpVelAssiBasdDampgRollgY
    connect CalRegn01Inin05GroupD.InertiaCmpVelAssiBasdDampgStatWhlImbRejctnOnY -> AAACalRegn01Inin05GroupD_Dummy.InertiaCmpVelAssiBasdDampgStatWhlImbRejctnOnY
    connect CalRegn01Inin05GroupD.InertiaCmpVelAssiBasdDampgStatY -> AAACalRegn01Inin05GroupD_Dummy.InertiaCmpVelAssiBasdDampgStatY
    connect CalRegn01Inin05GroupD.InertiaCmpVelCmdScaY -> AAACalRegn01Inin05GroupD_Dummy.InertiaCmpVelCmdScaY
    connect CalRegn01Inin05GroupD.InertiaCmpVelDampgDecelGain -> AAACalRegn01Inin05GroupD_Dummy.InertiaCmpVelDampgDecelGain
    connect CalRegn01Inin05GroupD.InertiaCmpVelDampgDecelGainFallSlew -> AAACalRegn01Inin05GroupD_Dummy.InertiaCmpVelDampgDecelGainFallSlew
    connect CalRegn01Inin05GroupD.InertiaCmpVelDampgDecelGainRisngSlewX -> AAACalRegn01Inin05GroupD_Dummy.InertiaCmpVelDampgDecelGainRisngSlewX
    connect CalRegn01Inin05GroupD.InertiaCmpVelDampgDecelGainRisngSlewY -> AAACalRegn01Inin05GroupD_Dummy.InertiaCmpVelDampgDecelGainRisngSlewY
    connect CalRegn01Inin05GroupD.InertiaCmpVelDampgFilFrq -> AAACalRegn01Inin05GroupD_Dummy.InertiaCmpVelDampgFilFrq
    connect CalRegn01Inin05GroupD.InertiaCmpVelDampgFilFrqWhlImbRejctnOn -> AAACalRegn01Inin05GroupD_Dummy.InertiaCmpVelDampgFilFrqWhlImbRejctnOn
    connect CalRegn01Inin05GroupD.InertiaCmpVelDampgGainOffThd -> AAACalRegn01Inin05GroupD_Dummy.InertiaCmpVelDampgGainOffThd
    connect CalRegn01Inin05GroupD.InertiaCmpVelDampgGainOnThd -> AAACalRegn01Inin05GroupD_Dummy.InertiaCmpVelDampgGainOnThd
    connect CalRegn01Inin05GroupD.InertiaCmpVelDampgSpdBlndY -> AAACalRegn01Inin05GroupD_Dummy.InertiaCmpVelDampgSpdBlndY
    connect CalRegn01Inin05GroupD.InertiaCmpVelDampgWhlImbRejctnBlndX -> AAACalRegn01Inin05GroupD_Dummy.InertiaCmpVelDampgWhlImbRejctnBlndX
    connect CalRegn01Inin05GroupD.InertiaCmpVelDampgWhlImbRejctnBlndY -> AAACalRegn01Inin05GroupD_Dummy.InertiaCmpVelDampgWhlImbRejctnBlndY
    connect CalRegn01Inin05GroupD.InertiaCmpVelDecelGainEnaCal -> AAACalRegn01Inin05GroupD_Dummy.InertiaCmpVelDecelGainEnaCal
    connect CalRegn01Inin05GroupD.InertiaCmpVelModWhlImbRejctnBlndX -> AAACalRegn01Inin05GroupD_Dummy.InertiaCmpVelModWhlImbRejctnBlndX
    connect CalRegn01Inin05GroupD.InertiaCmpVelModWhlImbRejctnBlndY -> AAACalRegn01Inin05GroupD_Dummy.InertiaCmpVelModWhlImbRejctnBlndY
    connect CalRegn01Inin05GroupD.InertiaCmpVelMotInertia -> AAACalRegn01Inin05GroupD_Dummy.InertiaCmpVelMotInertia
    connect CalRegn01Inin05GroupD.InertiaCmpVelMotVelBasdOutpScagX -> AAACalRegn01Inin05GroupD_Dummy.InertiaCmpVelMotVelBasdOutpScagX
    connect CalRegn01Inin05GroupD.InertiaCmpVelMotVelBasdOutpScagY -> AAACalRegn01Inin05GroupD_Dummy.InertiaCmpVelMotVelBasdOutpScagY
    connect CalRegn01Inin05GroupD.InertiaCmpVelNotchBlndY -> AAACalRegn01Inin05GroupD_Dummy.InertiaCmpVelNotchBlndY
    connect CalRegn01Inin05GroupD.InertiaCmpVelNotchFilStruct -> AAACalRegn01Inin05GroupD_Dummy.InertiaCmpVelNotchFilStruct
    connect CalRegn01Inin05GroupD.InertiaCmpVelTqSnsrVelFilFrq -> AAACalRegn01Inin05GroupD_Dummy.InertiaCmpVelTqSnsrVelFilFrq
    connect CalRegn01Inin05GroupD.InertiaCmpVelTqSnsrVelSca -> AAACalRegn01Inin05GroupD_Dummy.InertiaCmpVelTqSnsrVelSca
    connect CalRegn01Inin06.BmwHwAgArbnAndEotPosnKineIntegrityDiagcMaxRackLim -> AAACalRegn01Inin06_Dummy.BmwHwAgArbnAndEotPosnKineIntegrityDiagcMaxRackLim
    connect CalRegn01Inin06.EffortScaBlndX -> AAACalRegn01Inin06_Dummy.EffortScaBlndX
    connect CalRegn01Inin06.EffortScaBlndY -> AAACalRegn01Inin06_Dummy.EffortScaBlndY
    connect CalRegn01Inin06.EffortScaRackFThd -> AAACalRegn01Inin06_Dummy.EffortScaRackFThd
    connect CalRegn01Inin06.PosnTrakgServoArbnFltMtgtnLpFilCutOffFrq -> AAACalRegn01Inin06_Dummy.PosnTrakgServoArbnFltMtgtnLpFilCutOffFrq
    connect CalRegn01Inin06.PullCmpActvHwTqFilFrqLrngEna -> AAACalRegn01Inin06_Dummy.PullCmpActvHwTqFilFrqLrngEna
    connect CalRegn01Inin06.PullCmpActvYawRateFilFrq -> AAACalRegn01Inin06_Dummy.PullCmpActvYawRateFilFrq
    connect CalRegn01Inin06.SysFricLrngAvrgFricFrq -> AAACalRegn01Inin06_Dummy.SysFricLrngAvrgFricFrq
    connect CalRegn01Inin06.SysFricLrngBasLineEolFric -> AAACalRegn01Inin06_Dummy.SysFricLrngBasLineEolFric
    connect CalRegn01Inin06.SysFricLrngBasLineFric -> AAACalRegn01Inin06_Dummy.SysFricLrngBasLineFric
    connect CalRegn01Inin06.SysFricLrngBasLineHys -> AAACalRegn01Inin06_Dummy.SysFricLrngBasLineHys
    connect CalRegn01Inin06.SysFricLrngBasLineRngCntr -> AAACalRegn01Inin06_Dummy.SysFricLrngBasLineRngCntr
    connect CalRegn01Inin06.SysFricLrngDataPrepLpFilFrq -> AAACalRegn01Inin06_Dummy.SysFricLrngDataPrepLpFilFrq
    connect CalRegn01Inin06.SysFricLrngDebStep -> AAACalRegn01Inin06_Dummy.SysFricLrngDebStep
    connect CalRegn01Inin06.SysFricLrngEolFricDifHiLim -> AAACalRegn01Inin06_Dummy.SysFricLrngEolFricDifHiLim
    connect CalRegn01Inin06.SysFricLrngEolFricDifLoLim -> AAACalRegn01Inin06_Dummy.SysFricLrngEolFricDifLoLim
    connect CalRegn01Inin06.SysFricLrngEolFricDifScagFac -> AAACalRegn01Inin06_Dummy.SysFricLrngEolFricDifScagFac
    connect CalRegn01Inin06.SysFricLrngFricChgWght -> AAACalRegn01Inin06_Dummy.SysFricLrngFricChgWght
    connect CalRegn01Inin06.SysFricLrngFricDiagcThd -> AAACalRegn01Inin06_Dummy.SysFricLrngFricDiagcThd
    connect CalRegn01Inin06.SysFricLrngFricHysHwAgPt -> AAACalRegn01Inin06_Dummy.SysFricLrngFricHysHwAgPt
    connect CalRegn01Inin06.SysFricLrngFricOffs -> AAACalRegn01Inin06_Dummy.SysFricLrngFricOffs
    connect CalRegn01Inin06.SysFricLrngFricOffsHiLim -> AAACalRegn01Inin06_Dummy.SysFricLrngFricOffsHiLim
    connect CalRegn01Inin06.SysFricLrngFricOffsLoLim -> AAACalRegn01Inin06_Dummy.SysFricLrngFricOffsLoLim
    connect CalRegn01Inin06.SysFricLrngFricOffsLpFilFrq -> AAACalRegn01Inin06_Dummy.SysFricLrngFricOffsLpFilFrq
    connect CalRegn01Inin06.SysFricLrngGain -> AAACalRegn01Inin06_Dummy.SysFricLrngGain
    connect CalRegn01Inin06.SysFricLrngHiFricDebStep -> AAACalRegn01Inin06_Dummy.SysFricLrngHiFricDebStep
    connect CalRegn01Inin06.SysFricLrngHiFricDiagcThd -> AAACalRegn01Inin06_Dummy.SysFricLrngHiFricDiagcThd
    connect CalRegn01Inin06.SysFricLrngHwPosnAuthyThd -> AAACalRegn01Inin06_Dummy.SysFricLrngHwPosnAuthyThd
    connect CalRegn01Inin06.SysFricLrngHwVelConstrLim -> AAACalRegn01Inin06_Dummy.SysFricLrngHwVelConstrLim
    connect CalRegn01Inin06.SysFricLrngHwVelHiLim -> AAACalRegn01Inin06_Dummy.SysFricLrngHwVelHiLim
    connect CalRegn01Inin06.SysFricLrngHwVelLoLim -> AAACalRegn01Inin06_Dummy.SysFricLrngHwVelLoLim
    connect CalRegn01Inin06.SysFricLrngIgnCycFricChgLim -> AAACalRegn01Inin06_Dummy.SysFricLrngIgnCycFricChgLim
    connect CalRegn01Inin06.SysFricLrngIgnCycFricOffs -> AAACalRegn01Inin06_Dummy.SysFricLrngIgnCycFricOffs
    connect CalRegn01Inin06.SysFricLrngIvsTrsmRatX -> AAACalRegn01Inin06_Dummy.SysFricLrngIvsTrsmRatX
    connect CalRegn01Inin06.SysFricLrngIvsTrsmRatY -> AAACalRegn01Inin06_Dummy.SysFricLrngIvsTrsmRatY
    connect CalRegn01Inin06.SysFricLrngLatAHiLim -> AAACalRegn01Inin06_Dummy.SysFricLrngLatAHiLim
    connect CalRegn01Inin06.SysFricLrngLatALoLim -> AAACalRegn01Inin06_Dummy.SysFricLrngLatALoLim
    connect CalRegn01Inin06.SysFricLrngMaskVehSpd -> AAACalRegn01Inin06_Dummy.SysFricLrngMaskVehSpd
    connect CalRegn01Inin06.SysFricLrngRngCntrThd -> AAACalRegn01Inin06_Dummy.SysFricLrngRngCntrThd
    connect CalRegn01Inin06.SysFricLrngThd -> AAACalRegn01Inin06_Dummy.SysFricLrngThd
    connect CalRegn01Inin06.SysFricLrngTHiLim -> AAACalRegn01Inin06_Dummy.SysFricLrngTHiLim
    connect CalRegn01Inin06.SysFricLrngTLoLim -> AAACalRegn01Inin06_Dummy.SysFricLrngTLoLim
    connect CalRegn01Inin06.SysFricLrngVehSpd -> AAACalRegn01Inin06_Dummy.SysFricLrngVehSpd
    connect CalRegn01Inin06.SysGlbPrmSysKineRat -> AAACalRegn01Inin06_Dummy.SysGlbPrmSysKineRat
    connect CalRegn01Inin06.SysGlbPrmVehSpdBilnrSeln -> AAACalRegn01Inin06_Dummy.SysGlbPrmVehSpdBilnrSeln
    connect CalRegn01Inin06.SysKineAndEffMotAgToRackPosRatScaY -> AAACalRegn01Inin06_Dummy.SysKineAndEffMotAgToRackPosRatScaY
    connect CalRegn01Inin06.SysKineAndEffPinionAgToRackPosRatScaY -> AAACalRegn01Inin06_Dummy.SysKineAndEffPinionAgToRackPosRatScaY
    connect CalRegn01Inin06.SysKineAndEffPinionToRackEffScaY -> AAACalRegn01Inin06_Dummy.SysKineAndEffPinionToRackEffScaY
    connect CalRegn01Inin06.SysKineAndEffRoadWhlFromRackPosScaY -> AAACalRegn01Inin06_Dummy.SysKineAndEffRoadWhlFromRackPosScaY
    connect CalRegn01Inin06.SysKineAndEffSteerArmLenFromRackPosScaY -> AAACalRegn01Inin06_Dummy.SysKineAndEffSteerArmLenFromRackPosScaY
    connect CalRegn01Inin06.TunSelnAuthyVehSpdX -> AAACalRegn01Inin06_Dummy.TunSelnAuthyVehSpdX
    connect CalRegn01Inin06GroupA.BmwHwAgArbnAndEotPosnEotCcwMax -> AAACalRegn01Inin06GroupA_Dummy.BmwHwAgArbnAndEotPosnEotCcwMax
    connect CalRegn01Inin06GroupA.BmwHwAgArbnAndEotPosnEotCcwMin -> AAACalRegn01Inin06GroupA_Dummy.BmwHwAgArbnAndEotPosnEotCcwMin
    connect CalRegn01Inin06GroupA.BmwHwAgArbnAndEotPosnEotCwMax -> AAACalRegn01Inin06GroupA_Dummy.BmwHwAgArbnAndEotPosnEotCwMax
    connect CalRegn01Inin06GroupA.BmwHwAgArbnAndEotPosnEotCwMin -> AAACalRegn01Inin06GroupA_Dummy.BmwHwAgArbnAndEotPosnEotCwMin
    connect CalRegn01Inin06GroupA.BmwPwrPrkgDampgDiScadDampg -> AAACalRegn01Inin06GroupA_Dummy.BmwPwrPrkgDampgDiScadDampg
    connect CalRegn01Inin06GroupA.BmwPwrPrkgDampgMaxRate -> AAACalRegn01Inin06GroupA_Dummy.BmwPwrPrkgDampgMaxRate
    connect CalRegn01Inin06GroupA.EpsStEstimnMtrxA -> AAACalRegn01Inin06GroupA_Dummy.EpsStEstimnMtrxA
    connect CalRegn01Inin06GroupA.EpsStEstimnMtrxB -> AAACalRegn01Inin06GroupA_Dummy.EpsStEstimnMtrxB
    connect CalRegn01Inin06GroupA.EpsStEstimnMtrxC -> AAACalRegn01Inin06GroupA_Dummy.EpsStEstimnMtrxC
    connect CalRegn01Inin06GroupA.EpsStEstimnMtrxD -> AAACalRegn01Inin06GroupA_Dummy.EpsStEstimnMtrxD
    connect CalRegn01Inin06GroupA.HwTqTrakgCtrlFbGain{1..5} -> AAACalRegn01Inin06GroupA_Dummy.HwTqTrakgCtrlFbGain{1..5}
    connect CalRegn01Inin06GroupA.HwTqTrakgCtrlFfGainScaY -> AAACalRegn01Inin06GroupA_Dummy.HwTqTrakgCtrlFfGainScaY
    connect CalRegn01Inin06GroupA.HwTqTrakgCtrlVehSpdScaX -> AAACalRegn01Inin06GroupA_Dummy.HwTqTrakgCtrlVehSpdScaX
    connect CalRegn01Inin06GroupA.PosnTrakgServoEnaBlndFacTblX -> AAACalRegn01Inin06GroupA_Dummy.PosnTrakgServoEnaBlndFacTblX
    connect CalRegn01Inin06GroupA.PosnTrakgServoEnaBlndFacTblY -> AAACalRegn01Inin06GroupA_Dummy.PosnTrakgServoEnaBlndFacTblY
    connect CalRegn01Inin06GroupA.PosnTrakgServoGainArbnFltMtgtn -> AAACalRegn01Inin06GroupA_Dummy.PosnTrakgServoGainArbnFltMtgtn
    connect CalRegn01Inin06GroupA.PullCmpActvCmpLrnTiDecShoTerm -> AAACalRegn01Inin06GroupA_Dummy.PullCmpActvCmpLrnTiDecShoTerm
    connect CalRegn01Inin06GroupA.PullCmpActvCmpLrnTiIncShoTerm -> AAACalRegn01Inin06GroupA_Dummy.PullCmpActvCmpLrnTiIncShoTerm
    connect CalRegn01Inin06GroupA.PullCmpActvCmpLrnTiLongTerm -> AAACalRegn01Inin06GroupA_Dummy.PullCmpActvCmpLrnTiLongTerm
    connect CalRegn01Inin06GroupA.PullCmpActvCmpShoTermRstHwAgThd -> AAACalRegn01Inin06GroupA_Dummy.PullCmpActvCmpShoTermRstHwAgThd
    connect CalRegn01Inin06GroupA.PullCmpActvCmpShoTermRstHwTqThd -> AAACalRegn01Inin06GroupA_Dummy.PullCmpActvCmpShoTermRstHwTqThd
    connect CalRegn01Inin06GroupA.PullCmpActvCmpShoTermRstLatAThd -> AAACalRegn01Inin06GroupA_Dummy.PullCmpActvCmpShoTermRstLatAThd
    connect CalRegn01Inin06GroupA.PullCmpActvCmpShoTermRstYawRateThd -> AAACalRegn01Inin06GroupA_Dummy.PullCmpActvCmpShoTermRstYawRateThd
    connect CalRegn01Inin06GroupA.PullCmpActvEna -> AAACalRegn01Inin06GroupA_Dummy.PullCmpActvEna
    connect CalRegn01Inin06GroupA.PullCmpActvHwTqFilFrqLongTerm -> AAACalRegn01Inin06GroupA_Dummy.PullCmpActvHwTqFilFrqLongTerm
    connect CalRegn01Inin06GroupA.PullCmpActvHwTqFilFrqShoTerm -> AAACalRegn01Inin06GroupA_Dummy.PullCmpActvHwTqFilFrqShoTerm
    connect CalRegn01Inin06GroupA.PullCmpActvLongTermLim -> AAACalRegn01Inin06GroupA_Dummy.PullCmpActvLongTermLim
    connect CalRegn01Inin06GroupA.PullCmpActvLrngEnaAgConfMinMgn -> AAACalRegn01Inin06GroupA_Dummy.PullCmpActvLrngEnaAgConfMinMgn
    connect CalRegn01Inin06GroupA.PullCmpActvLrngEnaHwAgMaxMgn -> AAACalRegn01Inin06GroupA_Dummy.PullCmpActvLrngEnaHwAgMaxMgn
    connect CalRegn01Inin06GroupA.PullCmpActvLrngEnaHwTqMaxMgn -> AAACalRegn01Inin06GroupA_Dummy.PullCmpActvLrngEnaHwTqMaxMgn
    connect CalRegn01Inin06GroupA.PullCmpActvLrngEnaHwVelMaxMgn -> AAACalRegn01Inin06GroupA_Dummy.PullCmpActvLrngEnaHwVelMaxMgn
    connect CalRegn01Inin06GroupA.PullCmpActvLrngEnaLatAMaxMgn -> AAACalRegn01Inin06GroupA_Dummy.PullCmpActvLrngEnaLatAMaxMgn
    connect CalRegn01Inin06GroupA.PullCmpActvLrngEnaTiThd -> AAACalRegn01Inin06GroupA_Dummy.PullCmpActvLrngEnaTiThd
    connect CalRegn01Inin06GroupA.PullCmpActvLrngEnaVehSpdMaxMgn -> AAACalRegn01Inin06GroupA_Dummy.PullCmpActvLrngEnaVehSpdMaxMgn
    connect CalRegn01Inin06GroupA.PullCmpActvLrngEnaVehSpdMinMgn -> AAACalRegn01Inin06GroupA_Dummy.PullCmpActvLrngEnaVehSpdMinMgn
    connect CalRegn01Inin06GroupA.PullCmpActvLrngEnaVehSpdRateMaxMgn -> AAACalRegn01Inin06GroupA_Dummy.PullCmpActvLrngEnaVehSpdRateMaxMgn
    connect CalRegn01Inin06GroupA.PullCmpActvLrngEnaYawRateMaxMgn -> AAACalRegn01Inin06GroupA_Dummy.PullCmpActvLrngEnaYawRateMaxMgn
    connect CalRegn01Inin06GroupA.PullCmpActvOpstSignTiShoTerm -> AAACalRegn01Inin06GroupA_Dummy.PullCmpActvOpstSignTiShoTerm
    connect CalRegn01Inin06GroupA.PullCmpActvOutpMaxRate -> AAACalRegn01Inin06GroupA_Dummy.PullCmpActvOutpMaxRate
    connect CalRegn01Inin06GroupA.PullCmpActvPullCmpShoTermLim -> AAACalRegn01Inin06GroupA_Dummy.PullCmpActvPullCmpShoTermLim
    connect CalRegn01Inin06GroupA.PullCmpActvPullCmpTotLim -> AAACalRegn01Inin06GroupA_Dummy.PullCmpActvPullCmpTotLim
    connect CalRegn01Inin06GroupA.PullCmpActvPullErrLimLongTerm -> AAACalRegn01Inin06GroupA_Dummy.PullCmpActvPullErrLimLongTerm
    connect CalRegn01Inin06GroupA.PullCmpActvPullErrMgnThd -> AAACalRegn01Inin06GroupA_Dummy.PullCmpActvPullErrMgnThd
    connect CalRegn01Inin06GroupA.PullCmpActvPullErrShoTermLim -> AAACalRegn01Inin06GroupA_Dummy.PullCmpActvPullErrShoTermLim
    connect CalRegn01Inin06GroupA.PullCmpActvShoTermRampTi -> AAACalRegn01Inin06GroupA_Dummy.PullCmpActvShoTermRampTi
    connect CalRegn01Inin06GroupA.PullCmpActvVehSpdScaTblX -> AAACalRegn01Inin06GroupA_Dummy.PullCmpActvVehSpdScaTblX
    connect CalRegn01Inin06GroupA.PullCmpActvVehSpdScaTblY -> AAACalRegn01Inin06GroupA_Dummy.PullCmpActvVehSpdScaTblY
    connect CalRegn01Inin06GroupC.CtrldVelRtnDesVelLpFilFrq -> AAACalRegn01Inin06GroupC_Dummy.CtrldVelRtnDesVelLpFilFrq
    connect CalRegn01Inin06GroupC.CtrldVelRtnHwTqLpFilFrq -> AAACalRegn01Inin06GroupC_Dummy.CtrldVelRtnHwTqLpFilFrq
    connect CalRegn01Inin06GroupC.CtrldVelRtnHwTqScaSelnSlewHiLim -> AAACalRegn01Inin06GroupC_Dummy.CtrldVelRtnHwTqScaSelnSlewHiLim
    connect CalRegn01Inin06GroupC.CtrldVelRtnHwTqScaSelnSlewLoLim -> AAACalRegn01Inin06GroupC_Dummy.CtrldVelRtnHwTqScaSelnSlewLoLim
    connect CalRegn01Inin06GroupC.CtrldVelRtnHwTqScaSelnTqThd -> AAACalRegn01Inin06GroupC_Dummy.CtrldVelRtnHwTqScaSelnTqThd
    connect CalRegn01Inin06GroupC.CtrldVelRtnHwTqScaSelnVelThd -> AAACalRegn01Inin06GroupC_Dummy.CtrldVelRtnHwTqScaSelnVelThd
    connect CalRegn01Inin06GroupC.CtrldVelRtnIntgrLimY -> AAACalRegn01Inin06GroupC_Dummy.CtrldVelRtnIntgrLimY
    connect CalRegn01Inin06GroupC.CtrldVelRtnOffsSlewThd -> AAACalRegn01Inin06GroupC_Dummy.CtrldVelRtnOffsSlewThd
    connect CalRegn01Inin06GroupC.CtrldVelRtnOffsThd -> AAACalRegn01Inin06GroupC_Dummy.CtrldVelRtnOffsThd
    connect CalRegn01Inin06GroupC.CtrldVelRtnScaLpFilFrq -> AAACalRegn01Inin06GroupC_Dummy.CtrldVelRtnScaLpFilFrq
    connect CalRegn01Inin06GroupC.FalbckAssiAssiX -> AAACalRegn01Inin06GroupC_Dummy.FalbckAssiAssiX
    connect CalRegn01Inin06GroupC.FalbckAssiAssiY -> AAACalRegn01Inin06GroupC_Dummy.FalbckAssiAssiY
    connect CalRegn01Inin06GroupC.FalbckAssiNotchFil -> AAACalRegn01Inin06GroupC_Dummy.FalbckAssiNotchFil
    connect CalRegn01Inin06GroupC.GlbLimrBndX -> AAACalRegn01Inin06GroupC_Dummy.GlbLimrBndX
    connect CalRegn01Inin06GroupC.GlbLimrBndY -> AAACalRegn01Inin06GroupC_Dummy.GlbLimrBndY
    connect CalRegn01Inin06GroupC.GlbLimrNotchFilStruct -> AAACalRegn01Inin06GroupC_Dummy.GlbLimrNotchFilStruct
    connect CalRegn01Inin06GroupC.GlbLimrVehSpdBilnrSeln -> AAACalRegn01Inin06GroupC_Dummy.GlbLimrVehSpdBilnrSeln
    connect CalRegn01Inin06GroupD.EotProtnDampgVehSpdTbl -> AAACalRegn01Inin06GroupD_Dummy.EotProtnDampgVehSpdTbl
    connect CalRegn01Inin06GroupD.EotProtnDeltaTqThd -> AAACalRegn01Inin06GroupD_Dummy.EotProtnDeltaTqThd
    connect CalRegn01Inin06GroupD.EotProtnEntrGainAuthyThd -> AAACalRegn01Inin06GroupD_Dummy.EotProtnEntrGainAuthyThd
    connect CalRegn01Inin06GroupD.EotProtnEntrGainVehSpdTbl -> AAACalRegn01Inin06GroupD_Dummy.EotProtnEntrGainVehSpdTbl
    connect CalRegn01Inin06GroupD.EotProtnEntrGainX -> AAACalRegn01Inin06GroupD_Dummy.EotProtnEntrGainX
    connect CalRegn01Inin06GroupD.EotProtnEntrGainY -> AAACalRegn01Inin06GroupD_Dummy.EotProtnEntrGainY
    connect CalRegn01Inin06GroupD.EotProtnEntrStLpFilFrq -> AAACalRegn01Inin06GroupD_Dummy.EotProtnEntrStLpFilFrq
    connect CalRegn01Inin06GroupD.EotProtnExitDampgY -> AAACalRegn01Inin06GroupD_Dummy.EotProtnExitDampgY
    connect CalRegn01Inin06GroupD.EotProtnExitStLpFilFrq -> AAACalRegn01Inin06GroupD_Dummy.EotProtnExitStLpFilFrq
    connect CalRegn01Inin06GroupD.EotProtnHwDegDampgX -> AAACalRegn01Inin06GroupD_Dummy.EotProtnHwDegDampgX
    connect CalRegn01Inin06GroupD.EotProtnHwTqLpFilFrq -> AAACalRegn01Inin06GroupD_Dummy.EotProtnHwTqLpFilFrq
    connect CalRegn01Inin06GroupD.EotProtnHwTqScaX -> AAACalRegn01Inin06GroupD_Dummy.EotProtnHwTqScaX
    connect CalRegn01Inin06GroupD.EotProtnLoAuthyEntrGainY -> AAACalRegn01Inin06GroupD_Dummy.EotProtnLoAuthyEntrGainY
    connect CalRegn01Inin06GroupD.EotProtnMotSpdIncptSca -> AAACalRegn01Inin06GroupD_Dummy.EotProtnMotSpdIncptSca
    connect CalRegn01Inin06GroupD.EotProtnMotSpdIncptX -> AAACalRegn01Inin06GroupD_Dummy.EotProtnMotSpdIncptX
    connect CalRegn01Inin06GroupD.EotProtnMotSpdIncptY -> AAACalRegn01Inin06GroupD_Dummy.EotProtnMotSpdIncptY
    connect CalRegn01Inin06GroupD.EotProtnMotVelGain -> AAACalRegn01Inin06GroupD_Dummy.EotProtnMotVelGain
    connect CalRegn01Inin06GroupD.EotProtnNormDampgY -> AAACalRegn01Inin06GroupD_Dummy.EotProtnNormDampgY
    connect CalRegn01Inin06GroupD.EotProtnPosnRampStep -> AAACalRegn01Inin06GroupD_Dummy.EotProtnPosnRampStep
    connect CalRegn01Inin06GroupD.EotProtnRackTrvlLimrAuthyThd -> AAACalRegn01Inin06GroupD_Dummy.EotProtnRackTrvlLimrAuthyThd
    connect CalRegn01Inin06GroupD.EotProtnRackTrvlLimrAuthyThdLimd -> AAACalRegn01Inin06GroupD_Dummy.EotProtnRackTrvlLimrAuthyThdLimd
    connect CalRegn01Inin06GroupD.EotProtnRackTrvlLimrRng -> AAACalRegn01Inin06GroupD_Dummy.EotProtnRackTrvlLimrRng
    connect CalRegn01Inin06GroupD.EotProtnRackTrvlLimrRngLimd -> AAACalRegn01Inin06GroupD_Dummy.EotProtnRackTrvlLimrRngLimd
    connect CalRegn01Inin06GroupD.EotProtnRackTrvlLimrVehSpdThd -> AAACalRegn01Inin06GroupD_Dummy.EotProtnRackTrvlLimrVehSpdThd
    connect CalRegn01Inin06GroupD.EotProtnRunEotVelImpctAndSoftEndStop -> AAACalRegn01Inin06GroupD_Dummy.EotProtnRunEotVelImpctAndSoftEndStop
    connect CalRegn01Inin06GroupD.InertiaCmpVelAssiBasdDampgCoeffX -> AAACalRegn01Inin06GroupD_Dummy.InertiaCmpVelAssiBasdDampgCoeffX
    connect CalRegn01Inin06GroupD.InertiaCmpVelAssiBasdDampgRollgWhlImbRejctnOnY -> AAACalRegn01Inin06GroupD_Dummy.InertiaCmpVelAssiBasdDampgRollgWhlImbRejctnOnY
    connect CalRegn01Inin06GroupD.InertiaCmpVelAssiBasdDampgRollgY -> AAACalRegn01Inin06GroupD_Dummy.InertiaCmpVelAssiBasdDampgRollgY
    connect CalRegn01Inin06GroupD.InertiaCmpVelAssiBasdDampgStatWhlImbRejctnOnY -> AAACalRegn01Inin06GroupD_Dummy.InertiaCmpVelAssiBasdDampgStatWhlImbRejctnOnY
    connect CalRegn01Inin06GroupD.InertiaCmpVelAssiBasdDampgStatY -> AAACalRegn01Inin06GroupD_Dummy.InertiaCmpVelAssiBasdDampgStatY
    connect CalRegn01Inin06GroupD.InertiaCmpVelCmdScaY -> AAACalRegn01Inin06GroupD_Dummy.InertiaCmpVelCmdScaY
    connect CalRegn01Inin06GroupD.InertiaCmpVelDampgDecelGain -> AAACalRegn01Inin06GroupD_Dummy.InertiaCmpVelDampgDecelGain
    connect CalRegn01Inin06GroupD.InertiaCmpVelDampgDecelGainFallSlew -> AAACalRegn01Inin06GroupD_Dummy.InertiaCmpVelDampgDecelGainFallSlew
    connect CalRegn01Inin06GroupD.InertiaCmpVelDampgDecelGainRisngSlewX -> AAACalRegn01Inin06GroupD_Dummy.InertiaCmpVelDampgDecelGainRisngSlewX
    connect CalRegn01Inin06GroupD.InertiaCmpVelDampgDecelGainRisngSlewY -> AAACalRegn01Inin06GroupD_Dummy.InertiaCmpVelDampgDecelGainRisngSlewY
    connect CalRegn01Inin06GroupD.InertiaCmpVelDampgFilFrq -> AAACalRegn01Inin06GroupD_Dummy.InertiaCmpVelDampgFilFrq
    connect CalRegn01Inin06GroupD.InertiaCmpVelDampgFilFrqWhlImbRejctnOn -> AAACalRegn01Inin06GroupD_Dummy.InertiaCmpVelDampgFilFrqWhlImbRejctnOn
    connect CalRegn01Inin06GroupD.InertiaCmpVelDampgGainOffThd -> AAACalRegn01Inin06GroupD_Dummy.InertiaCmpVelDampgGainOffThd
    connect CalRegn01Inin06GroupD.InertiaCmpVelDampgGainOnThd -> AAACalRegn01Inin06GroupD_Dummy.InertiaCmpVelDampgGainOnThd
    connect CalRegn01Inin06GroupD.InertiaCmpVelDampgSpdBlndY -> AAACalRegn01Inin06GroupD_Dummy.InertiaCmpVelDampgSpdBlndY
    connect CalRegn01Inin06GroupD.InertiaCmpVelDampgWhlImbRejctnBlndX -> AAACalRegn01Inin06GroupD_Dummy.InertiaCmpVelDampgWhlImbRejctnBlndX
    connect CalRegn01Inin06GroupD.InertiaCmpVelDampgWhlImbRejctnBlndY -> AAACalRegn01Inin06GroupD_Dummy.InertiaCmpVelDampgWhlImbRejctnBlndY
    connect CalRegn01Inin06GroupD.InertiaCmpVelDecelGainEnaCal -> AAACalRegn01Inin06GroupD_Dummy.InertiaCmpVelDecelGainEnaCal
    connect CalRegn01Inin06GroupD.InertiaCmpVelModWhlImbRejctnBlndX -> AAACalRegn01Inin06GroupD_Dummy.InertiaCmpVelModWhlImbRejctnBlndX
    connect CalRegn01Inin06GroupD.InertiaCmpVelModWhlImbRejctnBlndY -> AAACalRegn01Inin06GroupD_Dummy.InertiaCmpVelModWhlImbRejctnBlndY
    connect CalRegn01Inin06GroupD.InertiaCmpVelMotInertia -> AAACalRegn01Inin06GroupD_Dummy.InertiaCmpVelMotInertia
    connect CalRegn01Inin06GroupD.InertiaCmpVelMotVelBasdOutpScagX -> AAACalRegn01Inin06GroupD_Dummy.InertiaCmpVelMotVelBasdOutpScagX
    connect CalRegn01Inin06GroupD.InertiaCmpVelMotVelBasdOutpScagY -> AAACalRegn01Inin06GroupD_Dummy.InertiaCmpVelMotVelBasdOutpScagY
    connect CalRegn01Inin06GroupD.InertiaCmpVelNotchBlndY -> AAACalRegn01Inin06GroupD_Dummy.InertiaCmpVelNotchBlndY
    connect CalRegn01Inin06GroupD.InertiaCmpVelNotchFilStruct -> AAACalRegn01Inin06GroupD_Dummy.InertiaCmpVelNotchFilStruct
    connect CalRegn01Inin06GroupD.InertiaCmpVelTqSnsrVelFilFrq -> AAACalRegn01Inin06GroupD_Dummy.InertiaCmpVelTqSnsrVelFilFrq
    connect CalRegn01Inin06GroupD.InertiaCmpVelTqSnsrVelSca -> AAACalRegn01Inin06GroupD_Dummy.InertiaCmpVelTqSnsrVelSca
    connect CalRegn01IninOptSetA00.DutyCycThermProtnAbsltCtrlTFetMtgtnTblX -> AAACalRegn01IninOptSetA00_Dummy.DutyCycThermProtnAbsltCtrlTFetMtgtnTblX
    connect CalRegn01IninOptSetA00.DutyCycThermProtnAbsltCtrlTTblX -> AAACalRegn01IninOptSetA00_Dummy.DutyCycThermProtnAbsltCtrlTTblX
    connect CalRegn01IninOptSetA00.DutyCycThermProtnAbsltCtrlTTqFetMtgtnTblY -> AAACalRegn01IninOptSetA00_Dummy.DutyCycThermProtnAbsltCtrlTTqFetMtgtnTblY
    connect CalRegn01IninOptSetA00.DutyCycThermProtnAbsltCtrlTTqTblY -> AAACalRegn01IninOptSetA00_Dummy.DutyCycThermProtnAbsltCtrlTTqTblY
    connect CalRegn01IninOptSetA00.DutyCycThermProtnAbsltCuTFetMtgtnTblX -> AAACalRegn01IninOptSetA00_Dummy.DutyCycThermProtnAbsltCuTFetMtgtnTblX
    connect CalRegn01IninOptSetA00.DutyCycThermProtnAbsltCuTTblX -> AAACalRegn01IninOptSetA00_Dummy.DutyCycThermProtnAbsltCuTTblX
    connect CalRegn01IninOptSetA00.DutyCycThermProtnAbsltCuTTqFetMtgtnTblY -> AAACalRegn01IninOptSetA00_Dummy.DutyCycThermProtnAbsltCuTTqFetMtgtnTblY
    connect CalRegn01IninOptSetA00.DutyCycThermProtnAbsltCuTTqTblY -> AAACalRegn01IninOptSetA00_Dummy.DutyCycThermProtnAbsltCuTTqTblY
    connect CalRegn01IninOptSetA00.DutyCycThermProtnAbsltMotVelBreakPt -> AAACalRegn01IninOptSetA00_Dummy.DutyCycThermProtnAbsltMotVelBreakPt
    connect CalRegn01IninOptSetA00.DutyCycThermProtnAbsltTTqSlewHiLim -> AAACalRegn01IninOptSetA00_Dummy.DutyCycThermProtnAbsltTTqSlewHiLim
    connect CalRegn01IninOptSetA00.DutyCycThermProtnAbsltTTqSlewLoLim -> AAACalRegn01IninOptSetA00_Dummy.DutyCycThermProtnAbsltTTqSlewLoLim
    connect CalRegn01IninOptSetA00.DutyCycThermProtnCtrlT -> AAACalRegn01IninOptSetA00_Dummy.DutyCycThermProtnCtrlT
    connect CalRegn01IninOptSetA00.DutyCycThermProtnCtrlTSeln -> AAACalRegn01IninOptSetA00_Dummy.DutyCycThermProtnCtrlTSeln
    connect CalRegn01IninOptSetA00.DutyCycThermProtnDutyCycFildThd -> AAACalRegn01IninOptSetA00_Dummy.DutyCycThermProtnDutyCycFildThd
    connect CalRegn01IninOptSetA00.DutyCycThermProtnIgnOffCtrlEna -> AAACalRegn01IninOptSetA00_Dummy.DutyCycThermProtnIgnOffCtrlEna
    connect CalRegn01IninOptSetA00.DutyCycThermProtnIgnOffMsgWaitTi -> AAACalRegn01IninOptSetA00_Dummy.DutyCycThermProtnIgnOffMsgWaitTi
    connect CalRegn01IninOptSetA00.DutyCycThermProtnLstTblValNonStall -> AAACalRegn01IninOptSetA00_Dummy.DutyCycThermProtnLstTblValNonStall
    connect CalRegn01IninOptSetA00.DutyCycThermProtnLstTblValStall -> AAACalRegn01IninOptSetA00_Dummy.DutyCycThermProtnLstTblValStall
    connect CalRegn01IninOptSetA00.DutyCycThermProtnMotPrTSeln -> AAACalRegn01IninOptSetA00_Dummy.DutyCycThermProtnMotPrTSeln
    connect CalRegn01IninOptSetA00.DutyCycThermProtnMplr1FetMtgtnNonStallTblY -> AAACalRegn01IninOptSetA00_Dummy.DutyCycThermProtnMplr1FetMtgtnNonStallTblY
    connect CalRegn01IninOptSetA00.DutyCycThermProtnMplr1FetMtgtnStallTblY -> AAACalRegn01IninOptSetA00_Dummy.DutyCycThermProtnMplr1FetMtgtnStallTblY
    connect CalRegn01IninOptSetA00.DutyCycThermProtnMplr1NonStallTblY -> AAACalRegn01IninOptSetA00_Dummy.DutyCycThermProtnMplr1NonStallTblY
    connect CalRegn01IninOptSetA00.DutyCycThermProtnMplr1StallTblY -> AAACalRegn01IninOptSetA00_Dummy.DutyCycThermProtnMplr1StallTblY
    connect CalRegn01IninOptSetA00.DutyCycThermProtnMplr2FetMtgtnNonStallTblY -> AAACalRegn01IninOptSetA00_Dummy.DutyCycThermProtnMplr2FetMtgtnNonStallTblY
    connect CalRegn01IninOptSetA00.DutyCycThermProtnMplr2FetMtgtnStallTblY -> AAACalRegn01IninOptSetA00_Dummy.DutyCycThermProtnMplr2FetMtgtnStallTblY
    connect CalRegn01IninOptSetA00.DutyCycThermProtnMplr2NonStallTblY -> AAACalRegn01IninOptSetA00_Dummy.DutyCycThermProtnMplr2NonStallTblY
    connect CalRegn01IninOptSetA00.DutyCycThermProtnMplr2StallTblY -> AAACalRegn01IninOptSetA00_Dummy.DutyCycThermProtnMplr2StallTblY
    connect CalRegn01IninOptSetA00.DutyCycThermProtnMplr3FetMtgtnNonStallTblY -> AAACalRegn01IninOptSetA00_Dummy.DutyCycThermProtnMplr3FetMtgtnNonStallTblY
    connect CalRegn01IninOptSetA00.DutyCycThermProtnMplr3FetMtgtnStallTblY -> AAACalRegn01IninOptSetA00_Dummy.DutyCycThermProtnMplr3FetMtgtnStallTblY
    connect CalRegn01IninOptSetA00.DutyCycThermProtnMplr3NonStallTblY -> AAACalRegn01IninOptSetA00_Dummy.DutyCycThermProtnMplr3NonStallTblY
    connect CalRegn01IninOptSetA00.DutyCycThermProtnMplr3StallTblY -> AAACalRegn01IninOptSetA00_Dummy.DutyCycThermProtnMplr3StallTblY
    connect CalRegn01IninOptSetA00.DutyCycThermProtnMplr4FetMtgtnNonStallTblY -> AAACalRegn01IninOptSetA00_Dummy.DutyCycThermProtnMplr4FetMtgtnNonStallTblY
    connect CalRegn01IninOptSetA00.DutyCycThermProtnMplr4FetMtgtnStallTblY -> AAACalRegn01IninOptSetA00_Dummy.DutyCycThermProtnMplr4FetMtgtnStallTblY
    connect CalRegn01IninOptSetA00.DutyCycThermProtnMplr4NonStallTblY -> AAACalRegn01IninOptSetA00_Dummy.DutyCycThermProtnMplr4NonStallTblY
    connect CalRegn01IninOptSetA00.DutyCycThermProtnMplr4StallTblY -> AAACalRegn01IninOptSetA00_Dummy.DutyCycThermProtnMplr4StallTblY
    connect CalRegn01IninOptSetA00.DutyCycThermProtnMplr5FetMtgtnNonStallTblY -> AAACalRegn01IninOptSetA00_Dummy.DutyCycThermProtnMplr5FetMtgtnNonStallTblY
    connect CalRegn01IninOptSetA00.DutyCycThermProtnMplr5FetMtgtnStallTblY -> AAACalRegn01IninOptSetA00_Dummy.DutyCycThermProtnMplr5FetMtgtnStallTblY
    connect CalRegn01IninOptSetA00.DutyCycThermProtnMplr5NonStallTblY -> AAACalRegn01IninOptSetA00_Dummy.DutyCycThermProtnMplr5NonStallTblY
    connect CalRegn01IninOptSetA00.DutyCycThermProtnMplr5StallTblY -> AAACalRegn01IninOptSetA00_Dummy.DutyCycThermProtnMplr5StallTblY
    connect CalRegn01IninOptSetA00.DutyCycThermProtnMplr6FetMtgtnNonStallTblY -> AAACalRegn01IninOptSetA00_Dummy.DutyCycThermProtnMplr6FetMtgtnNonStallTblY
    connect CalRegn01IninOptSetA00.DutyCycThermProtnMplr6FetMtgtnStallTblY -> AAACalRegn01IninOptSetA00_Dummy.DutyCycThermProtnMplr6FetMtgtnStallTblY
    connect CalRegn01IninOptSetA00.DutyCycThermProtnMplr6NonStallTblY -> AAACalRegn01IninOptSetA00_Dummy.DutyCycThermProtnMplr6NonStallTblY
    connect CalRegn01IninOptSetA00.DutyCycThermProtnMplr6StallTblY -> AAACalRegn01IninOptSetA00_Dummy.DutyCycThermProtnMplr6StallTblY
    connect CalRegn01IninOptSetA00.DutyCycThermProtnMplrFetMtgtnTblX -> AAACalRegn01IninOptSetA00_Dummy.DutyCycThermProtnMplrFetMtgtnTblX
    connect CalRegn01IninOptSetA00.DutyCycThermProtnMplrTblX -> AAACalRegn01IninOptSetA00_Dummy.DutyCycThermProtnMplrTblX
    connect CalRegn01IninOptSetA00.DutyCycThermProtnMplrTSeln -> AAACalRegn01IninOptSetA00_Dummy.DutyCycThermProtnMplrTSeln
    connect CalRegn01IninOptSetA00.DutyCycThermProtnSlowFilTSeln -> AAACalRegn01IninOptSetA00_Dummy.DutyCycThermProtnSlowFilTSeln
    connect CalRegn01IninOptSetA00.DutyCycThermProtnThermLimScaFac -> AAACalRegn01IninOptSetA00_Dummy.DutyCycThermProtnThermLimScaFac
    connect CalRegn01IninOptSetA00.DutyCycThermProtnThermLoadLimTblX -> AAACalRegn01IninOptSetA00_Dummy.DutyCycThermProtnThermLoadLimTblX
    connect CalRegn01IninOptSetA00.DutyCycThermProtnThermLoadLimTblY -> AAACalRegn01IninOptSetA00_Dummy.DutyCycThermProtnThermLoadLimTblY
    connect CalRegn01IninOptSetA00.DutyCycThermProtnTqCmdSlewDwn -> AAACalRegn01IninOptSetA00_Dummy.DutyCycThermProtnTqCmdSlewDwn
    connect CalRegn01IninOptSetA00.DutyCycThermProtnTqCmdSlewUp -> AAACalRegn01IninOptSetA00_Dummy.DutyCycThermProtnTqCmdSlewUp
    connect CalRegn01IninOptSetA00.HiLoadStallLimrMotVelMgnThd -> AAACalRegn01IninOptSetA00_Dummy.HiLoadStallLimrMotVelMgnThd
    connect CalRegn01IninOptSetA00.HiLoadStallLimrStallMotTqCmdFetMtgtnLimX -> AAACalRegn01IninOptSetA00_Dummy.HiLoadStallLimrStallMotTqCmdFetMtgtnLimX
    connect CalRegn01IninOptSetA00.HiLoadStallLimrStallMotTqCmdFetMtgtnLimY -> AAACalRegn01IninOptSetA00_Dummy.HiLoadStallLimrStallMotTqCmdFetMtgtnLimY
    connect CalRegn01IninOptSetA00.HiLoadStallLimrStallMotTqCmdLimX -> AAACalRegn01IninOptSetA00_Dummy.HiLoadStallLimrStallMotTqCmdLimX
    connect CalRegn01IninOptSetA00.HiLoadStallLimrStallMotTqCmdLimY -> AAACalRegn01IninOptSetA00_Dummy.HiLoadStallLimrStallMotTqCmdLimY
    connect CalRegn01IninOptSetA00.HiLoadStallLimrStallMotTqLimSlewRate -> AAACalRegn01IninOptSetA00_Dummy.HiLoadStallLimrStallMotTqLimSlewRate
    connect CalRegn01IninOptSetA00.HiLoadStallLimrStallThermLimSca -> AAACalRegn01IninOptSetA00_Dummy.HiLoadStallLimrStallThermLimSca
    connect CalRegn01IninOptSetA00.LrndRackCentrMotTqThd -> AAACalRegn01IninOptSetA00_Dummy.LrndRackCentrMotTqThd
    connect CalRegn01IninOptSetA00.LrndRackCentrMotVelThd -> AAACalRegn01IninOptSetA00_Dummy.LrndRackCentrMotVelThd
    connect CalRegn01IninOptSetA00.MotCtrlPrmEstimnFetRNom -> AAACalRegn01IninOptSetA00_Dummy.MotCtrlPrmEstimnFetRNom
    connect CalRegn01IninOptSetA00.MotCtrlPrmEstimnMotBackEmfConHiLim -> AAACalRegn01IninOptSetA00_Dummy.MotCtrlPrmEstimnMotBackEmfConHiLim
    connect CalRegn01IninOptSetA00.MotCtrlPrmEstimnMotBackEmfConLoLim -> AAACalRegn01IninOptSetA00_Dummy.MotCtrlPrmEstimnMotBackEmfConLoLim
    connect CalRegn01IninOptSetA00.MotCtrlPrmEstimnMotBackEmfConNom -> AAACalRegn01IninOptSetA00_Dummy.MotCtrlPrmEstimnMotBackEmfConNom
    connect CalRegn01IninOptSetA00.MotCtrlPrmEstimnMotBackEmfConSatnScaIvtrLoaMtgtn -> AAACalRegn01IninOptSetA00_Dummy.MotCtrlPrmEstimnMotBackEmfConSatnScaIvtrLoaMtgtn
    connect CalRegn01IninOptSetA00.MotCtrlPrmEstimnMotBackEmfConSatnX -> AAACalRegn01IninOptSetA00_Dummy.MotCtrlPrmEstimnMotBackEmfConSatnX
    connect CalRegn01IninOptSetA00.MotCtrlPrmEstimnMotBackEmfConSatnY -> AAACalRegn01IninOptSetA00_Dummy.MotCtrlPrmEstimnMotBackEmfConSatnY
    connect CalRegn01IninOptSetA00.MotCtrlPrmEstimnMotCurrDaxInduSatnBilnrSeln -> AAACalRegn01IninOptSetA00_Dummy.MotCtrlPrmEstimnMotCurrDaxInduSatnBilnrSeln
    connect CalRegn01IninOptSetA00.MotCtrlPrmEstimnMotCurrQaxInduSatnX -> AAACalRegn01IninOptSetA00_Dummy.MotCtrlPrmEstimnMotCurrQaxInduSatnX
    connect CalRegn01IninOptSetA00.MotCtrlPrmEstimnMotInduDaxHiLim -> AAACalRegn01IninOptSetA00_Dummy.MotCtrlPrmEstimnMotInduDaxHiLim
    connect CalRegn01IninOptSetA00.MotCtrlPrmEstimnMotInduDaxIvtrLoaMtgtn -> AAACalRegn01IninOptSetA00_Dummy.MotCtrlPrmEstimnMotInduDaxIvtrLoaMtgtn
    connect CalRegn01IninOptSetA00.MotCtrlPrmEstimnMotInduDaxLoLim -> AAACalRegn01IninOptSetA00_Dummy.MotCtrlPrmEstimnMotInduDaxLoLim
    connect CalRegn01IninOptSetA00.MotCtrlPrmEstimnMotInduDaxNom -> AAACalRegn01IninOptSetA00_Dummy.MotCtrlPrmEstimnMotInduDaxNom
    connect CalRegn01IninOptSetA00.MotCtrlPrmEstimnMotInduDaxSatnScaY -> AAACalRegn01IninOptSetA00_Dummy.MotCtrlPrmEstimnMotInduDaxSatnScaY
    connect CalRegn01IninOptSetA00.MotCtrlPrmEstimnMotInduQaxHiLim -> AAACalRegn01IninOptSetA00_Dummy.MotCtrlPrmEstimnMotInduQaxHiLim
    connect CalRegn01IninOptSetA00.MotCtrlPrmEstimnMotInduQaxIvtrLoaMtgtn -> AAACalRegn01IninOptSetA00_Dummy.MotCtrlPrmEstimnMotInduQaxIvtrLoaMtgtn
    connect CalRegn01IninOptSetA00.MotCtrlPrmEstimnMotInduQaxLoLim -> AAACalRegn01IninOptSetA00_Dummy.MotCtrlPrmEstimnMotInduQaxLoLim
    connect CalRegn01IninOptSetA00.MotCtrlPrmEstimnMotInduQaxNom -> AAACalRegn01IninOptSetA00_Dummy.MotCtrlPrmEstimnMotInduQaxNom
    connect CalRegn01IninOptSetA00.MotCtrlPrmEstimnMotInduQaxSatnScaY -> AAACalRegn01IninOptSetA00_Dummy.MotCtrlPrmEstimnMotInduQaxSatnScaY
    connect CalRegn01IninOptSetA00.MotCtrlPrmEstimnMotRHiLim -> AAACalRegn01IninOptSetA00_Dummy.MotCtrlPrmEstimnMotRHiLim
    connect CalRegn01IninOptSetA00.MotCtrlPrmEstimnMotRLoLim -> AAACalRegn01IninOptSetA00_Dummy.MotCtrlPrmEstimnMotRLoLim
    connect CalRegn01IninOptSetA00.MotCtrlPrmEstimnMotRNom -> AAACalRegn01IninOptSetA00_Dummy.MotCtrlPrmEstimnMotRNom
    connect CalRegn01IninOptSetA00.MotCtrlPrmEstimnMotWidgThermCoeff -> AAACalRegn01IninOptSetA00_Dummy.MotCtrlPrmEstimnMotWidgThermCoeff
    connect CalRegn01IninOptSetA00.MotCtrlPrmEstimnTNom -> AAACalRegn01IninOptSetA00_Dummy.MotCtrlPrmEstimnTNom
    connect CalRegn01IninOptSetA00.MotCurrPeakEstimnCurrFilFrq -> AAACalRegn01IninOptSetA00_Dummy.MotCurrPeakEstimnCurrFilFrq
    connect CalRegn01IninOptSetA00.MotCurrPeakEstimnCurrPeakEstimdFilFrq -> AAACalRegn01IninOptSetA00_Dummy.MotCurrPeakEstimnCurrPeakEstimdFilFrq
    connect CalRegn01IninOptSetA00.MotCurrRegCfgMotClsdLoopBwDaxY -> AAACalRegn01IninOptSetA00_Dummy.MotCurrRegCfgMotClsdLoopBwDaxY
    connect CalRegn01IninOptSetA00.MotCurrRegCfgMotClsdLoopBwQaxY -> AAACalRegn01IninOptSetA00_Dummy.MotCurrRegCfgMotClsdLoopBwQaxY
    connect CalRegn01IninOptSetA00.MotCurrRegCfgMotDampgRatDax -> AAACalRegn01IninOptSetA00_Dummy.MotCurrRegCfgMotDampgRatDax
    connect CalRegn01IninOptSetA00.MotCurrRegCfgMotDampgRatQax -> AAACalRegn01IninOptSetA00_Dummy.MotCurrRegCfgMotDampgRatQax
    connect CalRegn01IninOptSetA00.MotCurrRegCfgMotNatFrqDaxY -> AAACalRegn01IninOptSetA00_Dummy.MotCurrRegCfgMotNatFrqDaxY
    connect CalRegn01IninOptSetA00.MotCurrRegCfgMotNatFrqQaxY -> AAACalRegn01IninOptSetA00_Dummy.MotCurrRegCfgMotNatFrqQaxY
    connect CalRegn01IninOptSetA00.MotCurrRegCfgMotRVirtDax -> AAACalRegn01IninOptSetA00_Dummy.MotCurrRegCfgMotRVirtDax
    connect CalRegn01IninOptSetA00.MotCurrRegCfgMotRVirtQax -> AAACalRegn01IninOptSetA00_Dummy.MotCurrRegCfgMotRVirtQax
    connect CalRegn01IninOptSetA00.MotCurrRegCfgMotVelFilFrq -> AAACalRegn01IninOptSetA00_Dummy.MotCurrRegCfgMotVelFilFrq
    connect CalRegn01IninOptSetA00.MotCurrRegVltgLimrCurrLoaScarSlewRate -> AAACalRegn01IninOptSetA00_Dummy.MotCurrRegVltgLimrCurrLoaScarSlewRate
    connect CalRegn01IninOptSetA00.MotCurrRegVltgLimrDaxAntiWdupCoeff -> AAACalRegn01IninOptSetA00_Dummy.MotCurrRegVltgLimrDaxAntiWdupCoeff
    connect CalRegn01IninOptSetA00.MotCurrRegVltgLimrDualEcuLoaScarSlewRate -> AAACalRegn01IninOptSetA00_Dummy.MotCurrRegVltgLimrDualEcuLoaScarSlewRate
    connect CalRegn01IninOptSetA00.MotCurrRegVltgLimrFETLoaScarSlewRate -> AAACalRegn01IninOptSetA00_Dummy.MotCurrRegVltgLimrFETLoaScarSlewRate
    connect CalRegn01IninOptSetA00.MotCurrRegVltgLimrIvtrLoaScarSlewRate -> AAACalRegn01IninOptSetA00_Dummy.MotCurrRegVltgLimrIvtrLoaScarSlewRate
    connect CalRegn01IninOptSetA00.MotCurrRegVltgLimrMotVltgBrdgLpFilFrq -> AAACalRegn01IninOptSetA00_Dummy.MotCurrRegVltgLimrMotVltgBrdgLpFilFrq
    connect CalRegn01IninOptSetA00.MotCurrRegVltgLimrMotVltgDaxIntglHiLim -> AAACalRegn01IninOptSetA00_Dummy.MotCurrRegVltgLimrMotVltgDaxIntglHiLim
    connect CalRegn01IninOptSetA00.MotCurrRegVltgLimrMotVltgDaxIntglLoLim -> AAACalRegn01IninOptSetA00_Dummy.MotCurrRegVltgLimrMotVltgDaxIntglLoLim
    connect CalRegn01IninOptSetA00.MotCurrRegVltgLimrMotVltgQaxFfLpFilFrq -> AAACalRegn01IninOptSetA00_Dummy.MotCurrRegVltgLimrMotVltgQaxFfLpFilFrq
    connect CalRegn01IninOptSetA00.MotCurrRegVltgLimrMotVltgQaxIntglHiLim -> AAACalRegn01IninOptSetA00_Dummy.MotCurrRegVltgLimrMotVltgQaxIntglHiLim
    connect CalRegn01IninOptSetA00.MotCurrRegVltgLimrMotVltgQaxIntglLoLim -> AAACalRegn01IninOptSetA00_Dummy.MotCurrRegVltgLimrMotVltgQaxIntglLoLim
    connect CalRegn01IninOptSetA00.MotCurrRegVltgLimrQaxAntiWdupCoeff -> AAACalRegn01IninOptSetA00_Dummy.MotCurrRegVltgLimrQaxAntiWdupCoeff
    connect CalRegn01IninOptSetA00.MotCurrRegVltgLimrQaxAntiWdupScagDi -> AAACalRegn01IninOptSetA00_Dummy.MotCurrRegVltgLimrQaxAntiWdupScagDi
    connect CalRegn01IninOptSetA00.MotRefMdlCurrDaxBoostGain -> AAACalRegn01IninOptSetA00_Dummy.MotRefMdlCurrDaxBoostGain
    connect CalRegn01IninOptSetA00.MotRefMdlCurrDaxBoostTqScaX -> AAACalRegn01IninOptSetA00_Dummy.MotRefMdlCurrDaxBoostTqScaX
    connect CalRegn01IninOptSetA00.MotRefMdlCurrDaxBoostTqScaY -> AAACalRegn01IninOptSetA00_Dummy.MotRefMdlCurrDaxBoostTqScaY
    connect CalRegn01IninOptSetA00.MotRefMdlCurrDaxQaxRefDelta -> AAACalRegn01IninOptSetA00_Dummy.MotRefMdlCurrDaxQaxRefDelta
    connect CalRegn01IninOptSetA00.MotRefMdlCurrItrnTolr -> AAACalRegn01IninOptSetA00_Dummy.MotRefMdlCurrItrnTolr
    connect CalRegn01IninOptSetA00.MotRefMdlMotCurrDaxMaxSca -> AAACalRegn01IninOptSetA00_Dummy.MotRefMdlMotCurrDaxMaxSca
    connect CalRegn01IninOptSetA00.MotRefMdlQuad13VltgSdlX -> AAACalRegn01IninOptSetA00_Dummy.MotRefMdlQuad13VltgSdlX
    connect CalRegn01IninOptSetA00.MotRefMdlQuad13VltgSdlY -> AAACalRegn01IninOptSetA00_Dummy.MotRefMdlQuad13VltgSdlY
    connect CalRegn01IninOptSetA00.MotRefMdlQuad24VltgSdlX -> AAACalRegn01IninOptSetA00_Dummy.MotRefMdlQuad24VltgSdlX
    connect CalRegn01IninOptSetA00.MotRefMdlQuad24VltgSdlY -> AAACalRegn01IninOptSetA00_Dummy.MotRefMdlQuad24VltgSdlY
    connect CalRegn01IninOptSetA00.MotRefMdlVltgOverRThdSca -> AAACalRegn01IninOptSetA00_Dummy.MotRefMdlVltgOverRThdSca
    connect CalRegn01IninOptSetA00.MotTqTranlDampgCmdLim -> AAACalRegn01IninOptSetA00_Dummy.MotTqTranlDampgCmdLim
    connect CalRegn01IninOptSetA00.MotTqTranlDampgVelThd -> AAACalRegn01IninOptSetA00_Dummy.MotTqTranlDampgVelThd
    connect CalRegn01IninOptSetA00.PwrLimrAssiRednLpFilFrq -> AAACalRegn01IninOptSetA00_Dummy.PwrLimrAssiRednLpFilFrq
    connect CalRegn01IninOptSetA00.PwrLimrBackEmfConStdT -> AAACalRegn01IninOptSetA00_Dummy.PwrLimrBackEmfConStdT
    connect CalRegn01IninOptSetA00.PwrLimrBrdgVltgAdjSlew -> AAACalRegn01IninOptSetA00_Dummy.PwrLimrBrdgVltgAdjSlew
    connect CalRegn01IninOptSetA00.PwrLimrBrdgVltgAltFltAdj -> AAACalRegn01IninOptSetA00_Dummy.PwrLimrBrdgVltgAltFltAdj
    connect CalRegn01IninOptSetA00.PwrLimrFilAssiRednThd -> AAACalRegn01IninOptSetA00_Dummy.PwrLimrFilAssiRednThd
    connect CalRegn01IninOptSetA00.PwrLimrLoVoltAssiRcvrThd -> AAACalRegn01IninOptSetA00_Dummy.PwrLimrLoVoltAssiRcvrThd
    connect CalRegn01IninOptSetA00.PwrLimrLoVoltAssiRcvrTi -> AAACalRegn01IninOptSetA00_Dummy.PwrLimrLoVoltAssiRcvrTi
    connect CalRegn01IninOptSetA00.PwrLimrMotEnvlpX -> AAACalRegn01IninOptSetA00_Dummy.PwrLimrMotEnvlpX
    connect CalRegn01IninOptSetA00.PwrLimrMotEnvlpY -> AAACalRegn01IninOptSetA00_Dummy.PwrLimrMotEnvlpY
    connect CalRegn01IninOptSetA00.PwrLimrMotVelLpFilFrq -> AAACalRegn01IninOptSetA00_Dummy.PwrLimrMotVelLpFilFrq
    connect CalRegn01IninOptSetA00.PwrLimrSpdAdjSlewDec -> AAACalRegn01IninOptSetA00_Dummy.PwrLimrSpdAdjSlewDec
    connect CalRegn01IninOptSetA00.PwrLimrSpdAdjSlewEna -> AAACalRegn01IninOptSetA00_Dummy.PwrLimrSpdAdjSlewEna
    connect CalRegn01IninOptSetA00.PwrLimrSpdAdjSlewInc -> AAACalRegn01IninOptSetA00_Dummy.PwrLimrSpdAdjSlewInc
    connect CalRegn01IninOptSetA00.PwrLimrStdOperMotEnvlpX -> AAACalRegn01IninOptSetA00_Dummy.PwrLimrStdOperMotEnvlpX
    connect CalRegn01IninOptSetA00.PwrLimrStdOperMotEnvlpY -> AAACalRegn01IninOptSetA00_Dummy.PwrLimrStdOperMotEnvlpY
    connect CalRegn01IninOptSetA00.PwrLimrVltgDptMotVelOffsX -> AAACalRegn01IninOptSetA00_Dummy.PwrLimrVltgDptMotVelOffsX
    connect CalRegn01IninOptSetA00.PwrLimrVltgDptMotVelOffsY -> AAACalRegn01IninOptSetA00_Dummy.PwrLimrVltgDptMotVelOffsY
    connect CalRegn01IninOptSetA00.SysGlbPrmSysTqRat -> AAACalRegn01IninOptSetA00_Dummy.SysGlbPrmSysTqRat
    connect CalRegn01IninOptSetA00.TEstimnAmbPwrMplr -> AAACalRegn01IninOptSetA00_Dummy.TEstimnAmbPwrMplr
    connect CalRegn01IninOptSetA00.TEstimnAmbTSca -> AAACalRegn01IninOptSetA00_Dummy.TEstimnAmbTSca
    connect CalRegn01IninOptSetA00.TEstimnAssiMechAmbLpFilFrq -> AAACalRegn01IninOptSetA00_Dummy.TEstimnAssiMechAmbLpFilFrq
    connect CalRegn01IninOptSetA00.TEstimnAssiMechAmbLpFilFrqDualEcuFltMtgtn -> AAACalRegn01IninOptSetA00_Dummy.TEstimnAssiMechAmbLpFilFrqDualEcuFltMtgtn
    connect CalRegn01IninOptSetA00.TEstimnAssiMechAmbLpFilFrqFetMtgtnEna -> AAACalRegn01IninOptSetA00_Dummy.TEstimnAssiMechAmbLpFilFrqFetMtgtnEna
    connect CalRegn01IninOptSetA00.TEstimnAssiMechAmbMplr -> AAACalRegn01IninOptSetA00_Dummy.TEstimnAssiMechAmbMplr
    connect CalRegn01IninOptSetA00.TEstimnAssiMechCorrLim -> AAACalRegn01IninOptSetA00_Dummy.TEstimnAssiMechCorrLim
    connect CalRegn01IninOptSetA00.TEstimnAssiMechDampgSca -> AAACalRegn01IninOptSetA00_Dummy.TEstimnAssiMechDampgSca
    connect CalRegn01IninOptSetA00.TEstimnAssiMechDftT -> AAACalRegn01IninOptSetA00_Dummy.TEstimnAssiMechDftT
    connect CalRegn01IninOptSetA00.TEstimnAssiMechLLFilCoeffA1 -> AAACalRegn01IninOptSetA00_Dummy.TEstimnAssiMechLLFilCoeffA1
    connect CalRegn01IninOptSetA00.TEstimnAssiMechLLFilCoeffB0 -> AAACalRegn01IninOptSetA00_Dummy.TEstimnAssiMechLLFilCoeffB0
    connect CalRegn01IninOptSetA00.TEstimnAssiMechLLFilCoeffB1 -> AAACalRegn01IninOptSetA00_Dummy.TEstimnAssiMechLLFilCoeffB1
    connect CalRegn01IninOptSetA00.TEstimnAssiMechSlew -> AAACalRegn01IninOptSetA00_Dummy.TEstimnAssiMechSlew
    connect CalRegn01IninOptSetA00.TEstimnCorrnTAssiMech -> AAACalRegn01IninOptSetA00_Dummy.TEstimnCorrnTAssiMech
    connect CalRegn01IninOptSetA00.TEstimnCorrnTCu -> AAACalRegn01IninOptSetA00_Dummy.TEstimnCorrnTCu
    connect CalRegn01IninOptSetA00.TEstimnCorrnTMag -> AAACalRegn01IninOptSetA00_Dummy.TEstimnCorrnTMag
    connect CalRegn01IninOptSetA00.TEstimnCorrnTSi -> AAACalRegn01IninOptSetA00_Dummy.TEstimnCorrnTSi
    connect CalRegn01IninOptSetA00.TEstimnCuAmbLpFilFrq -> AAACalRegn01IninOptSetA00_Dummy.TEstimnCuAmbLpFilFrq
    connect CalRegn01IninOptSetA00.TEstimnCuAmbLpFilFrqDualEcuFltMtgtn -> AAACalRegn01IninOptSetA00_Dummy.TEstimnCuAmbLpFilFrqDualEcuFltMtgtn
    connect CalRegn01IninOptSetA00.TEstimnCuAmbLpFilFrqFetMtgtnEna -> AAACalRegn01IninOptSetA00_Dummy.TEstimnCuAmbLpFilFrqFetMtgtnEna
    connect CalRegn01IninOptSetA00.TEstimnCuAmbMplr -> AAACalRegn01IninOptSetA00_Dummy.TEstimnCuAmbMplr
    connect CalRegn01IninOptSetA00.TEstimnCuCorrnLim -> AAACalRegn01IninOptSetA00_Dummy.TEstimnCuCorrnLim
    connect CalRegn01IninOptSetA00.TEstimnCuLLFilCoeffA1 -> AAACalRegn01IninOptSetA00_Dummy.TEstimnCuLLFilCoeffA1
    connect CalRegn01IninOptSetA00.TEstimnCuLLFilCoeffB0 -> AAACalRegn01IninOptSetA00_Dummy.TEstimnCuLLFilCoeffB0
    connect CalRegn01IninOptSetA00.TEstimnCuLLFilCoeffB1 -> AAACalRegn01IninOptSetA00_Dummy.TEstimnCuLLFilCoeffB1
    connect CalRegn01IninOptSetA00.TEstimnEngTSca -> AAACalRegn01IninOptSetA00_Dummy.TEstimnEngTSca
    connect CalRegn01IninOptSetA00.TEstimnMagAmbLpFilFrq -> AAACalRegn01IninOptSetA00_Dummy.TEstimnMagAmbLpFilFrq
    connect CalRegn01IninOptSetA00.TEstimnMagAmbLpFilFrqDualEcuFltMtgtn -> AAACalRegn01IninOptSetA00_Dummy.TEstimnMagAmbLpFilFrqDualEcuFltMtgtn
    connect CalRegn01IninOptSetA00.TEstimnMagAmbLpFilFrqFetMtgtnEna -> AAACalRegn01IninOptSetA00_Dummy.TEstimnMagAmbLpFilFrqFetMtgtnEna
    connect CalRegn01IninOptSetA00.TEstimnMagAmbMplr -> AAACalRegn01IninOptSetA00_Dummy.TEstimnMagAmbMplr
    connect CalRegn01IninOptSetA00.TEstimnMagCorrnLim -> AAACalRegn01IninOptSetA00_Dummy.TEstimnMagCorrnLim
    connect CalRegn01IninOptSetA00.TEstimnMagLLFilCoeffA1 -> AAACalRegn01IninOptSetA00_Dummy.TEstimnMagLLFilCoeffA1
    connect CalRegn01IninOptSetA00.TEstimnMagLLFilCoeffB0 -> AAACalRegn01IninOptSetA00_Dummy.TEstimnMagLLFilCoeffB0
    connect CalRegn01IninOptSetA00.TEstimnMagLLFilCoeffB1 -> AAACalRegn01IninOptSetA00_Dummy.TEstimnMagLLFilCoeffB1
    connect CalRegn01IninOptSetA00.TEstimnSiAmbLpFilFrq -> AAACalRegn01IninOptSetA00_Dummy.TEstimnSiAmbLpFilFrq
    connect CalRegn01IninOptSetA00.TEstimnSiAmbLpFilFrqDualEcuFltMtgtn -> AAACalRegn01IninOptSetA00_Dummy.TEstimnSiAmbLpFilFrqDualEcuFltMtgtn
    connect CalRegn01IninOptSetA00.TEstimnSiAmbLpFilFrqFetMtgtnEna -> AAACalRegn01IninOptSetA00_Dummy.TEstimnSiAmbLpFilFrqFetMtgtnEna
    connect CalRegn01IninOptSetA00.TEstimnSiAmbMplr -> AAACalRegn01IninOptSetA00_Dummy.TEstimnSiAmbMplr
    connect CalRegn01IninOptSetA00.TEstimnSiCorrnLim -> AAACalRegn01IninOptSetA00_Dummy.TEstimnSiCorrnLim
    connect CalRegn01IninOptSetA00.TEstimnSiLLFilCoeffA1 -> AAACalRegn01IninOptSetA00_Dummy.TEstimnSiLLFilCoeffA1
    connect CalRegn01IninOptSetA00.TEstimnSiLLFilCoeffB0 -> AAACalRegn01IninOptSetA00_Dummy.TEstimnSiLLFilCoeffB0
    connect CalRegn01IninOptSetA00.TEstimnSiLLFilCoeffB1 -> AAACalRegn01IninOptSetA00_Dummy.TEstimnSiLLFilCoeffB1
    connect CalRegn01IninOptSetA00.TEstimnTauAssiMech -> AAACalRegn01IninOptSetA00_Dummy.TEstimnTauAssiMech
    connect CalRegn01IninOptSetA00.TEstimnTauCu -> AAACalRegn01IninOptSetA00_Dummy.TEstimnTauCu
    connect CalRegn01IninOptSetA00.TEstimnTauMag -> AAACalRegn01IninOptSetA00_Dummy.TEstimnTauMag
    connect CalRegn01IninOptSetA00.TEstimnTauSi -> AAACalRegn01IninOptSetA00_Dummy.TEstimnTauSi
    connect CalRegn01IninOptSetA00.TEstimnWghtAvrgTDi -> AAACalRegn01IninOptSetA00_Dummy.TEstimnWghtAvrgTDi
    connect CalRegn01IninOptSetA00.VehSpdLimrPosMaxOffs2 -> AAACalRegn01IninOptSetA00_Dummy.VehSpdLimrPosMaxOffs2
    connect CalRegn01IninOptSetA00.MotCurrRegCfgMotRVirtDax -> CDD_MotCurrRegVltgLimr.MotCurrRegCfgMotRVirtDax
    connect CalRegn01IninOptSetA00.MotCurrRegCfgMotRVirtQax -> CDD_MotCurrRegVltgLimr.MotCurrRegCfgMotRVirtQax
    connect CalRegn01IninOptSetA00.MotCurrRegVltgLimrCurrLoaScarSlewRate -> CDD_MotCurrRegVltgLimr.MotCurrRegVltgLimrCurrLoaScarSlewRate
    connect CalRegn01IninOptSetA00.MotCurrRegVltgLimrDaxAntiWdupCoeff -> CDD_MotCurrRegVltgLimr.MotCurrRegVltgLimrDaxAntiWdupCoeff
    connect CalRegn01IninOptSetA00.MotCurrRegVltgLimrDualEcuLoaScarSlewRate -> CDD_MotCurrRegVltgLimr.MotCurrRegVltgLimrDualEcuLoaScarSlewRate
    connect CalRegn01IninOptSetA00.MotCurrRegVltgLimrFETLoaScarSlewRate -> CDD_MotCurrRegVltgLimr.MotCurrRegVltgLimrFETLoaScarSlewRate
    connect CalRegn01IninOptSetA00.MotCurrRegVltgLimrIvtrLoaScarSlewRate -> CDD_MotCurrRegVltgLimr.MotCurrRegVltgLimrIvtrLoaScarSlewRate
    connect CalRegn01IninOptSetA00.MotCurrRegVltgLimrMotVltgBrdgLpFilFrq -> CDD_MotCurrRegVltgLimr.MotCurrRegVltgLimrMotVltgBrdgLpFilFrq
    connect CalRegn01IninOptSetA00.MotCurrRegVltgLimrMotVltgDaxIntglHiLim -> CDD_MotCurrRegVltgLimr.MotCurrRegVltgLimrMotVltgDaxIntglHiLim
    connect CalRegn01IninOptSetA00.MotCurrRegVltgLimrMotVltgDaxIntglLoLim -> CDD_MotCurrRegVltgLimr.MotCurrRegVltgLimrMotVltgDaxIntglLoLim
    connect CalRegn01IninOptSetA00.MotCurrRegVltgLimrMotVltgQaxFfLpFilFrq -> CDD_MotCurrRegVltgLimr.MotCurrRegVltgLimrMotVltgQaxFfLpFilFrq
    connect CalRegn01IninOptSetA00.MotCurrRegVltgLimrMotVltgQaxIntglHiLim -> CDD_MotCurrRegVltgLimr.MotCurrRegVltgLimrMotVltgQaxIntglHiLim
    connect CalRegn01IninOptSetA00.MotCurrRegVltgLimrMotVltgQaxIntglLoLim -> CDD_MotCurrRegVltgLimr.MotCurrRegVltgLimrMotVltgQaxIntglLoLim
    connect CalRegn01IninOptSetA00.MotCurrRegVltgLimrQaxAntiWdupCoeff -> CDD_MotCurrRegVltgLimr.MotCurrRegVltgLimrQaxAntiWdupCoeff
    connect CalRegn01IninOptSetA00.MotCurrRegVltgLimrQaxAntiWdupScagDi -> CDD_MotCurrRegVltgLimr.MotCurrRegVltgLimrQaxAntiWdupScagDi
    connect CalRegn01IninOptSetA00.SysGlbPrmSysTqRat -> CtrldVelRtn.SysGlbPrmSysTqRat
    connect CalRegn01IninOptSetA00.DutyCycThermProtnAbsltCtrlTFetMtgtnTblX -> DutyCycThermProtn.DutyCycThermProtnAbsltCtrlTFetMtgtnTblX
    connect CalRegn01IninOptSetA00.DutyCycThermProtnAbsltCtrlTTblX -> DutyCycThermProtn.DutyCycThermProtnAbsltCtrlTTblX
    connect CalRegn01IninOptSetA00.DutyCycThermProtnAbsltCtrlTTqFetMtgtnTblY -> DutyCycThermProtn.DutyCycThermProtnAbsltCtrlTTqFetMtgtnTblY
    connect CalRegn01IninOptSetA00.DutyCycThermProtnAbsltCtrlTTqTblY -> DutyCycThermProtn.DutyCycThermProtnAbsltCtrlTTqTblY
    connect CalRegn01IninOptSetA00.DutyCycThermProtnAbsltCuTFetMtgtnTblX -> DutyCycThermProtn.DutyCycThermProtnAbsltCuTFetMtgtnTblX
    connect CalRegn01IninOptSetA00.DutyCycThermProtnAbsltCuTTblX -> DutyCycThermProtn.DutyCycThermProtnAbsltCuTTblX
    connect CalRegn01IninOptSetA00.DutyCycThermProtnAbsltCuTTqFetMtgtnTblY -> DutyCycThermProtn.DutyCycThermProtnAbsltCuTTqFetMtgtnTblY
    connect CalRegn01IninOptSetA00.DutyCycThermProtnAbsltCuTTqTblY -> DutyCycThermProtn.DutyCycThermProtnAbsltCuTTqTblY
    connect CalRegn01IninOptSetA00.DutyCycThermProtnAbsltMotVelBreakPt -> DutyCycThermProtn.DutyCycThermProtnAbsltMotVelBreakPt
    connect CalRegn01IninOptSetA00.DutyCycThermProtnAbsltTTqSlewHiLim -> DutyCycThermProtn.DutyCycThermProtnAbsltTTqSlewHiLim
    connect CalRegn01IninOptSetA00.DutyCycThermProtnAbsltTTqSlewLoLim -> DutyCycThermProtn.DutyCycThermProtnAbsltTTqSlewLoLim
    connect CalRegn01IninOptSetA00.DutyCycThermProtnCtrlT -> DutyCycThermProtn.DutyCycThermProtnCtrlT
    connect CalRegn01IninOptSetA00.DutyCycThermProtnCtrlTSeln -> DutyCycThermProtn.DutyCycThermProtnCtrlTSeln
    connect CalRegn01IninOptSetA00.DutyCycThermProtnDutyCycFildThd -> DutyCycThermProtn.DutyCycThermProtnDutyCycFildThd
    connect CalRegn01IninOptSetA00.DutyCycThermProtnIgnOffCtrlEna -> DutyCycThermProtn.DutyCycThermProtnIgnOffCtrlEna
    connect CalRegn01IninOptSetA00.DutyCycThermProtnIgnOffMsgWaitTi -> DutyCycThermProtn.DutyCycThermProtnIgnOffMsgWaitTi
    connect CalRegn01IninOptSetA00.DutyCycThermProtnLstTblValNonStall -> DutyCycThermProtn.DutyCycThermProtnLstTblValNonStall
    connect CalRegn01IninOptSetA00.DutyCycThermProtnLstTblValStall -> DutyCycThermProtn.DutyCycThermProtnLstTblValStall
    connect CalRegn01IninOptSetA00.DutyCycThermProtnMotPrTSeln -> DutyCycThermProtn.DutyCycThermProtnMotPrTSeln
    connect CalRegn01IninOptSetA00.DutyCycThermProtnMplr1FetMtgtnNonStallTblY -> DutyCycThermProtn.DutyCycThermProtnMplr1FetMtgtnNonStallTblY
    connect CalRegn01IninOptSetA00.DutyCycThermProtnMplr1FetMtgtnStallTblY -> DutyCycThermProtn.DutyCycThermProtnMplr1FetMtgtnStallTblY
    connect CalRegn01IninOptSetA00.DutyCycThermProtnMplr1NonStallTblY -> DutyCycThermProtn.DutyCycThermProtnMplr1NonStallTblY
    connect CalRegn01IninOptSetA00.DutyCycThermProtnMplr1StallTblY -> DutyCycThermProtn.DutyCycThermProtnMplr1StallTblY
    connect CalRegn01IninOptSetA00.DutyCycThermProtnMplr2FetMtgtnNonStallTblY -> DutyCycThermProtn.DutyCycThermProtnMplr2FetMtgtnNonStallTblY
    connect CalRegn01IninOptSetA00.DutyCycThermProtnMplr2FetMtgtnStallTblY -> DutyCycThermProtn.DutyCycThermProtnMplr2FetMtgtnStallTblY
    connect CalRegn01IninOptSetA00.DutyCycThermProtnMplr2NonStallTblY -> DutyCycThermProtn.DutyCycThermProtnMplr2NonStallTblY
    connect CalRegn01IninOptSetA00.DutyCycThermProtnMplr2StallTblY -> DutyCycThermProtn.DutyCycThermProtnMplr2StallTblY
    connect CalRegn01IninOptSetA00.DutyCycThermProtnMplr3FetMtgtnNonStallTblY -> DutyCycThermProtn.DutyCycThermProtnMplr3FetMtgtnNonStallTblY
    connect CalRegn01IninOptSetA00.DutyCycThermProtnMplr3FetMtgtnStallTblY -> DutyCycThermProtn.DutyCycThermProtnMplr3FetMtgtnStallTblY
    connect CalRegn01IninOptSetA00.DutyCycThermProtnMplr3NonStallTblY -> DutyCycThermProtn.DutyCycThermProtnMplr3NonStallTblY
    connect CalRegn01IninOptSetA00.DutyCycThermProtnMplr3StallTblY -> DutyCycThermProtn.DutyCycThermProtnMplr3StallTblY
    connect CalRegn01IninOptSetA00.DutyCycThermProtnMplr4FetMtgtnNonStallTblY -> DutyCycThermProtn.DutyCycThermProtnMplr4FetMtgtnNonStallTblY
    connect CalRegn01IninOptSetA00.DutyCycThermProtnMplr4FetMtgtnStallTblY -> DutyCycThermProtn.DutyCycThermProtnMplr4FetMtgtnStallTblY
    connect CalRegn01IninOptSetA00.DutyCycThermProtnMplr4NonStallTblY -> DutyCycThermProtn.DutyCycThermProtnMplr4NonStallTblY
    connect CalRegn01IninOptSetA00.DutyCycThermProtnMplr4StallTblY -> DutyCycThermProtn.DutyCycThermProtnMplr4StallTblY
    connect CalRegn01IninOptSetA00.DutyCycThermProtnMplr5FetMtgtnNonStallTblY -> DutyCycThermProtn.DutyCycThermProtnMplr5FetMtgtnNonStallTblY
    connect CalRegn01IninOptSetA00.DutyCycThermProtnMplr5FetMtgtnStallTblY -> DutyCycThermProtn.DutyCycThermProtnMplr5FetMtgtnStallTblY
    connect CalRegn01IninOptSetA00.DutyCycThermProtnMplr5NonStallTblY -> DutyCycThermProtn.DutyCycThermProtnMplr5NonStallTblY
    connect CalRegn01IninOptSetA00.DutyCycThermProtnMplr5StallTblY -> DutyCycThermProtn.DutyCycThermProtnMplr5StallTblY
    connect CalRegn01IninOptSetA00.DutyCycThermProtnMplr6FetMtgtnNonStallTblY -> DutyCycThermProtn.DutyCycThermProtnMplr6FetMtgtnNonStallTblY
    connect CalRegn01IninOptSetA00.DutyCycThermProtnMplr6FetMtgtnStallTblY -> DutyCycThermProtn.DutyCycThermProtnMplr6FetMtgtnStallTblY
    connect CalRegn01IninOptSetA00.DutyCycThermProtnMplr6NonStallTblY -> DutyCycThermProtn.DutyCycThermProtnMplr6NonStallTblY
    connect CalRegn01IninOptSetA00.DutyCycThermProtnMplr6StallTblY -> DutyCycThermProtn.DutyCycThermProtnMplr6StallTblY
    connect CalRegn01IninOptSetA00.DutyCycThermProtnMplrFetMtgtnTblX -> DutyCycThermProtn.DutyCycThermProtnMplrFetMtgtnTblX
    connect CalRegn01IninOptSetA00.DutyCycThermProtnMplrTblX -> DutyCycThermProtn.DutyCycThermProtnMplrTblX
    connect CalRegn01IninOptSetA00.DutyCycThermProtnMplrTSeln -> DutyCycThermProtn.DutyCycThermProtnMplrTSeln
    connect CalRegn01IninOptSetA00.DutyCycThermProtnSlowFilTSeln -> DutyCycThermProtn.DutyCycThermProtnSlowFilTSeln
    connect CalRegn01IninOptSetA00.DutyCycThermProtnThermLimScaFac -> DutyCycThermProtn.DutyCycThermProtnThermLimScaFac
    connect CalRegn01IninOptSetA00.DutyCycThermProtnThermLoadLimTblX -> DutyCycThermProtn.DutyCycThermProtnThermLoadLimTblX
    connect CalRegn01IninOptSetA00.DutyCycThermProtnThermLoadLimTblY -> DutyCycThermProtn.DutyCycThermProtnThermLoadLimTblY
    connect CalRegn01IninOptSetA00.DutyCycThermProtnTqCmdSlewDwn -> DutyCycThermProtn.DutyCycThermProtnTqCmdSlewDwn
    connect CalRegn01IninOptSetA00.DutyCycThermProtnTqCmdSlewUp -> DutyCycThermProtn.DutyCycThermProtnTqCmdSlewUp
    connect CalRegn01IninOptSetA00.HiLoadStallLimrMotVelMgnThd -> HiLoadStallLimr.HiLoadStallLimrMotVelMgnThd
    connect CalRegn01IninOptSetA00.HiLoadStallLimrStallMotTqCmdFetMtgtnLimX -> HiLoadStallLimr.HiLoadStallLimrStallMotTqCmdFetMtgtnLimX
    connect CalRegn01IninOptSetA00.HiLoadStallLimrStallMotTqCmdFetMtgtnLimY -> HiLoadStallLimr.HiLoadStallLimrStallMotTqCmdFetMtgtnLimY
    connect CalRegn01IninOptSetA00.HiLoadStallLimrStallMotTqCmdLimX -> HiLoadStallLimr.HiLoadStallLimrStallMotTqCmdLimX
    connect CalRegn01IninOptSetA00.HiLoadStallLimrStallMotTqCmdLimY -> HiLoadStallLimr.HiLoadStallLimrStallMotTqCmdLimY
    connect CalRegn01IninOptSetA00.HiLoadStallLimrStallMotTqLimSlewRate -> HiLoadStallLimr.HiLoadStallLimrStallMotTqLimSlewRate
    connect CalRegn01IninOptSetA00.HiLoadStallLimrStallThermLimSca -> HiLoadStallLimr.HiLoadStallLimrStallThermLimSca
    connect CalRegn01IninOptSetA00.SysGlbPrmSysTqRat -> HwRefTqSum.SysGlbPrmSysTqRat
    connect CalRegn01IninOptSetA00.LrndRackCentrMotTqThd -> LrndRackCentr.LrndRackCentrMotTqThd
    connect CalRegn01IninOptSetA00.LrndRackCentrMotVelThd -> LrndRackCentr.LrndRackCentrMotVelThd
    connect CalRegn01IninOptSetA00.MotCtrlPrmEstimnFetRNom -> MotCtrlPrmEstimn.MotCtrlPrmEstimnFetRNom
    connect CalRegn01IninOptSetA00.MotCtrlPrmEstimnMotBackEmfConHiLim -> MotCtrlPrmEstimn.MotCtrlPrmEstimnMotBackEmfConHiLim
    connect CalRegn01IninOptSetA00.MotCtrlPrmEstimnMotBackEmfConLoLim -> MotCtrlPrmEstimn.MotCtrlPrmEstimnMotBackEmfConLoLim
    connect CalRegn01IninOptSetA00.MotCtrlPrmEstimnMotBackEmfConNom -> MotCtrlPrmEstimn.MotCtrlPrmEstimnMotBackEmfConNom
    connect CalRegn01IninOptSetA00.MotCtrlPrmEstimnMotBackEmfConSatnScaIvtrLoaMtgtn -> MotCtrlPrmEstimn.MotCtrlPrmEstimnMotBackEmfConSatnScaIvtrLoaMtgtn
    connect CalRegn01IninOptSetA00.MotCtrlPrmEstimnMotBackEmfConSatnX -> MotCtrlPrmEstimn.MotCtrlPrmEstimnMotBackEmfConSatnX
    connect CalRegn01IninOptSetA00.MotCtrlPrmEstimnMotBackEmfConSatnY -> MotCtrlPrmEstimn.MotCtrlPrmEstimnMotBackEmfConSatnY
    connect CalRegn01IninOptSetA00.MotCtrlPrmEstimnMotCurrDaxInduSatnBilnrSeln -> MotCtrlPrmEstimn.MotCtrlPrmEstimnMotCurrDaxInduSatnBilnrSeln
    connect CalRegn01IninOptSetA00.MotCtrlPrmEstimnMotCurrQaxInduSatnX -> MotCtrlPrmEstimn.MotCtrlPrmEstimnMotCurrQaxInduSatnX
    connect CalRegn01IninOptSetA00.MotCtrlPrmEstimnMotInduDaxHiLim -> MotCtrlPrmEstimn.MotCtrlPrmEstimnMotInduDaxHiLim
    connect CalRegn01IninOptSetA00.MotCtrlPrmEstimnMotInduDaxIvtrLoaMtgtn -> MotCtrlPrmEstimn.MotCtrlPrmEstimnMotInduDaxIvtrLoaMtgtn
    connect CalRegn01IninOptSetA00.MotCtrlPrmEstimnMotInduDaxLoLim -> MotCtrlPrmEstimn.MotCtrlPrmEstimnMotInduDaxLoLim
    connect CalRegn01IninOptSetA00.MotCtrlPrmEstimnMotInduDaxNom -> MotCtrlPrmEstimn.MotCtrlPrmEstimnMotInduDaxNom
    connect CalRegn01IninOptSetA00.MotCtrlPrmEstimnMotInduDaxSatnScaY -> MotCtrlPrmEstimn.MotCtrlPrmEstimnMotInduDaxSatnScaY
    connect CalRegn01IninOptSetA00.MotCtrlPrmEstimnMotInduQaxHiLim -> MotCtrlPrmEstimn.MotCtrlPrmEstimnMotInduQaxHiLim
    connect CalRegn01IninOptSetA00.MotCtrlPrmEstimnMotInduQaxIvtrLoaMtgtn -> MotCtrlPrmEstimn.MotCtrlPrmEstimnMotInduQaxIvtrLoaMtgtn
    connect CalRegn01IninOptSetA00.MotCtrlPrmEstimnMotInduQaxLoLim -> MotCtrlPrmEstimn.MotCtrlPrmEstimnMotInduQaxLoLim
    connect CalRegn01IninOptSetA00.MotCtrlPrmEstimnMotInduQaxNom -> MotCtrlPrmEstimn.MotCtrlPrmEstimnMotInduQaxNom
    connect CalRegn01IninOptSetA00.MotCtrlPrmEstimnMotInduQaxSatnScaY -> MotCtrlPrmEstimn.MotCtrlPrmEstimnMotInduQaxSatnScaY
    connect CalRegn01IninOptSetA00.MotCtrlPrmEstimnMotRHiLim -> MotCtrlPrmEstimn.MotCtrlPrmEstimnMotRHiLim
    connect CalRegn01IninOptSetA00.MotCtrlPrmEstimnMotRLoLim -> MotCtrlPrmEstimn.MotCtrlPrmEstimnMotRLoLim
    connect CalRegn01IninOptSetA00.MotCtrlPrmEstimnMotRNom -> MotCtrlPrmEstimn.MotCtrlPrmEstimnMotRNom
    connect CalRegn01IninOptSetA00.MotCtrlPrmEstimnMotWidgThermCoeff -> MotCtrlPrmEstimn.MotCtrlPrmEstimnMotWidgThermCoeff
    connect CalRegn01IninOptSetA00.MotCtrlPrmEstimnTNom -> MotCtrlPrmEstimn.MotCtrlPrmEstimnTNom
    connect CalRegn01IninOptSetA00.MotCurrPeakEstimnCurrFilFrq -> MotCurrPeakEstimn.MotCurrPeakEstimnCurrFilFrq
    connect CalRegn01IninOptSetA00.MotCurrPeakEstimnCurrPeakEstimdFilFrq -> MotCurrPeakEstimn.MotCurrPeakEstimnCurrPeakEstimdFilFrq
    connect CalRegn01IninOptSetA00.MotCurrRegCfgMotClsdLoopBwDaxY -> MotCurrRegCfg.MotCurrRegCfgMotClsdLoopBwDaxY
    connect CalRegn01IninOptSetA00.MotCurrRegCfgMotClsdLoopBwQaxY -> MotCurrRegCfg.MotCurrRegCfgMotClsdLoopBwQaxY
    connect CalRegn01IninOptSetA00.MotCurrRegCfgMotDampgRatDax -> MotCurrRegCfg.MotCurrRegCfgMotDampgRatDax
    connect CalRegn01IninOptSetA00.MotCurrRegCfgMotDampgRatQax -> MotCurrRegCfg.MotCurrRegCfgMotDampgRatQax
    connect CalRegn01IninOptSetA00.MotCurrRegCfgMotNatFrqDaxY -> MotCurrRegCfg.MotCurrRegCfgMotNatFrqDaxY
    connect CalRegn01IninOptSetA00.MotCurrRegCfgMotNatFrqQaxY -> MotCurrRegCfg.MotCurrRegCfgMotNatFrqQaxY
    connect CalRegn01IninOptSetA00.MotCurrRegCfgMotRVirtDax -> MotCurrRegCfg.MotCurrRegCfgMotRVirtDax
    connect CalRegn01IninOptSetA00.MotCurrRegCfgMotRVirtQax -> MotCurrRegCfg.MotCurrRegCfgMotRVirtQax
    connect CalRegn01IninOptSetA00.MotCurrRegCfgMotVelFilFrq -> MotCurrRegCfg.MotCurrRegCfgMotVelFilFrq
    connect CalRegn01IninOptSetA00.MotRefMdlCurrDaxBoostGain -> MotRefMdl.MotRefMdlCurrDaxBoostGain
    connect CalRegn01IninOptSetA00.MotRefMdlCurrDaxBoostTqScaX -> MotRefMdl.MotRefMdlCurrDaxBoostTqScaX
    connect CalRegn01IninOptSetA00.MotRefMdlCurrDaxBoostTqScaY -> MotRefMdl.MotRefMdlCurrDaxBoostTqScaY
    connect CalRegn01IninOptSetA00.MotRefMdlCurrDaxQaxRefDelta -> MotRefMdl.MotRefMdlCurrDaxQaxRefDelta
    connect CalRegn01IninOptSetA00.MotRefMdlCurrItrnTolr -> MotRefMdl.MotRefMdlCurrItrnTolr
    connect CalRegn01IninOptSetA00.MotRefMdlMotCurrDaxMaxSca -> MotRefMdl.MotRefMdlMotCurrDaxMaxSca
    connect CalRegn01IninOptSetA00.MotRefMdlQuad13VltgSdlX -> MotRefMdl.MotRefMdlQuad13VltgSdlX
    connect CalRegn01IninOptSetA00.MotRefMdlQuad13VltgSdlY -> MotRefMdl.MotRefMdlQuad13VltgSdlY
    connect CalRegn01IninOptSetA00.MotRefMdlQuad24VltgSdlX -> MotRefMdl.MotRefMdlQuad24VltgSdlX
    connect CalRegn01IninOptSetA00.MotRefMdlQuad24VltgSdlY -> MotRefMdl.MotRefMdlQuad24VltgSdlY
    connect CalRegn01IninOptSetA00.MotRefMdlVltgOverRThdSca -> MotRefMdl.MotRefMdlVltgOverRThdSca
    connect CalRegn01IninOptSetA00.MotTqTranlDampgCmdLim -> MotTqTranlDampg.MotTqTranlDampgCmdLim
    connect CalRegn01IninOptSetA00.MotTqTranlDampgVelThd -> MotTqTranlDampg.MotTqTranlDampgVelThd
    connect CalRegn01IninOptSetA00.SysGlbPrmSysTqRat -> PosnTrakgServo.SysGlbPrmSysTqRat
    connect CalRegn01IninOptSetA00.SysGlbPrmSysTqRat -> PullCmpActv.SysGlbPrmSysTqRat
    connect CalRegn01IninOptSetA00.PwrLimrAssiRednLpFilFrq -> PwrLimr.PwrLimrAssiRednLpFilFrq
    connect CalRegn01IninOptSetA00.PwrLimrBackEmfConStdT -> PwrLimr.PwrLimrBackEmfConStdT
    connect CalRegn01IninOptSetA00.PwrLimrBrdgVltgAdjSlew -> PwrLimr.PwrLimrBrdgVltgAdjSlew
    connect CalRegn01IninOptSetA00.PwrLimrBrdgVltgAltFltAdj -> PwrLimr.PwrLimrBrdgVltgAltFltAdj
    connect CalRegn01IninOptSetA00.PwrLimrFilAssiRednThd -> PwrLimr.PwrLimrFilAssiRednThd
    connect CalRegn01IninOptSetA00.PwrLimrLoVoltAssiRcvrThd -> PwrLimr.PwrLimrLoVoltAssiRcvrThd
    connect CalRegn01IninOptSetA00.PwrLimrLoVoltAssiRcvrTi -> PwrLimr.PwrLimrLoVoltAssiRcvrTi
    connect CalRegn01IninOptSetA00.PwrLimrMotEnvlpX -> PwrLimr.PwrLimrMotEnvlpX
    connect CalRegn01IninOptSetA00.PwrLimrMotEnvlpY -> PwrLimr.PwrLimrMotEnvlpY
    connect CalRegn01IninOptSetA00.PwrLimrMotVelLpFilFrq -> PwrLimr.PwrLimrMotVelLpFilFrq
    connect CalRegn01IninOptSetA00.PwrLimrSpdAdjSlewDec -> PwrLimr.PwrLimrSpdAdjSlewDec
    connect CalRegn01IninOptSetA00.PwrLimrSpdAdjSlewEna -> PwrLimr.PwrLimrSpdAdjSlewEna
    connect CalRegn01IninOptSetA00.PwrLimrSpdAdjSlewInc -> PwrLimr.PwrLimrSpdAdjSlewInc
    connect CalRegn01IninOptSetA00.PwrLimrStdOperMotEnvlpX -> PwrLimr.PwrLimrStdOperMotEnvlpX
    connect CalRegn01IninOptSetA00.PwrLimrStdOperMotEnvlpY -> PwrLimr.PwrLimrStdOperMotEnvlpY
    connect CalRegn01IninOptSetA00.PwrLimrVltgDptMotVelOffsX -> PwrLimr.PwrLimrVltgDptMotVelOffsX
    connect CalRegn01IninOptSetA00.PwrLimrVltgDptMotVelOffsY -> PwrLimr.PwrLimrVltgDptMotVelOffsY
    connect CalRegn01IninOptSetA00.TEstimnAmbPwrMplr -> TEstimn.TEstimnAmbPwrMplr
    connect CalRegn01IninOptSetA00.TEstimnAmbTSca -> TEstimn.TEstimnAmbTSca
    connect CalRegn01IninOptSetA00.TEstimnAssiMechAmbLpFilFrq -> TEstimn.TEstimnAssiMechAmbLpFilFrq
    connect CalRegn01IninOptSetA00.TEstimnAssiMechAmbLpFilFrqDualEcuFltMtgtn -> TEstimn.TEstimnAssiMechAmbLpFilFrqDualEcuFltMtgtn
    connect CalRegn01IninOptSetA00.TEstimnAssiMechAmbLpFilFrqFetMtgtnEna -> TEstimn.TEstimnAssiMechAmbLpFilFrqFetMtgtnEna
    connect CalRegn01IninOptSetA00.TEstimnAssiMechAmbMplr -> TEstimn.TEstimnAssiMechAmbMplr
    connect CalRegn01IninOptSetA00.TEstimnAssiMechCorrLim -> TEstimn.TEstimnAssiMechCorrLim
    connect CalRegn01IninOptSetA00.TEstimnAssiMechDampgSca -> TEstimn.TEstimnAssiMechDampgSca
    connect CalRegn01IninOptSetA00.TEstimnAssiMechDftT -> TEstimn.TEstimnAssiMechDftT
    connect CalRegn01IninOptSetA00.TEstimnAssiMechLLFilCoeffA1 -> TEstimn.TEstimnAssiMechLLFilCoeffA1
    connect CalRegn01IninOptSetA00.TEstimnAssiMechLLFilCoeffB0 -> TEstimn.TEstimnAssiMechLLFilCoeffB0
    connect CalRegn01IninOptSetA00.TEstimnAssiMechLLFilCoeffB1 -> TEstimn.TEstimnAssiMechLLFilCoeffB1
    connect CalRegn01IninOptSetA00.TEstimnAssiMechSlew -> TEstimn.TEstimnAssiMechSlew
    connect CalRegn01IninOptSetA00.TEstimnCorrnTAssiMech -> TEstimn.TEstimnCorrnTAssiMech
    connect CalRegn01IninOptSetA00.TEstimnCorrnTCu -> TEstimn.TEstimnCorrnTCu
    connect CalRegn01IninOptSetA00.TEstimnCorrnTMag -> TEstimn.TEstimnCorrnTMag
    connect CalRegn01IninOptSetA00.TEstimnCorrnTSi -> TEstimn.TEstimnCorrnTSi
    connect CalRegn01IninOptSetA00.TEstimnCuAmbLpFilFrq -> TEstimn.TEstimnCuAmbLpFilFrq
    connect CalRegn01IninOptSetA00.TEstimnCuAmbLpFilFrqDualEcuFltMtgtn -> TEstimn.TEstimnCuAmbLpFilFrqDualEcuFltMtgtn
    connect CalRegn01IninOptSetA00.TEstimnCuAmbLpFilFrqFetMtgtnEna -> TEstimn.TEstimnCuAmbLpFilFrqFetMtgtnEna
    connect CalRegn01IninOptSetA00.TEstimnCuAmbMplr -> TEstimn.TEstimnCuAmbMplr
    connect CalRegn01IninOptSetA00.TEstimnCuCorrnLim -> TEstimn.TEstimnCuCorrnLim
    connect CalRegn01IninOptSetA00.TEstimnCuLLFilCoeffA1 -> TEstimn.TEstimnCuLLFilCoeffA1
    connect CalRegn01IninOptSetA00.TEstimnCuLLFilCoeffB0 -> TEstimn.TEstimnCuLLFilCoeffB0
    connect CalRegn01IninOptSetA00.TEstimnCuLLFilCoeffB1 -> TEstimn.TEstimnCuLLFilCoeffB1
    connect CalRegn01IninOptSetA00.TEstimnEngTSca -> TEstimn.TEstimnEngTSca
    connect CalRegn01IninOptSetA00.TEstimnMagAmbLpFilFrq -> TEstimn.TEstimnMagAmbLpFilFrq
    connect CalRegn01IninOptSetA00.TEstimnMagAmbLpFilFrqDualEcuFltMtgtn -> TEstimn.TEstimnMagAmbLpFilFrqDualEcuFltMtgtn
    connect CalRegn01IninOptSetA00.TEstimnMagAmbLpFilFrqFetMtgtnEna -> TEstimn.TEstimnMagAmbLpFilFrqFetMtgtnEna
    connect CalRegn01IninOptSetA00.TEstimnMagAmbMplr -> TEstimn.TEstimnMagAmbMplr
    connect CalRegn01IninOptSetA00.TEstimnMagCorrnLim -> TEstimn.TEstimnMagCorrnLim
    connect CalRegn01IninOptSetA00.TEstimnMagLLFilCoeffA1 -> TEstimn.TEstimnMagLLFilCoeffA1
    connect CalRegn01IninOptSetA00.TEstimnMagLLFilCoeffB0 -> TEstimn.TEstimnMagLLFilCoeffB0
    connect CalRegn01IninOptSetA00.TEstimnMagLLFilCoeffB1 -> TEstimn.TEstimnMagLLFilCoeffB1
    connect CalRegn01IninOptSetA00.TEstimnSiAmbLpFilFrq -> TEstimn.TEstimnSiAmbLpFilFrq
    connect CalRegn01IninOptSetA00.TEstimnSiAmbLpFilFrqDualEcuFltMtgtn -> TEstimn.TEstimnSiAmbLpFilFrqDualEcuFltMtgtn
    connect CalRegn01IninOptSetA00.TEstimnSiAmbLpFilFrqFetMtgtnEna -> TEstimn.TEstimnSiAmbLpFilFrqFetMtgtnEna
    connect CalRegn01IninOptSetA00.TEstimnSiAmbMplr -> TEstimn.TEstimnSiAmbMplr
    connect CalRegn01IninOptSetA00.TEstimnSiCorrnLim -> TEstimn.TEstimnSiCorrnLim
    connect CalRegn01IninOptSetA00.TEstimnSiLLFilCoeffA1 -> TEstimn.TEstimnSiLLFilCoeffA1
    connect CalRegn01IninOptSetA00.TEstimnSiLLFilCoeffB0 -> TEstimn.TEstimnSiLLFilCoeffB0
    connect CalRegn01IninOptSetA00.TEstimnSiLLFilCoeffB1 -> TEstimn.TEstimnSiLLFilCoeffB1
    connect CalRegn01IninOptSetA00.TEstimnTauAssiMech -> TEstimn.TEstimnTauAssiMech
    connect CalRegn01IninOptSetA00.TEstimnTauCu -> TEstimn.TEstimnTauCu
    connect CalRegn01IninOptSetA00.TEstimnTauMag -> TEstimn.TEstimnTauMag
    connect CalRegn01IninOptSetA00.TEstimnTauSi -> TEstimn.TEstimnTauSi
    connect CalRegn01IninOptSetA00.TEstimnWghtAvrgTDi -> TEstimn.TEstimnWghtAvrgTDi
    connect CalRegn01IninOptSetA00.VehSpdLimrPosMaxOffs2 -> VehSpdLimr.VehSpdLimrPosMaxOffs2
    connect CalRegn01IninOptSetA01.DutyCycThermProtnAbsltCtrlTFetMtgtnTblX -> AAACalRegn01IninOptSetA01_Dummy.DutyCycThermProtnAbsltCtrlTFetMtgtnTblX
    connect CalRegn01IninOptSetA01.DutyCycThermProtnAbsltCtrlTTblX -> AAACalRegn01IninOptSetA01_Dummy.DutyCycThermProtnAbsltCtrlTTblX
    connect CalRegn01IninOptSetA01.DutyCycThermProtnAbsltCtrlTTqFetMtgtnTblY -> AAACalRegn01IninOptSetA01_Dummy.DutyCycThermProtnAbsltCtrlTTqFetMtgtnTblY
    connect CalRegn01IninOptSetA01.DutyCycThermProtnAbsltCtrlTTqTblY -> AAACalRegn01IninOptSetA01_Dummy.DutyCycThermProtnAbsltCtrlTTqTblY
    connect CalRegn01IninOptSetA01.DutyCycThermProtnAbsltCuTFetMtgtnTblX -> AAACalRegn01IninOptSetA01_Dummy.DutyCycThermProtnAbsltCuTFetMtgtnTblX
    connect CalRegn01IninOptSetA01.DutyCycThermProtnAbsltCuTTblX -> AAACalRegn01IninOptSetA01_Dummy.DutyCycThermProtnAbsltCuTTblX
    connect CalRegn01IninOptSetA01.DutyCycThermProtnAbsltCuTTqFetMtgtnTblY -> AAACalRegn01IninOptSetA01_Dummy.DutyCycThermProtnAbsltCuTTqFetMtgtnTblY
    connect CalRegn01IninOptSetA01.DutyCycThermProtnAbsltCuTTqTblY -> AAACalRegn01IninOptSetA01_Dummy.DutyCycThermProtnAbsltCuTTqTblY
    connect CalRegn01IninOptSetA01.DutyCycThermProtnAbsltMotVelBreakPt -> AAACalRegn01IninOptSetA01_Dummy.DutyCycThermProtnAbsltMotVelBreakPt
    connect CalRegn01IninOptSetA01.DutyCycThermProtnAbsltTTqSlewHiLim -> AAACalRegn01IninOptSetA01_Dummy.DutyCycThermProtnAbsltTTqSlewHiLim
    connect CalRegn01IninOptSetA01.DutyCycThermProtnAbsltTTqSlewLoLim -> AAACalRegn01IninOptSetA01_Dummy.DutyCycThermProtnAbsltTTqSlewLoLim
    connect CalRegn01IninOptSetA01.DutyCycThermProtnCtrlT -> AAACalRegn01IninOptSetA01_Dummy.DutyCycThermProtnCtrlT
    connect CalRegn01IninOptSetA01.DutyCycThermProtnCtrlTSeln -> AAACalRegn01IninOptSetA01_Dummy.DutyCycThermProtnCtrlTSeln
    connect CalRegn01IninOptSetA01.DutyCycThermProtnDutyCycFildThd -> AAACalRegn01IninOptSetA01_Dummy.DutyCycThermProtnDutyCycFildThd
    connect CalRegn01IninOptSetA01.DutyCycThermProtnIgnOffCtrlEna -> AAACalRegn01IninOptSetA01_Dummy.DutyCycThermProtnIgnOffCtrlEna
    connect CalRegn01IninOptSetA01.DutyCycThermProtnIgnOffMsgWaitTi -> AAACalRegn01IninOptSetA01_Dummy.DutyCycThermProtnIgnOffMsgWaitTi
    connect CalRegn01IninOptSetA01.DutyCycThermProtnLstTblValNonStall -> AAACalRegn01IninOptSetA01_Dummy.DutyCycThermProtnLstTblValNonStall
    connect CalRegn01IninOptSetA01.DutyCycThermProtnLstTblValStall -> AAACalRegn01IninOptSetA01_Dummy.DutyCycThermProtnLstTblValStall
    connect CalRegn01IninOptSetA01.DutyCycThermProtnMotPrTSeln -> AAACalRegn01IninOptSetA01_Dummy.DutyCycThermProtnMotPrTSeln
    connect CalRegn01IninOptSetA01.DutyCycThermProtnMplr1FetMtgtnNonStallTblY -> AAACalRegn01IninOptSetA01_Dummy.DutyCycThermProtnMplr1FetMtgtnNonStallTblY
    connect CalRegn01IninOptSetA01.DutyCycThermProtnMplr1FetMtgtnStallTblY -> AAACalRegn01IninOptSetA01_Dummy.DutyCycThermProtnMplr1FetMtgtnStallTblY
    connect CalRegn01IninOptSetA01.DutyCycThermProtnMplr1NonStallTblY -> AAACalRegn01IninOptSetA01_Dummy.DutyCycThermProtnMplr1NonStallTblY
    connect CalRegn01IninOptSetA01.DutyCycThermProtnMplr1StallTblY -> AAACalRegn01IninOptSetA01_Dummy.DutyCycThermProtnMplr1StallTblY
    connect CalRegn01IninOptSetA01.DutyCycThermProtnMplr2FetMtgtnNonStallTblY -> AAACalRegn01IninOptSetA01_Dummy.DutyCycThermProtnMplr2FetMtgtnNonStallTblY
    connect CalRegn01IninOptSetA01.DutyCycThermProtnMplr2FetMtgtnStallTblY -> AAACalRegn01IninOptSetA01_Dummy.DutyCycThermProtnMplr2FetMtgtnStallTblY
    connect CalRegn01IninOptSetA01.DutyCycThermProtnMplr2NonStallTblY -> AAACalRegn01IninOptSetA01_Dummy.DutyCycThermProtnMplr2NonStallTblY
    connect CalRegn01IninOptSetA01.DutyCycThermProtnMplr2StallTblY -> AAACalRegn01IninOptSetA01_Dummy.DutyCycThermProtnMplr2StallTblY
    connect CalRegn01IninOptSetA01.DutyCycThermProtnMplr3FetMtgtnNonStallTblY -> AAACalRegn01IninOptSetA01_Dummy.DutyCycThermProtnMplr3FetMtgtnNonStallTblY
    connect CalRegn01IninOptSetA01.DutyCycThermProtnMplr3FetMtgtnStallTblY -> AAACalRegn01IninOptSetA01_Dummy.DutyCycThermProtnMplr3FetMtgtnStallTblY
    connect CalRegn01IninOptSetA01.DutyCycThermProtnMplr3NonStallTblY -> AAACalRegn01IninOptSetA01_Dummy.DutyCycThermProtnMplr3NonStallTblY
    connect CalRegn01IninOptSetA01.DutyCycThermProtnMplr3StallTblY -> AAACalRegn01IninOptSetA01_Dummy.DutyCycThermProtnMplr3StallTblY
    connect CalRegn01IninOptSetA01.DutyCycThermProtnMplr4FetMtgtnNonStallTblY -> AAACalRegn01IninOptSetA01_Dummy.DutyCycThermProtnMplr4FetMtgtnNonStallTblY
    connect CalRegn01IninOptSetA01.DutyCycThermProtnMplr4FetMtgtnStallTblY -> AAACalRegn01IninOptSetA01_Dummy.DutyCycThermProtnMplr4FetMtgtnStallTblY
    connect CalRegn01IninOptSetA01.DutyCycThermProtnMplr4NonStallTblY -> AAACalRegn01IninOptSetA01_Dummy.DutyCycThermProtnMplr4NonStallTblY
    connect CalRegn01IninOptSetA01.DutyCycThermProtnMplr4StallTblY -> AAACalRegn01IninOptSetA01_Dummy.DutyCycThermProtnMplr4StallTblY
    connect CalRegn01IninOptSetA01.DutyCycThermProtnMplr5FetMtgtnNonStallTblY -> AAACalRegn01IninOptSetA01_Dummy.DutyCycThermProtnMplr5FetMtgtnNonStallTblY
    connect CalRegn01IninOptSetA01.DutyCycThermProtnMplr5FetMtgtnStallTblY -> AAACalRegn01IninOptSetA01_Dummy.DutyCycThermProtnMplr5FetMtgtnStallTblY
    connect CalRegn01IninOptSetA01.DutyCycThermProtnMplr5NonStallTblY -> AAACalRegn01IninOptSetA01_Dummy.DutyCycThermProtnMplr5NonStallTblY
    connect CalRegn01IninOptSetA01.DutyCycThermProtnMplr5StallTblY -> AAACalRegn01IninOptSetA01_Dummy.DutyCycThermProtnMplr5StallTblY
    connect CalRegn01IninOptSetA01.DutyCycThermProtnMplr6FetMtgtnNonStallTblY -> AAACalRegn01IninOptSetA01_Dummy.DutyCycThermProtnMplr6FetMtgtnNonStallTblY
    connect CalRegn01IninOptSetA01.DutyCycThermProtnMplr6FetMtgtnStallTblY -> AAACalRegn01IninOptSetA01_Dummy.DutyCycThermProtnMplr6FetMtgtnStallTblY
    connect CalRegn01IninOptSetA01.DutyCycThermProtnMplr6NonStallTblY -> AAACalRegn01IninOptSetA01_Dummy.DutyCycThermProtnMplr6NonStallTblY
    connect CalRegn01IninOptSetA01.DutyCycThermProtnMplr6StallTblY -> AAACalRegn01IninOptSetA01_Dummy.DutyCycThermProtnMplr6StallTblY
    connect CalRegn01IninOptSetA01.DutyCycThermProtnMplrFetMtgtnTblX -> AAACalRegn01IninOptSetA01_Dummy.DutyCycThermProtnMplrFetMtgtnTblX
    connect CalRegn01IninOptSetA01.DutyCycThermProtnMplrTblX -> AAACalRegn01IninOptSetA01_Dummy.DutyCycThermProtnMplrTblX
    connect CalRegn01IninOptSetA01.DutyCycThermProtnMplrTSeln -> AAACalRegn01IninOptSetA01_Dummy.DutyCycThermProtnMplrTSeln
    connect CalRegn01IninOptSetA01.DutyCycThermProtnSlowFilTSeln -> AAACalRegn01IninOptSetA01_Dummy.DutyCycThermProtnSlowFilTSeln
    connect CalRegn01IninOptSetA01.DutyCycThermProtnThermLimScaFac -> AAACalRegn01IninOptSetA01_Dummy.DutyCycThermProtnThermLimScaFac
    connect CalRegn01IninOptSetA01.DutyCycThermProtnThermLoadLimTblX -> AAACalRegn01IninOptSetA01_Dummy.DutyCycThermProtnThermLoadLimTblX
    connect CalRegn01IninOptSetA01.DutyCycThermProtnThermLoadLimTblY -> AAACalRegn01IninOptSetA01_Dummy.DutyCycThermProtnThermLoadLimTblY
    connect CalRegn01IninOptSetA01.DutyCycThermProtnTqCmdSlewDwn -> AAACalRegn01IninOptSetA01_Dummy.DutyCycThermProtnTqCmdSlewDwn
    connect CalRegn01IninOptSetA01.DutyCycThermProtnTqCmdSlewUp -> AAACalRegn01IninOptSetA01_Dummy.DutyCycThermProtnTqCmdSlewUp
    connect CalRegn01IninOptSetA01.HiLoadStallLimrMotVelMgnThd -> AAACalRegn01IninOptSetA01_Dummy.HiLoadStallLimrMotVelMgnThd
    connect CalRegn01IninOptSetA01.HiLoadStallLimrStallMotTqCmdFetMtgtnLimX -> AAACalRegn01IninOptSetA01_Dummy.HiLoadStallLimrStallMotTqCmdFetMtgtnLimX
    connect CalRegn01IninOptSetA01.HiLoadStallLimrStallMotTqCmdFetMtgtnLimY -> AAACalRegn01IninOptSetA01_Dummy.HiLoadStallLimrStallMotTqCmdFetMtgtnLimY
    connect CalRegn01IninOptSetA01.HiLoadStallLimrStallMotTqCmdLimX -> AAACalRegn01IninOptSetA01_Dummy.HiLoadStallLimrStallMotTqCmdLimX
    connect CalRegn01IninOptSetA01.HiLoadStallLimrStallMotTqCmdLimY -> AAACalRegn01IninOptSetA01_Dummy.HiLoadStallLimrStallMotTqCmdLimY
    connect CalRegn01IninOptSetA01.HiLoadStallLimrStallMotTqLimSlewRate -> AAACalRegn01IninOptSetA01_Dummy.HiLoadStallLimrStallMotTqLimSlewRate
    connect CalRegn01IninOptSetA01.HiLoadStallLimrStallThermLimSca -> AAACalRegn01IninOptSetA01_Dummy.HiLoadStallLimrStallThermLimSca
    connect CalRegn01IninOptSetA01.LrndRackCentrMotTqThd -> AAACalRegn01IninOptSetA01_Dummy.LrndRackCentrMotTqThd
    connect CalRegn01IninOptSetA01.LrndRackCentrMotVelThd -> AAACalRegn01IninOptSetA01_Dummy.LrndRackCentrMotVelThd
    connect CalRegn01IninOptSetA01.MotCtrlPrmEstimnFetRNom -> AAACalRegn01IninOptSetA01_Dummy.MotCtrlPrmEstimnFetRNom
    connect CalRegn01IninOptSetA01.MotCtrlPrmEstimnMotBackEmfConHiLim -> AAACalRegn01IninOptSetA01_Dummy.MotCtrlPrmEstimnMotBackEmfConHiLim
    connect CalRegn01IninOptSetA01.MotCtrlPrmEstimnMotBackEmfConLoLim -> AAACalRegn01IninOptSetA01_Dummy.MotCtrlPrmEstimnMotBackEmfConLoLim
    connect CalRegn01IninOptSetA01.MotCtrlPrmEstimnMotBackEmfConNom -> AAACalRegn01IninOptSetA01_Dummy.MotCtrlPrmEstimnMotBackEmfConNom
    connect CalRegn01IninOptSetA01.MotCtrlPrmEstimnMotBackEmfConSatnScaIvtrLoaMtgtn -> AAACalRegn01IninOptSetA01_Dummy.MotCtrlPrmEstimnMotBackEmfConSatnScaIvtrLoaMtgtn
    connect CalRegn01IninOptSetA01.MotCtrlPrmEstimnMotBackEmfConSatnX -> AAACalRegn01IninOptSetA01_Dummy.MotCtrlPrmEstimnMotBackEmfConSatnX
    connect CalRegn01IninOptSetA01.MotCtrlPrmEstimnMotBackEmfConSatnY -> AAACalRegn01IninOptSetA01_Dummy.MotCtrlPrmEstimnMotBackEmfConSatnY
    connect CalRegn01IninOptSetA01.MotCtrlPrmEstimnMotCurrDaxInduSatnBilnrSeln -> AAACalRegn01IninOptSetA01_Dummy.MotCtrlPrmEstimnMotCurrDaxInduSatnBilnrSeln
    connect CalRegn01IninOptSetA01.MotCtrlPrmEstimnMotCurrQaxInduSatnX -> AAACalRegn01IninOptSetA01_Dummy.MotCtrlPrmEstimnMotCurrQaxInduSatnX
    connect CalRegn01IninOptSetA01.MotCtrlPrmEstimnMotInduDaxHiLim -> AAACalRegn01IninOptSetA01_Dummy.MotCtrlPrmEstimnMotInduDaxHiLim
    connect CalRegn01IninOptSetA01.MotCtrlPrmEstimnMotInduDaxIvtrLoaMtgtn -> AAACalRegn01IninOptSetA01_Dummy.MotCtrlPrmEstimnMotInduDaxIvtrLoaMtgtn
    connect CalRegn01IninOptSetA01.MotCtrlPrmEstimnMotInduDaxLoLim -> AAACalRegn01IninOptSetA01_Dummy.MotCtrlPrmEstimnMotInduDaxLoLim
    connect CalRegn01IninOptSetA01.MotCtrlPrmEstimnMotInduDaxNom -> AAACalRegn01IninOptSetA01_Dummy.MotCtrlPrmEstimnMotInduDaxNom
    connect CalRegn01IninOptSetA01.MotCtrlPrmEstimnMotInduDaxSatnScaY -> AAACalRegn01IninOptSetA01_Dummy.MotCtrlPrmEstimnMotInduDaxSatnScaY
    connect CalRegn01IninOptSetA01.MotCtrlPrmEstimnMotInduQaxHiLim -> AAACalRegn01IninOptSetA01_Dummy.MotCtrlPrmEstimnMotInduQaxHiLim
    connect CalRegn01IninOptSetA01.MotCtrlPrmEstimnMotInduQaxIvtrLoaMtgtn -> AAACalRegn01IninOptSetA01_Dummy.MotCtrlPrmEstimnMotInduQaxIvtrLoaMtgtn
    connect CalRegn01IninOptSetA01.MotCtrlPrmEstimnMotInduQaxLoLim -> AAACalRegn01IninOptSetA01_Dummy.MotCtrlPrmEstimnMotInduQaxLoLim
    connect CalRegn01IninOptSetA01.MotCtrlPrmEstimnMotInduQaxNom -> AAACalRegn01IninOptSetA01_Dummy.MotCtrlPrmEstimnMotInduQaxNom
    connect CalRegn01IninOptSetA01.MotCtrlPrmEstimnMotInduQaxSatnScaY -> AAACalRegn01IninOptSetA01_Dummy.MotCtrlPrmEstimnMotInduQaxSatnScaY
    connect CalRegn01IninOptSetA01.MotCtrlPrmEstimnMotRHiLim -> AAACalRegn01IninOptSetA01_Dummy.MotCtrlPrmEstimnMotRHiLim
    connect CalRegn01IninOptSetA01.MotCtrlPrmEstimnMotRLoLim -> AAACalRegn01IninOptSetA01_Dummy.MotCtrlPrmEstimnMotRLoLim
    connect CalRegn01IninOptSetA01.MotCtrlPrmEstimnMotRNom -> AAACalRegn01IninOptSetA01_Dummy.MotCtrlPrmEstimnMotRNom
    connect CalRegn01IninOptSetA01.MotCtrlPrmEstimnMotWidgThermCoeff -> AAACalRegn01IninOptSetA01_Dummy.MotCtrlPrmEstimnMotWidgThermCoeff
    connect CalRegn01IninOptSetA01.MotCtrlPrmEstimnTNom -> AAACalRegn01IninOptSetA01_Dummy.MotCtrlPrmEstimnTNom
    connect CalRegn01IninOptSetA01.MotCurrPeakEstimnCurrFilFrq -> AAACalRegn01IninOptSetA01_Dummy.MotCurrPeakEstimnCurrFilFrq
    connect CalRegn01IninOptSetA01.MotCurrPeakEstimnCurrPeakEstimdFilFrq -> AAACalRegn01IninOptSetA01_Dummy.MotCurrPeakEstimnCurrPeakEstimdFilFrq
    connect CalRegn01IninOptSetA01.MotCurrRegCfgMotClsdLoopBwDaxY -> AAACalRegn01IninOptSetA01_Dummy.MotCurrRegCfgMotClsdLoopBwDaxY
    connect CalRegn01IninOptSetA01.MotCurrRegCfgMotClsdLoopBwQaxY -> AAACalRegn01IninOptSetA01_Dummy.MotCurrRegCfgMotClsdLoopBwQaxY
    connect CalRegn01IninOptSetA01.MotCurrRegCfgMotDampgRatDax -> AAACalRegn01IninOptSetA01_Dummy.MotCurrRegCfgMotDampgRatDax
    connect CalRegn01IninOptSetA01.MotCurrRegCfgMotDampgRatQax -> AAACalRegn01IninOptSetA01_Dummy.MotCurrRegCfgMotDampgRatQax
    connect CalRegn01IninOptSetA01.MotCurrRegCfgMotNatFrqDaxY -> AAACalRegn01IninOptSetA01_Dummy.MotCurrRegCfgMotNatFrqDaxY
    connect CalRegn01IninOptSetA01.MotCurrRegCfgMotNatFrqQaxY -> AAACalRegn01IninOptSetA01_Dummy.MotCurrRegCfgMotNatFrqQaxY
    connect CalRegn01IninOptSetA01.MotCurrRegCfgMotRVirtDax -> AAACalRegn01IninOptSetA01_Dummy.MotCurrRegCfgMotRVirtDax
    connect CalRegn01IninOptSetA01.MotCurrRegCfgMotRVirtQax -> AAACalRegn01IninOptSetA01_Dummy.MotCurrRegCfgMotRVirtQax
    connect CalRegn01IninOptSetA01.MotCurrRegCfgMotVelFilFrq -> AAACalRegn01IninOptSetA01_Dummy.MotCurrRegCfgMotVelFilFrq
    connect CalRegn01IninOptSetA01.MotCurrRegVltgLimrCurrLoaScarSlewRate -> AAACalRegn01IninOptSetA01_Dummy.MotCurrRegVltgLimrCurrLoaScarSlewRate
    connect CalRegn01IninOptSetA01.MotCurrRegVltgLimrDaxAntiWdupCoeff -> AAACalRegn01IninOptSetA01_Dummy.MotCurrRegVltgLimrDaxAntiWdupCoeff
    connect CalRegn01IninOptSetA01.MotCurrRegVltgLimrDualEcuLoaScarSlewRate -> AAACalRegn01IninOptSetA01_Dummy.MotCurrRegVltgLimrDualEcuLoaScarSlewRate
    connect CalRegn01IninOptSetA01.MotCurrRegVltgLimrFETLoaScarSlewRate -> AAACalRegn01IninOptSetA01_Dummy.MotCurrRegVltgLimrFETLoaScarSlewRate
    connect CalRegn01IninOptSetA01.MotCurrRegVltgLimrIvtrLoaScarSlewRate -> AAACalRegn01IninOptSetA01_Dummy.MotCurrRegVltgLimrIvtrLoaScarSlewRate
    connect CalRegn01IninOptSetA01.MotCurrRegVltgLimrMotVltgBrdgLpFilFrq -> AAACalRegn01IninOptSetA01_Dummy.MotCurrRegVltgLimrMotVltgBrdgLpFilFrq
    connect CalRegn01IninOptSetA01.MotCurrRegVltgLimrMotVltgDaxIntglHiLim -> AAACalRegn01IninOptSetA01_Dummy.MotCurrRegVltgLimrMotVltgDaxIntglHiLim
    connect CalRegn01IninOptSetA01.MotCurrRegVltgLimrMotVltgDaxIntglLoLim -> AAACalRegn01IninOptSetA01_Dummy.MotCurrRegVltgLimrMotVltgDaxIntglLoLim
    connect CalRegn01IninOptSetA01.MotCurrRegVltgLimrMotVltgQaxFfLpFilFrq -> AAACalRegn01IninOptSetA01_Dummy.MotCurrRegVltgLimrMotVltgQaxFfLpFilFrq
    connect CalRegn01IninOptSetA01.MotCurrRegVltgLimrMotVltgQaxIntglHiLim -> AAACalRegn01IninOptSetA01_Dummy.MotCurrRegVltgLimrMotVltgQaxIntglHiLim
    connect CalRegn01IninOptSetA01.MotCurrRegVltgLimrMotVltgQaxIntglLoLim -> AAACalRegn01IninOptSetA01_Dummy.MotCurrRegVltgLimrMotVltgQaxIntglLoLim
    connect CalRegn01IninOptSetA01.MotCurrRegVltgLimrQaxAntiWdupCoeff -> AAACalRegn01IninOptSetA01_Dummy.MotCurrRegVltgLimrQaxAntiWdupCoeff
    connect CalRegn01IninOptSetA01.MotCurrRegVltgLimrQaxAntiWdupScagDi -> AAACalRegn01IninOptSetA01_Dummy.MotCurrRegVltgLimrQaxAntiWdupScagDi
    connect CalRegn01IninOptSetA01.MotRefMdlCurrDaxBoostGain -> AAACalRegn01IninOptSetA01_Dummy.MotRefMdlCurrDaxBoostGain
    connect CalRegn01IninOptSetA01.MotRefMdlCurrDaxBoostTqScaX -> AAACalRegn01IninOptSetA01_Dummy.MotRefMdlCurrDaxBoostTqScaX
    connect CalRegn01IninOptSetA01.MotRefMdlCurrDaxBoostTqScaY -> AAACalRegn01IninOptSetA01_Dummy.MotRefMdlCurrDaxBoostTqScaY
    connect CalRegn01IninOptSetA01.MotRefMdlCurrDaxQaxRefDelta -> AAACalRegn01IninOptSetA01_Dummy.MotRefMdlCurrDaxQaxRefDelta
    connect CalRegn01IninOptSetA01.MotRefMdlCurrItrnTolr -> AAACalRegn01IninOptSetA01_Dummy.MotRefMdlCurrItrnTolr
    connect CalRegn01IninOptSetA01.MotRefMdlMotCurrDaxMaxSca -> AAACalRegn01IninOptSetA01_Dummy.MotRefMdlMotCurrDaxMaxSca
    connect CalRegn01IninOptSetA01.MotRefMdlQuad13VltgSdlX -> AAACalRegn01IninOptSetA01_Dummy.MotRefMdlQuad13VltgSdlX
    connect CalRegn01IninOptSetA01.MotRefMdlQuad13VltgSdlY -> AAACalRegn01IninOptSetA01_Dummy.MotRefMdlQuad13VltgSdlY
    connect CalRegn01IninOptSetA01.MotRefMdlQuad24VltgSdlX -> AAACalRegn01IninOptSetA01_Dummy.MotRefMdlQuad24VltgSdlX
    connect CalRegn01IninOptSetA01.MotRefMdlQuad24VltgSdlY -> AAACalRegn01IninOptSetA01_Dummy.MotRefMdlQuad24VltgSdlY
    connect CalRegn01IninOptSetA01.MotRefMdlVltgOverRThdSca -> AAACalRegn01IninOptSetA01_Dummy.MotRefMdlVltgOverRThdSca
    connect CalRegn01IninOptSetA01.MotTqTranlDampgCmdLim -> AAACalRegn01IninOptSetA01_Dummy.MotTqTranlDampgCmdLim
    connect CalRegn01IninOptSetA01.MotTqTranlDampgVelThd -> AAACalRegn01IninOptSetA01_Dummy.MotTqTranlDampgVelThd
    connect CalRegn01IninOptSetA01.PwrLimrAssiRednLpFilFrq -> AAACalRegn01IninOptSetA01_Dummy.PwrLimrAssiRednLpFilFrq
    connect CalRegn01IninOptSetA01.PwrLimrBackEmfConStdT -> AAACalRegn01IninOptSetA01_Dummy.PwrLimrBackEmfConStdT
    connect CalRegn01IninOptSetA01.PwrLimrBrdgVltgAdjSlew -> AAACalRegn01IninOptSetA01_Dummy.PwrLimrBrdgVltgAdjSlew
    connect CalRegn01IninOptSetA01.PwrLimrBrdgVltgAltFltAdj -> AAACalRegn01IninOptSetA01_Dummy.PwrLimrBrdgVltgAltFltAdj
    connect CalRegn01IninOptSetA01.PwrLimrFilAssiRednThd -> AAACalRegn01IninOptSetA01_Dummy.PwrLimrFilAssiRednThd
    connect CalRegn01IninOptSetA01.PwrLimrLoVoltAssiRcvrThd -> AAACalRegn01IninOptSetA01_Dummy.PwrLimrLoVoltAssiRcvrThd
    connect CalRegn01IninOptSetA01.PwrLimrLoVoltAssiRcvrTi -> AAACalRegn01IninOptSetA01_Dummy.PwrLimrLoVoltAssiRcvrTi
    connect CalRegn01IninOptSetA01.PwrLimrMotEnvlpX -> AAACalRegn01IninOptSetA01_Dummy.PwrLimrMotEnvlpX
    connect CalRegn01IninOptSetA01.PwrLimrMotEnvlpY -> AAACalRegn01IninOptSetA01_Dummy.PwrLimrMotEnvlpY
    connect CalRegn01IninOptSetA01.PwrLimrMotVelLpFilFrq -> AAACalRegn01IninOptSetA01_Dummy.PwrLimrMotVelLpFilFrq
    connect CalRegn01IninOptSetA01.PwrLimrSpdAdjSlewDec -> AAACalRegn01IninOptSetA01_Dummy.PwrLimrSpdAdjSlewDec
    connect CalRegn01IninOptSetA01.PwrLimrSpdAdjSlewEna -> AAACalRegn01IninOptSetA01_Dummy.PwrLimrSpdAdjSlewEna
    connect CalRegn01IninOptSetA01.PwrLimrSpdAdjSlewInc -> AAACalRegn01IninOptSetA01_Dummy.PwrLimrSpdAdjSlewInc
    connect CalRegn01IninOptSetA01.PwrLimrStdOperMotEnvlpX -> AAACalRegn01IninOptSetA01_Dummy.PwrLimrStdOperMotEnvlpX
    connect CalRegn01IninOptSetA01.PwrLimrStdOperMotEnvlpY -> AAACalRegn01IninOptSetA01_Dummy.PwrLimrStdOperMotEnvlpY
    connect CalRegn01IninOptSetA01.PwrLimrVltgDptMotVelOffsX -> AAACalRegn01IninOptSetA01_Dummy.PwrLimrVltgDptMotVelOffsX
    connect CalRegn01IninOptSetA01.PwrLimrVltgDptMotVelOffsY -> AAACalRegn01IninOptSetA01_Dummy.PwrLimrVltgDptMotVelOffsY
    connect CalRegn01IninOptSetA01.SysGlbPrmSysTqRat -> AAACalRegn01IninOptSetA01_Dummy.SysGlbPrmSysTqRat
    connect CalRegn01IninOptSetA01.TEstimnAmbPwrMplr -> AAACalRegn01IninOptSetA01_Dummy.TEstimnAmbPwrMplr
    connect CalRegn01IninOptSetA01.TEstimnAmbTSca -> AAACalRegn01IninOptSetA01_Dummy.TEstimnAmbTSca
    connect CalRegn01IninOptSetA01.TEstimnAssiMechAmbLpFilFrq -> AAACalRegn01IninOptSetA01_Dummy.TEstimnAssiMechAmbLpFilFrq
    connect CalRegn01IninOptSetA01.TEstimnAssiMechAmbLpFilFrqDualEcuFltMtgtn -> AAACalRegn01IninOptSetA01_Dummy.TEstimnAssiMechAmbLpFilFrqDualEcuFltMtgtn
    connect CalRegn01IninOptSetA01.TEstimnAssiMechAmbLpFilFrqFetMtgtnEna -> AAACalRegn01IninOptSetA01_Dummy.TEstimnAssiMechAmbLpFilFrqFetMtgtnEna
    connect CalRegn01IninOptSetA01.TEstimnAssiMechAmbMplr -> AAACalRegn01IninOptSetA01_Dummy.TEstimnAssiMechAmbMplr
    connect CalRegn01IninOptSetA01.TEstimnAssiMechCorrLim -> AAACalRegn01IninOptSetA01_Dummy.TEstimnAssiMechCorrLim
    connect CalRegn01IninOptSetA01.TEstimnAssiMechDampgSca -> AAACalRegn01IninOptSetA01_Dummy.TEstimnAssiMechDampgSca
    connect CalRegn01IninOptSetA01.TEstimnAssiMechDftT -> AAACalRegn01IninOptSetA01_Dummy.TEstimnAssiMechDftT
    connect CalRegn01IninOptSetA01.TEstimnAssiMechLLFilCoeffA1 -> AAACalRegn01IninOptSetA01_Dummy.TEstimnAssiMechLLFilCoeffA1
    connect CalRegn01IninOptSetA01.TEstimnAssiMechLLFilCoeffB0 -> AAACalRegn01IninOptSetA01_Dummy.TEstimnAssiMechLLFilCoeffB0
    connect CalRegn01IninOptSetA01.TEstimnAssiMechLLFilCoeffB1 -> AAACalRegn01IninOptSetA01_Dummy.TEstimnAssiMechLLFilCoeffB1
    connect CalRegn01IninOptSetA01.TEstimnAssiMechSlew -> AAACalRegn01IninOptSetA01_Dummy.TEstimnAssiMechSlew
    connect CalRegn01IninOptSetA01.TEstimnCorrnTAssiMech -> AAACalRegn01IninOptSetA01_Dummy.TEstimnCorrnTAssiMech
    connect CalRegn01IninOptSetA01.TEstimnCorrnTCu -> AAACalRegn01IninOptSetA01_Dummy.TEstimnCorrnTCu
    connect CalRegn01IninOptSetA01.TEstimnCorrnTMag -> AAACalRegn01IninOptSetA01_Dummy.TEstimnCorrnTMag
    connect CalRegn01IninOptSetA01.TEstimnCorrnTSi -> AAACalRegn01IninOptSetA01_Dummy.TEstimnCorrnTSi
    connect CalRegn01IninOptSetA01.TEstimnCuAmbLpFilFrq -> AAACalRegn01IninOptSetA01_Dummy.TEstimnCuAmbLpFilFrq
    connect CalRegn01IninOptSetA01.TEstimnCuAmbLpFilFrqDualEcuFltMtgtn -> AAACalRegn01IninOptSetA01_Dummy.TEstimnCuAmbLpFilFrqDualEcuFltMtgtn
    connect CalRegn01IninOptSetA01.TEstimnCuAmbLpFilFrqFetMtgtnEna -> AAACalRegn01IninOptSetA01_Dummy.TEstimnCuAmbLpFilFrqFetMtgtnEna
    connect CalRegn01IninOptSetA01.TEstimnCuAmbMplr -> AAACalRegn01IninOptSetA01_Dummy.TEstimnCuAmbMplr
    connect CalRegn01IninOptSetA01.TEstimnCuCorrnLim -> AAACalRegn01IninOptSetA01_Dummy.TEstimnCuCorrnLim
    connect CalRegn01IninOptSetA01.TEstimnCuLLFilCoeffA1 -> AAACalRegn01IninOptSetA01_Dummy.TEstimnCuLLFilCoeffA1
    connect CalRegn01IninOptSetA01.TEstimnCuLLFilCoeffB0 -> AAACalRegn01IninOptSetA01_Dummy.TEstimnCuLLFilCoeffB0
    connect CalRegn01IninOptSetA01.TEstimnCuLLFilCoeffB1 -> AAACalRegn01IninOptSetA01_Dummy.TEstimnCuLLFilCoeffB1
    connect CalRegn01IninOptSetA01.TEstimnEngTSca -> AAACalRegn01IninOptSetA01_Dummy.TEstimnEngTSca
    connect CalRegn01IninOptSetA01.TEstimnMagAmbLpFilFrq -> AAACalRegn01IninOptSetA01_Dummy.TEstimnMagAmbLpFilFrq
    connect CalRegn01IninOptSetA01.TEstimnMagAmbLpFilFrqDualEcuFltMtgtn -> AAACalRegn01IninOptSetA01_Dummy.TEstimnMagAmbLpFilFrqDualEcuFltMtgtn
    connect CalRegn01IninOptSetA01.TEstimnMagAmbLpFilFrqFetMtgtnEna -> AAACalRegn01IninOptSetA01_Dummy.TEstimnMagAmbLpFilFrqFetMtgtnEna
    connect CalRegn01IninOptSetA01.TEstimnMagAmbMplr -> AAACalRegn01IninOptSetA01_Dummy.TEstimnMagAmbMplr
    connect CalRegn01IninOptSetA01.TEstimnMagCorrnLim -> AAACalRegn01IninOptSetA01_Dummy.TEstimnMagCorrnLim
    connect CalRegn01IninOptSetA01.TEstimnMagLLFilCoeffA1 -> AAACalRegn01IninOptSetA01_Dummy.TEstimnMagLLFilCoeffA1
    connect CalRegn01IninOptSetA01.TEstimnMagLLFilCoeffB0 -> AAACalRegn01IninOptSetA01_Dummy.TEstimnMagLLFilCoeffB0
    connect CalRegn01IninOptSetA01.TEstimnMagLLFilCoeffB1 -> AAACalRegn01IninOptSetA01_Dummy.TEstimnMagLLFilCoeffB1
    connect CalRegn01IninOptSetA01.TEstimnSiAmbLpFilFrq -> AAACalRegn01IninOptSetA01_Dummy.TEstimnSiAmbLpFilFrq
    connect CalRegn01IninOptSetA01.TEstimnSiAmbLpFilFrqDualEcuFltMtgtn -> AAACalRegn01IninOptSetA01_Dummy.TEstimnSiAmbLpFilFrqDualEcuFltMtgtn
    connect CalRegn01IninOptSetA01.TEstimnSiAmbLpFilFrqFetMtgtnEna -> AAACalRegn01IninOptSetA01_Dummy.TEstimnSiAmbLpFilFrqFetMtgtnEna
    connect CalRegn01IninOptSetA01.TEstimnSiAmbMplr -> AAACalRegn01IninOptSetA01_Dummy.TEstimnSiAmbMplr
    connect CalRegn01IninOptSetA01.TEstimnSiCorrnLim -> AAACalRegn01IninOptSetA01_Dummy.TEstimnSiCorrnLim
    connect CalRegn01IninOptSetA01.TEstimnSiLLFilCoeffA1 -> AAACalRegn01IninOptSetA01_Dummy.TEstimnSiLLFilCoeffA1
    connect CalRegn01IninOptSetA01.TEstimnSiLLFilCoeffB0 -> AAACalRegn01IninOptSetA01_Dummy.TEstimnSiLLFilCoeffB0
    connect CalRegn01IninOptSetA01.TEstimnSiLLFilCoeffB1 -> AAACalRegn01IninOptSetA01_Dummy.TEstimnSiLLFilCoeffB1
    connect CalRegn01IninOptSetA01.TEstimnTauAssiMech -> AAACalRegn01IninOptSetA01_Dummy.TEstimnTauAssiMech
    connect CalRegn01IninOptSetA01.TEstimnTauCu -> AAACalRegn01IninOptSetA01_Dummy.TEstimnTauCu
    connect CalRegn01IninOptSetA01.TEstimnTauMag -> AAACalRegn01IninOptSetA01_Dummy.TEstimnTauMag
    connect CalRegn01IninOptSetA01.TEstimnTauSi -> AAACalRegn01IninOptSetA01_Dummy.TEstimnTauSi
    connect CalRegn01IninOptSetA01.TEstimnWghtAvrgTDi -> AAACalRegn01IninOptSetA01_Dummy.TEstimnWghtAvrgTDi
    connect CalRegn01IninOptSetA01.VehSpdLimrPosMaxOffs2 -> AAACalRegn01IninOptSetA01_Dummy.VehSpdLimrPosMaxOffs2
    connect CalRegn01IninOptSetA02.DutyCycThermProtnAbsltCtrlTFetMtgtnTblX -> AAACalRegn01IninOptSetA02_Dummy.DutyCycThermProtnAbsltCtrlTFetMtgtnTblX
    connect CalRegn01IninOptSetA02.DutyCycThermProtnAbsltCtrlTTblX -> AAACalRegn01IninOptSetA02_Dummy.DutyCycThermProtnAbsltCtrlTTblX
    connect CalRegn01IninOptSetA02.DutyCycThermProtnAbsltCtrlTTqFetMtgtnTblY -> AAACalRegn01IninOptSetA02_Dummy.DutyCycThermProtnAbsltCtrlTTqFetMtgtnTblY
    connect CalRegn01IninOptSetA02.DutyCycThermProtnAbsltCtrlTTqTblY -> AAACalRegn01IninOptSetA02_Dummy.DutyCycThermProtnAbsltCtrlTTqTblY
    connect CalRegn01IninOptSetA02.DutyCycThermProtnAbsltCuTFetMtgtnTblX -> AAACalRegn01IninOptSetA02_Dummy.DutyCycThermProtnAbsltCuTFetMtgtnTblX
    connect CalRegn01IninOptSetA02.DutyCycThermProtnAbsltCuTTblX -> AAACalRegn01IninOptSetA02_Dummy.DutyCycThermProtnAbsltCuTTblX
    connect CalRegn01IninOptSetA02.DutyCycThermProtnAbsltCuTTqFetMtgtnTblY -> AAACalRegn01IninOptSetA02_Dummy.DutyCycThermProtnAbsltCuTTqFetMtgtnTblY
    connect CalRegn01IninOptSetA02.DutyCycThermProtnAbsltCuTTqTblY -> AAACalRegn01IninOptSetA02_Dummy.DutyCycThermProtnAbsltCuTTqTblY
    connect CalRegn01IninOptSetA02.DutyCycThermProtnAbsltMotVelBreakPt -> AAACalRegn01IninOptSetA02_Dummy.DutyCycThermProtnAbsltMotVelBreakPt
    connect CalRegn01IninOptSetA02.DutyCycThermProtnAbsltTTqSlewHiLim -> AAACalRegn01IninOptSetA02_Dummy.DutyCycThermProtnAbsltTTqSlewHiLim
    connect CalRegn01IninOptSetA02.DutyCycThermProtnAbsltTTqSlewLoLim -> AAACalRegn01IninOptSetA02_Dummy.DutyCycThermProtnAbsltTTqSlewLoLim
    connect CalRegn01IninOptSetA02.DutyCycThermProtnCtrlT -> AAACalRegn01IninOptSetA02_Dummy.DutyCycThermProtnCtrlT
    connect CalRegn01IninOptSetA02.DutyCycThermProtnCtrlTSeln -> AAACalRegn01IninOptSetA02_Dummy.DutyCycThermProtnCtrlTSeln
    connect CalRegn01IninOptSetA02.DutyCycThermProtnDutyCycFildThd -> AAACalRegn01IninOptSetA02_Dummy.DutyCycThermProtnDutyCycFildThd
    connect CalRegn01IninOptSetA02.DutyCycThermProtnIgnOffCtrlEna -> AAACalRegn01IninOptSetA02_Dummy.DutyCycThermProtnIgnOffCtrlEna
    connect CalRegn01IninOptSetA02.DutyCycThermProtnIgnOffMsgWaitTi -> AAACalRegn01IninOptSetA02_Dummy.DutyCycThermProtnIgnOffMsgWaitTi
    connect CalRegn01IninOptSetA02.DutyCycThermProtnLstTblValNonStall -> AAACalRegn01IninOptSetA02_Dummy.DutyCycThermProtnLstTblValNonStall
    connect CalRegn01IninOptSetA02.DutyCycThermProtnLstTblValStall -> AAACalRegn01IninOptSetA02_Dummy.DutyCycThermProtnLstTblValStall
    connect CalRegn01IninOptSetA02.DutyCycThermProtnMotPrTSeln -> AAACalRegn01IninOptSetA02_Dummy.DutyCycThermProtnMotPrTSeln
    connect CalRegn01IninOptSetA02.DutyCycThermProtnMplr1FetMtgtnNonStallTblY -> AAACalRegn01IninOptSetA02_Dummy.DutyCycThermProtnMplr1FetMtgtnNonStallTblY
    connect CalRegn01IninOptSetA02.DutyCycThermProtnMplr1FetMtgtnStallTblY -> AAACalRegn01IninOptSetA02_Dummy.DutyCycThermProtnMplr1FetMtgtnStallTblY
    connect CalRegn01IninOptSetA02.DutyCycThermProtnMplr1NonStallTblY -> AAACalRegn01IninOptSetA02_Dummy.DutyCycThermProtnMplr1NonStallTblY
    connect CalRegn01IninOptSetA02.DutyCycThermProtnMplr1StallTblY -> AAACalRegn01IninOptSetA02_Dummy.DutyCycThermProtnMplr1StallTblY
    connect CalRegn01IninOptSetA02.DutyCycThermProtnMplr2FetMtgtnNonStallTblY -> AAACalRegn01IninOptSetA02_Dummy.DutyCycThermProtnMplr2FetMtgtnNonStallTblY
    connect CalRegn01IninOptSetA02.DutyCycThermProtnMplr2FetMtgtnStallTblY -> AAACalRegn01IninOptSetA02_Dummy.DutyCycThermProtnMplr2FetMtgtnStallTblY
    connect CalRegn01IninOptSetA02.DutyCycThermProtnMplr2NonStallTblY -> AAACalRegn01IninOptSetA02_Dummy.DutyCycThermProtnMplr2NonStallTblY
    connect CalRegn01IninOptSetA02.DutyCycThermProtnMplr2StallTblY -> AAACalRegn01IninOptSetA02_Dummy.DutyCycThermProtnMplr2StallTblY
    connect CalRegn01IninOptSetA02.DutyCycThermProtnMplr3FetMtgtnNonStallTblY -> AAACalRegn01IninOptSetA02_Dummy.DutyCycThermProtnMplr3FetMtgtnNonStallTblY
    connect CalRegn01IninOptSetA02.DutyCycThermProtnMplr3FetMtgtnStallTblY -> AAACalRegn01IninOptSetA02_Dummy.DutyCycThermProtnMplr3FetMtgtnStallTblY
    connect CalRegn01IninOptSetA02.DutyCycThermProtnMplr3NonStallTblY -> AAACalRegn01IninOptSetA02_Dummy.DutyCycThermProtnMplr3NonStallTblY
    connect CalRegn01IninOptSetA02.DutyCycThermProtnMplr3StallTblY -> AAACalRegn01IninOptSetA02_Dummy.DutyCycThermProtnMplr3StallTblY
    connect CalRegn01IninOptSetA02.DutyCycThermProtnMplr4FetMtgtnNonStallTblY -> AAACalRegn01IninOptSetA02_Dummy.DutyCycThermProtnMplr4FetMtgtnNonStallTblY
    connect CalRegn01IninOptSetA02.DutyCycThermProtnMplr4FetMtgtnStallTblY -> AAACalRegn01IninOptSetA02_Dummy.DutyCycThermProtnMplr4FetMtgtnStallTblY
    connect CalRegn01IninOptSetA02.DutyCycThermProtnMplr4NonStallTblY -> AAACalRegn01IninOptSetA02_Dummy.DutyCycThermProtnMplr4NonStallTblY
    connect CalRegn01IninOptSetA02.DutyCycThermProtnMplr4StallTblY -> AAACalRegn01IninOptSetA02_Dummy.DutyCycThermProtnMplr4StallTblY
    connect CalRegn01IninOptSetA02.DutyCycThermProtnMplr5FetMtgtnNonStallTblY -> AAACalRegn01IninOptSetA02_Dummy.DutyCycThermProtnMplr5FetMtgtnNonStallTblY
    connect CalRegn01IninOptSetA02.DutyCycThermProtnMplr5FetMtgtnStallTblY -> AAACalRegn01IninOptSetA02_Dummy.DutyCycThermProtnMplr5FetMtgtnStallTblY
    connect CalRegn01IninOptSetA02.DutyCycThermProtnMplr5NonStallTblY -> AAACalRegn01IninOptSetA02_Dummy.DutyCycThermProtnMplr5NonStallTblY
    connect CalRegn01IninOptSetA02.DutyCycThermProtnMplr5StallTblY -> AAACalRegn01IninOptSetA02_Dummy.DutyCycThermProtnMplr5StallTblY
    connect CalRegn01IninOptSetA02.DutyCycThermProtnMplr6FetMtgtnNonStallTblY -> AAACalRegn01IninOptSetA02_Dummy.DutyCycThermProtnMplr6FetMtgtnNonStallTblY
    connect CalRegn01IninOptSetA02.DutyCycThermProtnMplr6FetMtgtnStallTblY -> AAACalRegn01IninOptSetA02_Dummy.DutyCycThermProtnMplr6FetMtgtnStallTblY
    connect CalRegn01IninOptSetA02.DutyCycThermProtnMplr6NonStallTblY -> AAACalRegn01IninOptSetA02_Dummy.DutyCycThermProtnMplr6NonStallTblY
    connect CalRegn01IninOptSetA02.DutyCycThermProtnMplr6StallTblY -> AAACalRegn01IninOptSetA02_Dummy.DutyCycThermProtnMplr6StallTblY
    connect CalRegn01IninOptSetA02.DutyCycThermProtnMplrFetMtgtnTblX -> AAACalRegn01IninOptSetA02_Dummy.DutyCycThermProtnMplrFetMtgtnTblX
    connect CalRegn01IninOptSetA02.DutyCycThermProtnMplrTblX -> AAACalRegn01IninOptSetA02_Dummy.DutyCycThermProtnMplrTblX
    connect CalRegn01IninOptSetA02.DutyCycThermProtnMplrTSeln -> AAACalRegn01IninOptSetA02_Dummy.DutyCycThermProtnMplrTSeln
    connect CalRegn01IninOptSetA02.DutyCycThermProtnSlowFilTSeln -> AAACalRegn01IninOptSetA02_Dummy.DutyCycThermProtnSlowFilTSeln
    connect CalRegn01IninOptSetA02.DutyCycThermProtnThermLimScaFac -> AAACalRegn01IninOptSetA02_Dummy.DutyCycThermProtnThermLimScaFac
    connect CalRegn01IninOptSetA02.DutyCycThermProtnThermLoadLimTblX -> AAACalRegn01IninOptSetA02_Dummy.DutyCycThermProtnThermLoadLimTblX
    connect CalRegn01IninOptSetA02.DutyCycThermProtnThermLoadLimTblY -> AAACalRegn01IninOptSetA02_Dummy.DutyCycThermProtnThermLoadLimTblY
    connect CalRegn01IninOptSetA02.DutyCycThermProtnTqCmdSlewDwn -> AAACalRegn01IninOptSetA02_Dummy.DutyCycThermProtnTqCmdSlewDwn
    connect CalRegn01IninOptSetA02.DutyCycThermProtnTqCmdSlewUp -> AAACalRegn01IninOptSetA02_Dummy.DutyCycThermProtnTqCmdSlewUp
    connect CalRegn01IninOptSetA02.HiLoadStallLimrMotVelMgnThd -> AAACalRegn01IninOptSetA02_Dummy.HiLoadStallLimrMotVelMgnThd
    connect CalRegn01IninOptSetA02.HiLoadStallLimrStallMotTqCmdFetMtgtnLimX -> AAACalRegn01IninOptSetA02_Dummy.HiLoadStallLimrStallMotTqCmdFetMtgtnLimX
    connect CalRegn01IninOptSetA02.HiLoadStallLimrStallMotTqCmdFetMtgtnLimY -> AAACalRegn01IninOptSetA02_Dummy.HiLoadStallLimrStallMotTqCmdFetMtgtnLimY
    connect CalRegn01IninOptSetA02.HiLoadStallLimrStallMotTqCmdLimX -> AAACalRegn01IninOptSetA02_Dummy.HiLoadStallLimrStallMotTqCmdLimX
    connect CalRegn01IninOptSetA02.HiLoadStallLimrStallMotTqCmdLimY -> AAACalRegn01IninOptSetA02_Dummy.HiLoadStallLimrStallMotTqCmdLimY
    connect CalRegn01IninOptSetA02.HiLoadStallLimrStallMotTqLimSlewRate -> AAACalRegn01IninOptSetA02_Dummy.HiLoadStallLimrStallMotTqLimSlewRate
    connect CalRegn01IninOptSetA02.HiLoadStallLimrStallThermLimSca -> AAACalRegn01IninOptSetA02_Dummy.HiLoadStallLimrStallThermLimSca
    connect CalRegn01IninOptSetA02.LrndRackCentrMotTqThd -> AAACalRegn01IninOptSetA02_Dummy.LrndRackCentrMotTqThd
    connect CalRegn01IninOptSetA02.LrndRackCentrMotVelThd -> AAACalRegn01IninOptSetA02_Dummy.LrndRackCentrMotVelThd
    connect CalRegn01IninOptSetA02.MotCtrlPrmEstimnFetRNom -> AAACalRegn01IninOptSetA02_Dummy.MotCtrlPrmEstimnFetRNom
    connect CalRegn01IninOptSetA02.MotCtrlPrmEstimnMotBackEmfConHiLim -> AAACalRegn01IninOptSetA02_Dummy.MotCtrlPrmEstimnMotBackEmfConHiLim
    connect CalRegn01IninOptSetA02.MotCtrlPrmEstimnMotBackEmfConLoLim -> AAACalRegn01IninOptSetA02_Dummy.MotCtrlPrmEstimnMotBackEmfConLoLim
    connect CalRegn01IninOptSetA02.MotCtrlPrmEstimnMotBackEmfConNom -> AAACalRegn01IninOptSetA02_Dummy.MotCtrlPrmEstimnMotBackEmfConNom
    connect CalRegn01IninOptSetA02.MotCtrlPrmEstimnMotBackEmfConSatnScaIvtrLoaMtgtn -> AAACalRegn01IninOptSetA02_Dummy.MotCtrlPrmEstimnMotBackEmfConSatnScaIvtrLoaMtgtn
    connect CalRegn01IninOptSetA02.MotCtrlPrmEstimnMotBackEmfConSatnX -> AAACalRegn01IninOptSetA02_Dummy.MotCtrlPrmEstimnMotBackEmfConSatnX
    connect CalRegn01IninOptSetA02.MotCtrlPrmEstimnMotBackEmfConSatnY -> AAACalRegn01IninOptSetA02_Dummy.MotCtrlPrmEstimnMotBackEmfConSatnY
    connect CalRegn01IninOptSetA02.MotCtrlPrmEstimnMotCurrDaxInduSatnBilnrSeln -> AAACalRegn01IninOptSetA02_Dummy.MotCtrlPrmEstimnMotCurrDaxInduSatnBilnrSeln
    connect CalRegn01IninOptSetA02.MotCtrlPrmEstimnMotCurrQaxInduSatnX -> AAACalRegn01IninOptSetA02_Dummy.MotCtrlPrmEstimnMotCurrQaxInduSatnX
    connect CalRegn01IninOptSetA02.MotCtrlPrmEstimnMotInduDaxHiLim -> AAACalRegn01IninOptSetA02_Dummy.MotCtrlPrmEstimnMotInduDaxHiLim
    connect CalRegn01IninOptSetA02.MotCtrlPrmEstimnMotInduDaxIvtrLoaMtgtn -> AAACalRegn01IninOptSetA02_Dummy.MotCtrlPrmEstimnMotInduDaxIvtrLoaMtgtn
    connect CalRegn01IninOptSetA02.MotCtrlPrmEstimnMotInduDaxLoLim -> AAACalRegn01IninOptSetA02_Dummy.MotCtrlPrmEstimnMotInduDaxLoLim
    connect CalRegn01IninOptSetA02.MotCtrlPrmEstimnMotInduDaxNom -> AAACalRegn01IninOptSetA02_Dummy.MotCtrlPrmEstimnMotInduDaxNom
    connect CalRegn01IninOptSetA02.MotCtrlPrmEstimnMotInduDaxSatnScaY -> AAACalRegn01IninOptSetA02_Dummy.MotCtrlPrmEstimnMotInduDaxSatnScaY
    connect CalRegn01IninOptSetA02.MotCtrlPrmEstimnMotInduQaxHiLim -> AAACalRegn01IninOptSetA02_Dummy.MotCtrlPrmEstimnMotInduQaxHiLim
    connect CalRegn01IninOptSetA02.MotCtrlPrmEstimnMotInduQaxIvtrLoaMtgtn -> AAACalRegn01IninOptSetA02_Dummy.MotCtrlPrmEstimnMotInduQaxIvtrLoaMtgtn
    connect CalRegn01IninOptSetA02.MotCtrlPrmEstimnMotInduQaxLoLim -> AAACalRegn01IninOptSetA02_Dummy.MotCtrlPrmEstimnMotInduQaxLoLim
    connect CalRegn01IninOptSetA02.MotCtrlPrmEstimnMotInduQaxNom -> AAACalRegn01IninOptSetA02_Dummy.MotCtrlPrmEstimnMotInduQaxNom
    connect CalRegn01IninOptSetA02.MotCtrlPrmEstimnMotInduQaxSatnScaY -> AAACalRegn01IninOptSetA02_Dummy.MotCtrlPrmEstimnMotInduQaxSatnScaY
    connect CalRegn01IninOptSetA02.MotCtrlPrmEstimnMotRHiLim -> AAACalRegn01IninOptSetA02_Dummy.MotCtrlPrmEstimnMotRHiLim
    connect CalRegn01IninOptSetA02.MotCtrlPrmEstimnMotRLoLim -> AAACalRegn01IninOptSetA02_Dummy.MotCtrlPrmEstimnMotRLoLim
    connect CalRegn01IninOptSetA02.MotCtrlPrmEstimnMotRNom -> AAACalRegn01IninOptSetA02_Dummy.MotCtrlPrmEstimnMotRNom
    connect CalRegn01IninOptSetA02.MotCtrlPrmEstimnMotWidgThermCoeff -> AAACalRegn01IninOptSetA02_Dummy.MotCtrlPrmEstimnMotWidgThermCoeff
    connect CalRegn01IninOptSetA02.MotCtrlPrmEstimnTNom -> AAACalRegn01IninOptSetA02_Dummy.MotCtrlPrmEstimnTNom
    connect CalRegn01IninOptSetA02.MotCurrPeakEstimnCurrFilFrq -> AAACalRegn01IninOptSetA02_Dummy.MotCurrPeakEstimnCurrFilFrq
    connect CalRegn01IninOptSetA02.MotCurrPeakEstimnCurrPeakEstimdFilFrq -> AAACalRegn01IninOptSetA02_Dummy.MotCurrPeakEstimnCurrPeakEstimdFilFrq
    connect CalRegn01IninOptSetA02.MotCurrRegCfgMotClsdLoopBwDaxY -> AAACalRegn01IninOptSetA02_Dummy.MotCurrRegCfgMotClsdLoopBwDaxY
    connect CalRegn01IninOptSetA02.MotCurrRegCfgMotClsdLoopBwQaxY -> AAACalRegn01IninOptSetA02_Dummy.MotCurrRegCfgMotClsdLoopBwQaxY
    connect CalRegn01IninOptSetA02.MotCurrRegCfgMotDampgRatDax -> AAACalRegn01IninOptSetA02_Dummy.MotCurrRegCfgMotDampgRatDax
    connect CalRegn01IninOptSetA02.MotCurrRegCfgMotDampgRatQax -> AAACalRegn01IninOptSetA02_Dummy.MotCurrRegCfgMotDampgRatQax
    connect CalRegn01IninOptSetA02.MotCurrRegCfgMotNatFrqDaxY -> AAACalRegn01IninOptSetA02_Dummy.MotCurrRegCfgMotNatFrqDaxY
    connect CalRegn01IninOptSetA02.MotCurrRegCfgMotNatFrqQaxY -> AAACalRegn01IninOptSetA02_Dummy.MotCurrRegCfgMotNatFrqQaxY
    connect CalRegn01IninOptSetA02.MotCurrRegCfgMotRVirtDax -> AAACalRegn01IninOptSetA02_Dummy.MotCurrRegCfgMotRVirtDax
    connect CalRegn01IninOptSetA02.MotCurrRegCfgMotRVirtQax -> AAACalRegn01IninOptSetA02_Dummy.MotCurrRegCfgMotRVirtQax
    connect CalRegn01IninOptSetA02.MotCurrRegCfgMotVelFilFrq -> AAACalRegn01IninOptSetA02_Dummy.MotCurrRegCfgMotVelFilFrq
    connect CalRegn01IninOptSetA02.MotCurrRegVltgLimrCurrLoaScarSlewRate -> AAACalRegn01IninOptSetA02_Dummy.MotCurrRegVltgLimrCurrLoaScarSlewRate
    connect CalRegn01IninOptSetA02.MotCurrRegVltgLimrDaxAntiWdupCoeff -> AAACalRegn01IninOptSetA02_Dummy.MotCurrRegVltgLimrDaxAntiWdupCoeff
    connect CalRegn01IninOptSetA02.MotCurrRegVltgLimrDualEcuLoaScarSlewRate -> AAACalRegn01IninOptSetA02_Dummy.MotCurrRegVltgLimrDualEcuLoaScarSlewRate
    connect CalRegn01IninOptSetA02.MotCurrRegVltgLimrFETLoaScarSlewRate -> AAACalRegn01IninOptSetA02_Dummy.MotCurrRegVltgLimrFETLoaScarSlewRate
    connect CalRegn01IninOptSetA02.MotCurrRegVltgLimrIvtrLoaScarSlewRate -> AAACalRegn01IninOptSetA02_Dummy.MotCurrRegVltgLimrIvtrLoaScarSlewRate
    connect CalRegn01IninOptSetA02.MotCurrRegVltgLimrMotVltgBrdgLpFilFrq -> AAACalRegn01IninOptSetA02_Dummy.MotCurrRegVltgLimrMotVltgBrdgLpFilFrq
    connect CalRegn01IninOptSetA02.MotCurrRegVltgLimrMotVltgDaxIntglHiLim -> AAACalRegn01IninOptSetA02_Dummy.MotCurrRegVltgLimrMotVltgDaxIntglHiLim
    connect CalRegn01IninOptSetA02.MotCurrRegVltgLimrMotVltgDaxIntglLoLim -> AAACalRegn01IninOptSetA02_Dummy.MotCurrRegVltgLimrMotVltgDaxIntglLoLim
    connect CalRegn01IninOptSetA02.MotCurrRegVltgLimrMotVltgQaxFfLpFilFrq -> AAACalRegn01IninOptSetA02_Dummy.MotCurrRegVltgLimrMotVltgQaxFfLpFilFrq
    connect CalRegn01IninOptSetA02.MotCurrRegVltgLimrMotVltgQaxIntglHiLim -> AAACalRegn01IninOptSetA02_Dummy.MotCurrRegVltgLimrMotVltgQaxIntglHiLim
    connect CalRegn01IninOptSetA02.MotCurrRegVltgLimrMotVltgQaxIntglLoLim -> AAACalRegn01IninOptSetA02_Dummy.MotCurrRegVltgLimrMotVltgQaxIntglLoLim
    connect CalRegn01IninOptSetA02.MotCurrRegVltgLimrQaxAntiWdupCoeff -> AAACalRegn01IninOptSetA02_Dummy.MotCurrRegVltgLimrQaxAntiWdupCoeff
    connect CalRegn01IninOptSetA02.MotCurrRegVltgLimrQaxAntiWdupScagDi -> AAACalRegn01IninOptSetA02_Dummy.MotCurrRegVltgLimrQaxAntiWdupScagDi
    connect CalRegn01IninOptSetA02.MotRefMdlCurrDaxBoostGain -> AAACalRegn01IninOptSetA02_Dummy.MotRefMdlCurrDaxBoostGain
    connect CalRegn01IninOptSetA02.MotRefMdlCurrDaxBoostTqScaX -> AAACalRegn01IninOptSetA02_Dummy.MotRefMdlCurrDaxBoostTqScaX
    connect CalRegn01IninOptSetA02.MotRefMdlCurrDaxBoostTqScaY -> AAACalRegn01IninOptSetA02_Dummy.MotRefMdlCurrDaxBoostTqScaY
    connect CalRegn01IninOptSetA02.MotRefMdlCurrDaxQaxRefDelta -> AAACalRegn01IninOptSetA02_Dummy.MotRefMdlCurrDaxQaxRefDelta
    connect CalRegn01IninOptSetA02.MotRefMdlCurrItrnTolr -> AAACalRegn01IninOptSetA02_Dummy.MotRefMdlCurrItrnTolr
    connect CalRegn01IninOptSetA02.MotRefMdlMotCurrDaxMaxSca -> AAACalRegn01IninOptSetA02_Dummy.MotRefMdlMotCurrDaxMaxSca
    connect CalRegn01IninOptSetA02.MotRefMdlQuad13VltgSdlX -> AAACalRegn01IninOptSetA02_Dummy.MotRefMdlQuad13VltgSdlX
    connect CalRegn01IninOptSetA02.MotRefMdlQuad13VltgSdlY -> AAACalRegn01IninOptSetA02_Dummy.MotRefMdlQuad13VltgSdlY
    connect CalRegn01IninOptSetA02.MotRefMdlQuad24VltgSdlX -> AAACalRegn01IninOptSetA02_Dummy.MotRefMdlQuad24VltgSdlX
    connect CalRegn01IninOptSetA02.MotRefMdlQuad24VltgSdlY -> AAACalRegn01IninOptSetA02_Dummy.MotRefMdlQuad24VltgSdlY
    connect CalRegn01IninOptSetA02.MotRefMdlVltgOverRThdSca -> AAACalRegn01IninOptSetA02_Dummy.MotRefMdlVltgOverRThdSca
    connect CalRegn01IninOptSetA02.MotTqTranlDampgCmdLim -> AAACalRegn01IninOptSetA02_Dummy.MotTqTranlDampgCmdLim
    connect CalRegn01IninOptSetA02.MotTqTranlDampgVelThd -> AAACalRegn01IninOptSetA02_Dummy.MotTqTranlDampgVelThd
    connect CalRegn01IninOptSetA02.PwrLimrAssiRednLpFilFrq -> AAACalRegn01IninOptSetA02_Dummy.PwrLimrAssiRednLpFilFrq
    connect CalRegn01IninOptSetA02.PwrLimrBackEmfConStdT -> AAACalRegn01IninOptSetA02_Dummy.PwrLimrBackEmfConStdT
    connect CalRegn01IninOptSetA02.PwrLimrBrdgVltgAdjSlew -> AAACalRegn01IninOptSetA02_Dummy.PwrLimrBrdgVltgAdjSlew
    connect CalRegn01IninOptSetA02.PwrLimrBrdgVltgAltFltAdj -> AAACalRegn01IninOptSetA02_Dummy.PwrLimrBrdgVltgAltFltAdj
    connect CalRegn01IninOptSetA02.PwrLimrFilAssiRednThd -> AAACalRegn01IninOptSetA02_Dummy.PwrLimrFilAssiRednThd
    connect CalRegn01IninOptSetA02.PwrLimrLoVoltAssiRcvrThd -> AAACalRegn01IninOptSetA02_Dummy.PwrLimrLoVoltAssiRcvrThd
    connect CalRegn01IninOptSetA02.PwrLimrLoVoltAssiRcvrTi -> AAACalRegn01IninOptSetA02_Dummy.PwrLimrLoVoltAssiRcvrTi
    connect CalRegn01IninOptSetA02.PwrLimrMotEnvlpX -> AAACalRegn01IninOptSetA02_Dummy.PwrLimrMotEnvlpX
    connect CalRegn01IninOptSetA02.PwrLimrMotEnvlpY -> AAACalRegn01IninOptSetA02_Dummy.PwrLimrMotEnvlpY
    connect CalRegn01IninOptSetA02.PwrLimrMotVelLpFilFrq -> AAACalRegn01IninOptSetA02_Dummy.PwrLimrMotVelLpFilFrq
    connect CalRegn01IninOptSetA02.PwrLimrSpdAdjSlewDec -> AAACalRegn01IninOptSetA02_Dummy.PwrLimrSpdAdjSlewDec
    connect CalRegn01IninOptSetA02.PwrLimrSpdAdjSlewEna -> AAACalRegn01IninOptSetA02_Dummy.PwrLimrSpdAdjSlewEna
    connect CalRegn01IninOptSetA02.PwrLimrSpdAdjSlewInc -> AAACalRegn01IninOptSetA02_Dummy.PwrLimrSpdAdjSlewInc
    connect CalRegn01IninOptSetA02.PwrLimrStdOperMotEnvlpX -> AAACalRegn01IninOptSetA02_Dummy.PwrLimrStdOperMotEnvlpX
    connect CalRegn01IninOptSetA02.PwrLimrStdOperMotEnvlpY -> AAACalRegn01IninOptSetA02_Dummy.PwrLimrStdOperMotEnvlpY
    connect CalRegn01IninOptSetA02.PwrLimrVltgDptMotVelOffsX -> AAACalRegn01IninOptSetA02_Dummy.PwrLimrVltgDptMotVelOffsX
    connect CalRegn01IninOptSetA02.PwrLimrVltgDptMotVelOffsY -> AAACalRegn01IninOptSetA02_Dummy.PwrLimrVltgDptMotVelOffsY
    connect CalRegn01IninOptSetA02.SysGlbPrmSysTqRat -> AAACalRegn01IninOptSetA02_Dummy.SysGlbPrmSysTqRat
    connect CalRegn01IninOptSetA02.TEstimnAmbPwrMplr -> AAACalRegn01IninOptSetA02_Dummy.TEstimnAmbPwrMplr
    connect CalRegn01IninOptSetA02.TEstimnAmbTSca -> AAACalRegn01IninOptSetA02_Dummy.TEstimnAmbTSca
    connect CalRegn01IninOptSetA02.TEstimnAssiMechAmbLpFilFrq -> AAACalRegn01IninOptSetA02_Dummy.TEstimnAssiMechAmbLpFilFrq
    connect CalRegn01IninOptSetA02.TEstimnAssiMechAmbLpFilFrqDualEcuFltMtgtn -> AAACalRegn01IninOptSetA02_Dummy.TEstimnAssiMechAmbLpFilFrqDualEcuFltMtgtn
    connect CalRegn01IninOptSetA02.TEstimnAssiMechAmbLpFilFrqFetMtgtnEna -> AAACalRegn01IninOptSetA02_Dummy.TEstimnAssiMechAmbLpFilFrqFetMtgtnEna
    connect CalRegn01IninOptSetA02.TEstimnAssiMechAmbMplr -> AAACalRegn01IninOptSetA02_Dummy.TEstimnAssiMechAmbMplr
    connect CalRegn01IninOptSetA02.TEstimnAssiMechCorrLim -> AAACalRegn01IninOptSetA02_Dummy.TEstimnAssiMechCorrLim
    connect CalRegn01IninOptSetA02.TEstimnAssiMechDampgSca -> AAACalRegn01IninOptSetA02_Dummy.TEstimnAssiMechDampgSca
    connect CalRegn01IninOptSetA02.TEstimnAssiMechDftT -> AAACalRegn01IninOptSetA02_Dummy.TEstimnAssiMechDftT
    connect CalRegn01IninOptSetA02.TEstimnAssiMechLLFilCoeffA1 -> AAACalRegn01IninOptSetA02_Dummy.TEstimnAssiMechLLFilCoeffA1
    connect CalRegn01IninOptSetA02.TEstimnAssiMechLLFilCoeffB0 -> AAACalRegn01IninOptSetA02_Dummy.TEstimnAssiMechLLFilCoeffB0
    connect CalRegn01IninOptSetA02.TEstimnAssiMechLLFilCoeffB1 -> AAACalRegn01IninOptSetA02_Dummy.TEstimnAssiMechLLFilCoeffB1
    connect CalRegn01IninOptSetA02.TEstimnAssiMechSlew -> AAACalRegn01IninOptSetA02_Dummy.TEstimnAssiMechSlew
    connect CalRegn01IninOptSetA02.TEstimnCorrnTAssiMech -> AAACalRegn01IninOptSetA02_Dummy.TEstimnCorrnTAssiMech
    connect CalRegn01IninOptSetA02.TEstimnCorrnTCu -> AAACalRegn01IninOptSetA02_Dummy.TEstimnCorrnTCu
    connect CalRegn01IninOptSetA02.TEstimnCorrnTMag -> AAACalRegn01IninOptSetA02_Dummy.TEstimnCorrnTMag
    connect CalRegn01IninOptSetA02.TEstimnCorrnTSi -> AAACalRegn01IninOptSetA02_Dummy.TEstimnCorrnTSi
    connect CalRegn01IninOptSetA02.TEstimnCuAmbLpFilFrq -> AAACalRegn01IninOptSetA02_Dummy.TEstimnCuAmbLpFilFrq
    connect CalRegn01IninOptSetA02.TEstimnCuAmbLpFilFrqDualEcuFltMtgtn -> AAACalRegn01IninOptSetA02_Dummy.TEstimnCuAmbLpFilFrqDualEcuFltMtgtn
    connect CalRegn01IninOptSetA02.TEstimnCuAmbLpFilFrqFetMtgtnEna -> AAACalRegn01IninOptSetA02_Dummy.TEstimnCuAmbLpFilFrqFetMtgtnEna
    connect CalRegn01IninOptSetA02.TEstimnCuAmbMplr -> AAACalRegn01IninOptSetA02_Dummy.TEstimnCuAmbMplr
    connect CalRegn01IninOptSetA02.TEstimnCuCorrnLim -> AAACalRegn01IninOptSetA02_Dummy.TEstimnCuCorrnLim
    connect CalRegn01IninOptSetA02.TEstimnCuLLFilCoeffA1 -> AAACalRegn01IninOptSetA02_Dummy.TEstimnCuLLFilCoeffA1
    connect CalRegn01IninOptSetA02.TEstimnCuLLFilCoeffB0 -> AAACalRegn01IninOptSetA02_Dummy.TEstimnCuLLFilCoeffB0
    connect CalRegn01IninOptSetA02.TEstimnCuLLFilCoeffB1 -> AAACalRegn01IninOptSetA02_Dummy.TEstimnCuLLFilCoeffB1
    connect CalRegn01IninOptSetA02.TEstimnEngTSca -> AAACalRegn01IninOptSetA02_Dummy.TEstimnEngTSca
    connect CalRegn01IninOptSetA02.TEstimnMagAmbLpFilFrq -> AAACalRegn01IninOptSetA02_Dummy.TEstimnMagAmbLpFilFrq
    connect CalRegn01IninOptSetA02.TEstimnMagAmbLpFilFrqDualEcuFltMtgtn -> AAACalRegn01IninOptSetA02_Dummy.TEstimnMagAmbLpFilFrqDualEcuFltMtgtn
    connect CalRegn01IninOptSetA02.TEstimnMagAmbLpFilFrqFetMtgtnEna -> AAACalRegn01IninOptSetA02_Dummy.TEstimnMagAmbLpFilFrqFetMtgtnEna
    connect CalRegn01IninOptSetA02.TEstimnMagAmbMplr -> AAACalRegn01IninOptSetA02_Dummy.TEstimnMagAmbMplr
    connect CalRegn01IninOptSetA02.TEstimnMagCorrnLim -> AAACalRegn01IninOptSetA02_Dummy.TEstimnMagCorrnLim
    connect CalRegn01IninOptSetA02.TEstimnMagLLFilCoeffA1 -> AAACalRegn01IninOptSetA02_Dummy.TEstimnMagLLFilCoeffA1
    connect CalRegn01IninOptSetA02.TEstimnMagLLFilCoeffB0 -> AAACalRegn01IninOptSetA02_Dummy.TEstimnMagLLFilCoeffB0
    connect CalRegn01IninOptSetA02.TEstimnMagLLFilCoeffB1 -> AAACalRegn01IninOptSetA02_Dummy.TEstimnMagLLFilCoeffB1
    connect CalRegn01IninOptSetA02.TEstimnSiAmbLpFilFrq -> AAACalRegn01IninOptSetA02_Dummy.TEstimnSiAmbLpFilFrq
    connect CalRegn01IninOptSetA02.TEstimnSiAmbLpFilFrqDualEcuFltMtgtn -> AAACalRegn01IninOptSetA02_Dummy.TEstimnSiAmbLpFilFrqDualEcuFltMtgtn
    connect CalRegn01IninOptSetA02.TEstimnSiAmbLpFilFrqFetMtgtnEna -> AAACalRegn01IninOptSetA02_Dummy.TEstimnSiAmbLpFilFrqFetMtgtnEna
    connect CalRegn01IninOptSetA02.TEstimnSiAmbMplr -> AAACalRegn01IninOptSetA02_Dummy.TEstimnSiAmbMplr
    connect CalRegn01IninOptSetA02.TEstimnSiCorrnLim -> AAACalRegn01IninOptSetA02_Dummy.TEstimnSiCorrnLim
    connect CalRegn01IninOptSetA02.TEstimnSiLLFilCoeffA1 -> AAACalRegn01IninOptSetA02_Dummy.TEstimnSiLLFilCoeffA1
    connect CalRegn01IninOptSetA02.TEstimnSiLLFilCoeffB0 -> AAACalRegn01IninOptSetA02_Dummy.TEstimnSiLLFilCoeffB0
    connect CalRegn01IninOptSetA02.TEstimnSiLLFilCoeffB1 -> AAACalRegn01IninOptSetA02_Dummy.TEstimnSiLLFilCoeffB1
    connect CalRegn01IninOptSetA02.TEstimnTauAssiMech -> AAACalRegn01IninOptSetA02_Dummy.TEstimnTauAssiMech
    connect CalRegn01IninOptSetA02.TEstimnTauCu -> AAACalRegn01IninOptSetA02_Dummy.TEstimnTauCu
    connect CalRegn01IninOptSetA02.TEstimnTauMag -> AAACalRegn01IninOptSetA02_Dummy.TEstimnTauMag
    connect CalRegn01IninOptSetA02.TEstimnTauSi -> AAACalRegn01IninOptSetA02_Dummy.TEstimnTauSi
    connect CalRegn01IninOptSetA02.TEstimnWghtAvrgTDi -> AAACalRegn01IninOptSetA02_Dummy.TEstimnWghtAvrgTDi
    connect CalRegn01IninOptSetA02.VehSpdLimrPosMaxOffs2 -> AAACalRegn01IninOptSetA02_Dummy.VehSpdLimrPosMaxOffs2
    connect CalRegn01IninOptSetA03.DutyCycThermProtnAbsltCtrlTFetMtgtnTblX -> AAACalRegn01IninOptSetA03_Dummy.DutyCycThermProtnAbsltCtrlTFetMtgtnTblX
    connect CalRegn01IninOptSetA03.DutyCycThermProtnAbsltCtrlTTblX -> AAACalRegn01IninOptSetA03_Dummy.DutyCycThermProtnAbsltCtrlTTblX
    connect CalRegn01IninOptSetA03.DutyCycThermProtnAbsltCtrlTTqFetMtgtnTblY -> AAACalRegn01IninOptSetA03_Dummy.DutyCycThermProtnAbsltCtrlTTqFetMtgtnTblY
    connect CalRegn01IninOptSetA03.DutyCycThermProtnAbsltCtrlTTqTblY -> AAACalRegn01IninOptSetA03_Dummy.DutyCycThermProtnAbsltCtrlTTqTblY
    connect CalRegn01IninOptSetA03.DutyCycThermProtnAbsltCuTFetMtgtnTblX -> AAACalRegn01IninOptSetA03_Dummy.DutyCycThermProtnAbsltCuTFetMtgtnTblX
    connect CalRegn01IninOptSetA03.DutyCycThermProtnAbsltCuTTblX -> AAACalRegn01IninOptSetA03_Dummy.DutyCycThermProtnAbsltCuTTblX
    connect CalRegn01IninOptSetA03.DutyCycThermProtnAbsltCuTTqFetMtgtnTblY -> AAACalRegn01IninOptSetA03_Dummy.DutyCycThermProtnAbsltCuTTqFetMtgtnTblY
    connect CalRegn01IninOptSetA03.DutyCycThermProtnAbsltCuTTqTblY -> AAACalRegn01IninOptSetA03_Dummy.DutyCycThermProtnAbsltCuTTqTblY
    connect CalRegn01IninOptSetA03.DutyCycThermProtnAbsltMotVelBreakPt -> AAACalRegn01IninOptSetA03_Dummy.DutyCycThermProtnAbsltMotVelBreakPt
    connect CalRegn01IninOptSetA03.DutyCycThermProtnAbsltTTqSlewHiLim -> AAACalRegn01IninOptSetA03_Dummy.DutyCycThermProtnAbsltTTqSlewHiLim
    connect CalRegn01IninOptSetA03.DutyCycThermProtnAbsltTTqSlewLoLim -> AAACalRegn01IninOptSetA03_Dummy.DutyCycThermProtnAbsltTTqSlewLoLim
    connect CalRegn01IninOptSetA03.DutyCycThermProtnCtrlT -> AAACalRegn01IninOptSetA03_Dummy.DutyCycThermProtnCtrlT
    connect CalRegn01IninOptSetA03.DutyCycThermProtnCtrlTSeln -> AAACalRegn01IninOptSetA03_Dummy.DutyCycThermProtnCtrlTSeln
    connect CalRegn01IninOptSetA03.DutyCycThermProtnDutyCycFildThd -> AAACalRegn01IninOptSetA03_Dummy.DutyCycThermProtnDutyCycFildThd
    connect CalRegn01IninOptSetA03.DutyCycThermProtnIgnOffCtrlEna -> AAACalRegn01IninOptSetA03_Dummy.DutyCycThermProtnIgnOffCtrlEna
    connect CalRegn01IninOptSetA03.DutyCycThermProtnIgnOffMsgWaitTi -> AAACalRegn01IninOptSetA03_Dummy.DutyCycThermProtnIgnOffMsgWaitTi
    connect CalRegn01IninOptSetA03.DutyCycThermProtnLstTblValNonStall -> AAACalRegn01IninOptSetA03_Dummy.DutyCycThermProtnLstTblValNonStall
    connect CalRegn01IninOptSetA03.DutyCycThermProtnLstTblValStall -> AAACalRegn01IninOptSetA03_Dummy.DutyCycThermProtnLstTblValStall
    connect CalRegn01IninOptSetA03.DutyCycThermProtnMotPrTSeln -> AAACalRegn01IninOptSetA03_Dummy.DutyCycThermProtnMotPrTSeln
    connect CalRegn01IninOptSetA03.DutyCycThermProtnMplr1FetMtgtnNonStallTblY -> AAACalRegn01IninOptSetA03_Dummy.DutyCycThermProtnMplr1FetMtgtnNonStallTblY
    connect CalRegn01IninOptSetA03.DutyCycThermProtnMplr1FetMtgtnStallTblY -> AAACalRegn01IninOptSetA03_Dummy.DutyCycThermProtnMplr1FetMtgtnStallTblY
    connect CalRegn01IninOptSetA03.DutyCycThermProtnMplr1NonStallTblY -> AAACalRegn01IninOptSetA03_Dummy.DutyCycThermProtnMplr1NonStallTblY
    connect CalRegn01IninOptSetA03.DutyCycThermProtnMplr1StallTblY -> AAACalRegn01IninOptSetA03_Dummy.DutyCycThermProtnMplr1StallTblY
    connect CalRegn01IninOptSetA03.DutyCycThermProtnMplr2FetMtgtnNonStallTblY -> AAACalRegn01IninOptSetA03_Dummy.DutyCycThermProtnMplr2FetMtgtnNonStallTblY
    connect CalRegn01IninOptSetA03.DutyCycThermProtnMplr2FetMtgtnStallTblY -> AAACalRegn01IninOptSetA03_Dummy.DutyCycThermProtnMplr2FetMtgtnStallTblY
    connect CalRegn01IninOptSetA03.DutyCycThermProtnMplr2NonStallTblY -> AAACalRegn01IninOptSetA03_Dummy.DutyCycThermProtnMplr2NonStallTblY
    connect CalRegn01IninOptSetA03.DutyCycThermProtnMplr2StallTblY -> AAACalRegn01IninOptSetA03_Dummy.DutyCycThermProtnMplr2StallTblY
    connect CalRegn01IninOptSetA03.DutyCycThermProtnMplr3FetMtgtnNonStallTblY -> AAACalRegn01IninOptSetA03_Dummy.DutyCycThermProtnMplr3FetMtgtnNonStallTblY
    connect CalRegn01IninOptSetA03.DutyCycThermProtnMplr3FetMtgtnStallTblY -> AAACalRegn01IninOptSetA03_Dummy.DutyCycThermProtnMplr3FetMtgtnStallTblY
    connect CalRegn01IninOptSetA03.DutyCycThermProtnMplr3NonStallTblY -> AAACalRegn01IninOptSetA03_Dummy.DutyCycThermProtnMplr3NonStallTblY
    connect CalRegn01IninOptSetA03.DutyCycThermProtnMplr3StallTblY -> AAACalRegn01IninOptSetA03_Dummy.DutyCycThermProtnMplr3StallTblY
    connect CalRegn01IninOptSetA03.DutyCycThermProtnMplr4FetMtgtnNonStallTblY -> AAACalRegn01IninOptSetA03_Dummy.DutyCycThermProtnMplr4FetMtgtnNonStallTblY
    connect CalRegn01IninOptSetA03.DutyCycThermProtnMplr4FetMtgtnStallTblY -> AAACalRegn01IninOptSetA03_Dummy.DutyCycThermProtnMplr4FetMtgtnStallTblY
    connect CalRegn01IninOptSetA03.DutyCycThermProtnMplr4NonStallTblY -> AAACalRegn01IninOptSetA03_Dummy.DutyCycThermProtnMplr4NonStallTblY
    connect CalRegn01IninOptSetA03.DutyCycThermProtnMplr4StallTblY -> AAACalRegn01IninOptSetA03_Dummy.DutyCycThermProtnMplr4StallTblY
    connect CalRegn01IninOptSetA03.DutyCycThermProtnMplr5FetMtgtnNonStallTblY -> AAACalRegn01IninOptSetA03_Dummy.DutyCycThermProtnMplr5FetMtgtnNonStallTblY
    connect CalRegn01IninOptSetA03.DutyCycThermProtnMplr5FetMtgtnStallTblY -> AAACalRegn01IninOptSetA03_Dummy.DutyCycThermProtnMplr5FetMtgtnStallTblY
    connect CalRegn01IninOptSetA03.DutyCycThermProtnMplr5NonStallTblY -> AAACalRegn01IninOptSetA03_Dummy.DutyCycThermProtnMplr5NonStallTblY
    connect CalRegn01IninOptSetA03.DutyCycThermProtnMplr5StallTblY -> AAACalRegn01IninOptSetA03_Dummy.DutyCycThermProtnMplr5StallTblY
    connect CalRegn01IninOptSetA03.DutyCycThermProtnMplr6FetMtgtnNonStallTblY -> AAACalRegn01IninOptSetA03_Dummy.DutyCycThermProtnMplr6FetMtgtnNonStallTblY
    connect CalRegn01IninOptSetA03.DutyCycThermProtnMplr6FetMtgtnStallTblY -> AAACalRegn01IninOptSetA03_Dummy.DutyCycThermProtnMplr6FetMtgtnStallTblY
    connect CalRegn01IninOptSetA03.DutyCycThermProtnMplr6NonStallTblY -> AAACalRegn01IninOptSetA03_Dummy.DutyCycThermProtnMplr6NonStallTblY
    connect CalRegn01IninOptSetA03.DutyCycThermProtnMplr6StallTblY -> AAACalRegn01IninOptSetA03_Dummy.DutyCycThermProtnMplr6StallTblY
    connect CalRegn01IninOptSetA03.DutyCycThermProtnMplrFetMtgtnTblX -> AAACalRegn01IninOptSetA03_Dummy.DutyCycThermProtnMplrFetMtgtnTblX
    connect CalRegn01IninOptSetA03.DutyCycThermProtnMplrTblX -> AAACalRegn01IninOptSetA03_Dummy.DutyCycThermProtnMplrTblX
    connect CalRegn01IninOptSetA03.DutyCycThermProtnMplrTSeln -> AAACalRegn01IninOptSetA03_Dummy.DutyCycThermProtnMplrTSeln
    connect CalRegn01IninOptSetA03.DutyCycThermProtnSlowFilTSeln -> AAACalRegn01IninOptSetA03_Dummy.DutyCycThermProtnSlowFilTSeln
    connect CalRegn01IninOptSetA03.DutyCycThermProtnThermLimScaFac -> AAACalRegn01IninOptSetA03_Dummy.DutyCycThermProtnThermLimScaFac
    connect CalRegn01IninOptSetA03.DutyCycThermProtnThermLoadLimTblX -> AAACalRegn01IninOptSetA03_Dummy.DutyCycThermProtnThermLoadLimTblX
    connect CalRegn01IninOptSetA03.DutyCycThermProtnThermLoadLimTblY -> AAACalRegn01IninOptSetA03_Dummy.DutyCycThermProtnThermLoadLimTblY
    connect CalRegn01IninOptSetA03.DutyCycThermProtnTqCmdSlewDwn -> AAACalRegn01IninOptSetA03_Dummy.DutyCycThermProtnTqCmdSlewDwn
    connect CalRegn01IninOptSetA03.DutyCycThermProtnTqCmdSlewUp -> AAACalRegn01IninOptSetA03_Dummy.DutyCycThermProtnTqCmdSlewUp
    connect CalRegn01IninOptSetA03.HiLoadStallLimrMotVelMgnThd -> AAACalRegn01IninOptSetA03_Dummy.HiLoadStallLimrMotVelMgnThd
    connect CalRegn01IninOptSetA03.HiLoadStallLimrStallMotTqCmdFetMtgtnLimX -> AAACalRegn01IninOptSetA03_Dummy.HiLoadStallLimrStallMotTqCmdFetMtgtnLimX
    connect CalRegn01IninOptSetA03.HiLoadStallLimrStallMotTqCmdFetMtgtnLimY -> AAACalRegn01IninOptSetA03_Dummy.HiLoadStallLimrStallMotTqCmdFetMtgtnLimY
    connect CalRegn01IninOptSetA03.HiLoadStallLimrStallMotTqCmdLimX -> AAACalRegn01IninOptSetA03_Dummy.HiLoadStallLimrStallMotTqCmdLimX
    connect CalRegn01IninOptSetA03.HiLoadStallLimrStallMotTqCmdLimY -> AAACalRegn01IninOptSetA03_Dummy.HiLoadStallLimrStallMotTqCmdLimY
    connect CalRegn01IninOptSetA03.HiLoadStallLimrStallMotTqLimSlewRate -> AAACalRegn01IninOptSetA03_Dummy.HiLoadStallLimrStallMotTqLimSlewRate
    connect CalRegn01IninOptSetA03.HiLoadStallLimrStallThermLimSca -> AAACalRegn01IninOptSetA03_Dummy.HiLoadStallLimrStallThermLimSca
    connect CalRegn01IninOptSetA03.LrndRackCentrMotTqThd -> AAACalRegn01IninOptSetA03_Dummy.LrndRackCentrMotTqThd
    connect CalRegn01IninOptSetA03.LrndRackCentrMotVelThd -> AAACalRegn01IninOptSetA03_Dummy.LrndRackCentrMotVelThd
    connect CalRegn01IninOptSetA03.MotCtrlPrmEstimnFetRNom -> AAACalRegn01IninOptSetA03_Dummy.MotCtrlPrmEstimnFetRNom
    connect CalRegn01IninOptSetA03.MotCtrlPrmEstimnMotBackEmfConHiLim -> AAACalRegn01IninOptSetA03_Dummy.MotCtrlPrmEstimnMotBackEmfConHiLim
    connect CalRegn01IninOptSetA03.MotCtrlPrmEstimnMotBackEmfConLoLim -> AAACalRegn01IninOptSetA03_Dummy.MotCtrlPrmEstimnMotBackEmfConLoLim
    connect CalRegn01IninOptSetA03.MotCtrlPrmEstimnMotBackEmfConNom -> AAACalRegn01IninOptSetA03_Dummy.MotCtrlPrmEstimnMotBackEmfConNom
    connect CalRegn01IninOptSetA03.MotCtrlPrmEstimnMotBackEmfConSatnScaIvtrLoaMtgtn -> AAACalRegn01IninOptSetA03_Dummy.MotCtrlPrmEstimnMotBackEmfConSatnScaIvtrLoaMtgtn
    connect CalRegn01IninOptSetA03.MotCtrlPrmEstimnMotBackEmfConSatnX -> AAACalRegn01IninOptSetA03_Dummy.MotCtrlPrmEstimnMotBackEmfConSatnX
    connect CalRegn01IninOptSetA03.MotCtrlPrmEstimnMotBackEmfConSatnY -> AAACalRegn01IninOptSetA03_Dummy.MotCtrlPrmEstimnMotBackEmfConSatnY
    connect CalRegn01IninOptSetA03.MotCtrlPrmEstimnMotCurrDaxInduSatnBilnrSeln -> AAACalRegn01IninOptSetA03_Dummy.MotCtrlPrmEstimnMotCurrDaxInduSatnBilnrSeln
    connect CalRegn01IninOptSetA03.MotCtrlPrmEstimnMotCurrQaxInduSatnX -> AAACalRegn01IninOptSetA03_Dummy.MotCtrlPrmEstimnMotCurrQaxInduSatnX
    connect CalRegn01IninOptSetA03.MotCtrlPrmEstimnMotInduDaxHiLim -> AAACalRegn01IninOptSetA03_Dummy.MotCtrlPrmEstimnMotInduDaxHiLim
