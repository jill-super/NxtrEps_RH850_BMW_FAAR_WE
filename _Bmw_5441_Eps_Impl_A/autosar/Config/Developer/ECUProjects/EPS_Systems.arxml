[part 3 of 3: packages /BMW/SystemComposition to /Systems/EndToEndProtections]
AUTOSAR XML (schema 4-2-2)
package /BMW/SystemComposition  (continued)
  composition sw component type SystemComponent  (continued)
    connect CalRegn01IninOptSetA03.MotCtrlPrmEstimnMotInduDaxIvtrLoaMtgtn -> AAACalRegn01IninOptSetA03_Dummy.MotCtrlPrmEstimnMotInduDaxIvtrLoaMtgtn
    connect CalRegn01IninOptSetA03.MotCtrlPrmEstimnMotInduDaxLoLim -> AAACalRegn01IninOptSetA03_Dummy.MotCtrlPrmEstimnMotInduDaxLoLim
    connect CalRegn01IninOptSetA03.MotCtrlPrmEstimnMotInduDaxNom -> AAACalRegn01IninOptSetA03_Dummy.MotCtrlPrmEstimnMotInduDaxNom
    connect CalRegn01IninOptSetA03.MotCtrlPrmEstimnMotInduDaxSatnScaY -> AAACalRegn01IninOptSetA03_Dummy.MotCtrlPrmEstimnMotInduDaxSatnScaY
    connect CalRegn01IninOptSetA03.MotCtrlPrmEstimnMotInduQaxHiLim -> AAACalRegn01IninOptSetA03_Dummy.MotCtrlPrmEstimnMotInduQaxHiLim
    connect CalRegn01IninOptSetA03.MotCtrlPrmEstimnMotInduQaxIvtrLoaMtgtn -> AAACalRegn01IninOptSetA03_Dummy.MotCtrlPrmEstimnMotInduQaxIvtrLoaMtgtn
    connect CalRegn01IninOptSetA03.MotCtrlPrmEstimnMotInduQaxLoLim -> AAACalRegn01IninOptSetA03_Dummy.MotCtrlPrmEstimnMotInduQaxLoLim
    connect CalRegn01IninOptSetA03.MotCtrlPrmEstimnMotInduQaxNom -> AAACalRegn01IninOptSetA03_Dummy.MotCtrlPrmEstimnMotInduQaxNom
    connect CalRegn01IninOptSetA03.MotCtrlPrmEstimnMotInduQaxSatnScaY -> AAACalRegn01IninOptSetA03_Dummy.MotCtrlPrmEstimnMotInduQaxSatnScaY
    connect CalRegn01IninOptSetA03.MotCtrlPrmEstimnMotRHiLim -> AAACalRegn01IninOptSetA03_Dummy.MotCtrlPrmEstimnMotRHiLim
    connect CalRegn01IninOptSetA03.MotCtrlPrmEstimnMotRLoLim -> AAACalRegn01IninOptSetA03_Dummy.MotCtrlPrmEstimnMotRLoLim
    connect CalRegn01IninOptSetA03.MotCtrlPrmEstimnMotRNom -> AAACalRegn01IninOptSetA03_Dummy.MotCtrlPrmEstimnMotRNom
    connect CalRegn01IninOptSetA03.MotCtrlPrmEstimnMotWidgThermCoeff -> AAACalRegn01IninOptSetA03_Dummy.MotCtrlPrmEstimnMotWidgThermCoeff
    connect CalRegn01IninOptSetA03.MotCtrlPrmEstimnTNom -> AAACalRegn01IninOptSetA03_Dummy.MotCtrlPrmEstimnTNom
    connect CalRegn01IninOptSetA03.MotCurrPeakEstimnCurrFilFrq -> AAACalRegn01IninOptSetA03_Dummy.MotCurrPeakEstimnCurrFilFrq
    connect CalRegn01IninOptSetA03.MotCurrPeakEstimnCurrPeakEstimdFilFrq -> AAACalRegn01IninOptSetA03_Dummy.MotCurrPeakEstimnCurrPeakEstimdFilFrq
    connect CalRegn01IninOptSetA03.MotCurrRegCfgMotClsdLoopBwDaxY -> AAACalRegn01IninOptSetA03_Dummy.MotCurrRegCfgMotClsdLoopBwDaxY
    connect CalRegn01IninOptSetA03.MotCurrRegCfgMotClsdLoopBwQaxY -> AAACalRegn01IninOptSetA03_Dummy.MotCurrRegCfgMotClsdLoopBwQaxY
    connect CalRegn01IninOptSetA03.MotCurrRegCfgMotDampgRatDax -> AAACalRegn01IninOptSetA03_Dummy.MotCurrRegCfgMotDampgRatDax
    connect CalRegn01IninOptSetA03.MotCurrRegCfgMotDampgRatQax -> AAACalRegn01IninOptSetA03_Dummy.MotCurrRegCfgMotDampgRatQax
    connect CalRegn01IninOptSetA03.MotCurrRegCfgMotNatFrqDaxY -> AAACalRegn01IninOptSetA03_Dummy.MotCurrRegCfgMotNatFrqDaxY
    connect CalRegn01IninOptSetA03.MotCurrRegCfgMotNatFrqQaxY -> AAACalRegn01IninOptSetA03_Dummy.MotCurrRegCfgMotNatFrqQaxY
    connect CalRegn01IninOptSetA03.MotCurrRegCfgMotRVirtDax -> AAACalRegn01IninOptSetA03_Dummy.MotCurrRegCfgMotRVirtDax
    connect CalRegn01IninOptSetA03.MotCurrRegCfgMotRVirtQax -> AAACalRegn01IninOptSetA03_Dummy.MotCurrRegCfgMotRVirtQax
    connect CalRegn01IninOptSetA03.MotCurrRegCfgMotVelFilFrq -> AAACalRegn01IninOptSetA03_Dummy.MotCurrRegCfgMotVelFilFrq
    connect CalRegn01IninOptSetA03.MotCurrRegVltgLimrCurrLoaScarSlewRate -> AAACalRegn01IninOptSetA03_Dummy.MotCurrRegVltgLimrCurrLoaScarSlewRate
    connect CalRegn01IninOptSetA03.MotCurrRegVltgLimrDaxAntiWdupCoeff -> AAACalRegn01IninOptSetA03_Dummy.MotCurrRegVltgLimrDaxAntiWdupCoeff
    connect CalRegn01IninOptSetA03.MotCurrRegVltgLimrDualEcuLoaScarSlewRate -> AAACalRegn01IninOptSetA03_Dummy.MotCurrRegVltgLimrDualEcuLoaScarSlewRate
    connect CalRegn01IninOptSetA03.MotCurrRegVltgLimrFETLoaScarSlewRate -> AAACalRegn01IninOptSetA03_Dummy.MotCurrRegVltgLimrFETLoaScarSlewRate
    connect CalRegn01IninOptSetA03.MotCurrRegVltgLimrIvtrLoaScarSlewRate -> AAACalRegn01IninOptSetA03_Dummy.MotCurrRegVltgLimrIvtrLoaScarSlewRate
    connect CalRegn01IninOptSetA03.MotCurrRegVltgLimrMotVltgBrdgLpFilFrq -> AAACalRegn01IninOptSetA03_Dummy.MotCurrRegVltgLimrMotVltgBrdgLpFilFrq
    connect CalRegn01IninOptSetA03.MotCurrRegVltgLimrMotVltgDaxIntglHiLim -> AAACalRegn01IninOptSetA03_Dummy.MotCurrRegVltgLimrMotVltgDaxIntglHiLim
    connect CalRegn01IninOptSetA03.MotCurrRegVltgLimrMotVltgDaxIntglLoLim -> AAACalRegn01IninOptSetA03_Dummy.MotCurrRegVltgLimrMotVltgDaxIntglLoLim
    connect CalRegn01IninOptSetA03.MotCurrRegVltgLimrMotVltgQaxFfLpFilFrq -> AAACalRegn01IninOptSetA03_Dummy.MotCurrRegVltgLimrMotVltgQaxFfLpFilFrq
    connect CalRegn01IninOptSetA03.MotCurrRegVltgLimrMotVltgQaxIntglHiLim -> AAACalRegn01IninOptSetA03_Dummy.MotCurrRegVltgLimrMotVltgQaxIntglHiLim
    connect CalRegn01IninOptSetA03.MotCurrRegVltgLimrMotVltgQaxIntglLoLim -> AAACalRegn01IninOptSetA03_Dummy.MotCurrRegVltgLimrMotVltgQaxIntglLoLim
    connect CalRegn01IninOptSetA03.MotCurrRegVltgLimrQaxAntiWdupCoeff -> AAACalRegn01IninOptSetA03_Dummy.MotCurrRegVltgLimrQaxAntiWdupCoeff
    connect CalRegn01IninOptSetA03.MotCurrRegVltgLimrQaxAntiWdupScagDi -> AAACalRegn01IninOptSetA03_Dummy.MotCurrRegVltgLimrQaxAntiWdupScagDi
    connect CalRegn01IninOptSetA03.MotRefMdlCurrDaxBoostGain -> AAACalRegn01IninOptSetA03_Dummy.MotRefMdlCurrDaxBoostGain
    connect CalRegn01IninOptSetA03.MotRefMdlCurrDaxBoostTqScaX -> AAACalRegn01IninOptSetA03_Dummy.MotRefMdlCurrDaxBoostTqScaX
    connect CalRegn01IninOptSetA03.MotRefMdlCurrDaxBoostTqScaY -> AAACalRegn01IninOptSetA03_Dummy.MotRefMdlCurrDaxBoostTqScaY
    connect CalRegn01IninOptSetA03.MotRefMdlCurrDaxQaxRefDelta -> AAACalRegn01IninOptSetA03_Dummy.MotRefMdlCurrDaxQaxRefDelta
    connect CalRegn01IninOptSetA03.MotRefMdlCurrItrnTolr -> AAACalRegn01IninOptSetA03_Dummy.MotRefMdlCurrItrnTolr
    connect CalRegn01IninOptSetA03.MotRefMdlMotCurrDaxMaxSca -> AAACalRegn01IninOptSetA03_Dummy.MotRefMdlMotCurrDaxMaxSca
    connect CalRegn01IninOptSetA03.MotRefMdlQuad13VltgSdlX -> AAACalRegn01IninOptSetA03_Dummy.MotRefMdlQuad13VltgSdlX
    connect CalRegn01IninOptSetA03.MotRefMdlQuad13VltgSdlY -> AAACalRegn01IninOptSetA03_Dummy.MotRefMdlQuad13VltgSdlY
    connect CalRegn01IninOptSetA03.MotRefMdlQuad24VltgSdlX -> AAACalRegn01IninOptSetA03_Dummy.MotRefMdlQuad24VltgSdlX
    connect CalRegn01IninOptSetA03.MotRefMdlQuad24VltgSdlY -> AAACalRegn01IninOptSetA03_Dummy.MotRefMdlQuad24VltgSdlY
    connect CalRegn01IninOptSetA03.MotRefMdlVltgOverRThdSca -> AAACalRegn01IninOptSetA03_Dummy.MotRefMdlVltgOverRThdSca
    connect CalRegn01IninOptSetA03.MotTqTranlDampgCmdLim -> AAACalRegn01IninOptSetA03_Dummy.MotTqTranlDampgCmdLim
    connect CalRegn01IninOptSetA03.MotTqTranlDampgVelThd -> AAACalRegn01IninOptSetA03_Dummy.MotTqTranlDampgVelThd
    connect CalRegn01IninOptSetA03.PwrLimrAssiRednLpFilFrq -> AAACalRegn01IninOptSetA03_Dummy.PwrLimrAssiRednLpFilFrq
    connect CalRegn01IninOptSetA03.PwrLimrBackEmfConStdT -> AAACalRegn01IninOptSetA03_Dummy.PwrLimrBackEmfConStdT
    connect CalRegn01IninOptSetA03.PwrLimrBrdgVltgAdjSlew -> AAACalRegn01IninOptSetA03_Dummy.PwrLimrBrdgVltgAdjSlew
    connect CalRegn01IninOptSetA03.PwrLimrBrdgVltgAltFltAdj -> AAACalRegn01IninOptSetA03_Dummy.PwrLimrBrdgVltgAltFltAdj
    connect CalRegn01IninOptSetA03.PwrLimrFilAssiRednThd -> AAACalRegn01IninOptSetA03_Dummy.PwrLimrFilAssiRednThd
    connect CalRegn01IninOptSetA03.PwrLimrLoVoltAssiRcvrThd -> AAACalRegn01IninOptSetA03_Dummy.PwrLimrLoVoltAssiRcvrThd
    connect CalRegn01IninOptSetA03.PwrLimrLoVoltAssiRcvrTi -> AAACalRegn01IninOptSetA03_Dummy.PwrLimrLoVoltAssiRcvrTi
    connect CalRegn01IninOptSetA03.PwrLimrMotEnvlpX -> AAACalRegn01IninOptSetA03_Dummy.PwrLimrMotEnvlpX
    connect CalRegn01IninOptSetA03.PwrLimrMotEnvlpY -> AAACalRegn01IninOptSetA03_Dummy.PwrLimrMotEnvlpY
    connect CalRegn01IninOptSetA03.PwrLimrMotVelLpFilFrq -> AAACalRegn01IninOptSetA03_Dummy.PwrLimrMotVelLpFilFrq
    connect CalRegn01IninOptSetA03.PwrLimrSpdAdjSlewDec -> AAACalRegn01IninOptSetA03_Dummy.PwrLimrSpdAdjSlewDec
    connect CalRegn01IninOptSetA03.PwrLimrSpdAdjSlewEna -> AAACalRegn01IninOptSetA03_Dummy.PwrLimrSpdAdjSlewEna
    connect CalRegn01IninOptSetA03.PwrLimrSpdAdjSlewInc -> AAACalRegn01IninOptSetA03_Dummy.PwrLimrSpdAdjSlewInc
    connect CalRegn01IninOptSetA03.PwrLimrStdOperMotEnvlpX -> AAACalRegn01IninOptSetA03_Dummy.PwrLimrStdOperMotEnvlpX
    connect CalRegn01IninOptSetA03.PwrLimrStdOperMotEnvlpY -> AAACalRegn01IninOptSetA03_Dummy.PwrLimrStdOperMotEnvlpY
    connect CalRegn01IninOptSetA03.PwrLimrVltgDptMotVelOffsX -> AAACalRegn01IninOptSetA03_Dummy.PwrLimrVltgDptMotVelOffsX
    connect CalRegn01IninOptSetA03.PwrLimrVltgDptMotVelOffsY -> AAACalRegn01IninOptSetA03_Dummy.PwrLimrVltgDptMotVelOffsY
    connect CalRegn01IninOptSetA03.SysGlbPrmSysTqRat -> AAACalRegn01IninOptSetA03_Dummy.SysGlbPrmSysTqRat
    connect CalRegn01IninOptSetA03.TEstimnAmbPwrMplr -> AAACalRegn01IninOptSetA03_Dummy.TEstimnAmbPwrMplr
    connect CalRegn01IninOptSetA03.TEstimnAmbTSca -> AAACalRegn01IninOptSetA03_Dummy.TEstimnAmbTSca
    connect CalRegn01IninOptSetA03.TEstimnAssiMechAmbLpFilFrq -> AAACalRegn01IninOptSetA03_Dummy.TEstimnAssiMechAmbLpFilFrq
    connect CalRegn01IninOptSetA03.TEstimnAssiMechAmbLpFilFrqDualEcuFltMtgtn -> AAACalRegn01IninOptSetA03_Dummy.TEstimnAssiMechAmbLpFilFrqDualEcuFltMtgtn
    connect CalRegn01IninOptSetA03.TEstimnAssiMechAmbLpFilFrqFetMtgtnEna -> AAACalRegn01IninOptSetA03_Dummy.TEstimnAssiMechAmbLpFilFrqFetMtgtnEna
    connect CalRegn01IninOptSetA03.TEstimnAssiMechAmbMplr -> AAACalRegn01IninOptSetA03_Dummy.TEstimnAssiMechAmbMplr
    connect CalRegn01IninOptSetA03.TEstimnAssiMechCorrLim -> AAACalRegn01IninOptSetA03_Dummy.TEstimnAssiMechCorrLim
    connect CalRegn01IninOptSetA03.TEstimnAssiMechDampgSca -> AAACalRegn01IninOptSetA03_Dummy.TEstimnAssiMechDampgSca
    connect CalRegn01IninOptSetA03.TEstimnAssiMechDftT -> AAACalRegn01IninOptSetA03_Dummy.TEstimnAssiMechDftT
    connect CalRegn01IninOptSetA03.TEstimnAssiMechLLFilCoeffA1 -> AAACalRegn01IninOptSetA03_Dummy.TEstimnAssiMechLLFilCoeffA1
    connect CalRegn01IninOptSetA03.TEstimnAssiMechLLFilCoeffB0 -> AAACalRegn01IninOptSetA03_Dummy.TEstimnAssiMechLLFilCoeffB0
    connect CalRegn01IninOptSetA03.TEstimnAssiMechLLFilCoeffB1 -> AAACalRegn01IninOptSetA03_Dummy.TEstimnAssiMechLLFilCoeffB1
    connect CalRegn01IninOptSetA03.TEstimnAssiMechSlew -> AAACalRegn01IninOptSetA03_Dummy.TEstimnAssiMechSlew
    connect CalRegn01IninOptSetA03.TEstimnCorrnTAssiMech -> AAACalRegn01IninOptSetA03_Dummy.TEstimnCorrnTAssiMech
    connect CalRegn01IninOptSetA03.TEstimnCorrnTCu -> AAACalRegn01IninOptSetA03_Dummy.TEstimnCorrnTCu
    connect CalRegn01IninOptSetA03.TEstimnCorrnTMag -> AAACalRegn01IninOptSetA03_Dummy.TEstimnCorrnTMag
    connect CalRegn01IninOptSetA03.TEstimnCorrnTSi -> AAACalRegn01IninOptSetA03_Dummy.TEstimnCorrnTSi
    connect CalRegn01IninOptSetA03.TEstimnCuAmbLpFilFrq -> AAACalRegn01IninOptSetA03_Dummy.TEstimnCuAmbLpFilFrq
    connect CalRegn01IninOptSetA03.TEstimnCuAmbLpFilFrqDualEcuFltMtgtn -> AAACalRegn01IninOptSetA03_Dummy.TEstimnCuAmbLpFilFrqDualEcuFltMtgtn
    connect CalRegn01IninOptSetA03.TEstimnCuAmbLpFilFrqFetMtgtnEna -> AAACalRegn01IninOptSetA03_Dummy.TEstimnCuAmbLpFilFrqFetMtgtnEna
    connect CalRegn01IninOptSetA03.TEstimnCuAmbMplr -> AAACalRegn01IninOptSetA03_Dummy.TEstimnCuAmbMplr
    connect CalRegn01IninOptSetA03.TEstimnCuCorrnLim -> AAACalRegn01IninOptSetA03_Dummy.TEstimnCuCorrnLim
    connect CalRegn01IninOptSetA03.TEstimnCuLLFilCoeffA1 -> AAACalRegn01IninOptSetA03_Dummy.TEstimnCuLLFilCoeffA1
    connect CalRegn01IninOptSetA03.TEstimnCuLLFilCoeffB0 -> AAACalRegn01IninOptSetA03_Dummy.TEstimnCuLLFilCoeffB0
    connect CalRegn01IninOptSetA03.TEstimnCuLLFilCoeffB1 -> AAACalRegn01IninOptSetA03_Dummy.TEstimnCuLLFilCoeffB1
    connect CalRegn01IninOptSetA03.TEstimnEngTSca -> AAACalRegn01IninOptSetA03_Dummy.TEstimnEngTSca
    connect CalRegn01IninOptSetA03.TEstimnMagAmbLpFilFrq -> AAACalRegn01IninOptSetA03_Dummy.TEstimnMagAmbLpFilFrq
    connect CalRegn01IninOptSetA03.TEstimnMagAmbLpFilFrqDualEcuFltMtgtn -> AAACalRegn01IninOptSetA03_Dummy.TEstimnMagAmbLpFilFrqDualEcuFltMtgtn
    connect CalRegn01IninOptSetA03.TEstimnMagAmbLpFilFrqFetMtgtnEna -> AAACalRegn01IninOptSetA03_Dummy.TEstimnMagAmbLpFilFrqFetMtgtnEna
    connect CalRegn01IninOptSetA03.TEstimnMagAmbMplr -> AAACalRegn01IninOptSetA03_Dummy.TEstimnMagAmbMplr
    connect CalRegn01IninOptSetA03.TEstimnMagCorrnLim -> AAACalRegn01IninOptSetA03_Dummy.TEstimnMagCorrnLim
    connect CalRegn01IninOptSetA03.TEstimnMagLLFilCoeffA1 -> AAACalRegn01IninOptSetA03_Dummy.TEstimnMagLLFilCoeffA1
    connect CalRegn01IninOptSetA03.TEstimnMagLLFilCoeffB0 -> AAACalRegn01IninOptSetA03_Dummy.TEstimnMagLLFilCoeffB0
    connect CalRegn01IninOptSetA03.TEstimnMagLLFilCoeffB1 -> AAACalRegn01IninOptSetA03_Dummy.TEstimnMagLLFilCoeffB1
    connect CalRegn01IninOptSetA03.TEstimnSiAmbLpFilFrq -> AAACalRegn01IninOptSetA03_Dummy.TEstimnSiAmbLpFilFrq
    connect CalRegn01IninOptSetA03.TEstimnSiAmbLpFilFrqDualEcuFltMtgtn -> AAACalRegn01IninOptSetA03_Dummy.TEstimnSiAmbLpFilFrqDualEcuFltMtgtn
    connect CalRegn01IninOptSetA03.TEstimnSiAmbLpFilFrqFetMtgtnEna -> AAACalRegn01IninOptSetA03_Dummy.TEstimnSiAmbLpFilFrqFetMtgtnEna
    connect CalRegn01IninOptSetA03.TEstimnSiAmbMplr -> AAACalRegn01IninOptSetA03_Dummy.TEstimnSiAmbMplr
    connect CalRegn01IninOptSetA03.TEstimnSiCorrnLim -> AAACalRegn01IninOptSetA03_Dummy.TEstimnSiCorrnLim
    connect CalRegn01IninOptSetA03.TEstimnSiLLFilCoeffA1 -> AAACalRegn01IninOptSetA03_Dummy.TEstimnSiLLFilCoeffA1
    connect CalRegn01IninOptSetA03.TEstimnSiLLFilCoeffB0 -> AAACalRegn01IninOptSetA03_Dummy.TEstimnSiLLFilCoeffB0
    connect CalRegn01IninOptSetA03.TEstimnSiLLFilCoeffB1 -> AAACalRegn01IninOptSetA03_Dummy.TEstimnSiLLFilCoeffB1
    connect CalRegn01IninOptSetA03.TEstimnTauAssiMech -> AAACalRegn01IninOptSetA03_Dummy.TEstimnTauAssiMech
    connect CalRegn01IninOptSetA03.TEstimnTauCu -> AAACalRegn01IninOptSetA03_Dummy.TEstimnTauCu
    connect CalRegn01IninOptSetA03.TEstimnTauMag -> AAACalRegn01IninOptSetA03_Dummy.TEstimnTauMag
    connect CalRegn01IninOptSetA03.TEstimnTauSi -> AAACalRegn01IninOptSetA03_Dummy.TEstimnTauSi
    connect CalRegn01IninOptSetA03.TEstimnWghtAvrgTDi -> AAACalRegn01IninOptSetA03_Dummy.TEstimnWghtAvrgTDi
    connect CalRegn01IninOptSetA03.VehSpdLimrPosMaxOffs2 -> AAACalRegn01IninOptSetA03_Dummy.VehSpdLimrPosMaxOffs2
    connect CalRegn02Rt00.BmwStReqMgrAllwToOffThd -> AAACalRegn02Rt00_Dummy.BmwStReqMgrAllwToOffThd
    connect CalRegn02Rt00.BmwStReqMgrStsDrvrActvyTqChgThd -> AAACalRegn02Rt00_Dummy.BmwStReqMgrStsDrvrActvyTqChgThd
    connect CalRegn02Rt00.BmwStReqMgrAllwToOffThd -> BmwStReqMgr.BmwStReqMgrAllwToOffThd
    connect CalRegn02Rt00.BmwStReqMgrStsDrvrActvyTqChgThd -> BmwStReqMgr.BmwStReqMgrStsDrvrActvyTqChgThd
    connect CalRegn02Rt00GroupA.BmwPwrPrkgDampgBasPwrPrkgDampgY -> AAACalRegn02Rt00GroupA_Dummy.BmwPwrPrkgDampgBasPwrPrkgDampgY
    connect CalRegn02Rt00GroupA.BmwPwrPrkgDampgHwVelTblX -> AAACalRegn02Rt00GroupA_Dummy.BmwPwrPrkgDampgHwVelTblX
    connect CalRegn02Rt00GroupA.BmwPwrPrkgDampgPinionAgSelnTbl -> AAACalRegn02Rt00GroupA_Dummy.BmwPwrPrkgDampgPinionAgSelnTbl
    connect CalRegn02Rt00GroupA.BmwPwrPrkgDampgVehSpdLnrSelnX -> AAACalRegn02Rt00GroupA_Dummy.BmwPwrPrkgDampgVehSpdLnrSelnX
    connect CalRegn02Rt00GroupA.BmwPwrPrkgDampgVehSpdScaFacY -> AAACalRegn02Rt00GroupA_Dummy.BmwPwrPrkgDampgVehSpdScaFacY
    connect CalRegn02Rt00GroupA.BmwStReqMgrDrvrActvTmrThd -> AAACalRegn02Rt00GroupA_Dummy.BmwStReqMgrDrvrActvTmrThd
    connect CalRegn02Rt00GroupA.BmwStReqMgrHwTqThd -> AAACalRegn02Rt00GroupA_Dummy.BmwStReqMgrHwTqThd
    connect CalRegn02Rt00GroupA.BmwStReqMgrOperRampRate -> AAACalRegn02Rt00GroupA_Dummy.BmwStReqMgrOperRampRate
    connect CalRegn02Rt00GroupA.BmwStReqMgrSwtOffSpdLim -> AAACalRegn02Rt00GroupA_Dummy.BmwStReqMgrSwtOffSpdLim
    connect CalRegn02Rt00GroupA.BmwStReqMgrSysProtnRednFacThd -> AAACalRegn02Rt00GroupA_Dummy.BmwStReqMgrSysProtnRednFacThd
    connect CalRegn02Rt00GroupA.BmwPwrPrkgDampgBasPwrPrkgDampgY -> BmwPwrPrkgDampg.BmwPwrPrkgDampgBasPwrPrkgDampgY
    connect CalRegn02Rt00GroupA.BmwPwrPrkgDampgHwVelTblX -> BmwPwrPrkgDampg.BmwPwrPrkgDampgHwVelTblX
    connect CalRegn02Rt00GroupA.BmwPwrPrkgDampgPinionAgSelnTbl -> BmwPwrPrkgDampg.BmwPwrPrkgDampgPinionAgSelnTbl
    connect CalRegn02Rt00GroupA.BmwPwrPrkgDampgVehSpdLnrSelnX -> BmwPwrPrkgDampg.BmwPwrPrkgDampgVehSpdLnrSelnX
    connect CalRegn02Rt00GroupA.BmwPwrPrkgDampgVehSpdScaFacY -> BmwPwrPrkgDampg.BmwPwrPrkgDampgVehSpdScaFacY
    connect CalRegn02Rt00GroupA.BmwStReqMgrDrvrActvTmrThd -> BmwStReqMgr.BmwStReqMgrDrvrActvTmrThd
    connect CalRegn02Rt00GroupA.BmwStReqMgrHwTqThd -> BmwStReqMgr.BmwStReqMgrHwTqThd
    connect CalRegn02Rt00GroupA.BmwStReqMgrOperRampRate -> BmwStReqMgr.BmwStReqMgrOperRampRate
    connect CalRegn02Rt00GroupA.BmwStReqMgrSwtOffSpdLim -> BmwStReqMgr.BmwStReqMgrSwtOffSpdLim
    connect CalRegn02Rt00GroupA.BmwStReqMgrSysProtnRednFacThd -> BmwStReqMgr.BmwStReqMgrSysProtnRednFacThd
    connect CalRegn02Rt00GroupC.CtrldVelRtnDampgX -> AAACalRegn02Rt00GroupC_Dummy.CtrldVelRtnDampgX
    connect CalRegn02Rt00GroupC.CtrldVelRtnDampgY -> AAACalRegn02Rt00GroupC_Dummy.CtrldVelRtnDampgY
    connect CalRegn02Rt00GroupC.CtrldVelRtnDesVelScaX -> AAACalRegn02Rt00GroupC_Dummy.CtrldVelRtnDesVelScaX
    connect CalRegn02Rt00GroupC.CtrldVelRtnDesVelScaY -> AAACalRegn02Rt00GroupC_Dummy.CtrldVelRtnDesVelScaY
    connect CalRegn02Rt00GroupC.CtrldVelRtnDesVelX -> AAACalRegn02Rt00GroupC_Dummy.CtrldVelRtnDesVelX
    connect CalRegn02Rt00GroupC.CtrldVelRtnDesVelY -> AAACalRegn02Rt00GroupC_Dummy.CtrldVelRtnDesVelY
    connect CalRegn02Rt00GroupC.CtrldVelRtnHwPosnScaX -> AAACalRegn02Rt00GroupC_Dummy.CtrldVelRtnHwPosnScaX
    connect CalRegn02Rt00GroupC.CtrldVelRtnHwPosnScaY -> AAACalRegn02Rt00GroupC_Dummy.CtrldVelRtnHwPosnScaY
    connect CalRegn02Rt00GroupC.CtrldVelRtnHwTqSca1X -> AAACalRegn02Rt00GroupC_Dummy.CtrldVelRtnHwTqSca1X
    connect CalRegn02Rt00GroupC.CtrldVelRtnHwTqSca1Y -> AAACalRegn02Rt00GroupC_Dummy.CtrldVelRtnHwTqSca1Y
    connect CalRegn02Rt00GroupC.CtrldVelRtnHwTqSca2X -> AAACalRegn02Rt00GroupC_Dummy.CtrldVelRtnHwTqSca2X
    connect CalRegn02Rt00GroupC.CtrldVelRtnHwTqSca2Y -> AAACalRegn02Rt00GroupC_Dummy.CtrldVelRtnHwTqSca2Y
    connect CalRegn02Rt00GroupC.CtrldVelRtnIntglGain -> AAACalRegn02Rt00GroupC_Dummy.CtrldVelRtnIntglGain
    connect CalRegn02Rt00GroupC.CtrldVelRtnPinionTqScaX -> AAACalRegn02Rt00GroupC_Dummy.CtrldVelRtnPinionTqScaX
    connect CalRegn02Rt00GroupC.CtrldVelRtnPinionTqScaY -> AAACalRegn02Rt00GroupC_Dummy.CtrldVelRtnPinionTqScaY
    connect CalRegn02Rt00GroupC.CtrldVelRtnPropGain -> AAACalRegn02Rt00GroupC_Dummy.CtrldVelRtnPropGain
    connect CalRegn02Rt00GroupC.CtrldVelRtnTqGrdtScaX -> AAACalRegn02Rt00GroupC_Dummy.CtrldVelRtnTqGrdtScaX
    connect CalRegn02Rt00GroupC.CtrldVelRtnTqGrdtScaY -> AAACalRegn02Rt00GroupC_Dummy.CtrldVelRtnTqGrdtScaY
    connect CalRegn02Rt00GroupC.CtrldVelRtnVehSpdScaBilnrSeln -> AAACalRegn02Rt00GroupC_Dummy.CtrldVelRtnVehSpdScaBilnrSeln
    connect CalRegn02Rt00GroupC.CtrldVelRtnVelErrScaBilnrSeln -> AAACalRegn02Rt00GroupC_Dummy.CtrldVelRtnVelErrScaBilnrSeln
    connect CalRegn02Rt00GroupC.CtrldVelRtnVelErrScaEna -> AAACalRegn02Rt00GroupC_Dummy.CtrldVelRtnVelErrScaEna
    connect CalRegn02Rt00GroupC.CtrldVelRtnVelErrScaX -> AAACalRegn02Rt00GroupC_Dummy.CtrldVelRtnVelErrScaX
    connect CalRegn02Rt00GroupC.CtrldVelRtnVelErrScaY -> AAACalRegn02Rt00GroupC_Dummy.CtrldVelRtnVelErrScaY
    connect CalRegn02Rt00GroupC.CtrldVelRtnVelErrVehSpdScaY -> AAACalRegn02Rt00GroupC_Dummy.CtrldVelRtnVelErrVehSpdScaY
    connect CalRegn02Rt00GroupC.CtrldVelRtnVelSpdTbl -> AAACalRegn02Rt00GroupC_Dummy.CtrldVelRtnVelSpdTbl
    connect CalRegn02Rt00GroupC.CtrldVelRtnDampgX -> CtrldVelRtn.CtrldVelRtnDampgX
    connect CalRegn02Rt00GroupC.CtrldVelRtnDampgY -> CtrldVelRtn.CtrldVelRtnDampgY
    connect CalRegn02Rt00GroupC.CtrldVelRtnDesVelScaX -> CtrldVelRtn.CtrldVelRtnDesVelScaX
    connect CalRegn02Rt00GroupC.CtrldVelRtnDesVelScaY -> CtrldVelRtn.CtrldVelRtnDesVelScaY
    connect CalRegn02Rt00GroupC.CtrldVelRtnDesVelX -> CtrldVelRtn.CtrldVelRtnDesVelX
    connect CalRegn02Rt00GroupC.CtrldVelRtnDesVelY -> CtrldVelRtn.CtrldVelRtnDesVelY
    connect CalRegn02Rt00GroupC.CtrldVelRtnHwPosnScaX -> CtrldVelRtn.CtrldVelRtnHwPosnScaX
    connect CalRegn02Rt00GroupC.CtrldVelRtnHwPosnScaY -> CtrldVelRtn.CtrldVelRtnHwPosnScaY
    connect CalRegn02Rt00GroupC.CtrldVelRtnHwTqSca1X -> CtrldVelRtn.CtrldVelRtnHwTqSca1X
    connect CalRegn02Rt00GroupC.CtrldVelRtnHwTqSca1Y -> CtrldVelRtn.CtrldVelRtnHwTqSca1Y
    connect CalRegn02Rt00GroupC.CtrldVelRtnHwTqSca2X -> CtrldVelRtn.CtrldVelRtnHwTqSca2X
    connect CalRegn02Rt00GroupC.CtrldVelRtnHwTqSca2Y -> CtrldVelRtn.CtrldVelRtnHwTqSca2Y
    connect CalRegn02Rt00GroupC.CtrldVelRtnIntglGain -> CtrldVelRtn.CtrldVelRtnIntglGain
    connect CalRegn02Rt00GroupC.CtrldVelRtnPinionTqScaX -> CtrldVelRtn.CtrldVelRtnPinionTqScaX
    connect CalRegn02Rt00GroupC.CtrldVelRtnPinionTqScaY -> CtrldVelRtn.CtrldVelRtnPinionTqScaY
    connect CalRegn02Rt00GroupC.CtrldVelRtnPropGain -> CtrldVelRtn.CtrldVelRtnPropGain
    connect CalRegn02Rt00GroupC.CtrldVelRtnTqGrdtScaX -> CtrldVelRtn.CtrldVelRtnTqGrdtScaX
    connect CalRegn02Rt00GroupC.CtrldVelRtnTqGrdtScaY -> CtrldVelRtn.CtrldVelRtnTqGrdtScaY
    connect CalRegn02Rt00GroupC.CtrldVelRtnVehSpdScaBilnrSeln -> CtrldVelRtn.CtrldVelRtnVehSpdScaBilnrSeln
    connect CalRegn02Rt00GroupC.CtrldVelRtnVelErrScaBilnrSeln -> CtrldVelRtn.CtrldVelRtnVelErrScaBilnrSeln
    connect CalRegn02Rt00GroupC.CtrldVelRtnVelErrScaEna -> CtrldVelRtn.CtrldVelRtnVelErrScaEna
    connect CalRegn02Rt00GroupC.CtrldVelRtnVelErrScaX -> CtrldVelRtn.CtrldVelRtnVelErrScaX
    connect CalRegn02Rt00GroupC.CtrldVelRtnVelErrScaY -> CtrldVelRtn.CtrldVelRtnVelErrScaY
    connect CalRegn02Rt00GroupC.CtrldVelRtnVelErrVehSpdScaY -> CtrldVelRtn.CtrldVelRtnVelErrVehSpdScaY
    connect CalRegn02Rt00GroupC.CtrldVelRtnVelSpdTbl -> CtrldVelRtn.CtrldVelRtnVelSpdTbl
    connect CalRegn02Rt00GroupD.ClsdLoopDampgEotEntrX -> AAACalRegn02Rt00GroupD_Dummy.ClsdLoopDampgEotEntrX
    connect CalRegn02Rt00GroupD.ClsdLoopDampgEotEntrY -> AAACalRegn02Rt00GroupD_Dummy.ClsdLoopDampgEotEntrY
    connect CalRegn02Rt00GroupD.ClsdLoopDampgEotExitX -> AAACalRegn02Rt00GroupD_Dummy.ClsdLoopDampgEotExitX
    connect CalRegn02Rt00GroupD.ClsdLoopDampgEotExitY -> AAACalRegn02Rt00GroupD_Dummy.ClsdLoopDampgEotExitY
    connect CalRegn02Rt00GroupD.ClsdLoopDampgPinionVelX -> AAACalRegn02Rt00GroupD_Dummy.ClsdLoopDampgPinionVelX
    connect CalRegn02Rt00GroupD.ClsdLoopDampgPinionVelY -> AAACalRegn02Rt00GroupD_Dummy.ClsdLoopDampgPinionVelY
    connect CalRegn02Rt00GroupD.ClsdLoopDampgRackFX -> AAACalRegn02Rt00GroupD_Dummy.ClsdLoopDampgRackFX
    connect CalRegn02Rt00GroupD.ClsdLoopDampgRackFY -> AAACalRegn02Rt00GroupD_Dummy.ClsdLoopDampgRackFY
    connect CalRegn02Rt00GroupD.ClsdLoopHysDeltaY -> AAACalRegn02Rt00GroupD_Dummy.ClsdLoopHysDeltaY
    connect CalRegn02Rt00GroupD.ClsdLoopHysGainY -> AAACalRegn02Rt00GroupD_Dummy.ClsdLoopHysGainY
    connect CalRegn02Rt00GroupD.ClsdLoopHysHwAgBlndFac -> AAACalRegn02Rt00GroupD_Dummy.ClsdLoopHysHwAgBlndFac
    connect CalRegn02Rt00GroupD.ClsdLoopHysHwAgQuadBlndX -> AAACalRegn02Rt00GroupD_Dummy.ClsdLoopHysHwAgQuadBlndX
    connect CalRegn02Rt00GroupD.ClsdLoopHysHwAgQuadBlndY -> AAACalRegn02Rt00GroupD_Dummy.ClsdLoopHysHwAgQuadBlndY
    connect CalRegn02Rt00GroupD.ClsdLoopHysHwAgQuadQlfrX -> AAACalRegn02Rt00GroupD_Dummy.ClsdLoopHysHwAgQuadQlfrX
    connect CalRegn02Rt00GroupD.ClsdLoopHysHwAgQuadQlfrY -> AAACalRegn02Rt00GroupD_Dummy.ClsdLoopHysHwAgQuadQlfrY
    connect CalRegn02Rt00GroupD.ClsdLoopHysHwVelQuadBlndX -> AAACalRegn02Rt00GroupD_Dummy.ClsdLoopHysHwVelQuadBlndX
    connect CalRegn02Rt00GroupD.ClsdLoopHysHwVelQuadBlndY -> AAACalRegn02Rt00GroupD_Dummy.ClsdLoopHysHwVelQuadBlndY
    connect CalRegn02Rt00GroupD.ClsdLoopHysPolarity -> AAACalRegn02Rt00GroupD_Dummy.ClsdLoopHysPolarity
    connect CalRegn02Rt00GroupD.ClsdLoopHysRackFFacX -> AAACalRegn02Rt00GroupD_Dummy.ClsdLoopHysRackFFacX
    connect CalRegn02Rt00GroupD.ClsdLoopHysRackFFacY -> AAACalRegn02Rt00GroupD_Dummy.ClsdLoopHysRackFFacY
    connect CalRegn02Rt00GroupD.ClsdLoopHysRhoY -> AAACalRegn02Rt00GroupD_Dummy.ClsdLoopHysRhoY
    connect CalRegn02Rt00GroupD.ClsdLoopHysSteerInHwAgNegLowrLim -> AAACalRegn02Rt00GroupD_Dummy.ClsdLoopHysSteerInHwAgNegLowrLim
    connect CalRegn02Rt00GroupD.ClsdLoopHysSteerInHwAgNegUpprLim -> AAACalRegn02Rt00GroupD_Dummy.ClsdLoopHysSteerInHwAgNegUpprLim
    connect CalRegn02Rt00GroupD.ClsdLoopHysSteerInHwAgPosLowrLim -> AAACalRegn02Rt00GroupD_Dummy.ClsdLoopHysSteerInHwAgPosLowrLim
    connect CalRegn02Rt00GroupD.ClsdLoopHysSteerInHwAgPosUpprLim -> AAACalRegn02Rt00GroupD_Dummy.ClsdLoopHysSteerInHwAgPosUpprLim
    connect CalRegn02Rt00GroupD.ClsdLoopHysSteerOutHwAgNegLowrLim -> AAACalRegn02Rt00GroupD_Dummy.ClsdLoopHysSteerOutHwAgNegLowrLim
    connect CalRegn02Rt00GroupD.ClsdLoopHysSteerOutHwAgNegUpprLim -> AAACalRegn02Rt00GroupD_Dummy.ClsdLoopHysSteerOutHwAgNegUpprLim
    connect CalRegn02Rt00GroupD.ClsdLoopHysSteerOutHwAgPosLowrLim -> AAACalRegn02Rt00GroupD_Dummy.ClsdLoopHysSteerOutHwAgPosLowrLim
    connect CalRegn02Rt00GroupD.ClsdLoopHysSteerOutHwAgPosUpprLim -> AAACalRegn02Rt00GroupD_Dummy.ClsdLoopHysSteerOutHwAgPosUpprLim
    connect CalRegn02Rt00GroupD.ClsdLoopHysSysFricOffsLimX -> AAACalRegn02Rt00GroupD_Dummy.ClsdLoopHysSysFricOffsLimX
    connect CalRegn02Rt00GroupD.ClsdLoopHysSysFricOffsLimY -> AAACalRegn02Rt00GroupD_Dummy.ClsdLoopHysSysFricOffsLimY
    connect CalRegn02Rt00GroupD.ClsdLoopHysSysFricScaX -> AAACalRegn02Rt00GroupD_Dummy.ClsdLoopHysSysFricScaX
    connect CalRegn02Rt00GroupD.ClsdLoopHysSysFricScaY -> AAACalRegn02Rt00GroupD_Dummy.ClsdLoopHysSysFricScaY
    connect CalRegn02Rt00GroupD.EffortRackFX -> AAACalRegn02Rt00GroupD_Dummy.EffortRackFX
    connect CalRegn02Rt00GroupD.EffortRackFY -> AAACalRegn02Rt00GroupD_Dummy.EffortRackFY
    connect CalRegn02Rt00GroupD.EffortVehSpdBilnrSeln -> AAACalRegn02Rt00GroupD_Dummy.EffortVehSpdBilnrSeln
    connect CalRegn02Rt00GroupD.ClsdLoopDampgEotEntrX -> ClsdLoopDampg.ClsdLoopDampgEotEntrX
    connect CalRegn02Rt00GroupD.ClsdLoopDampgEotEntrY -> ClsdLoopDampg.ClsdLoopDampgEotEntrY
    connect CalRegn02Rt00GroupD.ClsdLoopDampgEotExitX -> ClsdLoopDampg.ClsdLoopDampgEotExitX
    connect CalRegn02Rt00GroupD.ClsdLoopDampgEotExitY -> ClsdLoopDampg.ClsdLoopDampgEotExitY
    connect CalRegn02Rt00GroupD.ClsdLoopDampgPinionVelX -> ClsdLoopDampg.ClsdLoopDampgPinionVelX
    connect CalRegn02Rt00GroupD.ClsdLoopDampgPinionVelY -> ClsdLoopDampg.ClsdLoopDampgPinionVelY
    connect CalRegn02Rt00GroupD.ClsdLoopDampgRackFX -> ClsdLoopDampg.ClsdLoopDampgRackFX
    connect CalRegn02Rt00GroupD.ClsdLoopDampgRackFY -> ClsdLoopDampg.ClsdLoopDampgRackFY
    connect CalRegn02Rt00GroupD.ClsdLoopHysDeltaY -> ClsdLoopHys.ClsdLoopHysDeltaY
    connect CalRegn02Rt00GroupD.ClsdLoopHysGainY -> ClsdLoopHys.ClsdLoopHysGainY
    connect CalRegn02Rt00GroupD.ClsdLoopHysHwAgBlndFac -> ClsdLoopHys.ClsdLoopHysHwAgBlndFac
    connect CalRegn02Rt00GroupD.ClsdLoopHysHwAgQuadBlndX -> ClsdLoopHys.ClsdLoopHysHwAgQuadBlndX
    connect CalRegn02Rt00GroupD.ClsdLoopHysHwAgQuadBlndY -> ClsdLoopHys.ClsdLoopHysHwAgQuadBlndY
    connect CalRegn02Rt00GroupD.ClsdLoopHysHwAgQuadQlfrX -> ClsdLoopHys.ClsdLoopHysHwAgQuadQlfrX
    connect CalRegn02Rt00GroupD.ClsdLoopHysHwAgQuadQlfrY -> ClsdLoopHys.ClsdLoopHysHwAgQuadQlfrY
    connect CalRegn02Rt00GroupD.ClsdLoopHysHwVelQuadBlndX -> ClsdLoopHys.ClsdLoopHysHwVelQuadBlndX
    connect CalRegn02Rt00GroupD.ClsdLoopHysHwVelQuadBlndY -> ClsdLoopHys.ClsdLoopHysHwVelQuadBlndY
    connect CalRegn02Rt00GroupD.ClsdLoopHysPolarity -> ClsdLoopHys.ClsdLoopHysPolarity
    connect CalRegn02Rt00GroupD.ClsdLoopHysRackFFacX -> ClsdLoopHys.ClsdLoopHysRackFFacX
    connect CalRegn02Rt00GroupD.ClsdLoopHysRackFFacY -> ClsdLoopHys.ClsdLoopHysRackFFacY
    connect CalRegn02Rt00GroupD.ClsdLoopHysRhoY -> ClsdLoopHys.ClsdLoopHysRhoY
    connect CalRegn02Rt00GroupD.ClsdLoopHysSteerInHwAgNegLowrLim -> ClsdLoopHys.ClsdLoopHysSteerInHwAgNegLowrLim
    connect CalRegn02Rt00GroupD.ClsdLoopHysSteerInHwAgNegUpprLim -> ClsdLoopHys.ClsdLoopHysSteerInHwAgNegUpprLim
    connect CalRegn02Rt00GroupD.ClsdLoopHysSteerInHwAgPosLowrLim -> ClsdLoopHys.ClsdLoopHysSteerInHwAgPosLowrLim
    connect CalRegn02Rt00GroupD.ClsdLoopHysSteerInHwAgPosUpprLim -> ClsdLoopHys.ClsdLoopHysSteerInHwAgPosUpprLim
    connect CalRegn02Rt00GroupD.ClsdLoopHysSteerOutHwAgNegLowrLim -> ClsdLoopHys.ClsdLoopHysSteerOutHwAgNegLowrLim
    connect CalRegn02Rt00GroupD.ClsdLoopHysSteerOutHwAgNegUpprLim -> ClsdLoopHys.ClsdLoopHysSteerOutHwAgNegUpprLim
    connect CalRegn02Rt00GroupD.ClsdLoopHysSteerOutHwAgPosLowrLim -> ClsdLoopHys.ClsdLoopHysSteerOutHwAgPosLowrLim
    connect CalRegn02Rt00GroupD.ClsdLoopHysSteerOutHwAgPosUpprLim -> ClsdLoopHys.ClsdLoopHysSteerOutHwAgPosUpprLim
    connect CalRegn02Rt00GroupD.ClsdLoopHysSysFricOffsLimX -> ClsdLoopHys.ClsdLoopHysSysFricOffsLimX
    connect CalRegn02Rt00GroupD.ClsdLoopHysSysFricOffsLimY -> ClsdLoopHys.ClsdLoopHysSysFricOffsLimY
    connect CalRegn02Rt00GroupD.ClsdLoopHysSysFricScaX -> ClsdLoopHys.ClsdLoopHysSysFricScaX
    connect CalRegn02Rt00GroupD.ClsdLoopHysSysFricScaY -> ClsdLoopHys.ClsdLoopHysSysFricScaY
    connect CalRegn02Rt00GroupD.EffortRackFX -> Effort.EffortRackFX
    connect CalRegn02Rt00GroupD.EffortRackFY -> Effort.EffortRackFY
    connect CalRegn02Rt00GroupD.EffortVehSpdBilnrSeln -> Effort.EffortVehSpdBilnrSeln
    connect CalRegn02Rt01.BmwStReqMgrAllwToOffThd -> AAACalRegn02Rt01_Dummy.BmwStReqMgrAllwToOffThd
    connect CalRegn02Rt01.BmwStReqMgrStsDrvrActvyTqChgThd -> AAACalRegn02Rt01_Dummy.BmwStReqMgrStsDrvrActvyTqChgThd
    connect CalRegn02Rt01GroupA.BmwPwrPrkgDampgBasPwrPrkgDampgY -> AAACalRegn02Rt01GroupA_Dummy.BmwPwrPrkgDampgBasPwrPrkgDampgY
    connect CalRegn02Rt01GroupA.BmwPwrPrkgDampgHwVelTblX -> AAACalRegn02Rt01GroupA_Dummy.BmwPwrPrkgDampgHwVelTblX
    connect CalRegn02Rt01GroupA.BmwPwrPrkgDampgPinionAgSelnTbl -> AAACalRegn02Rt01GroupA_Dummy.BmwPwrPrkgDampgPinionAgSelnTbl
    connect CalRegn02Rt01GroupA.BmwPwrPrkgDampgVehSpdLnrSelnX -> AAACalRegn02Rt01GroupA_Dummy.BmwPwrPrkgDampgVehSpdLnrSelnX
    connect CalRegn02Rt01GroupA.BmwPwrPrkgDampgVehSpdScaFacY -> AAACalRegn02Rt01GroupA_Dummy.BmwPwrPrkgDampgVehSpdScaFacY
    connect CalRegn02Rt01GroupA.BmwStReqMgrDrvrActvTmrThd -> AAACalRegn02Rt01GroupA_Dummy.BmwStReqMgrDrvrActvTmrThd
    connect CalRegn02Rt01GroupA.BmwStReqMgrHwTqThd -> AAACalRegn02Rt01GroupA_Dummy.BmwStReqMgrHwTqThd
    connect CalRegn02Rt01GroupA.BmwStReqMgrOperRampRate -> AAACalRegn02Rt01GroupA_Dummy.BmwStReqMgrOperRampRate
    connect CalRegn02Rt01GroupA.BmwStReqMgrSwtOffSpdLim -> AAACalRegn02Rt01GroupA_Dummy.BmwStReqMgrSwtOffSpdLim
    connect CalRegn02Rt01GroupA.BmwStReqMgrSysProtnRednFacThd -> AAACalRegn02Rt01GroupA_Dummy.BmwStReqMgrSysProtnRednFacThd
    connect CalRegn02Rt01GroupC.CtrldVelRtnDampgX -> AAACalRegn02Rt01GroupC_Dummy.CtrldVelRtnDampgX
    connect CalRegn02Rt01GroupC.CtrldVelRtnDampgY -> AAACalRegn02Rt01GroupC_Dummy.CtrldVelRtnDampgY
    connect CalRegn02Rt01GroupC.CtrldVelRtnDesVelScaX -> AAACalRegn02Rt01GroupC_Dummy.CtrldVelRtnDesVelScaX
    connect CalRegn02Rt01GroupC.CtrldVelRtnDesVelScaY -> AAACalRegn02Rt01GroupC_Dummy.CtrldVelRtnDesVelScaY
    connect CalRegn02Rt01GroupC.CtrldVelRtnDesVelX -> AAACalRegn02Rt01GroupC_Dummy.CtrldVelRtnDesVelX
    connect CalRegn02Rt01GroupC.CtrldVelRtnDesVelY -> AAACalRegn02Rt01GroupC_Dummy.CtrldVelRtnDesVelY
    connect CalRegn02Rt01GroupC.CtrldVelRtnHwPosnScaX -> AAACalRegn02Rt01GroupC_Dummy.CtrldVelRtnHwPosnScaX
    connect CalRegn02Rt01GroupC.CtrldVelRtnHwPosnScaY -> AAACalRegn02Rt01GroupC_Dummy.CtrldVelRtnHwPosnScaY
    connect CalRegn02Rt01GroupC.CtrldVelRtnHwTqSca1X -> AAACalRegn02Rt01GroupC_Dummy.CtrldVelRtnHwTqSca1X
    connect CalRegn02Rt01GroupC.CtrldVelRtnHwTqSca1Y -> AAACalRegn02Rt01GroupC_Dummy.CtrldVelRtnHwTqSca1Y
    connect CalRegn02Rt01GroupC.CtrldVelRtnHwTqSca2X -> AAACalRegn02Rt01GroupC_Dummy.CtrldVelRtnHwTqSca2X
    connect CalRegn02Rt01GroupC.CtrldVelRtnHwTqSca2Y -> AAACalRegn02Rt01GroupC_Dummy.CtrldVelRtnHwTqSca2Y
    connect CalRegn02Rt01GroupC.CtrldVelRtnIntglGain -> AAACalRegn02Rt01GroupC_Dummy.CtrldVelRtnIntglGain
    connect CalRegn02Rt01GroupC.CtrldVelRtnPinionTqScaX -> AAACalRegn02Rt01GroupC_Dummy.CtrldVelRtnPinionTqScaX
    connect CalRegn02Rt01GroupC.CtrldVelRtnPinionTqScaY -> AAACalRegn02Rt01GroupC_Dummy.CtrldVelRtnPinionTqScaY
    connect CalRegn02Rt01GroupC.CtrldVelRtnPropGain -> AAACalRegn02Rt01GroupC_Dummy.CtrldVelRtnPropGain
    connect CalRegn02Rt01GroupC.CtrldVelRtnTqGrdtScaX -> AAACalRegn02Rt01GroupC_Dummy.CtrldVelRtnTqGrdtScaX
    connect CalRegn02Rt01GroupC.CtrldVelRtnTqGrdtScaY -> AAACalRegn02Rt01GroupC_Dummy.CtrldVelRtnTqGrdtScaY
    connect CalRegn02Rt01GroupC.CtrldVelRtnVehSpdScaBilnrSeln -> AAACalRegn02Rt01GroupC_Dummy.CtrldVelRtnVehSpdScaBilnrSeln
    connect CalRegn02Rt01GroupC.CtrldVelRtnVelErrScaBilnrSeln -> AAACalRegn02Rt01GroupC_Dummy.CtrldVelRtnVelErrScaBilnrSeln
    connect CalRegn02Rt01GroupC.CtrldVelRtnVelErrScaEna -> AAACalRegn02Rt01GroupC_Dummy.CtrldVelRtnVelErrScaEna
    connect CalRegn02Rt01GroupC.CtrldVelRtnVelErrScaX -> AAACalRegn02Rt01GroupC_Dummy.CtrldVelRtnVelErrScaX
    connect CalRegn02Rt01GroupC.CtrldVelRtnVelErrScaY -> AAACalRegn02Rt01GroupC_Dummy.CtrldVelRtnVelErrScaY
    connect CalRegn02Rt01GroupC.CtrldVelRtnVelErrVehSpdScaY -> AAACalRegn02Rt01GroupC_Dummy.CtrldVelRtnVelErrVehSpdScaY
    connect CalRegn02Rt01GroupC.CtrldVelRtnVelSpdTbl -> AAACalRegn02Rt01GroupC_Dummy.CtrldVelRtnVelSpdTbl
    connect CalRegn02Rt01GroupD.ClsdLoopDampgEotEntrX -> AAACalRegn02Rt01GroupD_Dummy.ClsdLoopDampgEotEntrX
    connect CalRegn02Rt01GroupD.ClsdLoopDampgEotEntrY -> AAACalRegn02Rt01GroupD_Dummy.ClsdLoopDampgEotEntrY
    connect CalRegn02Rt01GroupD.ClsdLoopDampgEotExitX -> AAACalRegn02Rt01GroupD_Dummy.ClsdLoopDampgEotExitX
    connect CalRegn02Rt01GroupD.ClsdLoopDampgEotExitY -> AAACalRegn02Rt01GroupD_Dummy.ClsdLoopDampgEotExitY
    connect CalRegn02Rt01GroupD.ClsdLoopDampgPinionVelX -> AAACalRegn02Rt01GroupD_Dummy.ClsdLoopDampgPinionVelX
    connect CalRegn02Rt01GroupD.ClsdLoopDampgPinionVelY -> AAACalRegn02Rt01GroupD_Dummy.ClsdLoopDampgPinionVelY
    connect CalRegn02Rt01GroupD.ClsdLoopDampgRackFX -> AAACalRegn02Rt01GroupD_Dummy.ClsdLoopDampgRackFX
    connect CalRegn02Rt01GroupD.ClsdLoopDampgRackFY -> AAACalRegn02Rt01GroupD_Dummy.ClsdLoopDampgRackFY
    connect CalRegn02Rt01GroupD.ClsdLoopHysDeltaY -> AAACalRegn02Rt01GroupD_Dummy.ClsdLoopHysDeltaY
    connect CalRegn02Rt01GroupD.ClsdLoopHysGainY -> AAACalRegn02Rt01GroupD_Dummy.ClsdLoopHysGainY
    connect CalRegn02Rt01GroupD.ClsdLoopHysHwAgBlndFac -> AAACalRegn02Rt01GroupD_Dummy.ClsdLoopHysHwAgBlndFac
    connect CalRegn02Rt01GroupD.ClsdLoopHysHwAgQuadBlndX -> AAACalRegn02Rt01GroupD_Dummy.ClsdLoopHysHwAgQuadBlndX
    connect CalRegn02Rt01GroupD.ClsdLoopHysHwAgQuadBlndY -> AAACalRegn02Rt01GroupD_Dummy.ClsdLoopHysHwAgQuadBlndY
    connect CalRegn02Rt01GroupD.ClsdLoopHysHwAgQuadQlfrX -> AAACalRegn02Rt01GroupD_Dummy.ClsdLoopHysHwAgQuadQlfrX
    connect CalRegn02Rt01GroupD.ClsdLoopHysHwAgQuadQlfrY -> AAACalRegn02Rt01GroupD_Dummy.ClsdLoopHysHwAgQuadQlfrY
    connect CalRegn02Rt01GroupD.ClsdLoopHysHwVelQuadBlndX -> AAACalRegn02Rt01GroupD_Dummy.ClsdLoopHysHwVelQuadBlndX
    connect CalRegn02Rt01GroupD.ClsdLoopHysHwVelQuadBlndY -> AAACalRegn02Rt01GroupD_Dummy.ClsdLoopHysHwVelQuadBlndY
    connect CalRegn02Rt01GroupD.ClsdLoopHysPolarity -> AAACalRegn02Rt01GroupD_Dummy.ClsdLoopHysPolarity
    connect CalRegn02Rt01GroupD.ClsdLoopHysRackFFacX -> AAACalRegn02Rt01GroupD_Dummy.ClsdLoopHysRackFFacX
    connect CalRegn02Rt01GroupD.ClsdLoopHysRackFFacY -> AAACalRegn02Rt01GroupD_Dummy.ClsdLoopHysRackFFacY
    connect CalRegn02Rt01GroupD.ClsdLoopHysRhoY -> AAACalRegn02Rt01GroupD_Dummy.ClsdLoopHysRhoY
    connect CalRegn02Rt01GroupD.ClsdLoopHysSteerInHwAgNegLowrLim -> AAACalRegn02Rt01GroupD_Dummy.ClsdLoopHysSteerInHwAgNegLowrLim
    connect CalRegn02Rt01GroupD.ClsdLoopHysSteerInHwAgNegUpprLim -> AAACalRegn02Rt01GroupD_Dummy.ClsdLoopHysSteerInHwAgNegUpprLim
    connect CalRegn02Rt01GroupD.ClsdLoopHysSteerInHwAgPosLowrLim -> AAACalRegn02Rt01GroupD_Dummy.ClsdLoopHysSteerInHwAgPosLowrLim
    connect CalRegn02Rt01GroupD.ClsdLoopHysSteerInHwAgPosUpprLim -> AAACalRegn02Rt01GroupD_Dummy.ClsdLoopHysSteerInHwAgPosUpprLim
    connect CalRegn02Rt01GroupD.ClsdLoopHysSteerOutHwAgNegLowrLim -> AAACalRegn02Rt01GroupD_Dummy.ClsdLoopHysSteerOutHwAgNegLowrLim
    connect CalRegn02Rt01GroupD.ClsdLoopHysSteerOutHwAgNegUpprLim -> AAACalRegn02Rt01GroupD_Dummy.ClsdLoopHysSteerOutHwAgNegUpprLim
    connect CalRegn02Rt01GroupD.ClsdLoopHysSteerOutHwAgPosLowrLim -> AAACalRegn02Rt01GroupD_Dummy.ClsdLoopHysSteerOutHwAgPosLowrLim
    connect CalRegn02Rt01GroupD.ClsdLoopHysSteerOutHwAgPosUpprLim -> AAACalRegn02Rt01GroupD_Dummy.ClsdLoopHysSteerOutHwAgPosUpprLim
    connect CalRegn02Rt01GroupD.ClsdLoopHysSysFricOffsLimX -> AAACalRegn02Rt01GroupD_Dummy.ClsdLoopHysSysFricOffsLimX
    connect CalRegn02Rt01GroupD.ClsdLoopHysSysFricOffsLimY -> AAACalRegn02Rt01GroupD_Dummy.ClsdLoopHysSysFricOffsLimY
    connect CalRegn02Rt01GroupD.ClsdLoopHysSysFricScaX -> AAACalRegn02Rt01GroupD_Dummy.ClsdLoopHysSysFricScaX
    connect CalRegn02Rt01GroupD.ClsdLoopHysSysFricScaY -> AAACalRegn02Rt01GroupD_Dummy.ClsdLoopHysSysFricScaY
    connect CalRegn02Rt01GroupD.EffortRackFX -> AAACalRegn02Rt01GroupD_Dummy.EffortRackFX
    connect CalRegn02Rt01GroupD.EffortRackFY -> AAACalRegn02Rt01GroupD_Dummy.EffortRackFY
    connect CalRegn02Rt01GroupD.EffortVehSpdBilnrSeln -> AAACalRegn02Rt01GroupD_Dummy.EffortVehSpdBilnrSeln
    connect CalRegn02Rt02.BmwStReqMgrAllwToOffThd -> AAACalRegn02Rt02_Dummy.BmwStReqMgrAllwToOffThd
    connect CalRegn02Rt02.BmwStReqMgrStsDrvrActvyTqChgThd -> AAACalRegn02Rt02_Dummy.BmwStReqMgrStsDrvrActvyTqChgThd
    connect CalRegn02Rt02GroupA.BmwPwrPrkgDampgBasPwrPrkgDampgY -> AAACalRegn02Rt02GroupA_Dummy.BmwPwrPrkgDampgBasPwrPrkgDampgY
    connect CalRegn02Rt02GroupA.BmwPwrPrkgDampgHwVelTblX -> AAACalRegn02Rt02GroupA_Dummy.BmwPwrPrkgDampgHwVelTblX
    connect CalRegn02Rt02GroupA.BmwPwrPrkgDampgPinionAgSelnTbl -> AAACalRegn02Rt02GroupA_Dummy.BmwPwrPrkgDampgPinionAgSelnTbl
    connect CalRegn02Rt02GroupA.BmwPwrPrkgDampgVehSpdLnrSelnX -> AAACalRegn02Rt02GroupA_Dummy.BmwPwrPrkgDampgVehSpdLnrSelnX
    connect CalRegn02Rt02GroupA.BmwPwrPrkgDampgVehSpdScaFacY -> AAACalRegn02Rt02GroupA_Dummy.BmwPwrPrkgDampgVehSpdScaFacY
    connect CalRegn02Rt02GroupA.BmwStReqMgrDrvrActvTmrThd -> AAACalRegn02Rt02GroupA_Dummy.BmwStReqMgrDrvrActvTmrThd
    connect CalRegn02Rt02GroupA.BmwStReqMgrHwTqThd -> AAACalRegn02Rt02GroupA_Dummy.BmwStReqMgrHwTqThd
    connect CalRegn02Rt02GroupA.BmwStReqMgrOperRampRate -> AAACalRegn02Rt02GroupA_Dummy.BmwStReqMgrOperRampRate
    connect CalRegn02Rt02GroupA.BmwStReqMgrSwtOffSpdLim -> AAACalRegn02Rt02GroupA_Dummy.BmwStReqMgrSwtOffSpdLim
    connect CalRegn02Rt02GroupA.BmwStReqMgrSysProtnRednFacThd -> AAACalRegn02Rt02GroupA_Dummy.BmwStReqMgrSysProtnRednFacThd
    connect CalRegn02Rt02GroupC.CtrldVelRtnDampgX -> AAACalRegn02Rt02GroupC_Dummy.CtrldVelRtnDampgX
    connect CalRegn02Rt02GroupC.CtrldVelRtnDampgY -> AAACalRegn02Rt02GroupC_Dummy.CtrldVelRtnDampgY
    connect CalRegn02Rt02GroupC.CtrldVelRtnDesVelScaX -> AAACalRegn02Rt02GroupC_Dummy.CtrldVelRtnDesVelScaX
    connect CalRegn02Rt02GroupC.CtrldVelRtnDesVelScaY -> AAACalRegn02Rt02GroupC_Dummy.CtrldVelRtnDesVelScaY
    connect CalRegn02Rt02GroupC.CtrldVelRtnDesVelX -> AAACalRegn02Rt02GroupC_Dummy.CtrldVelRtnDesVelX
    connect CalRegn02Rt02GroupC.CtrldVelRtnDesVelY -> AAACalRegn02Rt02GroupC_Dummy.CtrldVelRtnDesVelY
    connect CalRegn02Rt02GroupC.CtrldVelRtnHwPosnScaX -> AAACalRegn02Rt02GroupC_Dummy.CtrldVelRtnHwPosnScaX
    connect CalRegn02Rt02GroupC.CtrldVelRtnHwPosnScaY -> AAACalRegn02Rt02GroupC_Dummy.CtrldVelRtnHwPosnScaY
    connect CalRegn02Rt02GroupC.CtrldVelRtnHwTqSca1X -> AAACalRegn02Rt02GroupC_Dummy.CtrldVelRtnHwTqSca1X
    connect CalRegn02Rt02GroupC.CtrldVelRtnHwTqSca1Y -> AAACalRegn02Rt02GroupC_Dummy.CtrldVelRtnHwTqSca1Y
    connect CalRegn02Rt02GroupC.CtrldVelRtnHwTqSca2X -> AAACalRegn02Rt02GroupC_Dummy.CtrldVelRtnHwTqSca2X
    connect CalRegn02Rt02GroupC.CtrldVelRtnHwTqSca2Y -> AAACalRegn02Rt02GroupC_Dummy.CtrldVelRtnHwTqSca2Y
    connect CalRegn02Rt02GroupC.CtrldVelRtnIntglGain -> AAACalRegn02Rt02GroupC_Dummy.CtrldVelRtnIntglGain
    connect CalRegn02Rt02GroupC.CtrldVelRtnPinionTqScaX -> AAACalRegn02Rt02GroupC_Dummy.CtrldVelRtnPinionTqScaX
    connect CalRegn02Rt02GroupC.CtrldVelRtnPinionTqScaY -> AAACalRegn02Rt02GroupC_Dummy.CtrldVelRtnPinionTqScaY
    connect CalRegn02Rt02GroupC.CtrldVelRtnPropGain -> AAACalRegn02Rt02GroupC_Dummy.CtrldVelRtnPropGain
    connect CalRegn02Rt02GroupC.CtrldVelRtnTqGrdtScaX -> AAACalRegn02Rt02GroupC_Dummy.CtrldVelRtnTqGrdtScaX
    connect CalRegn02Rt02GroupC.CtrldVelRtnTqGrdtScaY -> AAACalRegn02Rt02GroupC_Dummy.CtrldVelRtnTqGrdtScaY
    connect CalRegn02Rt02GroupC.CtrldVelRtnVehSpdScaBilnrSeln -> AAACalRegn02Rt02GroupC_Dummy.CtrldVelRtnVehSpdScaBilnrSeln
    connect CalRegn02Rt02GroupC.CtrldVelRtnVelErrScaBilnrSeln -> AAACalRegn02Rt02GroupC_Dummy.CtrldVelRtnVelErrScaBilnrSeln
    connect CalRegn02Rt02GroupC.CtrldVelRtnVelErrScaEna -> AAACalRegn02Rt02GroupC_Dummy.CtrldVelRtnVelErrScaEna
    connect CalRegn02Rt02GroupC.CtrldVelRtnVelErrScaX -> AAACalRegn02Rt02GroupC_Dummy.CtrldVelRtnVelErrScaX
    connect CalRegn02Rt02GroupC.CtrldVelRtnVelErrScaY -> AAACalRegn02Rt02GroupC_Dummy.CtrldVelRtnVelErrScaY
    connect CalRegn02Rt02GroupC.CtrldVelRtnVelErrVehSpdScaY -> AAACalRegn02Rt02GroupC_Dummy.CtrldVelRtnVelErrVehSpdScaY
    connect CalRegn02Rt02GroupC.CtrldVelRtnVelSpdTbl -> AAACalRegn02Rt02GroupC_Dummy.CtrldVelRtnVelSpdTbl
    connect CalRegn02Rt02GroupD.ClsdLoopDampgEotEntrX -> AAACalRegn02Rt02GroupD_Dummy.ClsdLoopDampgEotEntrX
    connect CalRegn02Rt02GroupD.ClsdLoopDampgEotEntrY -> AAACalRegn02Rt02GroupD_Dummy.ClsdLoopDampgEotEntrY
    connect CalRegn02Rt02GroupD.ClsdLoopDampgEotExitX -> AAACalRegn02Rt02GroupD_Dummy.ClsdLoopDampgEotExitX
    connect CalRegn02Rt02GroupD.ClsdLoopDampgEotExitY -> AAACalRegn02Rt02GroupD_Dummy.ClsdLoopDampgEotExitY
    connect CalRegn02Rt02GroupD.ClsdLoopDampgPinionVelX -> AAACalRegn02Rt02GroupD_Dummy.ClsdLoopDampgPinionVelX
    connect CalRegn02Rt02GroupD.ClsdLoopDampgPinionVelY -> AAACalRegn02Rt02GroupD_Dummy.ClsdLoopDampgPinionVelY
    connect CalRegn02Rt02GroupD.ClsdLoopDampgRackFX -> AAACalRegn02Rt02GroupD_Dummy.ClsdLoopDampgRackFX
    connect CalRegn02Rt02GroupD.ClsdLoopDampgRackFY -> AAACalRegn02Rt02GroupD_Dummy.ClsdLoopDampgRackFY
    connect CalRegn02Rt02GroupD.ClsdLoopHysDeltaY -> AAACalRegn02Rt02GroupD_Dummy.ClsdLoopHysDeltaY
    connect CalRegn02Rt02GroupD.ClsdLoopHysGainY -> AAACalRegn02Rt02GroupD_Dummy.ClsdLoopHysGainY
    connect CalRegn02Rt02GroupD.ClsdLoopHysHwAgBlndFac -> AAACalRegn02Rt02GroupD_Dummy.ClsdLoopHysHwAgBlndFac
    connect CalRegn02Rt02GroupD.ClsdLoopHysHwAgQuadBlndX -> AAACalRegn02Rt02GroupD_Dummy.ClsdLoopHysHwAgQuadBlndX
    connect CalRegn02Rt02GroupD.ClsdLoopHysHwAgQuadBlndY -> AAACalRegn02Rt02GroupD_Dummy.ClsdLoopHysHwAgQuadBlndY
    connect CalRegn02Rt02GroupD.ClsdLoopHysHwAgQuadQlfrX -> AAACalRegn02Rt02GroupD_Dummy.ClsdLoopHysHwAgQuadQlfrX
    connect CalRegn02Rt02GroupD.ClsdLoopHysHwAgQuadQlfrY -> AAACalRegn02Rt02GroupD_Dummy.ClsdLoopHysHwAgQuadQlfrY
    connect CalRegn02Rt02GroupD.ClsdLoopHysHwVelQuadBlndX -> AAACalRegn02Rt02GroupD_Dummy.ClsdLoopHysHwVelQuadBlndX
    connect CalRegn02Rt02GroupD.ClsdLoopHysHwVelQuadBlndY -> AAACalRegn02Rt02GroupD_Dummy.ClsdLoopHysHwVelQuadBlndY
    connect CalRegn02Rt02GroupD.ClsdLoopHysPolarity -> AAACalRegn02Rt02GroupD_Dummy.ClsdLoopHysPolarity
    connect CalRegn02Rt02GroupD.ClsdLoopHysRackFFacX -> AAACalRegn02Rt02GroupD_Dummy.ClsdLoopHysRackFFacX
    connect CalRegn02Rt02GroupD.ClsdLoopHysRackFFacY -> AAACalRegn02Rt02GroupD_Dummy.ClsdLoopHysRackFFacY
    connect CalRegn02Rt02GroupD.ClsdLoopHysRhoY -> AAACalRegn02Rt02GroupD_Dummy.ClsdLoopHysRhoY
    connect CalRegn02Rt02GroupD.ClsdLoopHysSteerInHwAgNegLowrLim -> AAACalRegn02Rt02GroupD_Dummy.ClsdLoopHysSteerInHwAgNegLowrLim
    connect CalRegn02Rt02GroupD.ClsdLoopHysSteerInHwAgNegUpprLim -> AAACalRegn02Rt02GroupD_Dummy.ClsdLoopHysSteerInHwAgNegUpprLim
    connect CalRegn02Rt02GroupD.ClsdLoopHysSteerInHwAgPosLowrLim -> AAACalRegn02Rt02GroupD_Dummy.ClsdLoopHysSteerInHwAgPosLowrLim
    connect CalRegn02Rt02GroupD.ClsdLoopHysSteerInHwAgPosUpprLim -> AAACalRegn02Rt02GroupD_Dummy.ClsdLoopHysSteerInHwAgPosUpprLim
    connect CalRegn02Rt02GroupD.ClsdLoopHysSteerOutHwAgNegLowrLim -> AAACalRegn02Rt02GroupD_Dummy.ClsdLoopHysSteerOutHwAgNegLowrLim
    connect CalRegn02Rt02GroupD.ClsdLoopHysSteerOutHwAgNegUpprLim -> AAACalRegn02Rt02GroupD_Dummy.ClsdLoopHysSteerOutHwAgNegUpprLim
    connect CalRegn02Rt02GroupD.ClsdLoopHysSteerOutHwAgPosLowrLim -> AAACalRegn02Rt02GroupD_Dummy.ClsdLoopHysSteerOutHwAgPosLowrLim
    connect CalRegn02Rt02GroupD.ClsdLoopHysSteerOutHwAgPosUpprLim -> AAACalRegn02Rt02GroupD_Dummy.ClsdLoopHysSteerOutHwAgPosUpprLim
    connect CalRegn02Rt02GroupD.ClsdLoopHysSysFricOffsLimX -> AAACalRegn02Rt02GroupD_Dummy.ClsdLoopHysSysFricOffsLimX
    connect CalRegn02Rt02GroupD.ClsdLoopHysSysFricOffsLimY -> AAACalRegn02Rt02GroupD_Dummy.ClsdLoopHysSysFricOffsLimY
    connect CalRegn02Rt02GroupD.ClsdLoopHysSysFricScaX -> AAACalRegn02Rt02GroupD_Dummy.ClsdLoopHysSysFricScaX
    connect CalRegn02Rt02GroupD.ClsdLoopHysSysFricScaY -> AAACalRegn02Rt02GroupD_Dummy.ClsdLoopHysSysFricScaY
    connect CalRegn02Rt02GroupD.EffortRackFX -> AAACalRegn02Rt02GroupD_Dummy.EffortRackFX
    connect CalRegn02Rt02GroupD.EffortRackFY -> AAACalRegn02Rt02GroupD_Dummy.EffortRackFY
    connect CalRegn02Rt02GroupD.EffortVehSpdBilnrSeln -> AAACalRegn02Rt02GroupD_Dummy.EffortVehSpdBilnrSeln
    connect CalRegn02Rt03.BmwStReqMgrAllwToOffThd -> AAACalRegn02Rt03_Dummy.BmwStReqMgrAllwToOffThd
    connect CalRegn02Rt03.BmwStReqMgrStsDrvrActvyTqChgThd -> AAACalRegn02Rt03_Dummy.BmwStReqMgrStsDrvrActvyTqChgThd
    connect CalRegn02Rt03GroupA.BmwPwrPrkgDampgBasPwrPrkgDampgY -> AAACalRegn02Rt03GroupA_Dummy.BmwPwrPrkgDampgBasPwrPrkgDampgY
    connect CalRegn02Rt03GroupA.BmwPwrPrkgDampgHwVelTblX -> AAACalRegn02Rt03GroupA_Dummy.BmwPwrPrkgDampgHwVelTblX
    connect CalRegn02Rt03GroupA.BmwPwrPrkgDampgPinionAgSelnTbl -> AAACalRegn02Rt03GroupA_Dummy.BmwPwrPrkgDampgPinionAgSelnTbl
    connect CalRegn02Rt03GroupA.BmwPwrPrkgDampgVehSpdLnrSelnX -> AAACalRegn02Rt03GroupA_Dummy.BmwPwrPrkgDampgVehSpdLnrSelnX
    connect CalRegn02Rt03GroupA.BmwPwrPrkgDampgVehSpdScaFacY -> AAACalRegn02Rt03GroupA_Dummy.BmwPwrPrkgDampgVehSpdScaFacY
    connect CalRegn02Rt03GroupA.BmwStReqMgrDrvrActvTmrThd -> AAACalRegn02Rt03GroupA_Dummy.BmwStReqMgrDrvrActvTmrThd
    connect CalRegn02Rt03GroupA.BmwStReqMgrHwTqThd -> AAACalRegn02Rt03GroupA_Dummy.BmwStReqMgrHwTqThd
    connect CalRegn02Rt03GroupA.BmwStReqMgrOperRampRate -> AAACalRegn02Rt03GroupA_Dummy.BmwStReqMgrOperRampRate
    connect CalRegn02Rt03GroupA.BmwStReqMgrSwtOffSpdLim -> AAACalRegn02Rt03GroupA_Dummy.BmwStReqMgrSwtOffSpdLim
    connect CalRegn02Rt03GroupA.BmwStReqMgrSysProtnRednFacThd -> AAACalRegn02Rt03GroupA_Dummy.BmwStReqMgrSysProtnRednFacThd
    connect CalRegn02Rt03GroupC.CtrldVelRtnDampgX -> AAACalRegn02Rt03GroupC_Dummy.CtrldVelRtnDampgX
    connect CalRegn02Rt03GroupC.CtrldVelRtnDampgY -> AAACalRegn02Rt03GroupC_Dummy.CtrldVelRtnDampgY
    connect CalRegn02Rt03GroupC.CtrldVelRtnDesVelScaX -> AAACalRegn02Rt03GroupC_Dummy.CtrldVelRtnDesVelScaX
    connect CalRegn02Rt03GroupC.CtrldVelRtnDesVelScaY -> AAACalRegn02Rt03GroupC_Dummy.CtrldVelRtnDesVelScaY
    connect CalRegn02Rt03GroupC.CtrldVelRtnDesVelX -> AAACalRegn02Rt03GroupC_Dummy.CtrldVelRtnDesVelX
    connect CalRegn02Rt03GroupC.CtrldVelRtnDesVelY -> AAACalRegn02Rt03GroupC_Dummy.CtrldVelRtnDesVelY
    connect CalRegn02Rt03GroupC.CtrldVelRtnHwPosnScaX -> AAACalRegn02Rt03GroupC_Dummy.CtrldVelRtnHwPosnScaX
    connect CalRegn02Rt03GroupC.CtrldVelRtnHwPosnScaY -> AAACalRegn02Rt03GroupC_Dummy.CtrldVelRtnHwPosnScaY
    connect CalRegn02Rt03GroupC.CtrldVelRtnHwTqSca1X -> AAACalRegn02Rt03GroupC_Dummy.CtrldVelRtnHwTqSca1X
    connect CalRegn02Rt03GroupC.CtrldVelRtnHwTqSca1Y -> AAACalRegn02Rt03GroupC_Dummy.CtrldVelRtnHwTqSca1Y
    connect CalRegn02Rt03GroupC.CtrldVelRtnHwTqSca2X -> AAACalRegn02Rt03GroupC_Dummy.CtrldVelRtnHwTqSca2X
    connect CalRegn02Rt03GroupC.CtrldVelRtnHwTqSca2Y -> AAACalRegn02Rt03GroupC_Dummy.CtrldVelRtnHwTqSca2Y
    connect CalRegn02Rt03GroupC.CtrldVelRtnIntglGain -> AAACalRegn02Rt03GroupC_Dummy.CtrldVelRtnIntglGain
    connect CalRegn02Rt03GroupC.CtrldVelRtnPinionTqScaX -> AAACalRegn02Rt03GroupC_Dummy.CtrldVelRtnPinionTqScaX
    connect CalRegn02Rt03GroupC.CtrldVelRtnPinionTqScaY -> AAACalRegn02Rt03GroupC_Dummy.CtrldVelRtnPinionTqScaY
    connect CalRegn02Rt03GroupC.CtrldVelRtnPropGain -> AAACalRegn02Rt03GroupC_Dummy.CtrldVelRtnPropGain
    connect CalRegn02Rt03GroupC.CtrldVelRtnTqGrdtScaX -> AAACalRegn02Rt03GroupC_Dummy.CtrldVelRtnTqGrdtScaX
    connect CalRegn02Rt03GroupC.CtrldVelRtnTqGrdtScaY -> AAACalRegn02Rt03GroupC_Dummy.CtrldVelRtnTqGrdtScaY
    connect CalRegn02Rt03GroupC.CtrldVelRtnVehSpdScaBilnrSeln -> AAACalRegn02Rt03GroupC_Dummy.CtrldVelRtnVehSpdScaBilnrSeln
    connect CalRegn02Rt03GroupC.CtrldVelRtnVelErrScaBilnrSeln -> AAACalRegn02Rt03GroupC_Dummy.CtrldVelRtnVelErrScaBilnrSeln
    connect CalRegn02Rt03GroupC.CtrldVelRtnVelErrScaEna -> AAACalRegn02Rt03GroupC_Dummy.CtrldVelRtnVelErrScaEna
    connect CalRegn02Rt03GroupC.CtrldVelRtnVelErrScaX -> AAACalRegn02Rt03GroupC_Dummy.CtrldVelRtnVelErrScaX
    connect CalRegn02Rt03GroupC.CtrldVelRtnVelErrScaY -> AAACalRegn02Rt03GroupC_Dummy.CtrldVelRtnVelErrScaY
    connect CalRegn02Rt03GroupC.CtrldVelRtnVelErrVehSpdScaY -> AAACalRegn02Rt03GroupC_Dummy.CtrldVelRtnVelErrVehSpdScaY
    connect CalRegn02Rt03GroupC.CtrldVelRtnVelSpdTbl -> AAACalRegn02Rt03GroupC_Dummy.CtrldVelRtnVelSpdTbl
    connect CalRegn02Rt03GroupD.ClsdLoopDampgEotEntrX -> AAACalRegn02Rt03GroupD_Dummy.ClsdLoopDampgEotEntrX
    connect CalRegn02Rt03GroupD.ClsdLoopDampgEotEntrY -> AAACalRegn02Rt03GroupD_Dummy.ClsdLoopDampgEotEntrY
    connect CalRegn02Rt03GroupD.ClsdLoopDampgEotExitX -> AAACalRegn02Rt03GroupD_Dummy.ClsdLoopDampgEotExitX
    connect CalRegn02Rt03GroupD.ClsdLoopDampgEotExitY -> AAACalRegn02Rt03GroupD_Dummy.ClsdLoopDampgEotExitY
    connect CalRegn02Rt03GroupD.ClsdLoopDampgPinionVelX -> AAACalRegn02Rt03GroupD_Dummy.ClsdLoopDampgPinionVelX
    connect CalRegn02Rt03GroupD.ClsdLoopDampgPinionVelY -> AAACalRegn02Rt03GroupD_Dummy.ClsdLoopDampgPinionVelY
    connect CalRegn02Rt03GroupD.ClsdLoopDampgRackFX -> AAACalRegn02Rt03GroupD_Dummy.ClsdLoopDampgRackFX
    connect CalRegn02Rt03GroupD.ClsdLoopDampgRackFY -> AAACalRegn02Rt03GroupD_Dummy.ClsdLoopDampgRackFY
    connect CalRegn02Rt03GroupD.ClsdLoopHysDeltaY -> AAACalRegn02Rt03GroupD_Dummy.ClsdLoopHysDeltaY
    connect CalRegn02Rt03GroupD.ClsdLoopHysGainY -> AAACalRegn02Rt03GroupD_Dummy.ClsdLoopHysGainY
    connect CalRegn02Rt03GroupD.ClsdLoopHysHwAgBlndFac -> AAACalRegn02Rt03GroupD_Dummy.ClsdLoopHysHwAgBlndFac
    connect CalRegn02Rt03GroupD.ClsdLoopHysHwAgQuadBlndX -> AAACalRegn02Rt03GroupD_Dummy.ClsdLoopHysHwAgQuadBlndX
    connect CalRegn02Rt03GroupD.ClsdLoopHysHwAgQuadBlndY -> AAACalRegn02Rt03GroupD_Dummy.ClsdLoopHysHwAgQuadBlndY
    connect CalRegn02Rt03GroupD.ClsdLoopHysHwAgQuadQlfrX -> AAACalRegn02Rt03GroupD_Dummy.ClsdLoopHysHwAgQuadQlfrX
    connect CalRegn02Rt03GroupD.ClsdLoopHysHwAgQuadQlfrY -> AAACalRegn02Rt03GroupD_Dummy.ClsdLoopHysHwAgQuadQlfrY
    connect CalRegn02Rt03GroupD.ClsdLoopHysHwVelQuadBlndX -> AAACalRegn02Rt03GroupD_Dummy.ClsdLoopHysHwVelQuadBlndX
    connect CalRegn02Rt03GroupD.ClsdLoopHysHwVelQuadBlndY -> AAACalRegn02Rt03GroupD_Dummy.ClsdLoopHysHwVelQuadBlndY
    connect CalRegn02Rt03GroupD.ClsdLoopHysPolarity -> AAACalRegn02Rt03GroupD_Dummy.ClsdLoopHysPolarity
    connect CalRegn02Rt03GroupD.ClsdLoopHysRackFFacX -> AAACalRegn02Rt03GroupD_Dummy.ClsdLoopHysRackFFacX
    connect CalRegn02Rt03GroupD.ClsdLoopHysRackFFacY -> AAACalRegn02Rt03GroupD_Dummy.ClsdLoopHysRackFFacY
    connect CalRegn02Rt03GroupD.ClsdLoopHysRhoY -> AAACalRegn02Rt03GroupD_Dummy.ClsdLoopHysRhoY
    connect CalRegn02Rt03GroupD.ClsdLoopHysSteerInHwAgNegLowrLim -> AAACalRegn02Rt03GroupD_Dummy.ClsdLoopHysSteerInHwAgNegLowrLim
    connect CalRegn02Rt03GroupD.ClsdLoopHysSteerInHwAgNegUpprLim -> AAACalRegn02Rt03GroupD_Dummy.ClsdLoopHysSteerInHwAgNegUpprLim
    connect CalRegn02Rt03GroupD.ClsdLoopHysSteerInHwAgPosLowrLim -> AAACalRegn02Rt03GroupD_Dummy.ClsdLoopHysSteerInHwAgPosLowrLim
    connect CalRegn02Rt03GroupD.ClsdLoopHysSteerInHwAgPosUpprLim -> AAACalRegn02Rt03GroupD_Dummy.ClsdLoopHysSteerInHwAgPosUpprLim
    connect CalRegn02Rt03GroupD.ClsdLoopHysSteerOutHwAgNegLowrLim -> AAACalRegn02Rt03GroupD_Dummy.ClsdLoopHysSteerOutHwAgNegLowrLim
    connect CalRegn02Rt03GroupD.ClsdLoopHysSteerOutHwAgNegUpprLim -> AAACalRegn02Rt03GroupD_Dummy.ClsdLoopHysSteerOutHwAgNegUpprLim
    connect CalRegn02Rt03GroupD.ClsdLoopHysSteerOutHwAgPosLowrLim -> AAACalRegn02Rt03GroupD_Dummy.ClsdLoopHysSteerOutHwAgPosLowrLim
    connect CalRegn02Rt03GroupD.ClsdLoopHysSteerOutHwAgPosUpprLim -> AAACalRegn02Rt03GroupD_Dummy.ClsdLoopHysSteerOutHwAgPosUpprLim
    connect CalRegn02Rt03GroupD.ClsdLoopHysSysFricOffsLimX -> AAACalRegn02Rt03GroupD_Dummy.ClsdLoopHysSysFricOffsLimX
    connect CalRegn02Rt03GroupD.ClsdLoopHysSysFricOffsLimY -> AAACalRegn02Rt03GroupD_Dummy.ClsdLoopHysSysFricOffsLimY
    connect CalRegn02Rt03GroupD.ClsdLoopHysSysFricScaX -> AAACalRegn02Rt03GroupD_Dummy.ClsdLoopHysSysFricScaX
    connect CalRegn02Rt03GroupD.ClsdLoopHysSysFricScaY -> AAACalRegn02Rt03GroupD_Dummy.ClsdLoopHysSysFricScaY
    connect CalRegn02Rt03GroupD.EffortRackFX -> AAACalRegn02Rt03GroupD_Dummy.EffortRackFX
    connect CalRegn02Rt03GroupD.EffortRackFY -> AAACalRegn02Rt03GroupD_Dummy.EffortRackFY
    connect CalRegn02Rt03GroupD.EffortVehSpdBilnrSeln -> AAACalRegn02Rt03GroupD_Dummy.EffortVehSpdBilnrSeln
    connect CDD_Adc1CfgAndUse.Adc1CfgAndUseAdc1EnaCnvn -> CDD_DmaCfgAndUse.Adc1CfgAndUseAdc1EnaCnvn
    connect CDD_AdcDiagc.AdcDiagcEndPtrOutp -> CDD_Adc1CfgAndUse.AdcDiagcEndPtrOutp
    connect CDD_AdcDiagc.AdcDiagcStrtPtrOutp -> CDD_Adc1CfgAndUse.AdcDiagcStrtPtrOutp
    connect CDD_AdcDiagc.Adc0Faild -> CDD_Bmw5441McuCfg.Adc0Faild
    connect CDD_AdcDiagc.Adc1Faild -> CDD_Bmw5441McuCfg.Adc1Faild
    connect CDD_AdcDiagc.AdcDiagcEndPtrOutp -> CDD_MotCtrlMgr.AdcDiagcEndPtrOutp
    connect CDD_AdcDiagc.AdcDiagcStrtPtrOutp -> CDD_MotCtrlMgr.AdcDiagcStrtPtrOutp
    connect CDD_BattRtnCurr.BattRtnCurrAmpr -> BmwMsgSlot49Bas1Repn2BusFrChA.BattRtnCurrAmpr
    connect CDD_BattRtnCurr.BattRtnCurrStsQlfr -> BmwMsgSlot49Bas1Repn2BusFrChA.BattRtnCurrAmprQlfr
    connect CDD_Bmw5441McuCfg.BattVltgSwd1 -> BattVltg.BattVltgSwd1
    connect CDD_Bmw5441McuCfg.BattVltgAdcFaild -> BattVltgCorrln.BattVltgAdcFaild
    connect CDD_Bmw5441McuCfg.BattVltgSwd1 -> BattVltgCorrln.BattVltgSwd1
    connect CDD_Bmw5441McuCfg.BattVltgSwd1AdcFaild -> BattVltgCorrln.BattVltgSwd1AdcFaild
    connect CDD_Bmw5441McuCfg.Adc1ScanGroup2Ref0 -> CDD_AdcDiagc.Adc1ScanGroup2Ref0
    connect CDD_Bmw5441McuCfg.Adc1ScanGroup2Ref1 -> CDD_AdcDiagc.Adc1ScanGroup2Ref1
    connect CDD_Bmw5441McuCfg.Adc1ScanGroup3Ref0 -> CDD_AdcDiagc.Adc1ScanGroup3Ref0
    connect CDD_Bmw5441McuCfg.Adc1ScanGroup3Ref1 -> CDD_AdcDiagc.Adc1ScanGroup3Ref1
    connect CDD_Bmw5441McuCfg.Adc1SelfDiag0 -> CDD_AdcDiagc.Adc1SelfDiag0
    connect CDD_Bmw5441McuCfg.Adc1SelfDiag2 -> CDD_AdcDiagc.Adc1SelfDiag2
    connect CDD_Bmw5441McuCfg.Adc1SelfDiag4 -> CDD_AdcDiagc.Adc1SelfDiag4
    connect CDD_Bmw5441McuCfg.BattRtnCurrAdcFaild -> CDD_BattRtnCurr.BattRtnCurrAdcFaild
    connect CDD_Bmw5441McuCfg.HwTq4RawAdcAdcFaild -> CDD_HwTq4Meas.HwTq4RawAdcAdcFaild
    connect CDD_Bmw5441McuCfg.HwTq4RawAdcAdcFaild -> CDD_HwTq4Meas.HwTq4RawFastAdcAdcFaild
    connect CDD_Bmw5441McuCfg.HwTq5RawAdcAdcFaild -> CDD_HwTq5Meas.HwTq5RawAdcAdcFaild
    connect CDD_Bmw5441McuCfg.HwTq5RawAdcAdcFaild -> CDD_HwTq5Meas.HwTq5RawFastAdcAdcFaild
    connect CDD_Bmw5441McuCfg.MotCurrAdcVlyAAdcFaild -> CDD_MotCtrlMgr.MotCurrAdcVlyAAdcFaild
    connect CDD_Bmw5441McuCfg.MotCurrAdcVlyBAdcFaild -> CDD_MotCtrlMgr.MotCurrAdcVlyBAdcFaild
    connect CDD_Bmw5441McuCfg.MotCurrAdcVlyCAdcFaild -> CDD_MotCtrlMgr.MotCurrAdcVlyCAdcFaild
    connect CDD_Bmw5441McuCfg.EcuT -> EcuTMeas.EcuT
    connect CDD_Bmw5441McuCfg.EcuTAdcFaild -> EcuTMeas.EcuTAdcFaild
    connect CDD_Bmw5441McuCfg.BattVltgSwd1 -> PwrDiscnct.BattVltgSwd1
    connect CDD_Bmw5441McuCfg.MotDrvr1IninTestCmpl -> PwrUpSeq.MotDrvr1IninTestCmpl
    connect CDD_Bmw5441McuCfg.RvsBattDiagcGndAdc -> RvsBattProtn.RvsBattDiagcGndAdc
    connect CDD_Bmw5441McuCfg.RvsBattDiagcGndAdcFaild -> RvsBattProtn.RvsBattDiagcGndAdcFaild
    connect CDD_Bmw5441McuCfg.RvsBattDiagcRtnAdc -> RvsBattProtn.RvsBattDiagcRtnAdc
    connect CDD_Bmw5441McuCfg.RvsBattDiagcRtnAdcFaild -> RvsBattProtn.RvsBattDiagcRtnAdcFaild
    connect CDD_CurrMeas.CurrMeasWrmIninTestCmpl -> CDD_MotCtrlMgr.CurrMeasWrmIninTestCmpl
    connect CDD_CurrMeas.MotCurrEolCalSt -> CDD_MotCtrlMgr.MotCurrEolCalSt
    connect CDD_CurrMeas.MotCurrQlfr1 -> CDD_MotCtrlMgr.MotCurrQlfr1
    connect CDD_CurrMeas.MotCurrEolCalSt -> CDD_TSG31CfgAndUse.MotCurrEolCalSt
    connect CDD_CurrMeas.CurrMeasEolGainReq -> CmnMfgSrv.CurrMeasEolGainReq
    connect CDD_CurrMeas.CurrMeasEolGainStsReq -> CmnMfgSrv.CurrMeasEolGainStReq
    connect CDD_CurrMeas.CurrMeasEolOffsReq -> CmnMfgSrv.CurrMeasEolOffsReq
    connect CDD_CurrMeas.CurrMeasEolOffsStsReq -> CmnMfgSrv.CurrMeasEolOffsStReq
    connect CDD_CurrMeas.CurrMeasGainReadReqSngIvtr -> CmnMfgSrv.CurrMeasGainReadReqSngIvtr
    connect CDD_CurrMeas.CurrMeasGainWrReqSngIvtr -> CmnMfgSrv.CurrMeasGainWrReqSngIvtr
    connect CDD_CurrMeas.CurrMeasOffsReadReqSngIvtr -> CmnMfgSrv.CurrMeasOffsReadReqSngIvtr
    connect CDD_CurrMeas.CurrMeasOffsWrReqSngIvtr -> CmnMfgSrv.CurrMeasOffsWrReqSngIvtr
    connect CDD_CurrMeas.MotCurrEolCalSt -> CurrMeasCorrln.MotCurrEolCalSt
    connect CDD_CurrMeas.MotCurrEolCalSt -> MotCurrRegCfg.MotCurrEolCalSt
    connect CDD_CurrMeas.MotCurrQlfr1 -> PhaDiscnct.MotCurrQlfr1
    connect CDD_CurrMeas.CurrMeasWrmIninTestCmpl -> PwrUpSeq.CurrMeasWrmIninTestCmpl
    connect CDD_DmaCfgAndUse.MotAg0SnsrCfgDmaStrt -> CDD_MotAg0Meas.MotAg0SnsrCfgDmaStrt
    connect CDD_DmaCfgAndUse.DmaEna2MilliSecToMotCtrlTrf -> CDD_MotCtrlMgr.DmaEna2MilliSecToMotCtrlTrf
    connect CDD_DmaCfgAndUse.DmaWaitForMotCtrlTo2MilliSecTrf -> CDD_MotCtrlMgr.DmaWaitForMotCtrlTo2MilliSecTrf
    connect CDD_EcmOutpAndDiagc.CtrlErrOut -> TmplMonr.CtrlErrOut
    connect CDD_ExcpnHndlg.GetMcuDiagcSpplData -> DiagcMgr.GetMcuDiagcSpplData
    connect CDD_FlsMem.SwApplCrc -> DiagcMgr.SwApplCrc
    connect CDD_FlsMem.CodFlsCrcChkCmpl -> PwrUpSeq.CodFlsCrcChkCmpl
    connect CDD_HwTq4Meas.HwTq4Qlfr -> BmwMsgSlot49Bas0Repn2BusFrChA.HwTq4Qlfr
    connect CDD_HwTq4Meas.HwTq4AutTrim -> CmnMfgSrv.HwTq4AutTrim
    connect CDD_HwTq4Meas.HwTq4ClrSnsrSca -> CmnMfgSrv.HwTq4ClrSnsrSca
    connect CDD_HwTq4Meas.HwTq4ClrTrim -> CmnMfgSrv.HwTq4ClrTrim
    connect CDD_HwTq4Meas.HwTq4ReadSnsrSca -> CmnMfgSrv.HwTq4ReadSnsrSca
    connect CDD_HwTq4Meas.HwTq4ReadTrim -> CmnMfgSrv.HwTq4ReadTrim
    connect CDD_HwTq4Meas.HwTq4SnsrScaPrfmdSts -> CmnMfgSrv.HwTq4SnsrScaPrfmdSts
    connect CDD_HwTq4Meas.HwTq4TrimPrfmdSts -> CmnMfgSrv.HwTq4TrimPrfmdSts
    connect CDD_HwTq4Meas.HwTq4WrSnsrSca -> CmnMfgSrv.HwTq4WrSnsrSca
    connect CDD_HwTq4Meas.HwTq4WrTrim -> CmnMfgSrv.HwTq4WrTrim
    connect CDD_HwTq4Meas.HwTq4 -> HwTqArbn.HwTqA
    connect CDD_HwTq4Meas.HwTq4Qlfr -> HwTqArbn.HwTqAQlfr
    connect CDD_HwTq4Meas.HwTq4RollgCntr -> HwTqArbn.HwTqARollgCntr
    connect CDD_HwTq4Meas.HwTq4 -> HwTqCorrln.HwTqA
    connect CDD_HwTq4Meas.HwTq4Qlfr -> HwTqCorrln.HwTqAQlfr
    connect CDD_HwTq4Meas.HwTq4RollgCntr -> HwTqCorrln.HwTqARollgCntr
    connect CDD_HwTq5Meas.HwTq5Qlfr -> BmwMsgSlot49Bas0Repn2BusFrChA.HwTq5Qlfr
    connect CDD_HwTq5Meas.HwTq5AutTrim -> CmnMfgSrv.HwTq5AutTrim
    connect CDD_HwTq5Meas.HwTq5ClrSnsrSca -> CmnMfgSrv.HwTq5ClrSnsrSca
    connect CDD_HwTq5Meas.HwTq5ClrTrim -> CmnMfgSrv.HwTq5ClrTrim
    connect CDD_HwTq5Meas.HwTq5ReadSnsrSca -> CmnMfgSrv.HwTq5ReadSnsrSca
    connect CDD_HwTq5Meas.HwTq5ReadTrim -> CmnMfgSrv.HwTq5ReadTrim
    connect CDD_HwTq5Meas.HwTq5SnsrScaPrfmdSts -> CmnMfgSrv.HwTq5SnsrScaPrfmdSts
    connect CDD_HwTq5Meas.HwTq5TrimPrfmdSts -> CmnMfgSrv.HwTq5TrimPrfmdSts
    connect CDD_HwTq5Meas.HwTq5WrSnsrSca -> CmnMfgSrv.HwTq5WrSnsrSca
    connect CDD_HwTq5Meas.HwTq5WrTrim -> CmnMfgSrv.HwTq5WrTrim
    connect CDD_HwTq5Meas.HwTq5 -> HwTqArbn.HwTqB
    connect CDD_HwTq5Meas.HwTq5Qlfr -> HwTqArbn.HwTqBQlfr
    connect CDD_HwTq5Meas.HwTq5RollgCntr -> HwTqArbn.HwTqBRollgCntr
    connect CDD_HwTq5Meas.HwTq5 -> HwTqCorrln.HwTqB
    connect CDD_HwTq5Meas.HwTq5Qlfr -> HwTqCorrln.HwTqBQlfr
    connect CDD_HwTq5Meas.HwTq5RollgCntr -> HwTqCorrln.HwTqBRollgCntr
    connect CDD_McuDiagc.LoopCntr2MilliSec -> CDD_MotCtrlMgr.LoopCntr2MilliSec
    connect CDD_MotAg0Meas.MotAg0TurnCntr -> BmwHwAgArbnAndEotPosn.MotAgTurnCntr
    connect CDD_MotAg0Meas.MotAg0SnsrCfgAdr -> CDD_DmaCfgAndUse.MotAg0SnsrCfgAdr
    connect CDD_MotAg0Meas.MotAg0QepFaild -> CDD_MotCtrlMgr.MotAg0QepFaild
    connect CDD_MotAg0Meas.MotAg0CoeffTblRead -> CmnMfgSrv.MotAg0MeasMotAg0CoeffTblRead
    connect CDD_MotAg0Meas.MotAg0CoeffTblWr -> CmnMfgSrv.MotAg0MeasMotAg0CoeffTblWr
    connect CDD_MotAg0Meas.MotAg0MeclQlfr -> MotAgCorrln.MotAgAMeclQlfr
    connect CDD_MotAg0Meas.MotAg0TurnCntr -> TurnCntrCorrln.MotAgATurnCntr
    connect CDD_MotAg0Meas.MotAg0TurnCntrQlfr -> TurnCntrCorrln.MotAgATurnCntrQlfr
    connect CDD_MotAg0Meas.MotAg0TurnCntrRollgCntr -> TurnCntrCorrln.MotAgATurnCntrRollgCntr
    connect CDD_MotAg1Meas.MotAg1MeclQlfr -> CDD_MotAg0Meas.MotAg1MeclQlfr
    connect CDD_MotAg1Meas.MotAg1TurnCntrQlfr -> CDD_MotAg0Meas.MotAg1TurnCntrQlfr
    connect CDD_MotAg1Meas.MotAg1QepFaild -> CDD_MotCtrlMgr.MotAg1QepFaild
    connect CDD_MotAg1Meas.MotAg1CoeffTblRead -> CmnMfgSrv.MotAg1MeasMotAg1CoeffTblRead
    connect CDD_MotAg1Meas.MotAg1CoeffTblWr -> CmnMfgSrv.MotAg1MeasMotAg1CoeffTblWr
    connect CDD_MotAg1Meas.MotAg1MeclQlfr -> MotAgCorrln.MotAgBMeclQlfr
    connect CDD_MotAg1Meas.MotAg1TurnCntr -> TurnCntrCorrln.MotAgBTurnCntr
    connect CDD_MotAg1Meas.MotAg1TurnCntrQlfr -> TurnCntrCorrln.MotAgBTurnCntrQlfr
    connect CDD_MotAg1Meas.MotAg1TurnCntrRollgCntr -> TurnCntrCorrln.MotAgBTurnCntrRollgCntr
    connect CDD_MotAgCmp.MotAgCumvAlgndMrf -> BmwHwAgArbnAndEotPosn.MotAgCumvAlgndMrf
    connect CDD_MotAgCmp.MotAgCmpBackEmfRead -> CmnMfgSrv.MotAgCmpBackEmfRead
    connect CDD_MotAgCmp.MotAgCmpBackEmfWr -> CmnMfgSrv.MotAgCmpBackEmfWr
    connect CDD_MotAgCmp.MotAgCumvAlgndMrf -> CmnMfgSrv.MotAgCumvAlgndMrf
    connect CDD_MotAgCmp.MotAgCumvAlgndMrf -> MotQuadDetn.MotAgCumvAlgndMrf
    connect CDD_MotAgCmp.MotAgCumvAlgndMrf -> SysKineAndEff.MotAgCumvAlgndMrf
    connect CDD_MotCtrlMgr.BattVltgAdc -> BattVltg.BattVltg
    connect CDD_MotCtrlMgr.BattVltgAdc -> BattVltgCorrln.BattVltg
    connect CDD_MotCtrlMgr.HwTq4RawAdc -> BmwMsgSlot315Bas0Repn1BusFrChA.HwTq4RawAdc
    connect CDD_MotCtrlMgr.HwTq5RawAdc -> BmwMsgSlot315Bas0Repn1BusFrChA.HwTq5RawAdc
    connect CDD_MotCtrlMgr.Adc0ScanGroup2Ref0 -> CDD_AdcDiagc.Adc0ScanGroup2Ref0
    connect CDD_MotCtrlMgr.Adc0ScanGroup2Ref1 -> CDD_AdcDiagc.Adc0ScanGroup2Ref1
    connect CDD_MotCtrlMgr.Adc0ScanGroup3Ref0 -> CDD_AdcDiagc.Adc0ScanGroup3Ref0
    connect CDD_MotCtrlMgr.Adc0ScanGroup3Ref1 -> CDD_AdcDiagc.Adc0ScanGroup3Ref1
    connect CDD_MotCtrlMgr.Adc0SelfDiag0 -> CDD_AdcDiagc.Adc0SelfDiag0
    connect CDD_MotCtrlMgr.Adc0SelfDiag2 -> CDD_AdcDiagc.Adc0SelfDiag2
    connect CDD_MotCtrlMgr.Adc0SelfDiag4 -> CDD_AdcDiagc.Adc0SelfDiag4
    connect CDD_MotCtrlMgr.BattRtnCurrAdc -> CDD_BattRtnCurr.BattRtnCurrAdc
    connect CDD_MotCtrlMgr.MotCurrAdcVlyA -> CDD_CurrMeas.MotCurrAdcVlyA
    connect CDD_MotCtrlMgr.MotCurrAdcVlyB -> CDD_CurrMeas.MotCurrAdcVlyB
    connect CDD_MotCtrlMgr.MotCurrAdcVlyC -> CDD_CurrMeas.MotCurrAdcVlyC
    connect CDD_MotCtrlMgr.Ntc5DErrCnt -> CDD_CurrMeas.Ntc5DErrCnt
    connect CDD_MotCtrlMgr.HwTq4RawAdc -> CDD_HwTq4Meas.HwTq4RawAdc
    connect CDD_MotCtrlMgr.HwTq4RawFastAdcBuf -> CDD_HwTq4Meas.HwTq4RawFastAdcBuf
    connect CDD_MotCtrlMgr.HwTq5RawAdc -> CDD_HwTq5Meas.HwTq5RawAdc
    connect CDD_MotCtrlMgr.HwTq5RawFastAdcBuf -> CDD_HwTq5Meas.HwTq5RawFastAdcBuf
    connect CDD_MotCtrlMgr.FastLoopCntr -> CDD_McuDiagc.FastLoopCntr
    connect CDD_MotCtrlMgr.SlowLoopCntr -> CDD_McuDiagc.SlowLoopCntr
    connect CDD_MotCtrlMgr.MotAg0ErrReg -> CDD_MotAg0Meas.MotAg0ErrReg
    connect CDD_MotCtrlMgr.MotAg0ParFltCnt -> CDD_MotAg0Meas.MotAg0ParFltCnt
    connect CDD_MotCtrlMgr.MotAg0SpiMecl -> CDD_MotAg0Meas.MotAg0SpiMecl
    connect CDD_MotCtrlMgr.MotAg0TurnCntrReg -> CDD_MotAg0Meas.MotAg0TurnCntrReg
    connect CDD_MotCtrlMgr.MotAg0VltgFltCnt -> CDD_MotAg0Meas.MotAg0VltgFltCnt
    connect CDD_MotCtrlMgr.MotAg0WarnReg -> CDD_MotAg0Meas.MotAg0WarnReg
    connect CDD_MotCtrlMgr.MotAg3Mecl -> CDD_MotAg0Meas.MotAg3Mecl
    connect CDD_MotCtrlMgr.MotAg1ErrReg -> CDD_MotAg1Meas.MotAg1ErrReg
    connect CDD_MotCtrlMgr.MotAg1ParFltCnt -> CDD_MotAg1Meas.MotAg1ParFltCnt
    connect CDD_MotCtrlMgr.MotAg1SpiMecl -> CDD_MotAg1Meas.MotAg1SpiMecl
    connect CDD_MotCtrlMgr.MotAg1TurnCntrReg -> CDD_MotAg1Meas.MotAg1TurnCntrReg
    connect CDD_MotCtrlMgr.MotAg1VltgFltCnt -> CDD_MotAg1Meas.MotAg1VltgFltCnt
    connect CDD_MotCtrlMgr.MotAg1WarnReg -> CDD_MotAg1Meas.MotAg1WarnReg
    connect CDD_MotCtrlMgr.MotAg4Mecl -> CDD_MotAg1Meas.MotAg4Mecl
    connect CDD_MotCtrlMgr.MotAgCumvAlgndMrfRev -> CDD_MotAgCmp.MotAgCumvAlgndMrfRev
    connect CDD_MotCtrlMgr.MotAgCumvInid -> CDD_MotAgCmp.MotAgCumvInid
    connect CDD_MotCtrlMgr.MotAgBuf -> CDD_MotVel.MotAgBuf
    connect CDD_MotCtrlMgr.MotAgBufIdx -> CDD_MotVel.MotAgBufIdx
    connect CDD_MotCtrlMgr.MotAgTiBuf -> CDD_MotVel.MotAgTiBuf
    connect CDD_MotCtrlMgr.MotAg0Mecl -> CmnMfgSrv.MotAg0Mecl
    connect CDD_MotCtrlMgr.MotAg1Mecl -> CmnMfgSrv.MotAg1Mecl
    connect CDD_MotCtrlMgr.MotCurrDax -> CmnMfgSrv.MotCurrDax
    connect CDD_MotCtrlMgr.MotCurrQax -> CmnMfgSrv.MotCurrQax
    connect CDD_MotCtrlMgr.MotCurrCorrdA -> CurrMeasCorrln.MotCurrCorrdA
    connect CDD_MotCtrlMgr.MotCurrCorrdB -> CurrMeasCorrln.MotCurrCorrdB
    connect CDD_MotCtrlMgr.MotCurrCorrdC -> CurrMeasCorrln.MotCurrCorrdC
    connect CDD_MotCtrlMgr.MotCurrRollgCntr1 -> CurrMeasCorrln.MotCurrRollgCntr1
    connect CDD_MotCtrlMgr.MotCurrDax -> ElecPwrCns.MotCurrDax
    connect CDD_MotCtrlMgr.MotCurrQax -> ElecPwrCns.MotCurrQax
    connect CDD_MotCtrlMgr.MotVltgDax -> ElecPwrCns.MotVltgDax
    connect CDD_MotCtrlMgr.MotVltgQax -> ElecPwrCns.MotVltgQax
    connect CDD_MotCtrlMgr.PhaOnTiSumA -> GateDrv0Ctrl.PhaOnTiSumA
    connect CDD_MotCtrlMgr.PhaOnTiSumB -> GateDrv0Ctrl.PhaOnTiSumB
    connect CDD_MotCtrlMgr.PhaOnTiSumC -> GateDrv0Ctrl.PhaOnTiSumC
    connect CDD_MotCtrlMgr.MotAg0Mecl -> MotAgCorrln.MotAgAMecl
    connect CDD_MotCtrlMgr.MotAg0MeclRollgCntr -> MotAgCorrln.MotAgAMeclRollgCntr
    connect CDD_MotCtrlMgr.MotAg1Mecl -> MotAgCorrln.MotAgBMecl
    connect CDD_MotCtrlMgr.MotAg1MeclRollgCntr -> MotAgCorrln.MotAgBMeclRollgCntr
    connect CDD_MotCtrlMgr.MotCurrDax -> MotCurrPeakEstimn.MotCurrDax
    connect CDD_MotCtrlMgr.MotCurrQax -> MotCurrPeakEstimn.MotCurrQax
    connect CDD_MotCtrlMgr.MotCurrDax -> MotTqCalcd.MotCurrDax
    connect CDD_MotCtrlMgr.MotCurrQax -> MotTqCalcd.MotCurrQax
    connect CDD_MotCtrlMgr.MotCurrCorrdA -> PhaDiscnct.MotCurrCorrdA
    connect CDD_MotCtrlMgr.MotCurrCorrdB -> PhaDiscnct.MotCurrCorrdB
    connect CDD_MotCtrlMgr.MotCurrCorrdC -> PhaDiscnct.MotCurrCorrdC
    connect CDD_MotCtrlMgr.BattVltgAdc -> PwrDiscnct.BattVltg
    connect CDD_MotVel.MotVelMrf -> BmwMsgSlot315Bas0Repn1BusFrChA.MotVelMrf
    connect CDD_MotVel.MotVelCrf -> BmwTqOvrlCdngAndDrvgDynFac.MotVelCrf
    connect CDD_MotVel.MotVelCrf -> BmwTrfcJamAssiDampg.MotVelCrf
    connect CDD_MotVel.MotVelMrf -> CDD_CurrMeas.MotVelMrf
    connect CDD_MotVel.MotVelMrf -> CDD_MotCtrlMgr.MotVelMrf
    connect CDD_MotVel.MotVelMrf -> CmnMfgSrv.MotVelMrf
    connect CDD_MotVel.MotVelCrf -> DutyCycThermProtn.MotVelCrf
    connect CDD_MotVel.MotVelCrf -> EotProtn.MotVelCrf
    connect CDD_MotVel.MotVelCrf -> EpsStEstimn.MotVelCrf
    connect CDD_MotVel.MotVelCrf -> HiLoadStallLimr.MotVelCrf
    connect CDD_MotVel.MotVelCrf -> InertiaCmpVel.MotVelCrf
    connect CDD_MotVel.MotVelCrf -> LrndRackCentr.MotVelCrf
    connect CDD_MotVel.MotVelCrf -> LrnPinionCentr.MotVelCrf
    connect CDD_MotVel.MotVelMrf -> MotCurrRegCfg.MotVelMrf
    connect CDD_MotVel.MotVelMrf -> MotRefMdl.MotVelMrf
    connect CDD_MotVel.MotVelCrf -> MotTqTranlDampg.MotVelCrf
    connect CDD_MotVel.MotVelCrf -> MotVelCtrl.MotVelCrf
    connect CDD_MotVel.MotVelCrf -> PosnTrakgServo.MotVelCrf
    connect CDD_MotVel.MotVelMrf -> PwrLimr.MotVelMrf
    connect CDD_MotVel.MotVelCrf -> SysKineAndEff.MotVelCrf
    connect CDD_NxtrTi.GetRefTmr1MicroSec32bit -> BmwDiagcSrvHndlg.GetRefTmr1MicroSec32bit
    connect CDD_NxtrTi.GetTiSpan1MicroSec32bit -> BmwDiagcSrvHndlg.GetTiSpan1MicroSec32bit
    connect CDD_NxtrTi.GetRefTmr100MicroSec32bit -> BmwDrvgDynStMac.GetRefTmr100MicroSec32bit
    connect CDD_NxtrTi.GetTiSpan100MicroSec32bit -> BmwDrvgDynStMac.GetTiSpan100MicroSec32bit
    connect CDD_NxtrTi.GetRefTmr100MicroSec32bit -> BmwHaptcFb.GetRefTmr100MicroSec32bit
    connect CDD_NxtrTi.GetTiSpan100MicroSec32bit -> BmwHaptcFb.GetTiSpan100MicroSec32bit
    connect CDD_NxtrTi.GetRefTmr100MicroSec32bit -> BmwHwAgArbnAndEotPosn.GetRefTmr100MicroSec32bit
    connect CDD_NxtrTi.GetTiSpan100MicroSec32bit -> BmwHwAgArbnAndEotPosn.GetTiSpan100MicroSec32bit
    connect CDD_NxtrTi.GetRefTmr100MicroSec32bit -> BmwHwTqOvrlArbn.GetRefTmr100MicroSec32bit
    connect CDD_NxtrTi.GetTiSpan100MicroSec32bit -> BmwHwTqOvrlArbn.GetTiSpan100MicroSec32bit
    connect CDD_NxtrTi.GetRefTmr100MicroSec32bit -> BmwMotTqOvrlArbn.GetRefTmr100MicroSec32bit
    connect CDD_NxtrTi.GetTiSpan100MicroSec32bit -> BmwMotTqOvrlArbn.GetTiSpan100MicroSec32bit
    connect CDD_NxtrTi.GetRefTmr100MicroSec32bit -> BmwStReqMgr.GetRefTmr100MicroSec32bit
    connect CDD_NxtrTi.GetTiSpan100MicroSec32bit -> BmwStReqMgr.GetTiSpan100MicroSec32bit
    connect CDD_NxtrTi.GetRefTmr100MicroSec32bit -> BmwTqOvrlCdngAndDrvgDynFac.GetRefTmr100MicroSec32bit
    connect CDD_NxtrTi.GetTiSpan100MicroSec32bit -> BmwTqOvrlCdngAndDrvgDynFac.GetTiSpan100MicroSec32bit
    connect CDD_NxtrTi.GetRefTmr100MicroSec32bit -> BmwTrfcJamAssiDampg.GetRefTmr100MicroSec32bit
    connect CDD_NxtrTi.GetTiSpan100MicroSec32bit -> BmwTrfcJamAssiDampg.GetTiSpan100MicroSec32bit
    connect CDD_NxtrTi.GetRefTmr100MicroSec32bit -> BmwTunSetHndlr.GetRefTmr100MicroSec32bit
    connect CDD_NxtrTi.GetTiSpan100MicroSec32bit -> BmwTunSetHndlr.GetTiSpan100MicroSec32bit
    connect CDD_NxtrTi.GetRefTmr100MicroSec32bit -> BmwVehSpd.GetRefTmr100MicroSec32bit
    connect CDD_NxtrTi.GetTiSpan100MicroSec32bit -> BmwVehSpd.GetTiSpan100MicroSec32bit
    connect CDD_NxtrTi.GetRefTmr1MicroSec32bit -> CDD_Bmw5441McuCfg.GetRefTmr1MicroSec32bit
    connect CDD_NxtrTi.GetTiSpan1MicroSec32bit -> CDD_Bmw5441McuCfg.GetTiSpan1MicroSec32bit
    connect CDD_NxtrTi.GetRefTmr1MicroSec32bit -> CDD_DmaCfgAndUse.GetRefTmr1MicroSec32bit
    connect CDD_NxtrTi.GetTiSpan1MicroSec32bit -> CDD_DmaCfgAndUse.GetTiSpan1MicroSec32bit
    connect CDD_NxtrTi.GetTiSpan100MicroSec32bit -> CDD_FlsMem.GetTiSpan100MicroSec32bit
    connect CDD_NxtrTi.GetRefTmr1MicroSec32bit -> CDD_XcpIf.GetRefTmr1MicroSec32bit
    connect CDD_NxtrTi.GetRefTmr100MicroSec32bit -> CmnMfgSrv.GetRefTmr100MicroSec32bit1
    connect CDD_NxtrTi.GetTiSpan100MicroSec32bit -> CmnMfgSrv.GetTiSpan100MicroSec32bit1
    connect CDD_NxtrTi.GetRefTmr100MicroSec32bit -> FltInj.GetRefTmr100MicroSec32bit
    connect CDD_NxtrTi.GetTiSpan100MicroSec32bit -> FltInj.GetTiSpan100MicroSec32bit
    connect CDD_NxtrTi.GetRefTmr100MicroSec32bit -> LrndRackCentr.GetRefTmr100MicroSec32bit
    connect CDD_NxtrTi.GetTiSpan100MicroSec32bit -> LrndRackCentr.GetTiSpan100MicroSec32bit
    connect CDD_NxtrTi.GetRefTmr100MicroSec32bit -> LrnPinionCentr.GetRefTmr100MicroSec32bit
    connect CDD_NxtrTi.GetTiSpan100MicroSec32bit -> LrnPinionCentr.GetTiSpan100MicroSec32bit
    connect CDD_NxtrTi.GetRefTmr100MicroSec32bit -> MotTqTranlDampg.GetRefTmr100MicroSec32bit
    connect CDD_NxtrTi.GetTiSpan100MicroSec32bit -> MotTqTranlDampg.GetTiSpan100MicroSec32bit
    connect CDD_NxtrTi.GetRefTmr100MicroSec32bit -> MotVelCtrl.GetRefTmr100MicroSec32bit
    connect CDD_NxtrTi.GetTiSpan100MicroSec32bit -> MotVelCtrl.GetTiSpan100MicroSec32bit
    connect CDD_NxtrTi.GetRefTmr100MicroSec32bit -> PhaDiscnct.GetRefTmr100MicroSec32bit
    connect CDD_NxtrTi.GetTiSpan100MicroSec32bit -> PhaDiscnct.GetTiSpan100MicroSec32bit
    connect CDD_NxtrTi.GetRefTmr100MicroSec32bit -> PullCmpActv.GetRefTmr100MicroSec32bit
    connect CDD_NxtrTi.GetTiSpan100MicroSec32bit -> PullCmpActv.GetTiSpan100MicroSec32bit
    connect CDD_NxtrTi.GetRefTmr100MicroSec32bit -> PwrLimr.GetRefTmr100MicroSec32bit
    connect CDD_NxtrTi.GetTiSpan100MicroSec32bit -> PwrLimr.GetTiSpan100MicroSec32bit
    connect CDD_NxtrTi.GetRefTmr100MicroSec32bit -> SteerCmdArbnAndLim.GetRefTmr100MicroSec32bit
    connect CDD_NxtrTi.GetTiSpan100MicroSec32bit -> SteerCmdArbnAndLim.GetTiSpan100MicroSec32bit
    connect CDD_NxtrTi.GetRefTmr100MicroSec32bit -> Swp.GetRefTmr100MicroSec32bit
    connect CDD_NxtrTi.GetTiSpan100MicroSec32bit -> Swp.GetTiSpan100MicroSec32bit
    connect CDD_NxtrTi.GetRefTmr100MicroSec32bit -> SysFricLrng.GetRefTmr100MicroSec32bit
    connect CDD_NxtrTi.GetTiSpan100MicroSec32bit -> SysFricLrng.GetTiSpan100MicroSec32bit
    connect CDD_NxtrTi.GetRefTmr1MicroSec32bit -> TmplMonr.GetRefTmr1MicroSec32bit
    connect CDD_NxtrTi.GetTiSpan1MicroSec32bit -> TmplMonr.GetTiSpan1MicroSec32bit
    connect CDD_SyncCrc.ResvCrcHwUnit -> CDD_FlsMem.ResvCrcHwUnit
    connect CDD_SyncCrc.Calc32BitCrc_u32 -> TunSelnMngt.Calc32BitCrc_u32
    connect CDD_Tauj0CfgAndUse.PhaOnTiMeasdA -> GateDrv0Ctrl.PhaOnTiMeasdA
    connect CDD_Tauj0CfgAndUse.PhaOnTiMeasdB -> GateDrv0Ctrl.PhaOnTiMeasdB
    connect CDD_Tauj0CfgAndUse.PhaOnTiMeasdC -> GateDrv0Ctrl.PhaOnTiMeasdC
    connect CDD_VrfyCritReg.MCalReadVrfyFailFltInfo -> McalErrHndlg.MCalReadVrfyFailFltInfo
    connect ClsdLoopDampg.HwTqCmdDampg -> BmwPwrPrkgDampg.DampgCmdBas
    connect ClsdLoopHys.HwTqCmdHys -> BmwSwFctDi.HwTqCmdHys
    connect CmnMfgSrv.InertiaCmpVelCmdDi -> BmwSwFctDi.InertiaCmpVelCmdDi
    connect CmnMfgSrv.PullCmpCmdDi -> BmwSwFctDi.PullCmpCmdDi
    connect CmnMfgSrv.MfgEnaSt -> CDD_XcpIf.MfgEnaSt
    connect CmnMfgSrv.CmnMfgSrvCmnMfgSrvMaiFct -> CmnMfgSrvIf.CmnMfgSrvCmnMfgSrvMaiFct
    connect CmnMfgSrv.RtnCmdDi -> CtrldVelRtn.RtnCmdDi
    connect CmnMfgSrv.IgnCntr -> DiagcMgr.IgnCntr
    connect CmnMfgSrv.MfgDiagcInhb -> DiagcMgr.MfgDiagcInhb
    connect CmnMfgSrv.MfgEnaSt -> DiagcMgr.MfgEnaSt
    connect CmnMfgSrv.DutyCycThermProtnDi -> DutyCycThermProtn.DutyCycThermProtnDi
    connect CmnMfgSrv.EotProtnDi -> EotProtn.EotProtnDi
    connect CmnMfgSrv.StallMotTqLimDi -> HiLoadStallLimr.StallMotTqLimDi
    connect CmnMfgSrv.LoaScaDi -> LoaMgr.LoaScaDi
    connect CmnMfgSrv.PullCmpLrngDi -> PullCmpActv.PullCmpLrngDi
    connect CmnMfgSrv.AssiLnrGain -> SteerCmdArbnAndLim.AssiLnrGain
    connect CmnMfgSrv.AssiLnrGainEna -> SteerCmdArbnAndLim.AssiLnrGainEna
    connect CmnMfgSrv.SysMotTqCmdRampRateDi -> StOutpCtrl.SysMotTqCmdRampRateDi
    connect CmnMfgSrv.FricLrngDi -> SysFricLrng.FricLrngDi
    connect CmnMfgSrv.SysStImdtTranReqOff -> SysStMod.SysStImdtTranReqOff
    connect CmnMfgSrv.AssiMechTEstimnDi -> TEstimn.AssiMechTEstimnDi
    connect CmplncErr.CmplncErrMotToPinion -> BmwHwAgArbnAndEotPosn.CmplncErrMotToPinion
    connect Coding.DataMode -> BmwSwFctDi.Coding_DataMode
    connect Coding.Data -> BmwSwFctDi.Data
    connect CtrldVelRtn.CtrldVelRtnCmd -> BmwSwFctDi.CtrldVelRtnCmd
    connect CurrMeasCorrln.CurrMeasCorrlnSts -> CDD_MotCtrlMgr.CurrMeasCorrlnSts
    connect CurrMeasCorrln.CurrMeasIdptSig -> LoaMgr.CurrMeasIdptSig
    connect Darh.RoeStatePort -> StdDiag.RoeStatePort
    connect DiagcMgr.DiagcStsCtrldShtDwnFltPrsnt -> BmwDrvgDynStMac.DiagcStsCtrldShtDwnFltPrsnt
    connect DiagcMgr.DiagcStsNonRcvrlReqDiFltPrsnt -> BmwDrvgDynStMac.DiagcStsNonRcvrlReqDiFltPrsnt
    connect DiagcMgr.SysStFltOutpReqDi -> BmwDrvgDynStMac.SysStFltOutpReqDi
    connect DiagcMgr.DiagcStsNonRcvrlReqDiFltPrsnt -> BmwHaptcFb.DiagcStsNonRcvrlReqDiFltPrsnt
    connect DiagcMgr.DiagcStsNonRcvrlReqDiFltPrsnt -> BmwStReqMgr.DiagcStsNonRcvrlReqDiFltPrsnt
    connect DiagcMgr.SysStFltOutpReqDi -> BmwStReqMgr.SysStFltOutpReqDi
    connect DiagcMgr.CnvSnpshtData_f32 -> CDD_BattRtnCurr.CnvSnpshtData_f32
    connect DiagcMgr.CnvSnpshtData_u08 -> CDD_BattRtnCurr.CnvSnpshtData_u08
    connect DiagcMgr.CnvSnpshtData_s16 -> CDD_MotAg0Meas.CnvSnpshtData_s16
    connect DiagcMgr.CnvSnpshtData_u16 -> CDD_MotAg0Meas.CnvSnpshtData_u16
    connect DiagcMgr.CnvSnpshtData_s16 -> CDD_MotAg1Meas.CnvSnpshtData_s16
    connect DiagcMgr.CnvSnpshtData_u16 -> CDD_MotAg1Meas.CnvSnpshtData_u16
    connect DiagcMgr.ClrAllDiagc -> CmnMfgSrv.ClrAllDiagc
    connect DiagcMgr.ClrLtchCntrData -> CmnMfgSrv.ClrLtchCntrData
    connect DiagcMgr.ClrSnpshtData -> CmnMfgSrv.ClrSnpshtData
    connect DiagcMgr.ReadSnpshtData -> CmnMfgSrv.ReadExtdSnpshtData
    connect DiagcMgr.ReadLtchCntrData -> CmnMfgSrv.ReadLtchCntrData
    connect DiagcMgr.ReadNtcFltAry -> CmnMfgSrv.ReadNtcFltAry
    connect DiagcMgr.ReadNtcInfoAndDebCntr -> CmnMfgSrv.ReadNtcInfoAndDebCntr
    connect DiagcMgr.ClrDiagcFlgProxy -> DiagcMgrProxyAppl10.ClrDiagcFlgProxy
    connect DiagcMgr.DiagcMgrIninCore -> DiagcMgrProxyAppl10.DiagcMgrIninCore
    connect DiagcMgr.GetNtcActvCore -> DiagcMgrProxyAppl10.GetNtcActvCore
    connect DiagcMgr.GetNtcQlfrStsCore -> DiagcMgrProxyAppl10.GetNtcQlfrStsCore
    connect DiagcMgr.GetNtcStsCore -> DiagcMgrProxyAppl10.GetNtcStsCore
    connect DiagcMgr.SetNtcStsCore -> DiagcMgrProxyAppl10.SetNtcStsCore
    connect DiagcMgr.ClrDiagcFlgProxy -> DiagcMgrProxyAppl7.ClrDiagcFlgProxy
    connect DiagcMgr.DiagcMgrIninCore -> DiagcMgrProxyAppl7.DiagcMgrIninCore
    connect DiagcMgr.GetNtcActvCore -> DiagcMgrProxyAppl7.GetNtcActvCore
    connect DiagcMgr.GetNtcQlfrStsCore -> DiagcMgrProxyAppl7.GetNtcQlfrStsCore
    connect DiagcMgr.GetNtcStsCore -> DiagcMgrProxyAppl7.GetNtcStsCore
    connect DiagcMgr.SetNtcStsCore -> DiagcMgrProxyAppl7.SetNtcStsCore
    connect DiagcMgr.ClrDiagcFlgProxy -> DiagcMgrProxyAppl8.ClrDiagcFlgProxy
    connect DiagcMgr.DiagcMgrIninCore -> DiagcMgrProxyAppl8.DiagcMgrIninCore
    connect DiagcMgr.GetNtcActvCore -> DiagcMgrProxyAppl8.GetNtcActvCore
    connect DiagcMgr.GetNtcQlfrStsCore -> DiagcMgrProxyAppl8.GetNtcQlfrStsCore
    connect DiagcMgr.GetNtcStsCore -> DiagcMgrProxyAppl8.GetNtcStsCore
    connect DiagcMgr.SetNtcStsCore -> DiagcMgrProxyAppl8.SetNtcStsCore
    connect DiagcMgr.ClrDiagcFlgProxy -> DiagcMgrProxyAppl9.ClrDiagcFlgProxy
    connect DiagcMgr.DiagcMgrIninCore -> DiagcMgrProxyAppl9.DiagcMgrIninCore
    connect DiagcMgr.GetNtcActvCore -> DiagcMgrProxyAppl9.GetNtcActvCore
    connect DiagcMgr.GetNtcQlfrStsCore -> DiagcMgrProxyAppl9.GetNtcQlfrStsCore
    connect DiagcMgr.GetNtcStsCore -> DiagcMgrProxyAppl9.GetNtcStsCore
    connect DiagcMgr.SetNtcStsCore -> DiagcMgrProxyAppl9.SetNtcStsCore
    connect DiagcMgr.CnvSnpshtData_f32 -> EcuTMeas.CnvSnpshtData_f32
    connect DiagcMgr.CnvSnpshtData_logl -> EcuTMeas.CnvSnpshtData_logl
    connect DiagcMgr.DiagcStsCtrldShtDwnFltPrsnt -> MotTqTranlDampg.DiagcStsCtrldShtDwnFltPrsnt
    connect DiagcMgr.CnvSnpshtData_f32 -> RvsBattProtn.CnvSnpshtData_f32
    connect DiagcMgr.DiagcStsCtrldShtDwnFltPrsnt -> StOutpCtrl.DiagcStsCtrldShtDwnFltPrsnt
    connect DiagcMgr.SysDiMotTqCmdSca -> StOutpCtrl.SysDiMotTqCmdSca
    connect DiagcMgr.SysDiRampRate -> StOutpCtrl.SysDiRampRate
    connect DiagcMgr.SysStFltOutpReqDi -> StOutpCtrl.SysStFltOutpReqDi
    connect DiagcMgr.SysStFltOutpReqDi -> SysStMod.SysStFltOutpReqDi
    connect DiagcMgrProxyAppl10.GetNtcQlfrSts10 -> BattVltgCorrln.GetNtcQlfrSts
    connect DiagcMgrProxyAppl10.SetNtcSts10 -> BattVltgCorrln.SetNtcSts
    connect DiagcMgrProxyAppl10.GetNtcActv10 -> BmwDiagcSrvHndlg.GetNtcActv
    connect DiagcMgrProxyAppl10.GetNtcQlfrSts10 -> BmwHwAgArbnAndEotPosn.GetNtcQlfrSts
    connect DiagcMgrProxyAppl10.SetNtcSts10 -> BmwHwAgArbnAndEotPosn.SetNtcSts
    connect DiagcMgrProxyAppl10.SetNtcSts10 -> BmwMsgSlot107Bas0Repn1BusFrChA.SetNtcSts
    connect DiagcMgrProxyAppl10.SetNtcSts10 -> BmwMsgSlot108Bas0Repn2BusFrChA.SetNtcSts
    connect DiagcMgrProxyAppl10.SetNtcSts10 -> BmwMsgSlot121Bas1Repn2BusFrChA.SetNtcSts
    connect DiagcMgrProxyAppl10.SetNtcSts10 -> BmwMsgSlot269Bas2Repn4BusFrChA.SetNtcSts
    connect DiagcMgrProxyAppl10.SetNtcSts10 -> BmwMsgSlot276Bas4Repn8BusFrChA.SetNtcSts
    connect DiagcMgrProxyAppl10.SetNtcSts10 -> BmwMsgSlot53Bas3Repn8BusFrChA.SetNtcSts
    connect DiagcMgrProxyAppl10.SetNtcSts10 -> BmwMsgSlot55Bas0Repn2BusFrChA.SetNtcSts
    connect DiagcMgrProxyAppl10.SetNtcSts10 -> BmwMsgSlot55Bas3Repn4BusFrChA.SetNtcSts
    connect DiagcMgrProxyAppl10.SetNtcSts10 -> BmwMsgSlot56Bas0Repn2BusFrChA.SetNtcSts
    connect DiagcMgrProxyAppl10.SetNtcSts10 -> BmwMsgSlot68Bas0Repn2BusFrChA.SetNtcSts
    connect DiagcMgrProxyAppl10.SetNtcSts10 -> BmwMsgSlot68Bas1Repn2BusFrChA.SetNtcSts
    connect DiagcMgrProxyAppl10.SetNtcSts10 -> BmwTunSetHndlr.SetNtcSts
    connect DiagcMgrProxyAppl10.GetNtcQlfrSts10 -> CDD_AdcDiagc.GetNtcQlfrSts
    connect DiagcMgrProxyAppl10.SetNtcSts10 -> CDD_AdcDiagc.SetNtcSts
    connect DiagcMgrProxyAppl10.SetNtcSts10 -> CDD_CoreVltgMonr.SetNtcSts
    connect DiagcMgrProxyAppl10.GetNtcQlfrSts10 -> CDD_CurrMeas.GetNtcQlfrSts
    connect DiagcMgrProxyAppl10.SetNtcSts10 -> CDD_CurrMeas.SetNtcSts
    connect DiagcMgrProxyAppl10.SetNtcSts10 -> CDD_ExcpnHndlg.SetNtcSts
    connect DiagcMgrProxyAppl10.SetNtcSts10 -> CDD_FlsMem.SetNtcSts
    connect DiagcMgrProxyAppl10.GetNtcQlfrSts10 -> CDD_HwTq4Meas.GetNtcQlfrSts
    connect DiagcMgrProxyAppl10.SetNtcSts10 -> CDD_HwTq4Meas.SetNtcSts
    connect DiagcMgrProxyAppl10.GetNtcQlfrSts10 -> CDD_HwTq5Meas.GetNtcQlfrSts
    connect DiagcMgrProxyAppl10.SetNtcSts10 -> CDD_HwTq5Meas.SetNtcSts
    connect DiagcMgrProxyAppl10.SetNtcSts10 -> CDD_McuDiagc.SetNtcSts
    connect DiagcMgrProxyAppl10.GetNtcQlfrSts10 -> CDD_MotAg0Meas.GetNtcQlfrSts
    connect DiagcMgrProxyAppl10.SetNtcStsAndSnpshtData10 -> CDD_MotAg0Meas.SetNtcStsAndSnpshtData
    connect DiagcMgrProxyAppl10.GetNtcQlfrSts10 -> CDD_MotAg1Meas.GetNtcQlfrSts
    connect DiagcMgrProxyAppl10.SetNtcStsAndSnpshtData10 -> CDD_MotAg1Meas.SetNtcStsAndSnpshtData
    connect DiagcMgrProxyAppl10.SetNtcSts10 -> CDD_NvMProxy.SetNtcSts
    connect DiagcMgrProxyAppl10.SetNtcSts10 -> CDD_NxtrTi.SetNtcSts
    connect DiagcMgrProxyAppl10.SetNtcSts10 -> CDD_RamMem.SetNtcSts
    connect DiagcMgrProxyAppl10.SetNtcSts10 -> CDD_VrfyCritReg.SetNtcSts
    connect DiagcMgrProxyAppl10.GetNtcSts10 -> CmnMfgSrv.GetNtcSts
    connect DiagcMgrProxyAppl10.GetNtcQlfrSts10 -> CurrMeasCorrln.GetNtcQlfrSts
    connect DiagcMgrProxyAppl10.SetNtcSts10 -> CurrMeasCorrln.SetNtcSts
    connect DiagcMgrProxyAppl10.GetDiagcDataAppl10 -> DiagcMgr.GetDiagcDataAppl10
    connect DiagcMgrProxyAppl10.GetNtcDebCntrAppl10 -> DiagcMgr.GetNtcDebCntrAppl10
    connect DiagcMgrProxyAppl10.GetNtcInfoAppl10 -> DiagcMgr.GetNtcInfoAppl10
    connect DiagcMgrProxyAppl10.GetNtcQlfrSts10 -> GateDrv0Ctrl.GetNtcQlfrSts
    connect DiagcMgrProxyAppl10.SetNtcSts10 -> GateDrv0Ctrl.SetNtcSts
    connect DiagcMgrProxyAppl10.SetNtcStsAndSnpshtData10 -> GateDrv0Ctrl.SetNtcStsAndSnpshtData
    connect DiagcMgrProxyAppl10.GetNtcQlfrSts10 -> HwTqCorrln.GetNtcQlfrSts
    connect DiagcMgrProxyAppl10.SetNtcSts10 -> HwTqCorrln.SetNtcSts
    connect DiagcMgrProxyAppl10.SetNtcSts10 -> LoaMgr.SetNtcSts
    connect DiagcMgrProxyAppl10.SetNtcSts10 -> McalErrHndlg.SetNtcSts
    connect DiagcMgrProxyAppl10.GetNtcQlfrSts10 -> MotAgCorrln.GetNtcQlfrSts
    connect DiagcMgrProxyAppl10.SetNtcSts10 -> MotAgCorrln.SetNtcSts
    connect DiagcMgrProxyAppl10.SetNtcSts10 -> NxtrMath.SetNtcSts
    connect DiagcMgrProxyAppl10.SetNtcStsAndSnpshtData10 -> PhaDiscnct.SetNtcStsAndSnpshtData
    connect DiagcMgrProxyAppl10.GetNtcQlfrSts10 -> PwrDiscnct.GetNtcQlfrSts
    connect DiagcMgrProxyAppl10.SetNtcSts10 -> PwrDiscnct.SetNtcSts
    connect DiagcMgrProxyAppl10.SetNtcSts10 -> PwrLimr.SetNtcSts
    connect DiagcMgrProxyAppl10.SetNtcSts10 -> PwrSply.SetNtcSts
    connect DiagcMgrProxyAppl10.SetNtcSts10 -> SteerCmdArbnAndLim.SetNtcSts
    connect DiagcMgrProxyAppl10.GetNtcQlfrSts10 -> SysFricLrng.GetNtcQlfrSts
    connect DiagcMgrProxyAppl10.SetNtcSts10 -> SysFricLrng.SetNtcSts
    connect DiagcMgrProxyAppl10.SetNtcSts10 -> TmplMonr.SetNtcSts
    connect DiagcMgrProxyAppl10.SetNtcSts10 -> TunSelnMngt.SetNtcSts
    connect DiagcMgrProxyAppl7.GetDiagcDataAppl7 -> DiagcMgr.GetDiagcDataAppl7
    connect DiagcMgrProxyAppl7.GetNtcDebCntrAppl7 -> DiagcMgr.GetNtcDebCntrAppl7
    connect DiagcMgrProxyAppl7.GetNtcInfoAppl7 -> DiagcMgr.GetNtcInfoAppl7
    connect DiagcMgrProxyAppl7.SetNtcSts7 -> DutyCycThermProtn.SetNtcSts
    connect DiagcMgrProxyAppl7.GetNtcQlfrSts7 -> RvsBattProtn.GetNtcQlfrSts
    connect DiagcMgrProxyAppl7.SetNtcStsAndSnpshtData7 -> RvsBattProtn.SetNtcStsAndSnpshtData
    connect DiagcMgrProxyAppl8.GetNtcQlfrSts8 -> CDD_BattRtnCurr.GetNtcQlfrSts
    connect DiagcMgrProxyAppl8.SetNtcStsAndSnpshtData8 -> CDD_BattRtnCurr.SetNtcStsAndSnpshtData
    connect DiagcMgrProxyAppl8.GetDiagcDataAppl8 -> DiagcMgr.GetDiagcDataAppl8
    connect DiagcMgrProxyAppl8.GetNtcDebCntrAppl8 -> DiagcMgr.GetNtcDebCntrAppl8
    connect DiagcMgrProxyAppl8.GetNtcInfoAppl8 -> DiagcMgr.GetNtcInfoAppl8
    connect DiagcMgrProxyAppl8.GetNtcQlfrSts8 -> TurnCntrCorrln.GetNtcQlfrSts
    connect DiagcMgrProxyAppl8.SetNtcSts8 -> TurnCntrCorrln.SetNtcSts
    connect DiagcMgrProxyAppl9.SetNtcSts9 -> BmwSplyCurrLim.SetNtcSts
    connect DiagcMgrProxyAppl9.GetDiagcDataAppl9 -> DiagcMgr.GetDiagcDataAppl9
    connect DiagcMgrProxyAppl9.GetNtcDebCntrAppl9 -> DiagcMgr.GetNtcDebCntrAppl9
    connect DiagcMgrProxyAppl9.GetNtcInfoAppl9 -> DiagcMgr.GetNtcInfoAppl9
    connect DiagcMgrProxyAppl9.GetNtcActv9 -> EcuTMeas.GetNtcActv
    connect DiagcMgrProxyAppl9.SetNtcStsAndSnpshtData9 -> EcuTMeas.SetNtcStsAndSnpshtData
    connect DiagcMgrStub.GetDiagcDataStub -> DiagcMgr.GetDiagcDataAppl{0..5}
    connect DiagcMgrStub.GetNtcDebCntrStub -> DiagcMgr.GetNtcDebCntrAppl{0..5}
    connect DiagcMgrStub.GetNtcInfoStub -> DiagcMgr.GetNtcInfoAppl{0..5}
    connect DutyCycThermProtn.ThermRednFac -> BmwHaptcFb.ThermRednFac
    connect DutyCycThermProtn.ThermRednFac -> BmwStReqMgr.ThermRednFac
    connect DutyCycThermProtn.ThermMotTqLim -> LimrCdng.ThermMotTqLim
    connect EcuTMeas.EcuTFild -> BmwDiagcSrvHndlg.EcuTFild
    connect EcuTMeas.EcuTFild -> BmwMsgSlot315Bas0Repn1BusFrChA.EcuTFild
    connect EcuTMeas.EcuTFild -> CDD_MotCtrlMgr.EcuTFild
    connect EcuTMeas.EcuTFild -> CmnMfgSrv.EcuTFild
    connect EcuTMeas.EcuTFild -> DiagcMgr.EcuTFild
    connect EcuTMeas.DiagcStsLimdTPrfmnc -> DutyCycThermProtn.DiagcStsLimdTPrfmnc
    connect EcuTMeas.EcuTFild -> DutyCycThermProtn.EcuTFild
    connect EcuTMeas.EcuTFild -> TEstimn.EcuTFild
    connect Effort.HwTqCmdEffort -> ClsdLoopHys.HwTqCmdEffort
    connect Effort.HwTqCmdEffort -> HwRefTqSum.HwTqCmdEffort
    connect ElecPwrCns.ElecInpPwrEstim -> BmwMsgSlot49Bas0Repn2BusFrChA.ElecInpPwrEstim
    connect ElecPwrCns.SplyCurrEstim -> CDD_BattRtnCurr.SplyCurrEstim
    connect EotProtn.EotAssiSca -> LimrCdng.EotAssiSca
    connect EotProtn.EotMotTqLim -> LimrCdng.EotMotTqLim
    connect EotProtn.EotAssiSca -> SteerCmdArbnAndLim.EotCtrlSca
    connect EpsStEstimn.RackFEstimd -> BmwMsgSlot49Bas0Repn2BusFrChA.RackFEstimd
    connect EpsStEstimn.RackFEstimd -> ClsdLoopDampg.RackFEstimd
    connect EpsStEstimn.RackFEstimd -> ClsdLoopHys.RackFEstimd
    connect EpsStEstimn.RackFEstimd -> Effort.RackFEstimd
    connect EpsStEstimn.TorsBarStEstimd -> HwTqTrakgCtrl.TorsBarStEstimd
    connect FalbckAssi.FalbckAssiMotTqCmd -> SteerCmdArbnAndLim.FalbckAssiMotTqCmd
    connect FltInj.FltInj_f32 -> BmwTqOvrlCdngAndDrvgDynFac.FltInj_f32
    connect FltInj.FltInj_f32 -> CDD_CurrMeas.FltInj_f32
    connect FltInj.FltInj_u08 -> CDD_CurrMeas.FltInj_u08
    connect FltInj.FltInj_u08 -> CurrMeasCorrln.FltInj_u08
    connect FltInj.FltInj_u08 -> HwTqCorrln.FltInj_u08
    connect FltInj.FltInj_f32 -> InertiaCmpVel.FltInj_f32
    connect FltInj.FltInj_f32 -> LimrCdng.FltInj_f32
    connect FltInj.FltInj_u08 -> MotAgCorrln.FltInj_u08
    connect FltInj.FltInj_f32 -> PullCmpActv.FltInj_f32
    connect FltInj.FltInj_f32 -> SysFricLrng.FltInj_f32
    connect FltInj.FltInj_f32 -> TqOscn.FltInj_f32
    connect FltInj.FltInj_f32 -> VehSigCdng.FltInj_f32
    connect GateDrv0Ctrl.DiagcStsIvtr1Inactv -> BattVltgCorrln.DiagcStsIvtr1Inactv
    connect GateDrv0Ctrl.DiagcStsIvtr1Inactv -> CDD_CurrMeas.DiagcStsIvtr1Inactv
    connect GateDrv0Ctrl.DiagcStsIvtr1Inactv -> CDD_MotCtrlMgr.DiagcStsIvtr1Inactv
    connect GateDrv0Ctrl.IvtrFetFltPha -> CDD_MotCtrlMgr.IvtrFetFltPha
    connect GateDrv0Ctrl.IvtrFetFltTyp -> CDD_MotCtrlMgr.IvtrFetFltTyp
    connect GateDrv0Ctrl.DiagcStsIvtr1Inactv -> CurrMeasCorrln.DiagcStsIvtr1Inactv
    connect GateDrv0Ctrl.DiagcStsIvtr1Inactv -> LoaMgr.DiagcStsIvtr1Inactv
    connect GateDrv0Ctrl.IvtrFetFltTyp -> LoaMgr.IvtrFetFltTyp
    connect GateDrv0Ctrl.DiagcStsIvtr1Inactv -> PhaDiscnct.DiagcStsIvtr1Inactv
    connect GateDrv0Ctrl.IvtrFetFltPha -> PhaDiscnct.IvtrFetFltPha
    connect GateDrv0Ctrl.IvtrFetFltTyp -> PhaDiscnct.IvtrFetFltTyp
    connect GateDrv0Ctrl.MotDrvr0IninTestCmpl -> PwrUpSeq.MotDrvr0IninTestCmpl
    connect GateDrv0Ctrl.DiagcStsIvtr1Inactv -> ShtdwnMech.DiagcStsIvtr1Inactv
    connect GlbLimr.LimdMotTqCmd -> SteerCmdArbnAndLim.LimdMotTqCmd
    connect HiLoadStallLimr.StallMotTqLim -> LimrCdng.StallMotTqLim
    connect HwRefTqSum.HwTqCmdSum -> HwTqTrakgCtrl.HwTqCmd
    connect HwTqArbn.HwTq -> BmwDiagcSrvHndlg.HwTq
    connect HwTqArbn.HwTq -> BmwHaptcFb.HwTq
    connect HwTqArbn.HwTq -> BmwMsgSlot49Bas0Repn2BusFrChA.HwTq
    connect HwTqArbn.HwTq -> BmwStReqMgr.HwTq
    connect HwTqArbn.HwTq -> BmwTqOvrlCdngAndDrvgDynFac.HwTq
    connect HwTqArbn.HwTq -> ClsdLoopHys.HwTq
    connect HwTqArbn.HwTq -> CmnMfgSrv.HwTq
    connect HwTqArbn.HwTq -> CmplncErr.HwTq
    connect HwTqArbn.HwTq -> DiagcMgr.HwTq
    connect HwTqArbn.HwTq -> EotProtn.HwTq
    connect HwTqArbn.HwTq -> FalbckAssi.HwTq
    connect HwTqArbn.HwTq -> HwTqCorrln.HwTqChA
    connect HwTqArbn.HwTq -> InertiaCmpVel.HwTq
    connect HwTqArbn.HwTq -> PosnTrakgServo.HwTq
    connect HwTqArbn.HwTq -> PullCmpActv.HwTq
    connect HwTqArbn.HwTq -> SteerCmdArbnAndLim.HwTq
    connect HwTqArbn.HwTq -> Swp.HwTq
    connect HwTqArbn.HwTq -> SysFricLrng.HwTq
    connect HwTqArbn.HwTq -> TunSelnAuthy.HwTq
    connect HwTqArbn.HwTq -> VehSigCdng.HwTq
    connect HwTqCorrln.HwTqIdptSig -> BmwDiagcSrvHndlg.HwTqIdptSig
    connect HwTqCorrln.HwTqCorrlnSts -> HwTqArbn.HwTqCorrlnSts
    connect HwTqCorrln.HwTqIdptSig -> LoaMgr.HwTqIdptSig
    connect HwTqTrakgCtrl.MotTqCmdTrakgCtrl -> BmwMsgSlot51Bas0Repn2BusFrChA.BmwTarMotTq
    connect HwTqTrakgCtrl.MotTqCmdTrakgCtrl -> GlbLimr.MotTqCmd
    connect HwTqTrakgCtrl.MotTqCmdTrakgCtrl -> SteerCmdArbnAndLim.MotTqCmd
    connect IoHwAb.GetGpioMcuEna -> BmwStReqMgr.IoHwAb_GetGpioMcuEna
    connect IoHwAb.SetFctGpioMotAg0Clk -> CDD_MotAg0Meas.IoHwAb_SetFctGpioMotAg0Clk
    connect IoHwAb.SetFctGpioMotAg0Cs -> CDD_MotAg0Meas.IoHwAb_SetFctGpioMotAg0Cs
    connect IoHwAb.SetFctGpioMotAg0Mosi -> CDD_MotAg0Meas.IoHwAb_SetFctGpioMotAg0Mosi
    connect IoHwAb.SetGpioMotAg0Clk -> CDD_MotAg0Meas.IoHwAb_SetGpioMotAg0Clk
    connect IoHwAb.SetGpioMotAg0Cs -> CDD_MotAg0Meas.IoHwAb_SetGpioMotAg0Cs
    connect IoHwAb.SetGpioMotAg0Mosi -> CDD_MotAg0Meas.IoHwAb_SetGpioMotAg0Mosi
    connect IoHwAb.SetFctGpioMotAg1Clk -> CDD_MotAg1Meas.IoHwAb_SetFctGpioMotAg1Clk
    connect IoHwAb.SetFctGpioMotAg1Cs -> CDD_MotAg1Meas.IoHwAb_SetFctGpioMotAg1Cs
    connect IoHwAb.SetFctGpioMotAg1Mosi -> CDD_MotAg1Meas.IoHwAb_SetFctGpioMotAg1Mosi
    connect IoHwAb.SetGpioMotAg1Clk -> CDD_MotAg1Meas.IoHwAb_SetGpioMotAg1Clk
    connect IoHwAb.SetGpioMotAg1Cs -> CDD_MotAg1Meas.IoHwAb_SetGpioMotAg1Cs
    connect IoHwAb.SetGpioMotAg1Mosi -> CDD_MotAg1Meas.IoHwAb_SetGpioMotAg1Mosi
    connect IoHwAb.SetFctGpioPhaALowrCmd -> CDD_TSG31CfgAndUse.IoHwAb_SetFctGpioPhaALowrCmd
    connect IoHwAb.SetFctGpioPhaAUpprCmd -> CDD_TSG31CfgAndUse.IoHwAb_SetFctGpioPhaAUpprCmd
    connect IoHwAb.SetFctGpioPhaBLowrCmd -> CDD_TSG31CfgAndUse.IoHwAb_SetFctGpioPhaBLowrCmd
    connect IoHwAb.SetFctGpioPhaBUpprCmd -> CDD_TSG31CfgAndUse.IoHwAb_SetFctGpioPhaBUpprCmd
    connect IoHwAb.SetFctGpioPhaCLowrCmd -> CDD_TSG31CfgAndUse.IoHwAb_SetFctGpioPhaCLowrCmd
    connect IoHwAb.SetFctGpioPhaCUpprCmd -> CDD_TSG31CfgAndUse.IoHwAb_SetFctGpioPhaCUpprCmd
    connect IoHwAb.SetFctPeriphPhaALowrCmd -> CDD_TSG31CfgAndUse.IoHwAb_SetFctPeriphPhaALowrCmd
    connect IoHwAb.SetFctPeriphPhaAUpprCmd -> CDD_TSG31CfgAndUse.IoHwAb_SetFctPeriphPhaAUpprCmd
    connect IoHwAb.SetFctPeriphPhaBLowrCmd -> CDD_TSG31CfgAndUse.IoHwAb_SetFctPeriphPhaBLowrCmd
    connect IoHwAb.SetFctPeriphPhaBUpprCmd -> CDD_TSG31CfgAndUse.IoHwAb_SetFctPeriphPhaBUpprCmd
    connect IoHwAb.SetFctPeriphPhaCLowrCmd -> CDD_TSG31CfgAndUse.IoHwAb_SetFctPeriphPhaCLowrCmd
    connect IoHwAb.SetFctPeriphPhaCUpprCmd -> CDD_TSG31CfgAndUse.IoHwAb_SetFctPeriphPhaCUpprCmd
    connect IoHwAb.SetGpioPhaALowrCmd -> CDD_TSG31CfgAndUse.IoHwAb_SetGpioPhaALowrCmd
    connect IoHwAb.SetGpioPhaAUpprCmd -> CDD_TSG31CfgAndUse.IoHwAb_SetGpioPhaAUpprCmd
    connect IoHwAb.SetGpioPhaBLowrCmd -> CDD_TSG31CfgAndUse.IoHwAb_SetGpioPhaBLowrCmd
    connect IoHwAb.SetGpioPhaBUpprCmd -> CDD_TSG31CfgAndUse.IoHwAb_SetGpioPhaBUpprCmd
    connect IoHwAb.SetGpioPhaCLowrCmd -> CDD_TSG31CfgAndUse.IoHwAb_SetGpioPhaCLowrCmd
    connect IoHwAb.SetGpioPhaCUpprCmd -> CDD_TSG31CfgAndUse.IoHwAb_SetGpioPhaCUpprCmd
    connect IoHwAb.GetGpioGateDrv0Diagc -> GateDrv0Ctrl.IoHwAb_GetGpioMotDrvr0Diag
    connect IoHwAb.SetGpioGateDrv0Rst -> GateDrv0Ctrl.IoHwAb_SetGpioGateDrv0Rst
    connect IoHwAb.SetGpioSysFlt2A -> GateDrv0Ctrl.IoHwAb_SetGpioSysFlt2A
    connect IoHwAb.SetGpioPhaDiscnctA -> PhaDiscnct.IoHwAb_SetGpioPhaDiscnctA
    connect IoHwAb.SetGpioPhaDiscnctB -> PhaDiscnct.IoHwAb_SetGpioPhaDiscnctB
    connect IoHwAb.SetGpioPhaDiscnctC -> PhaDiscnct.IoHwAb_SetGpioPhaDiscnctC
    connect IoHwAb.SetGpioPwrTurnOffCtrl -> PwrUpSeq.IoHwAb_SetGpioPwrTurnOffCtrl
    connect IoHwAb.SetGpioSysFlt2A -> ShtdwnMech.IoHwAb_SetGpioSysFlt2A
    connect IoHwAb.GetGpioPwrOutpEnaFb -> TmplMonr.IoHwAb_GetGpioPwrOutpEnaFb
    connect IoHwAb.SetGpioTmplMonrWdg -> TmplMonr.IoHwAb_SetGpioTmplMonrWdg
    connect LimrCdng.SysMotTqCmdScaCdnd -> BmwSplyCurrLim.SysMotTqCmdSca
    connect LimrCdng.StallMotTqLimCdnd -> SteerCmdArbnAndLim.StallMotTqLim
    connect LimrCdng.SysMotTqCmdScaCdnd -> SteerCmdArbnAndLim.SysMotTqCmdSca
    connect LimrCdng.ThermMotTqLimCdnd -> SteerCmdArbnAndLim.ThermMotTqLim
    connect LimrCdng.VehSpdMotTqLimCdnd -> SteerCmdArbnAndLim.VehSpdMotTqLim
    connect LoaMgr.MotAndThermProtnLoaMod -> CDD_MotCtrlMgr.MotAndThermProtnLoaMod
    connect LoaMgr.MotAndThermProtnLoaMod -> DutyCycThermProtn.MotAndThermProtnLoaMod
    connect LoaMgr.MotAndThermProtnLoaMod -> ElecPwrCns.MotAndThermProtnLoaMod
    connect LoaMgr.MotAndThermProtnLoaMod -> HiLoadStallLimr.MotAndThermProtnLoaMod
    connect LoaMgr.MotAndThermProtnLoaMod -> MotCtrlPrmEstimn.MotAndThermProtnLoaMod
    connect LoaMgr.MotAndThermProtnLoaMod -> MotCurrPeakEstimn.MotAndThermProtnLoaMod
    connect LoaMgr.MotAndThermProtnLoaMod -> MotCurrRegCfg.MotAndThermProtnLoaMod
    connect LoaMgr.MotAndThermProtnLoaMod -> MotRefMdl.MotAndThermProtnLoaMod
    connect LoaMgr.MotAndThermProtnLoaMod -> MotTqCalcd.MotAndThermProtnLoaMod
    connect LoaMgr.LoaSt -> MotTqTranlDampg.LoaSt
    connect LoaMgr.MotAndThermProtnLoaMod -> PwrLimr.MotAndThermProtnLoaMod
    connect LoaMgr.LoaRateLim -> StOutpCtrl.LoaRateLim
    connect LoaMgr.LoaSca -> StOutpCtrl.LoaSca
    connect LoaMgr.MotAndThermProtnLoaMod -> TEstimn.MotAndThermProtnLoaMod
    connect LrndRackCentr.LongTermRackCentrCmpl -> BmwDiagcSrvHndlg.LongTermRackCentrCmpl
    connect LrndRackCentr.RackCentrCmpl -> BmwDiagcSrvHndlg.RackCentrCmpl
    connect LrndRackCentr.RackCentrMotAgErrPrsnt -> BmwDiagcSrvHndlg.RackCentrMotAgErrPrsnt
    connect LrndRackCentr.RackCentrMotAgVld -> BmwDiagcSrvHndlg.RackCentrMotAgVld
    connect LrndRackCentr.RstRackCentrMotAg -> BmwDiagcSrvHndlg.RstRackCentrMotAg
    connect LrndRackCentr.RstRackCentrMotRev -> BmwDiagcSrvHndlg.RstRackCentrMotRev
    connect LrndRackCentr.TotRackTrvl -> BmwDiagcSrvHndlg.TotRackTrvl
    connect LrndRackCentr.LongTermRackCentrCmpl -> BmwHwAgArbnAndEotPosn.LongTermRackCentrCmpl
    connect LrndRackCentr.RackCentrPinionAg -> BmwHwAgArbnAndEotPosn.RackCentrPinionAg
    connect LrndRackCentr.RstRackCentrMotRev -> BmwHwAgArbnAndEotPosn.RstRackCentrMotRev
    connect LrndRackCentr.TotRackTrvl -> BmwHwAgArbnAndEotPosn.TotRackTrvl
    connect LrnPinionCentr.PinionCentrLrnHwTrvl -> BmwDiagcSrvHndlg.PinionCentrLrnHwTrvl
    connect LrnPinionCentr.PinionCentrLrnSt -> BmwDiagcSrvHndlg.PinionCentrLrnSt
    connect LrnPinionCentr.SetInpPrm -> BmwDiagcSrvHndlg.SetInpPrm
    connect LrnPinionCentr.PinionCentrLrnCmd -> BmwMotTqOvrlArbn.PinionCentrLrnCmd
    connect LrnPinionCentr.PinionCentrLrnHwCentr -> LrndRackCentr.PinionCentrLrnHwCentr
    connect LrnPinionCentr.PinionCentrLrnHwTrvl -> LrndRackCentr.PinionCentrLrnHwTrvl
    connect LrnPinionCentr.PinionCentrLrnSt -> LrndRackCentr.PinionCentrLrnSt
    connect McuErrInj.ReadErrInjReg -> CDD_AdcDiagc.ReadErrInjReg
    connect McuErrInj.StrtErrInjCntr -> CDD_AdcDiagc.StrtErrInjCntr
    connect McuErrInj.ClrErrInjReg -> CDD_NxtrTi.ClrErrInjReg
    connect McuErrInj.ReadErrInjReg -> CDD_NxtrTi.ReadErrInjReg
    connect McuErrInj.UpdErrInjReg -> CmnMfgSrv.UpdErrInjReg
    connect MotAgCorrln.MotAgMeclCorrlnSt -> BmwHwAgArbnAndEotPosn.MotAgMeclCorrlnSt
    connect MotAgCorrln.MotAgMeclIdptSig -> CDD_MotVel.MotAgMeclIdptSig
    connect MotAgCorrln.MotAgMeclIdptSig -> LoaMgr.MotAgMeclIdptSig
    connect MotCtrlPrmEstimn.MotInduDaxEstimdIvs -> CDD_MotCtrlMgr.MotInduDaxEstimdIvs
    connect MotCtrlPrmEstimn.MotInduQaxEstimdIvs -> CDD_MotCtrlMgr.MotInduQaxEstimdIvs
    connect MotCtrlPrmEstimn.MotREstimd -> CDD_MotCtrlMgr.MotREstimd
    connect MotCtrlPrmEstimn.GetMotPrmNomEol -> CmnMfgSrv.GetMotPrmNomEol
    connect MotCtrlPrmEstimn.SetMotPrmNomEol -> CmnMfgSrv.SetMotPrmNomEol
    connect MotCtrlPrmEstimn.MotInduDaxEstimd -> MotCurrRegCfg.MotInduDaxEstimd
    connect MotCtrlPrmEstimn.MotInduQaxEstimd -> MotCurrRegCfg.MotInduQaxEstimd
    connect MotCtrlPrmEstimn.MotREstimd -> MotCurrRegCfg.MotREstimd
    connect MotCtrlPrmEstimn.MotBackEmfConEstimd -> MotRefMdl.MotBackEmfConEstimd
    connect MotCtrlPrmEstimn.MotInduDaxEstimd -> MotRefMdl.MotInduDaxEstimd
    connect MotCtrlPrmEstimn.MotInduQaxEstimd -> MotRefMdl.MotInduQaxEstimd
    connect MotCtrlPrmEstimn.MotREstimd -> MotRefMdl.MotREstimd
    connect MotCtrlPrmEstimn.MotBackEmfConEstimd -> MotTqCalcd.MotBackEmfConEstimd
    connect MotCtrlPrmEstimn.MotInduDaxEstimd -> MotTqCalcd.MotInduDaxEstimd
    connect MotCtrlPrmEstimn.MotInduQaxEstimd -> MotTqCalcd.MotInduQaxEstimd
    connect MotCtrlPrmEstimn.MotBackEmfConEstimd -> PwrLimr.MotBackEmfConEstimd
    connect MotCurrPeakEstimn.MotCurrPeakEstimdFild -> BmwMsgSlot315Bas0Repn1BusFrChA.MotCurrPeakEstimdFild
    connect MotCurrPeakEstimn.MotCurrPeakEstimd -> DutyCycThermProtn.MotCurrPeakEstimd
    connect MotCurrPeakEstimn.MotCurrPeakEstimdFild -> DutyCycThermProtn.MotCurrPeakEstimdFild
    connect MotCurrPeakEstimn.MotCurrPeakEstimd -> TEstimn.MotCurrPeakEstimd
    connect MotCurrRegCfg.MotAgElecDly -> CDD_MotCtrlMgr.MotAgElecDly
    connect MotCurrRegCfg.MotDampgDax -> CDD_MotCtrlMgr.MotDampgDax
    connect MotCurrRegCfg.MotDampgQax -> CDD_MotCtrlMgr.MotDampgQax
    connect MotCurrRegCfg.MotIntglGainDax -> CDD_MotCtrlMgr.MotIntglGainDax
    connect MotCurrRegCfg.MotIntglGainQax -> CDD_MotCtrlMgr.MotIntglGainQax
    connect MotCurrRegCfg.MotPropGainDax -> CDD_MotCtrlMgr.MotPropGainDax
    connect MotCurrRegCfg.MotPropGainQax -> CDD_MotCtrlMgr.MotPropGainQax
    connect MotQuadDetn.MotQuad -> MotRefMdl.MotQuad
    connect MotRefMdl.MotBackEmfVltg -> CDD_MotCtrlMgr.MotBackEmfVltg
    connect MotRefMdl.MotCurrDaxCmd -> CDD_MotCtrlMgr.MotCurrDaxCmd
    connect MotRefMdl.MotCurrDaxMax -> CDD_MotCtrlMgr.MotCurrDaxMax
    connect MotRefMdl.MotCurrQaxCmd -> CDD_MotCtrlMgr.MotCurrQaxCmd
    connect MotRefMdl.MotReacncDax -> CDD_MotCtrlMgr.MotReacncDax
    connect MotRefMdl.MotReacncQax -> CDD_MotCtrlMgr.MotReacncQax
    connect MotRefMdl.MotVltgDaxFf -> CDD_MotCtrlMgr.MotVltgDaxFf
    connect MotRefMdl.MotVltgQaxFf -> CDD_MotCtrlMgr.MotVltgQaxFf
    connect MotRefMdl.MotCurrDaxCmd -> ElecPwrCns.MotCurrDaxCmd
    connect MotRefMdl.MotCurrQaxCmd -> ElecPwrCns.MotCurrQaxCmd
    connect MotRefMdl.MotCurrDaxCmd -> MotCtrlPrmEstimn.MotCurrDaxCmd
    connect MotRefMdl.MotCurrQaxCmd -> MotCtrlPrmEstimn.MotCurrQaxCmd
    connect MotRefMdl.MotCurrDaxCmd -> MotCurrPeakEstimn.MotCurrDaxCmd
    connect MotRefMdl.MotCurrQaxCmd -> MotCurrPeakEstimn.MotCurrQaxCmd
    connect MotRefMdl.MotCurrDaxCmd -> MotTqCalcd.MotCurrDaxCmd
    connect MotRefMdl.MotCurrQaxCmd -> MotTqCalcd.MotCurrQaxCmd
    connect MotTqCalcd.MotTqEstimd -> EpsStEstimn.MotTqEstimd
    connect MotTqCmdSca.MotTqCmdMrfScad -> BmwDiagcSrvHndlg.MotTqCmdMrfScad
    connect MotTqCmdSca.GetMotTqCmdSca -> CmnMfgSrv.GetMotTqCmdSca
    connect MotTqCmdSca.SetMotTqCmdSca -> CmnMfgSrv.SetMotTqCmdSca
    connect MotTqCmdSca.MotTqCmdMrfScad -> DiagcMgr.MotTqCmdMrfScad
    connect MotTqCmdSca.MotTqCmdMrfScad -> MotQuadDetn.MotTqCmd
    connect MotTqCmdSca.MotTqCmdMrfScad -> MotRefMdl.MotTqCmdMrfScad
    connect MotTqTranlDampg.MotTqCmdCrfDampd -> CmplncErr.MotTqCmdCrf
    connect MotTqTranlDampg.MotTqCmdCrfDampd -> LrndRackCentr.MotTqCmd
    connect MotTqTranlDampg.MotTqCmdMrfDampd -> PwrLimr.MotTqCmdMrf
    connect MotTqTranlDampg.MotTqTranlDampgCmpl -> StOutpCtrl.MotTqTranlDampgCmpl
    connect MotTqTranlDampg.MotTqCmdCrfDampd -> SysFricLrng.MotTqCmdCrf
    connect MotVelCtrl.GetCtrlPrm -> CmnMfgSrv.GetCtrlPrm
    connect MotVelCtrl.SetCtrlPrm -> CmnMfgSrv.SetCtrlPrm
    connect MotVelCtrl.StopCtrl -> CmnMfgSrv.StopCtrl
    connect MotVelCtrl.StrtCtrl -> CmnMfgSrv.StrtCtrl
    connect NxtrCalIds.NxtrCalIdsCalDevlpRd -> CmnMfgSrv.NxtrCalIdsCalDevlpRd
    connect NxtrCalIds.NxtrCalIdsCalRelRd -> CmnMfgSrv.NxtrCalIdsCalRelRd
    connect NxtrSwIds.NxtrSwIdsPsrInfoRd -> CmnMfgSrv.NxtrSwIdsPsrInfoRd
    connect NxtrSwIds.NxtrSwIdsSwBuildDateTiRd -> CmnMfgSrv.NxtrSwIdsSwBuildDateTiRd
    connect NxtrSwIds.NxtrSwIdsSwRelInfoRd -> CmnMfgSrv.NxtrSwIdsSwRelInfoRd
    connect NxtrSwIds.NxtrSwIdsSwRelNrRd -> CmnMfgSrv.NxtrSwIdsSwRelNrRd
    connect NxtrSwIds.NxtrSwIdsSwRelVerRd -> CmnMfgSrv.NxtrSwIdsSwRelVerRd
    connect Omc.StdDiagCbk -> StdDiag.AllowOpModeChangeCbkPort
    connect Omc.extendedOperatingModeSwitchPort -> StdDiag.ExtendedOperatingModeControlPort
    connect Omc.operatingModeSwitchPort -> StdDiag.OperatingModeControlPort
    connect PhaDiscnct.PhaDiscnctDiagcActv -> CDD_MotCtrlMgr.PhaDiscnctDiagcActv
    connect PhaDiscnct.PhaDiscnctDiagcPwmVect -> CDD_MotCtrlMgr.PhaDiscnctDiagcPwmVect
    connect PhaDiscnct.PhaDiscnctDiagcActv -> CDD_TSG31CfgAndUse.PhaDiscnctDiagcActv
    connect PhaDiscnct.PhaDiscnctWrmIninTestCmpl -> PwrUpSeq.PhaDiscnctWrmIninTestCmpl
    connect PolarityCfg.HwTq4Polarity -> CDD_HwTq4Meas.HwTq4Polarity
    connect PolarityCfg.HwTq5Polarity -> CDD_HwTq5Meas.HwTq5Polarity
    connect PolarityCfg.MotAgMecl0Polarity -> CDD_MotAg0Meas.MotAg0Polarity
    connect PolarityCfg.MotAgMecl1Polarity -> CDD_MotAg1Meas.MotAg1Polarity
    connect PolarityCfg.MotAgMecl3Polarity -> CDD_MotAg3Meas.MotAgMecl3Polarity
    connect PolarityCfg.MotAgMecl4Polarity -> CDD_MotAg4Meas.MotAgMecl4Polarity
    connect PolarityCfg.AssiMechPolarity -> CDD_MotAgCmp.AssiMechPolarity
    connect PolarityCfg.MotElecMeclPolarity -> CDD_MotCtrlMgr.MotElecMeclPolarity
    connect PolarityCfg.AssiMechPolarity -> CDD_MotVel.AssiMechPolarity
    connect PolarityCfg.MotElecMeclPolarity -> CDD_SinVltgGenn.MotElecMeclPolarity
    connect PolarityCfg.PolarityCfgRead -> CmnMfgSrv.PolarityCfgRead
    connect PolarityCfg.PolarityCfgWr -> CmnMfgSrv.PolarityCfgWr
    connect PolarityCfg.AssiMechPolarity -> CtrldVelRtn.AssiMechPolarity
    connect PolarityCfg.AssiMechPolarity -> MotTqTranlDampg.AssiMechPolarity
    connect PosnTrakgServo.PosnServoCmd -> BmwMotTqOvrlArbn.PosnServoCmd
    connect PullCmpActv.PullCmpCmd -> BmwMotTqOvrlArbn.PullCmpCmd
    connect PullCmpActv.GetPullCmpPrm -> CmnMfgSrv.GetPullCmpPrm
    connect PullCmpActv.RstPullCmp -> CmnMfgSrv.RstPullCmp
    connect PullCmpActv.SetPullCmpLongTerm -> CmnMfgSrv.SetPullCmpLongTerm
    connect PullCmpActv.SetPullCmpShoTerm -> CmnMfgSrv.SetPullCmpShoTerm
    connect PwrDiscnct.PwrDiscnctATestCmpl -> PwrUpSeq.PwrDiscnctATestCmpl
    connect PwrDiscnct.PwrDiscnctBTestCmpl -> PwrUpSeq.PwrDiscnctBTestCmpl
    connect PwrLimr.MotTqCmdPwrLimd -> BmwDrvgDynStMac.MotTqCmdPwrLimd
    connect PwrLimr.MotTqCmdPwrLimd -> BmwMsgSlot315Bas0Repn1BusFrChA.MotTqCmdPwrLimd
    connect PwrLimr.PwrLimrRednFac -> BmwStReqMgr.PwrLimrRednFac
    connect PwrLimr.MotTqCmdPwrLimd -> CtrldVelRtn.MotTqCmdPwrLimd
    connect PwrLimr.MotTqCmdPwrLimd -> MotTqCmdSca.MotTqCmdMrf
    connect PwrUpSeq.StrtUpSt -> BattVltgCorrln.StrtUpSt
    connect PwrUpSeq.StrtUpSt -> CDD_CurrMeas.StrtUpSt
    connect PwrUpSeq.StrtUpSt -> GateDrv0Ctrl.StrtUpSt
    connect PwrUpSeq.StrtUpSt -> PhaDiscnct.StrtUpSt
    connect PwrUpSeq.StrtUpSt -> PwrDiscnct.StrtUpSt
    connect PwrUpSeq.StrtUpSt -> ShtdwnMech.StrtUpSt
    connect PwrUpSeq.StrtUpSt -> SysStMod.StrtUpSt
    connect PwrUpSeq.SysStWrmIninCmpl -> SysStMod.SysStWrmIninCmpl
    connect PwrUpSeq.StrtUpSt -> TmplMonr.StrtUpSt
    connect Rmh_Cdd.TriggerIPDUSend -> Rmh.TriggerIPDUSend
    connect StdDiag.AllowOpModeChangePort -> Omc.StdDiag
    connect SteerCmdArbnAndLim.SetManTqCmd -> CmnMfgSrv.SetManTqCmd
    connect SteerCmdArbnAndLim.MotTqCmdLimdPreStall -> HiLoadStallLimr.MotTqCmdLimdPreStall
    connect SteerCmdArbnAndLim.SetManTqCmd -> MotVelCtrl.SetManTqCmd
    connect SteerCmdArbnAndLim.ArbdMotTqCmd -> Swp.MotTqCmd
    connect StOutpCtrl.SysMotTqCmdSca -> EotProtn.SysMotTqCmdSca
    connect StOutpCtrl.SysMotTqCmdSca -> LimrCdng.SysMotTqCmdSca
    connect StOutpCtrl.SysStReqDi -> SysStMod.SysStReqDi
    connect Swp.HwTqSwp -> CtrldVelRtn.HwTq
    connect Swp.HwTqSwp -> EpsStEstimn.HwTq
    connect Swp.HwTqSwp -> GlbLimr.HwTq
    connect Swp.MotTqCmdSwp -> MotTqTranlDampg.MotTqCmdCrf
    connect SysFricLrng.SysFricOffs -> ClsdLoopHys.SysFricOffs
    connect SysFricLrng.ClrFricLrngOperMod -> CmnMfgSrv.ClrFricLrngOperMod
    connect SysFricLrng.GetFricData -> CmnMfgSrv.GetFricData
    connect SysFricLrng.GetFricLrngData -> CmnMfgSrv.GetFricLrngData
    connect SysFricLrng.GetFricOffsOutpDi -> CmnMfgSrv.GetFricOffsOutpDi
    connect SysFricLrng.InitFricLrngTbl -> CmnMfgSrv.InitFricLrngTbl
    connect SysFricLrng.SetFricData -> CmnMfgSrv.SetFricData
    connect SysFricLrng.SetFricLrngData -> CmnMfgSrv.SetFricLrngData
    connect SysFricLrng.SetFricOffsOutpDi -> CmnMfgSrv.SetFricOffsOutpDi
    connect SysKineAndEff.HwVel -> BmwDiagcSrvHndlg.HwVel
    connect SysKineAndEff.HwVel -> BmwPwrPrkgDampg.HwVel
    connect SysKineAndEff.PinionVel -> ClsdLoopDampg.PinionVel
    connect SysKineAndEff.HwVel -> ClsdLoopHys.HwVel
    connect SysKineAndEff.HwVel -> CtrldVelRtn.HwVel
    connect SysKineAndEff.PinionTqToRackFInstsRat -> EpsStEstimn.PinionTqToRackFInstsRat
    connect SysKineAndEff.SysKineRat -> EpsStEstimn.SysKineRat
    connect SysKineAndEff.SysTqRat -> EpsStEstimn.SysTqRat
    connect SysKineAndEff.HwVel -> FltInj.HwVel
    connect SysKineAndEff.SysTqRat -> HwTqTrakgCtrl.SysTqRat
    connect SysKineAndEff.HwVel -> PullCmpActv.HwVel
    connect SysKineAndEff.HwVel -> SysFricLrng.HwVel
    connect SysKineAndEff.HwVel -> TEstimn.HwVel
    connect SysKineAndEff.HwVel -> TunSelnAuthy.HwVel
    connect SysStMod.SysSt -> BattVltgCorrln.SysSt
    connect SysStMod.SysSt -> BmwDiagcSrvHndlg.SysSt
    connect SysStMod.SysSt -> BmwMsgSlot315Bas0Repn1BusFrChA.SysSt
    connect SysStMod.SysSt -> BmwStReqMgr.SysSt
    connect SysStMod.SysSt -> CDD_BattRtnCurr.SysSt
    connect SysStMod.SysSt -> CDD_CurrMeas.SysSt
    connect SysStMod.SysSt -> CDD_McuDiagc.SysSt
    connect SysStMod.SysSt -> CDD_MotCtrlMgr.SysSt
    connect SysStMod.SysSt -> CDD_TSG31CfgAndUse.SysSt
    connect SysStMod.SysSt -> CmnMfgSrv.SysSt
    connect SysStMod.SysSt -> CurrMeasCorrln.SysSt
    connect SysStMod.SysSt -> DiagcMgr.SysSt
    connect SysStMod.SysSt -> GateDrv0Ctrl.SysSt
    connect SysStMod.SysSt -> MotTqTranlDampg.SysSt
    connect SysStMod.SysSt -> PhaDiscnct.SysSt
    connect SysStMod.SysSt -> PwrSply.SysSt
    connect SysStMod.SysSt -> PwrUpSeq.SysSt
    connect SysStMod.SysSt -> TmplMonr.SysSt
    connect TEstimn.MotFetT -> BmwMsgSlot315Bas0Repn1BusFrChA.MotFetT
    connect TEstimn.MotMagT -> BmwMsgSlot315Bas0Repn1BusFrChA.MotMagT
    connect TEstimn.MotWidgT -> BmwMsgSlot315Bas0Repn1BusFrChA.MotWidgT
    connect TEstimn.MotFetT -> DutyCycThermProtn.MotFetT
    connect TEstimn.MotMagT -> DutyCycThermProtn.MotMagT
    connect TEstimn.MotWidgT -> DutyCycThermProtn.MotWidgT
    connect TEstimn.MotFetT -> MotCtrlPrmEstimn.MotFetT
    connect TEstimn.MotMagT -> MotCtrlPrmEstimn.MotMagT
    connect TEstimn.MotWidgT -> MotCtrlPrmEstimn.MotWidgT
    connect TEstimn.AssiMechT -> SysFricLrng.AssiMechT
    connect TmplMonr.TmplMonrIninTestCmpl -> PwrUpSeq.TmplMonIninTestCmpl
    connect TqOscn.HwOscnActv -> BmwHaptcFb.HwOscnActv
    connect TqOscn.HwOscnDcThdExcdd -> BmwHaptcFb.HwOscnDcThdExcdd
    connect TqOscn.HwOscnActv -> BmwMotTqOvrlArbn.HwOscnActv
    connect TqOscn.HwOscnCmd -> BmwMotTqOvrlArbn.HwOscnCmd
    connect TqOscn.HwOscnDcThdExcdd -> BmwMotTqOvrlArbn.HwOscnDcThdExcdd
    connect TunSelnAuthy.XcpCalChgReq -> CDD_XcpIf.XcpCalChgReq
    connect TunSelnAuthy.RtCalChgReq -> TunSelnMngt.RtCalChgReq
    connect TunSelnMngt.ActvGroup -> CDD_XcpIf.ActvGroup
    connect TunSelnMngt.ActvIninIdx -> CDD_XcpIf.ActvIninIdx
    connect TunSelnMngt.ActvIninOptSetAIdx -> CDD_XcpIf.ActvIninOptSetAIdx
    connect TunSelnMngt.ActvRtIdx -> CDD_XcpIf.ActvRtIdx
    connect TunSelnMngt.CalCopySts -> CDD_XcpIf.CalCopySts
    connect TunSelnMngt.CopyCalPageReq -> CDD_XcpIf.CopyCalPageReq
    connect TunSelnMngt.GetCalPageReq -> CDD_XcpIf.GetCalPageReq
    connect TunSelnMngt.GetSegInfoReq -> CDD_XcpIf.GetSegInfoReq
    connect TunSelnMngt.OnlineTunRamAdrMpg -> CDD_XcpIf.OnlineTunRamAdrMpg
    connect TunSelnMngt.SetCalPageReq -> CDD_XcpIf.SetCalPageReq
    connect TurnCntrCorrln.TurnCntrCorrlnSts -> BmwDiagcSrvHndlg.TurnCntrCorrlnSts
    connect TurnCntrCorrln.TurnCntrCorrlnSts -> BmwHwAgArbnAndEotPosn.TurnCntrCorrlnSts
    connect TurnCntrCorrln.TurnCntrIdptSig -> CDD_MotAg0Meas.TurnCntrIdptSig
    connect VehSigCdng.VehLgtA -> InertiaCmpVel.VehLgtA
    connect VehSigCdng.VehLgtA -> PullCmpActv.VehLatA
    connect VehSigCdng.VehLatA -> SysFricLrng.VehLatA
    connect VehSpdLimr.VehSpdMotTqLim -> LimrCdng.VehSpdMotTqLim
    connect Vin.Vin -> Coding.Vin
    delegate Rmh.RxRequestedMsgID <-> outer port ANFRAGE_ID2
    delegate BmwMsgSlot108Bas0Repn2BusFrChA.AVL_STEA_PNI_OFFS <-> outer port AVL_STEA_PNI_OFFS
    delegate BmwMsgSlot315Bas0Repn1BusFrChA.BATT_VLTG_EPS <-> outer port BATT_VLTG_EPS
    delegate BmwMsgSlot269Bas2Repn4BusFrChA.CTR_WARN_DIR_VIB_EPS <-> outer port CTR_WARN_DIR_VIB_EPS
    delegate BmwMsgSlot269Bas2Repn4BusFrChA.CTR_WARN_ILVL_VIB_EPS <-> outer port CTR_WARN_ILVL_VIB_EPS
    delegate BmwMsgSlot269Bas2Repn4BusFrChA.CTR_WARN_PTRN_VIB_EPS <-> outer port CTR_WARN_PTRN_VIB_EPS
    delegate BmwMsgSlot315Bas0Repn1BusFrChA.DBG_EPS_BS_MOD_58_BYTE_ID2 <-> outer port DBG_EPS_BS_MOD_58_BYTE_ID2
    delegate BmwMsgSlot315Bas0Repn1BusFrChA.ECU_TEMP_EPS <-> outer port ECU_TEMP_EPS
    delegate BmwMsgSlot315Bas0Repn1BusFrChA.ESTIMD_PEAK_MOT_CURR_EPS <-> outer port ESTIMD_PEAK_MOT_CURR_EPS
    delegate BmwMsgSlot53Bas3Repn8BusFrChA.FACT_MO_STE_SO_DXP <-> outer port FACT_MO_STE_SO_DXP
    delegate BmwMsgSlot276Bas4Repn8BusFrChA.MILE_KM <-> outer port MILE_KM
    delegate BmwMsgSlot315Bas0Repn1BusFrChA.MOT_FET_TEMP_EPS <-> outer port MOT_FET_TEMP_EPS
    delegate BmwMsgSlot315Bas0Repn1BusFrChA.MOT_MAG_TEMP_EPS <-> outer port MOT_MAG_TEMP_EPS
    delegate BmwMsgSlot315Bas0Repn1BusFrChA.MOT_TQ_CMD_EPS <-> outer port MOT_TQ_CMD_EPS
    delegate BmwMsgSlot315Bas0Repn1BusFrChA.MOT_TQ_CMD_LIMD_EPS <-> outer port MOT_TQ_CMD_LIMD_EPS
    delegate BmwMsgSlot315Bas0Repn1BusFrChA.MOT_VEL_EPS <-> outer port MOT_VEL_EPS
    delegate BmwMsgSlot315Bas0Repn1BusFrChA.MOT_WIDG_TEMP_EPS <-> outer port MOT_WIDG_TEMP_EPS
    delegate BacComIf.NO_VECH_{1..7} <-> outer port NO_VECH_{1..7}
    delegate BmwMsgSlot315Bas0Repn1BusFrChA.PRIM_HW_TQ_SNSR_VLTG_EPS <-> outer port PRIM_HW_TQ_SNSR_VLTG_EPS
    delegate BmwMsgSlot315Bas0Repn1BusFrChA.SECDRY_HW_TQ_SNSR_VLTG_EPS <-> outer port SECDRY_HW_TQ_SNSR_VLTG_EPS
    delegate BmwMsgSlot55Bas0Repn2BusFrChA.sigGroup_ACLNY_MASSCNTR <-> outer port sigGroup_ACLNY_MASSCNTR
    delegate BmwMsgSlot49Bas0Repn2BusFrChA.sigGroup_AVL_FORC_GRD <-> outer port sigGroup_AVL_FORC_GRD
    delegate BmwMsgSlot51Bas0Repn2BusFrChA.sigGroup_AVL_PO_EPS <-> outer port sigGroup_AVL_PO_EPS
    delegate BmwMsgSlot49Bas0Repn2BusFrChA.sigGroup_AVL_STMOM_DV_ACT <-> outer port sigGroup_AVL_STMOM_DV_ACT
    delegate BmwMsgSlot121Bas1Repn2BusFrChA.sigGroup_CON_VEH <-> outer port sigGroup_CON_VEH
    delegate BmwMsgSlot274Bas2Repn4BusFrChA.sigGroup_DISP_CC_EPS <-> outer port sigGroup_DISP_CC_EPS
    delegate BmwMsgSlot49Bas1Repn2BusFrChA.sigGroup_DT_EST <-> outer port sigGroup_DT_EST
    delegate BmwMsgSlot68Bas1Repn2BusFrChA.sigGroup_ENERG_DGR_DRDY <-> outer port sigGroup_ENERG_DGR_DRDY
    delegate BmwMsgSlot107Bas0Repn1BusFrChA.sigGroup_OFFS_QUAD_EPS <-> outer port sigGroup_OFFS_QUAD_EPS
    delegate BmwMsgSlot234Bas1Repn2BusFrChA.sigGroup_ST_EST <-> outer port sigGroup_ST_EST
    delegate BmwMsgSlot274Bas0Repn8BusFrChA.sigGroup_SU_EPS <-> outer port sigGroup_SU_EPS
    delegate BmwMsgSlot68Bas0Repn2BusFrChA.sigGroup_TAR_QTA_STRMOM_DV <-> outer port sigGroup_TAR_QTA_STRMOM_DV
    delegate BmwMsgSlot68Bas0Repn2BusFrChA.sigGroup_TAR_STMOM_DV_ACT <-> outer port sigGroup_TAR_STMOM_DV_ACT
    delegate BmwMsgSlot55Bas3Repn4BusFrChA.sigGroup_V_VEH <-> outer port sigGroup_V_VEH
    delegate BmwMsgSlot56Bas0Repn2BusFrChA.sigGroup_VYAW_VEH <-> outer port sigGroup_VYAW_VEH
    delegate BmwMsgSlot315Bas0Repn1BusFrChA.ST_CON_VEH_EPS <-> outer port ST_CON_VEH_EPS
    delegate Stm.EnergyModeRx <-> outer port ST_ENERG_FZM
    delegate Stm.CentralErrorLockRx <-> outer port ST_ILK_ERRM_FZM
    delegate BmwMsgSlot53Bas3Repn8BusFrChA.SU_CLU_STMOM_SFE_DXP <-> outer port SU_CLU_STMOM_SFE_DXP
    delegate BmwMsgSlot315Bas0Repn1BusFrChA.SYS_ST_EPS <-> outer port SYS_ST_EPS
    delegate SysTime.SysTimeRx <-> outer port T_SEC_COU_REL
    delegate BmwMsgSlot51Bas0Repn2BusFrChA.TRGG_ENGTORQ_EPS <-> outer port TRGG_ENGTORQ_EPS
    delegate BmwMsgSlot315Bas0Repn1BusFrChA.VEH_SPD_EPS <-> outer port VEH_SPD_EPS
package /Systems
  system EPS: category=SYSTEM_EXTRACT
    system mapping EPS_MPPNG
      data-mappings:
        sender-receiver-to-signal-mapping={data-element=SystemComponentPrototype.NO_VECH_7.NO_VECH_7, system-signal=NO_VECH_7}
        sender-receiver-to-signal-mapping={data-element=SystemComponentPrototype.FACT_MO_STE_SO_DXP.FACT_MO_STE_SO_DXP, system-signal=FACT_MO_STE_SO_DXP}
        sender-receiver-to-signal-mapping={data-element=SystemComponentPrototype.ECU_TEMP_EPS.ECU_TEMP_EPS, system-signal=ECU_TEMP_EPS}
        sender-receiver-to-signal-mapping={data-element=SystemComponentPrototype.NO_VECH_4.NO_VECH_4, system-signal=NO_VECH_4}
        sender-receiver-to-signal-group-mapping={data-element=SystemComponentPrototype.sigGroup_CON_VEH.sigGroup_CON_VEH, signal-group=sigGroup_CON_VEH, type-mapping=sender-rec-record-type-mapping=record-element-mappings=[{implementation-record-element=ST_CON_VEH, system-signal=ST_CON_VEH}, {implementation-record-element=QU_ST_CON_VEH, system-signal=QU_ST_CON_VEH}, {implementation-record-element=CTR_FKTN_PRTNT, system-signal=CTR_FKTN_PRTNT}, {implementation-record-element=CTR_BS_PRTNT, system-signal=CTR_BS_PRTNT}, {implementation-record-element=CRC_CON_VEH, system-signal=CRC_CON_VEH}, {implementation-record-element=CON_VEH_dummy_56_63, system-signal=CON_VEH_dummy_56_63}, {implementation-record-element=ALIV_CON_VEH, system-signal=ALIV_CON_VEH}]}
        sender-receiver-to-signal-mapping={data-element=SystemComponentPrototype.CTR_WARN_PTRN_VIB_EPS.CTR_WARN_PTRN_VIB_EPS, system-signal=CTR_WARN_PTRN_VIB_EPS}
        sender-receiver-to-signal-mapping={data-element=SystemComponentPrototype.ST_ILK_ERRM_FZM.centralErrorLock, system-signal=ST_ILK_ERRM_FZM}
        sender-receiver-to-signal-group-mapping={data-element=SystemComponentPrototype.sigGroup_DT_EST.sigGroup_DT_EST, signal-group=sigGroup_DT_EST, type-mapping=sender-rec-record-type-mapping=record-element-mappings=[{implementation-record-element=ST_CULI_EST, system-signal=ST_CULI_EST}, {implementation-record-element=QU_AVL_I_ACT_EST, system-signal=QU_AVL_I_ACT_EST}, {implementation-record-element=DT_EST_dummy_96_127, system-signal=DT_EST_dummy_96_127}, {implementation-record-element=DT_EST_dummy_64_95, system-signal=DT_EST_dummy_64_95}, {implementation-record-element=DT_EST_dummy_16_47, system-signal=DT_EST_dummy_16_47}, {implementation-record-element=DT_EST_dummy_12_15, system-signal=DT_EST_dummy_12_15}, {implementation-record-element=CRC_DT_EST, system-signal=CRC_DT_EST}, {implementation-record-element=AVL_I_ACT_EST, system-signal=AVL_I_ACT_EST}, {implementation-record-element=ALIV_DT_EST, system-signal=ALIV_DT_EST}]}
        sender-receiver-to-signal-group-mapping={data-element=SystemComponentPrototype.sigGroup_AVL_PO_EPS.sigGroup_AVL_PO_EPS, signal-group=sigGroup_AVL_PO_EPS, type-mapping=sender-rec-record-type-mapping=record-element-mappings=[{implementation-record-element=UN_PO_EPS, system-signal=UN_PO_EPS}, {implementation-record-element=QU_AVL_PO_EPS, system-signal=QU_AVL_PO_EPS}, {implementation-record-element=OFFS_GRD_MID_EPS, system-signal=OFFS_GRD_MID_EPS}, {implementation-record-element=IDX_TORQ_SEN, system-signal=IDX_TORQ_SEN}, {implementation-record-element=CRC_AVL_PO_EPS, system-signal=CRC_AVL_PO_EPS}, {implementation-record-element=AVL_PO_IDX_EPS, system-signal=AVL_PO_IDX_EPS}, {implementation-record-element=AVL_PO_EPS, system-signal=AVL_PO_EPS}, {implementation-record-element=ALIV_AVL_PO_EPS, system-signal=ALIV_AVL_PO_EPS}]}
        sender-receiver-to-signal-mapping={data-element=SystemComponentPrototype.TRGG_ENGTORQ_EPS.TRGG_ENGTORQ_EPS, system-signal=TRGG_ENGTORQ_EPS}
        sender-receiver-to-signal-group-mapping={data-element=SystemComponentPrototype.sigGroup_ST_EST.sigGroup_ST_EST, signal-group=sigGroup_ST_EST, type-mapping=sender-rec-record-type-mapping=record-element-mappings=[{implementation-record-element=ST_EST_dummy_16_23, system-signal=ST_EST_dummy_16_23}, {implementation-record-element=QU_SER_STMOM_DV_ACT, system-signal=QU_SER_STMOM_DV_ACT}, {implementation-record-element=QU_FN_VIB_EPS, system-signal=QU_FN_VIB_EPS}, {implementation-record-element=QU_FN_EST, system-signal=QU_FN_EST}, {implementation-record-element=CRC_ST_EST_FTAX, system-signal=CRC_ST_EST_FTAX}, {implementation-record-element=ALIV_ST_EST_FTAX, system-signal=ALIV_ST_EST_FTAX}]}
        sender-receiver-to-signal-mapping={data-element=SystemComponentPrototype.ST_ENERG_FZM.energyState, system-signal=ST_ENERG_FZM}
        sender-receiver-to-signal-mapping={data-element=SystemComponentPrototype.NO_VECH_6.NO_VECH_6, system-signal=NO_VECH_6}
        sender-receiver-to-signal-mapping={data-element=SystemComponentPrototype.AVL_STEA_PNI_OFFS.AVL_STEA_PNI_OFFS, system-signal=AVL_STEA_PNI_OFFS}
        sender-receiver-to-signal-mapping={data-element=SystemComponentPrototype.MOT_WIDG_TEMP_EPS.MOT_WIDG_TEMP_EPS, system-signal=MOT_WIDG_TEMP_EPS}
        sender-receiver-to-signal-mapping={data-element=SystemComponentPrototype.NO_VECH_1.NO_VECH_1, system-signal=NO_VECH_1}
        sender-receiver-to-signal-mapping={data-element=SystemComponentPrototype.BATT_VLTG_EPS.BATT_VLTG_EPS, system-signal=BATT_VLTG_EPS}
        sender-receiver-to-signal-group-mapping={data-element=SystemComponentPrototype.sigGroup_AVL_STMOM_DV_ACT.sigGroup_AVL_STMOM_DV_ACT, signal-group=sigGroup_AVL_STMOM_DV_ACT, type-mapping=sender-rec-record-type-mapping=record-element-mappings=[{implementation-record-element=QU_AVL_STMOM_DV_ACT, system-signal=QU_AVL_STMOM_DV_ACT}, {implementation-record-element=CRC_AVL_STMOM_DV_ACT, system-signal=CRC_AVL_STMOM_DV_ACT}, {implementation-record-element=AVL_STMOM_DV_ACT_dummy_12_15, system-signal=AVL_STMOM_DV_ACT_dummy_12_15}, {implementation-record-element=AVL_STMOM_DV_ACT, system-signal=AVL_STMOM_DV_ACT}, {implementation-record-element=ALIV_AVL_STMOM_DV_ACT, system-signal=ALIV_AVL_STMOM_DV_ACT}]}
        sender-receiver-to-signal-mapping={data-element=SystemComponentPrototype.MOT_FET_TEMP_EPS.MOT_FET_TEMP_EPS, system-signal=MOT_FET_TEMP_EPS}
        sender-receiver-to-signal-mapping={data-element=SystemComponentPrototype.MILE_KM.MILE_KM, system-signal=MILE_KM}
        sender-receiver-to-signal-mapping={data-element=SystemComponentPrototype.SU_CLU_STMOM_SFE_DXP.SU_CLU_STMOM_SFE_DXP, system-signal=SU_CLU_STMOM_SFE_DXP}
        sender-receiver-to-signal-group-mapping={data-element=SystemComponentPrototype.sigGroup_TAR_QTA_STRMOM_DV.sigGroup_TAR_QTA_STRMOM_DV, signal-group=sigGroup_TAR_QTA_STRMOM_DV, type-mapping=sender-rec-record-type-mapping=record-element-mappings=[{implementation-record-element=TAR_QTA_STRMOM_DV_dummy_12_15, system-signal=TAR_QTA_STRMOM_DV_dummy_12_15}, {implementation-record-element=TAR_QTA_STMOM_DV, system-signal=TAR_QTA_STMOM_DV}, {implementation-record-element=QU_TAR_QTA_STMOM_DV, system-signal=QU_TAR_QTA_STMOM_DV}, {implementation-record-element=QU_TAR_FACT_STMOM_FTAX, system-signal=QU_TAR_FACT_STMOM_FTAX}, {implementation-record-element=FACT_DMPNG_STMOM_FTAX, system-signal=FACT_DMPNG_STMOM_FTAX}, {implementation-record-element=FACT_CTRR_STMOM_FTAX, system-signal=FACT_CTRR_STMOM_FTAX}, {implementation-record-element=FACT_ASS_STMOM_FTAX, system-signal=FACT_ASS_STMOM_FTAX}, {implementation-record-element=CTR_DEAC_EPS_FNS, system-signal=CTR_DEAC_EPS_FNS}, {implementation-record-element=CRC_TAR_QTA_STMOM_DV, system-signal=CRC_TAR_QTA_STMOM_DV}, {implementation-record-element=ALIV_TAR_QTA_STMOM_DV, system-signal=ALIV_TAR_QTA_STMOM_DV}]}
        sender-receiver-to-signal-mapping={data-element=SystemComponentPrototype.MOT_TQ_CMD_EPS.MOT_TQ_CMD_EPS, system-signal=MOT_TQ_CMD_EPS}
        sender-receiver-to-signal-group-mapping={data-element=SystemComponentPrototype.sigGroup_DISP_CC_EPS.sigGroup_DISP_CC_EPS, signal-group=sigGroup_DISP_CC_EPS, type-mapping=sender-rec-record-type-mapping=record-element-mappings=[{implementation-record-element=TRANF_CC_EPS, system-signal=TRANF_CC_EPS}, {implementation-record-element=ST_IDC_CC_EPS, system-signal=ST_IDC_CC_EPS}, {implementation-record-element=ST_CC_EPS, system-signal=ST_CC_EPS}, {implementation-record-element=NO_CC_EPS, system-signal=NO_CC_EPS}, {implementation-record-element=CRC_DISP_CC_EPS, system-signal=CRC_DISP_CC_EPS}, {implementation-record-element=CHL_DISP_CC_EPS, system-signal=CHL_DISP_CC_EPS}, {implementation-record-element=ALIV_DISP_CC_EPS, system-signal=ALIV_DISP_CC_EPS}]}
        sender-receiver-to-signal-mapping={data-element=SystemComponentPrototype.NO_VECH_5.NO_VECH_5, system-signal=NO_VECH_5}
        sender-receiver-to-signal-mapping={data-element=SystemComponentPrototype.MOT_VEL_EPS.MOT_VEL_EPS, system-signal=MOT_VEL_EPS}
        sender-receiver-to-signal-mapping={data-element=SystemComponentPrototype.CTR_WARN_ILVL_VIB_EPS.CTR_WARN_ILVL_VIB_EPS, system-signal=CTR_WARN_ILVL_VIB_EPS}
        sender-receiver-to-signal-group-mapping={data-element=SystemComponentPrototype.sigGroup_TAR_STMOM_DV_ACT.sigGroup_TAR_STMOM_DV_ACT, signal-group=sigGroup_TAR_STMOM_DV_ACT, type-mapping=sender-rec-record-type-mapping=record-element-mappings=[{implementation-record-element=TAR_STMOM_DV_ACT_dummy_32_51, system-signal=TAR_STMOM_DV_ACT_dummy_32_51}, {implementation-record-element=TAR_STMOM_DV_ACT_dummy_12_15, system-signal=TAR_STMOM_DV_ACT_dummy_12_15}, {implementation-record-element=TAR_STMOM_DV_ACT, system-signal=TAR_STMOM_DV_ACT}, {implementation-record-element=QU_TAR_STMOM_DV_ACT, system-signal=QU_TAR_STMOM_DV_ACT}, {implementation-record-element=QU_TAR_DMPNG_ADDON_STMOM_FTAX, system-signal=QU_TAR_DMPNG_ADDON_STMOM_FTAX}, {implementation-record-element=FACT_DMPNG_ADDON_STMOM_FTAX, system-signal=FACT_DMPNG_ADDON_STMOM_FTAX}, {implementation-record-element=CRC_TAR_STMOM_DV_ACT, system-signal=CRC_TAR_STMOM_DV_ACT}, {implementation-record-element=ALIV_TAR_STMOM_DV_ACT, system-signal=ALIV_TAR_STMOM_DV_ACT}]}
        sender-receiver-to-signal-group-mapping={data-element=SystemComponentPrototype.sigGroup_V_VEH.sigGroup_V_VEH, signal-group=sigGroup_V_VEH, type-mapping=sender-rec-record-type-mapping=record-element-mappings=[{implementation-record-element=V_VEH_dummy_39_39, system-signal=V_VEH_dummy_39_39}, {implementation-record-element=V_VEH_COG, system-signal=V_VEH_COG}, {implementation-record-element=ST_V_VEH_NSS, system-signal=ST_V_VEH_NSS}, {implementation-record-element=QU_V_VEH_COG, system-signal=QU_V_VEH_COG}, {implementation-record-element=DVCO_VEH, system-signal=DVCO_VEH}, {implementation-record-element=CRC_V_VEH, system-signal=CRC_V_VEH}, {implementation-record-element=ALIV_V_VEH, system-signal=ALIV_V_VEH}]}
        sender-receiver-to-signal-mapping={data-element=SystemComponentPrototype.MOT_TQ_CMD_LIMD_EPS.MOT_TQ_CMD_LIMD_EPS, system-signal=MOT_TQ_CMD_LIMD_EPS}
        sender-receiver-to-signal-mapping={data-element=SystemComponentPrototype.T_SEC_COU_REL.timeSignal, system-signal=T_SEC_COU_REL}
        sender-receiver-to-signal-mapping={data-element=SystemComponentPrototype.NO_VECH_2.NO_VECH_2, system-signal=NO_VECH_2}
        sender-receiver-to-signal-mapping={data-element=SystemComponentPrototype.PRIM_HW_TQ_SNSR_VLTG_EPS.PRIM_HW_TQ_SNSR_VLTG_EPS, system-signal=PRIM_HW_TQ_SNSR_VLTG_EPS}
        sender-receiver-to-signal-mapping={data-element=SystemComponentPrototype.NO_VECH_3.NO_VECH_3, system-signal=NO_VECH_3}
        sender-receiver-to-signal-group-mapping={data-element=SystemComponentPrototype.sigGroup_ENERG_DGR_DRDY.sigGroup_ENERG_DGR_DRDY, signal-group=sigGroup_ENERG_DGR_DRDY, type-mapping=sender-rec-record-type-mapping=record-element-mappings=[{implementation-record-element=RQ_CULI_EST_SFY, system-signal=RQ_CULI_EST_SFY}, {implementation-record-element=QU_DGR_AISP_ENERG, system-signal=QU_DGR_AISP_ENERG}, {implementation-record-element=MAX_I_SPEC_EPS, system-signal=MAX_I_SPEC_EPS}, {implementation-record-element=MAX_I_SPEC_BAX_STE, system-signal=MAX_I_SPEC_BAX_STE}, {implementation-record-element=MAX_I_RECUP_SPEC_ARS, system-signal=MAX_I_RECUP_SPEC_ARS}, {implementation-record-element=MAX_I_LD_SPEC_ARS, system-signal=MAX_I_LD_SPEC_ARS}, {implementation-record-element=ENERG_DGR_DRDY_dummy_12_15, system-signal=ENERG_DGR_DRDY_dummy_12_15}, {implementation-record-element=ENERG_AVAI_ARS, system-signal=ENERG_AVAI_ARS}, {implementation-record-element=CRC_ENERG_DGR_DRDY, system-signal=CRC_ENERG_DGR_DRDY}, {implementation-record-element=ALIV_ENERG_DGR_DRDY, system-signal=ALIV_ENERG_DGR_DRDY}]}
        sender-receiver-to-signal-mapping={data-element=SystemComponentPrototype.ANFRAGE_ID2.requestedMsgID, system-signal=ANFRAGE_ID2}
        sender-receiver-to-signal-group-mapping={data-element=SystemComponentPrototype.sigGroup_VYAW_VEH.sigGroup_VYAW_VEH, signal-group=sigGroup_VYAW_VEH, type-mapping=sender-rec-record-type-mapping=record-element-mappings=[{implementation-record-element=VYAW_VEH_dummy_12_15, system-signal=VYAW_VEH_dummy_12_15}, {implementation-record-element=VYAW_VEH_ERR_AMP, system-signal=VYAW_VEH_ERR_AMP}, {implementation-record-element=VYAW_VEH, system-signal=VYAW_VEH}, {implementation-record-element=QU_VYAW_VEH, system-signal=QU_VYAW_VEH}, {implementation-record-element=CRC_VYAW_VEH, system-signal=CRC_VYAW_VEH}, {implementation-record-element=ALIV_VYAW_VEH, system-signal=ALIV_VYAW_VEH}]}
        sender-receiver-to-signal-group-mapping={data-element=SystemComponentPrototype.sigGroup_AVL_FORC_GRD.sigGroup_AVL_FORC_GRD, signal-group=sigGroup_AVL_FORC_GRD, type-mapping=sender-rec-record-type-mapping=record-element-mappings=[{implementation-record-element=QU_AVL_FORC_GRD, system-signal=QU_AVL_FORC_GRD}, {implementation-record-element=CRC_AVL_FORC_GRD, system-signal=CRC_AVL_FORC_GRD}, {implementation-record-element=AVL_PWR_EL_EPS_COOD, system-signal=AVL_PWR_EL_EPS_COOD}, {implementation-record-element=AVL_FORC_GRD_dummy_12_15, system-signal=AVL_FORC_GRD_dummy_12_15}, {implementation-record-element=AVL_FORC_GRD, system-signal=AVL_FORC_GRD}, {implementation-record-element=ALIV_AVL_FORC_GRD, system-signal=ALIV_AVL_FORC_GRD}]}
        sender-receiver-to-signal-mapping={data-element=SystemComponentPrototype.CTR_WARN_DIR_VIB_EPS.CTR_WARN_DIR_VIB_EPS, system-signal=CTR_WARN_DIR_VIB_EPS}
        sender-receiver-to-signal-mapping={data-element=SystemComponentPrototype.DBG_EPS_BS_MOD_58_BYTE_ID2.DBG_EPS_BS_MOD_58_BYTE_ID2, system-signal=DBG_EPS_BS_MOD_58_BYTE_ID2}
        sender-receiver-to-signal-group-mapping={data-element=SystemComponentPrototype.sigGroup_ACLNY_MASSCNTR.sigGroup_ACLNY_MASSCNTR, signal-group=sigGroup_ACLNY_MASSCNTR, type-mapping=sender-rec-record-type-mapping=record-element-mappings=[{implementation-record-element=QU_ACLNY_COG, system-signal=QU_ACLNY_COG}, {implementation-record-element=CRC_ACLNY_COG, system-signal=CRC_ACLNY_COG}, {implementation-record-element=ALIV_ACLNY_COG, system-signal=ALIV_ACLNY_COG}, {implementation-record-element=ACLNY_MASSCNTR_dummy_12_15, system-signal=ACLNY_MASSCNTR_dummy_12_15}, {implementation-record-element=ACLNY_COG_ERR_AMP, system-signal=ACLNY_COG_ERR_AMP}, {implementation-record-element=ACLNY_COG, system-signal=ACLNY_COG}]}
        sender-receiver-to-signal-group-mapping={data-element=SystemComponentPrototype.sigGroup_SU_EPS.sigGroup_SU_EPS, signal-group=sigGroup_SU_EPS, type-mapping=sender-rec-record-type-mapping=record-element-mappings=[{implementation-record-element=UN_TOT_STR_EPS, system-signal=UN_TOT_STR_EPS}, {implementation-record-element=TOT_STR_EPS, system-signal=TOT_STR_EPS}, {implementation-record-element=SU_EPS_dummy_20_51, system-signal=SU_EPS_dummy_20_51}, {implementation-record-element=SU_EPS_dummy_14_19, system-signal=SU_EPS_dummy_14_19}, {implementation-record-element=CRC_SU_EPS, system-signal=CRC_SU_EPS}, {implementation-record-element=ALIV_SU_EPS, system-signal=ALIV_SU_EPS}]}
        sender-receiver-to-signal-mapping={data-element=SystemComponentPrototype.SECDRY_HW_TQ_SNSR_VLTG_EPS.SECDRY_HW_TQ_SNSR_VLTG_EPS, system-signal=SECDRY_HW_TQ_SNSR_VLTG_EPS}
        sender-receiver-to-signal-group-mapping={data-element=SystemComponentPrototype.sigGroup_OFFS_QUAD_EPS.sigGroup_OFFS_QUAD_EPS, signal-group=sigGroup_OFFS_QUAD_EPS, type-mapping=sender-rec-record-type-mapping=record-element-mappings=[{implementation-record-element=ST_OFFS_QUAD_EPS, system-signal=ST_OFFS_QUAD_EPS}, {implementation-record-element=OFFS_QUAD_RTR_EPS, system-signal=OFFS_QUAD_RTR_EPS}, {implementation-record-element=CRC_OFFS_QUAD_EPS, system-signal=CRC_OFFS_QUAD_EPS}, {implementation-record-element=AVL_PO_IDX_ICM, system-signal=AVL_PO_IDX_ICM}, {implementation-record-element=ALIV_OFFS_QUAD_EPS, system-signal=ALIV_OFFS_QUAD_EPS}]}
        sender-receiver-to-signal-mapping={data-element=SystemComponentPrototype.MOT_MAG_TEMP_EPS.MOT_MAG_TEMP_EPS, system-signal=MOT_MAG_TEMP_EPS}
        sender-receiver-to-signal-mapping={data-element=SystemComponentPrototype.VEH_SPD_EPS.VEH_SPD_EPS, system-signal=VEH_SPD_EPS}
    root-software-compositions:
      root sw composition prototype SystemComponentPrototype: software-composition=SystemComponent
package /Systems/EndToEndProtections
  end to end protection set EndToEndProtectionSet
    18 x end to end protection:
      endToEndProt_ACLNY_MASSCNTR: end-to-end-profile={category=PROFILE_01, data-ids=[31, 31, 31, 31, 31, 31, 31, 31, 31, 31, 31, 31, 31, 31, 31, 31, 31, 31, 31, 31, 31, 31, 31, 31, 31, 31, 31, 31, 31, 31, 31, 31, 31, 31, 31, 31, 31, 31, 31, 31, 31, 31, 31, 31, 31, 31, 31, 31, 31, 31, 31, 31, 31, 31, 31, 31, 31, 31, 31, 31, 31, 31, 31, 31, 31, 31, 31, 31, 31, 31, 31, 31, 31, 31, 31, 31, 31, 31, 31, 31, 31, 31, 31, 31, 31, 31, 31, 31, 31, 31, 31, 31, 31, 31, 31, 31, 31, 31, 31, 31, 31, 31, 31, 31, 31, 31, 31, 31, 31, 31, 31, 31, 31, 31, 31, 31, 31, 31, 31, 31, 31, 31, 31, 31, 31, 31, 31, 31, 31, 31, 31, 31, 31, 31, 31, 31, 31, 31, 31, 31, 31, 31, 31, 31, 31, 31, 31, 31, 31, 31, 31, 31, 31, 31, 31, 31, 31, 31, 31, 31, 31, 31, 31, 31, 31, 31, 31, 31, 31, 31, 31, 31, 31, 31, 31, 31, 31, 31, 31, 31, 31, 31, 31, 31, 31, 31, 31, 31, 31, 31, 31, 31, 31, 31, 31, 31, 31, 31, 31, 31, 31, 31, 31, 31, 31, 31, 31, 31, 31, 31, 31, 31, 31, 31, 31, 31, 31, 31, 31, 31, 31, 31, 31, 31, 31, 31, 31, 31, 31, 31, 31, 31, 31, 31, 31, 31, 31, 31, 31, 31, 31, 31, 31, 31, 31, 31, 31, 31, 31, 31, 31, 31, 31, 31, 31, 31, 31, 31, 31, 31, 31, 31, 31, 31, 31, 31, 31, 31, 31, 31, 31, 31, 31, 31, 31, 31, 31, 31, 31, 31, 31, 31, 31, 31, 31, 31, 31, 31, 31, 31, 31, 31, 31, 31, 31, 31, 31, 31, 31, 31], data-id-mode=0, data-length=48, max-delta-counter-init=14, crc-offset=0, counter-offset=8, data-id-nibble-offset=0}, end-to-end-protection-variable-prototype=receiver=BmwMsgSlot55Bas0Repn2BusFrChA.SystemComponentPrototype.sigGroup_ACLNY_MASSCNTR.sigGroup_ACLNY_MASSCNTR
      endToEndProt_AVL_FORC_GRD: end-to-end-profile={category=PROFILE_01, data-ids=[190, 190, 190, 190, 190, 190, 190, 190, 190, 190, 190, 190, 190, 190, 190, 190, 190, 190, 190, 190, 190, 190, 190, 190, 190, 190, 190, 190, 190, 190, 190, 190, 190, 190, 190, 190, 190, 190, 190, 190, 190, 190, 190, 190, 190, 190, 190, 190, 190, 190, 190, 190, 190, 190, 190, 190, 190, 190, 190, 190, 190, 190, 190, 190, 190, 190, 190, 190, 190, 190, 190, 190, 190, 190, 190, 190, 190, 190, 190, 190, 190, 190, 190, 190, 190, 190, 190, 190, 190, 190, 190, 190, 190, 190, 190, 190, 190, 190, 190, 190, 190, 190, 190, 190, 190, 190, 190, 190, 190, 190, 190, 190, 190, 190, 190, 190, 190, 190, 190, 190, 190, 190, 190, 190, 190, 190, 190, 190, 190, 190, 190, 190, 190, 190, 190, 190, 190, 190, 190, 190, 190, 190, 190, 190, 190, 190, 190, 190, 190, 190, 190, 190, 190, 190, 190, 190, 190, 190, 190, 190, 190, 190, 190, 190, 190, 190, 190, 190, 190, 190, 190, 190, 190, 190, 190, 190, 190, 190, 190, 190, 190, 190, 190, 190, 190, 190, 190, 190, 190, 190, 190, 190, 190, 190, 190, 190, 190, 190, 190, 190, 190, 190, 190, 190, 190, 190, 190, 190, 190, 190, 190, 190, 190, 190, 190, 190, 190, 190, 190, 190, 190, 190, 190, 190, 190, 190, 190, 190, 190, 190, 190, 190, 190, 190, 190, 190, 190, 190, 190, 190, 190, 190, 190, 190, 190, 190, 190, 190, 190, 190, 190, 190, 190, 190, 190, 190, 190, 190, 190, 190, 190, 190, 190, 190, 190, 190, 190, 190, 190, 190, 190, 190, 190, 190, 190, 190, 190, 190, 190, 190, 190, 190, 190, 190, 190, 190, 190, 190, 190, 190, 190, 190, 190, 190, 190, 190, 190, 190, 190, 190], data-id-mode=0, data-length=40, max-delta-counter-init=14, crc-offset=0, counter-offset=8, data-id-nibble-offset=0}, end-to-end-protection-variable-prototype=BmwMsgSlot49Bas0Repn2BusFrChA.SystemComponentPrototype.sigGroup_AVL_FORC_GRD.sigGroup_AVL_FORC_GRD
      endToEndProt_AVL_PO_EPS: end-to-end-profile={category=PROFILE_01, data-ids=[186, 186, 186, 186, 186, 186, 186, 186, 186, 186, 186, 186, 186, 186, 186, 186, 186, 186, 186, 186, 186, 186, 186, 186, 186, 186, 186, 186, 186, 186, 186, 186, 186, 186, 186, 186, 186, 186, 186, 186, 186, 186, 186, 186, 186, 186, 186, 186, 186, 186, 186, 186, 186, 186, 186, 186, 186, 186, 186, 186, 186, 186, 186, 186, 186, 186, 186, 186, 186, 186, 186, 186, 186, 186, 186, 186, 186, 186, 186, 186, 186, 186, 186, 186, 186, 186, 186, 186, 186, 186, 186, 186, 186, 186, 186, 186, 186, 186, 186, 186, 186, 186, 186, 186, 186, 186, 186, 186, 186, 186, 186, 186, 186, 186, 186, 186, 186, 186, 186, 186, 186, 186, 186, 186, 186, 186, 186, 186, 186, 186, 186, 186, 186, 186, 186, 186, 186, 186, 186, 186, 186, 186, 186, 186, 186, 186, 186, 186, 186, 186, 186, 186, 186, 186, 186, 186, 186, 186, 186, 186, 186, 186, 186, 186, 186, 186, 186, 186, 186, 186, 186, 186, 186, 186, 186, 186, 186, 186, 186, 186, 186, 186, 186, 186, 186, 186, 186, 186, 186, 186, 186, 186, 186, 186, 186, 186, 186, 186, 186, 186, 186, 186, 186, 186, 186, 186, 186, 186, 186, 186, 186, 186], data-id-mode=0, data-length=64, max-delta-counter-init=14, crc-offset=0, counter-offset=8, data-id-nibble-offset=0}, end-to-end-protection-variable-prototype=BmwMsgSlot51Bas0Repn2BusFrChA.SystemComponentPrototype.sigGroup_AVL_PO_EPS.sigGroup_AVL_PO_EPS
      endToEndProt_AVL_RPM_WHL: end-to-end-profile={category=PROFILE_01, data-ids=[17, 17, 17, 17, 17, 17, 17, 17, 17, 17, 17, 17, 17, 17, 17, 17, 17, 17, 17, 17, 17, 17, 17, 17, 17, 17, 17, 17, 17, 17, 17, 17, 17, 17, 17, 17, 17, 17, 17, 17, 17, 17, 17, 17, 17, 17, 17, 17, 17, 17, 17, 17, 17, 17, 17, 17, 17, 17, 17, 17, 17, 17, 17, 17, 17, 17, 17, 17, 17, 17, 17, 17, 17, 17, 17, 17, 17, 17, 17, 17, 17, 17, 17, 17, 17, 17, 17, 17, 17, 17, 17, 17, 17, 17, 17, 17, 17, 17, 17, 17, 17, 17, 17, 17, 17, 17, 17, 17, 17, 17, 17, 17, 17, 17, 17, 17, 17, 17, 17, 17, 17, 17, 17, 17, 17, 17, 17, 17, 17, 17, 17, 17, 17, 17, 17, 17, 17, 17, 17, 17, 17, 17, 17, 17, 17, 17, 17, 17, 17, 17, 17, 17, 17, 17, 17, 17, 17, 17, 17, 17, 17, 17, 17, 17, 17, 17, 17, 17, 17, 17, 17, 17, 17, 17, 17, 17, 17, 17, 17, 17, 17, 17, 17, 17, 17, 17, 17, 17, 17, 17, 17, 17, 17, 17, 17, 17, 17, 17, 17, 17, 17, 17, 17, 17, 17, 17, 17, 17, 17, 17, 17, 17, 17, 17, 17, 17, 17, 17, 17, 17, 17, 17, 17, 17, 17, 17, 17, 17, 17, 17, 17, 17, 17, 17, 17, 17, 17, 17, 17, 17, 17, 17, 17, 17, 17, 17, 17, 17, 17, 17, 17, 17, 17, 17, 17, 17, 17, 17, 17, 17, 17, 17, 17, 17, 17, 17, 17, 17, 17, 17, 17, 17, 17, 17, 17, 17, 17, 17, 17, 17, 17, 17, 17, 17, 17, 17, 17, 17, 17, 17, 17, 17, 17, 17, 17, 17, 17, 17, 17, 17], data-id-mode=0, data-length=96, max-delta-counter-init=14, crc-offset=0, counter-offset=8, data-id-nibble-offset=0}, end-to-end-protection-i-signal-i-pdu{data-offset=0, i-signal-group=sigGroup_AVL_RPM_WHL, i-signal-i-pdu=AVL_RPM_WHL}
      endToEndProt_AVL_STMOM_DV_ACT: end-to-end-profile={category=PROFILE_01, data-ids=[108, 108, 108, 108, 108, 108, 108, 108, 108, 108, 108, 108, 108, 108, 108, 108, 108, 108, 108, 108, 108, 108, 108, 108, 108, 108, 108, 108, 108, 108, 108, 108, 108, 108, 108, 108, 108, 108, 108, 108, 108, 108, 108, 108, 108, 108, 108, 108, 108, 108, 108, 108, 108, 108, 108, 108, 108, 108, 108, 108, 108, 108, 108, 108, 108, 108, 108, 108, 108, 108, 108, 108, 108, 108, 108, 108, 108, 108, 108, 108, 108, 108, 108, 108, 108, 108, 108, 108, 108, 108, 108, 108, 108, 108, 108, 108, 108, 108, 108, 108, 108, 108, 108, 108, 108, 108, 108, 108, 108, 108, 108, 108, 108, 108, 108, 108, 108, 108, 108, 108, 108, 108, 108, 108, 108, 108, 108, 108, 108, 108, 108, 108, 108, 108, 108, 108, 108, 108, 108, 108, 108, 108, 108, 108, 108, 108, 108, 108, 108, 108, 108, 108, 108, 108, 108, 108, 108, 108, 108, 108, 108, 108, 108, 108, 108, 108, 108, 108, 108, 108, 108, 108, 108, 108, 108, 108, 108, 108, 108, 108, 108, 108, 108, 108, 108, 108, 108, 108, 108, 108, 108, 108, 108, 108, 108, 108, 108, 108, 108, 108, 108, 108, 108, 108, 108, 108, 108, 108, 108, 108, 108, 108, 108, 108, 108, 108, 108, 108, 108, 108, 108, 108, 108, 108, 108, 108, 108, 108, 108, 108, 108, 108, 108, 108, 108, 108, 108, 108, 108, 108, 108, 108, 108, 108, 108, 108, 108, 108, 108, 108, 108, 108, 108, 108, 108, 108, 108, 108, 108, 108, 108, 108, 108, 108, 108, 108, 108, 108, 108, 108, 108, 108, 108, 108, 108, 108, 108, 108, 108, 108, 108, 108, 108, 108, 108, 108, 108, 108, 108, 108, 108, 108, 108, 108, 108, 108, 108, 108, 108, 108], data-id-mode=0, data-length=32, max-delta-counter-init=14, crc-offset=0, counter-offset=8, data-id-nibble-offset=0}, end-to-end-protection-variable-prototype=BmwMsgSlot49Bas0Repn2BusFrChA.SystemComponentPrototype.sigGroup_AVL_STMOM_DV_ACT.sigGroup_AVL_STMOM_DV_ACT
      endToEndProt_CON_VEH: end-to-end-profile={category=PROFILE_01, data-ids=[197, 197, 197, 197, 197, 197, 197, 197, 197, 197, 197, 197, 197, 197, 197, 197, 197, 197, 197, 197, 197, 197, 197, 197, 197, 197, 197, 197, 197, 197, 197, 197, 197, 197, 197, 197, 197, 197, 197, 197, 197, 197, 197, 197, 197, 197, 197, 197, 197, 197, 197, 197, 197, 197, 197, 197, 197, 197, 197, 197, 197, 197, 197, 197, 197, 197, 197, 197, 197, 197, 197, 197, 197, 197, 197, 197, 197, 197, 197, 197, 197, 197, 197, 197, 197, 197, 197, 197, 197, 197, 197, 197, 197, 197, 197, 197, 197, 197, 197, 197, 197, 197, 197, 197, 197, 197, 197, 197, 197, 197, 197, 197, 197, 197, 197, 197, 197, 197, 197, 197, 197, 197, 197, 197, 197, 197, 197, 197, 197, 197, 197, 197, 197, 197, 197, 197, 197, 197, 197, 197, 197, 197, 197, 197, 197, 197, 197, 197, 197, 197, 197, 197, 197, 197, 197, 197, 197, 197, 197, 197, 197, 197, 197, 197, 197, 197, 197, 197, 197, 197, 197, 197, 197, 197, 197, 197, 197, 197, 197, 197, 197, 197, 197, 197, 197, 197, 197, 197, 197, 197, 197, 197, 197, 197, 197, 197, 197, 197, 197, 197, 197, 197, 197, 197, 197, 197, 197, 197, 197, 197, 197, 197, 197, 197, 197, 197, 197, 197, 197, 197, 197, 197, 197, 197, 197, 197], data-id-mode=0, data-length=64, max-delta-counter-init=14, crc-offset=0, counter-offset=8, data-id-nibble-offset=0}, end-to-end-protection-variable-prototype=receiver=BmwMsgSlot121Bas1Repn2BusFrChA.SystemComponentPrototype.sigGroup_CON_VEH.sigGroup_CON_VEH
      endToEndProt_DISP_CC_EPS: end-to-end-profile={category=PROFILE_01, data-ids=[3148, 3148, 3148, 3148, 3148, 3148, 3148, 3148, 3148, 3148, 3148, 3148, 3148, 3148, 3148, 3148, 3148, 3148, 3148, 3148, 3148, 3148, 3148, 3148, 3148, 3148, 3148, 3148, 3148, 3148, 3148, 3148, 3148, 3148, 3148, 3148, 3148, 3148, 3148, 3148, 3148, 3148, 3148, 3148, 3148, 3148, 3148, 3148, 3148, 3148, 3148, 3148, 3148, 3148, 3148, 3148, 3148, 3148, 3148, 3148, 3148, 3148, 3148, 3148, 3148, 3148, 3148, 3148, 3148, 3148, 3148, 3148, 3148, 3148, 3148, 3148, 3148, 3148, 3148, 3148, 3148, 3148, 3148, 3148, 3148, 3148, 3148, 3148, 3148, 3148, 3148, 3148, 3148, 3148, 3148, 3148, 3148, 3148, 3148, 3148, 3148, 3148, 3148, 3148, 3148, 3148, 3148, 3148, 3148, 3148, 3148, 3148, 3148, 3148, 3148, 3148, 3148, 3148, 3148, 3148, 3148, 3148, 3148, 3148, 3148, 3148, 3148, 3148, 3148, 3148, 3148, 3148, 3148, 3148, 3148, 3148, 3148, 3148, 3148, 3148, 3148, 3148, 3148, 3148, 3148, 3148, 3148, 3148, 3148, 3148, 3148, 3148, 3148, 3148, 3148, 3148, 3148, 3148, 3148, 3148, 3148, 3148, 3148, 3148, 3148, 3148, 3148, 3148, 3148, 3148, 3148, 3148, 3148, 3148, 3148, 3148, 3148, 3148, 3148, 3148, 3148, 3148, 3148, 3148, 3148, 3148, 3148, 3148, 3148, 3148, 3148, 3148, 3148, 3148, 3148, 3148, 3148, 3148, 3148, 3148, 3148, 3148, 3148, 3148, 3148, 3148, 3148, 3148, 3148, 3148, 3148, 3148, 3148, 3148], data-id-mode=3, data-length=40, max-delta-counter-init=14, crc-offset=0, counter-offset=8, data-id-nibble-offset=12}, end-to-end-protection-variable-prototype=BmwMsgSlot274Bas2Repn4BusFrChA.SystemComponentPrototype.sigGroup_DISP_CC_EPS.sigGroup_DISP_CC_EPS
      endToEndProt_DT_EST: end-to-end-profile={category=PROFILE_01, data-ids=[230, 230, 230, 230, 230, 230, 230, 230, 230, 230, 230, 230, 230, 230, 230, 230, 230, 230, 230, 230, 230, 230, 230, 230, 230, 230, 230, 230, 230, 230, 230, 230, 230, 230, 230, 230, 230, 230, 230, 230, 230, 230, 230, 230, 230, 230, 230, 230, 230, 230, 230, 230, 230, 230, 230, 230, 230, 230, 230, 230, 230, 230, 230, 230, 230, 230, 230, 230, 230, 230, 230, 230, 230, 230, 230, 230, 230, 230, 230, 230, 230, 230, 230, 230, 230, 230, 230, 230, 230, 230, 230, 230, 230, 230, 230, 230, 230, 230, 230, 230, 230, 230, 230, 230, 230, 230, 230, 230, 230, 230, 230, 230, 230, 230, 230, 230, 230, 230, 230, 230, 230, 230, 230, 230, 230, 230, 230, 230, 230, 230, 230, 230, 230, 230, 230, 230, 230, 230, 230, 230, 230, 230, 230, 230, 230, 230, 230, 230, 230, 230, 230, 230, 230, 230, 230, 230, 230, 230, 230, 230, 230, 230, 230, 230, 230, 230, 230, 230, 230, 230, 230, 230, 230, 230, 230, 230, 230, 230, 230, 230, 230, 230, 230, 230, 230, 230, 230, 230, 230, 230, 230, 230, 230, 230, 230, 230, 230, 230, 230, 230, 230, 230, 230, 230, 230, 230, 230, 230, 230, 230, 230, 230, 230, 230, 230, 230, 230, 230, 230, 230, 230, 230, 230, 230, 230, 230, 230, 230, 230, 230, 230, 230, 230, 230, 230, 230, 230, 230, 230, 230, 230, 230, 230, 230, 230, 230, 230, 230, 230, 230, 230, 230, 230, 230, 230, 230, 230, 230, 230, 230, 230, 230, 230, 230, 230, 230, 230, 230, 230, 230, 230, 230, 230, 230, 230, 230, 230, 230, 230, 230, 230, 230, 230, 230, 230, 230, 230, 230, 230, 230, 230, 230, 230, 230, 230, 230, 230, 230, 230, 230], data-id-mode=0, data-length=128, max-delta-counter-init=14, crc-offset=0, counter-offset=8, data-id-nibble-offset=0}, end-to-end-protection-variable-prototype=BmwMsgSlot49Bas1Repn2BusFrChA.SystemComponentPrototype.sigGroup_DT_EST.sigGroup_DT_EST
      endToEndProt_ENERG_DGR_DRDY: end-to-end-profile={category=PROFILE_01, data-ids=[56, 56, 56, 56, 56, 56, 56, 56, 56, 56, 56, 56, 56, 56, 56, 56, 56, 56, 56, 56, 56, 56, 56, 56, 56, 56, 56, 56, 56, 56, 56, 56, 56, 56, 56, 56, 56, 56, 56, 56, 56, 56, 56, 56, 56, 56, 56, 56, 56, 56, 56, 56, 56, 56, 56, 56, 56, 56, 56, 56, 56, 56, 56, 56, 56, 56, 56, 56, 56, 56, 56, 56, 56, 56, 56, 56, 56, 56, 56, 56, 56, 56, 56, 56, 56, 56, 56, 56, 56, 56, 56, 56, 56, 56, 56, 56, 56, 56, 56, 56, 56, 56, 56, 56, 56, 56, 56, 56, 56, 56, 56, 56, 56, 56, 56, 56, 56, 56, 56, 56, 56, 56, 56, 56, 56, 56, 56, 56, 56, 56, 56, 56, 56, 56, 56, 56, 56, 56, 56, 56, 56, 56, 56, 56, 56, 56, 56, 56, 56, 56, 56, 56, 56, 56, 56, 56, 56, 56, 56, 56, 56, 56, 56, 56, 56, 56, 56, 56, 56, 56, 56, 56, 56, 56, 56, 56, 56, 56, 56, 56, 56, 56, 56, 56, 56, 56, 56, 56, 56, 56, 56, 56, 56, 56, 56, 56, 56, 56, 56, 56, 56, 56, 56, 56, 56, 56, 56, 56, 56, 56, 56, 56, 56, 56, 56, 56, 56, 56, 56, 56, 56, 56, 56, 56, 56, 56, 56, 56, 56, 56, 56, 56, 56, 56, 56, 56, 56, 56, 56, 56, 56, 56, 56, 56, 56, 56, 56, 56, 56, 56, 56, 56, 56, 56, 56, 56, 56, 56, 56, 56, 56, 56, 56, 56, 56, 56, 56, 56, 56, 56, 56, 56, 56, 56, 56, 56, 56, 56, 56, 56, 56, 56, 56, 56, 56, 56, 56, 56, 56, 56, 56, 56, 56, 56, 56, 56, 56, 56, 56, 56], data-id-mode=0, data-length=64, max-delta-counter-init=14, crc-offset=56, counter-offset=52, data-id-nibble-offset=0}, end-to-end-protection-variable-prototype=receiver=BmwMsgSlot68Bas1Repn2BusFrChA.SystemComponentPrototype.sigGroup_ENERG_DGR_DRDY.sigGroup_ENERG_DGR_DRDY
      endToEndProt_ENSU_SFY: end-to-end-profile={category=PROFILE_01, data-ids=[628, 628, 628, 628, 628, 628, 628, 628, 628, 628, 628, 628, 628, 628, 628, 628, 628, 628, 628, 628, 628, 628, 628, 628, 628, 628, 628, 628, 628, 628, 628, 628, 628, 628, 628, 628, 628, 628, 628, 628, 628, 628, 628, 628, 628, 628, 628, 628, 628, 628, 628, 628, 628, 628, 628, 628, 628, 628, 628, 628, 628, 628, 628, 628, 628, 628, 628, 628, 628, 628, 628, 628, 628, 628, 628, 628, 628, 628, 628, 628, 628, 628, 628, 628, 628, 628, 628, 628, 628, 628, 628, 628, 628, 628, 628, 628, 628, 628, 628, 628, 628, 628, 628, 628, 628, 628, 628, 628, 628, 628, 628, 628, 628, 628, 628, 628, 628, 628, 628, 628, 628, 628, 628, 628, 628, 628, 628, 628, 628, 628, 628, 628, 628, 628, 628, 628, 628, 628, 628, 628, 628, 628, 628, 628, 628, 628, 628, 628, 628, 628, 628, 628, 628, 628, 628, 628, 628, 628, 628, 628, 628, 628, 628, 628, 628, 628, 628, 628, 628, 628, 628, 628, 628, 628, 628, 628, 628, 628, 628, 628, 628, 628, 628, 628, 628, 628, 628, 628, 628, 628, 628, 628, 628, 628, 628, 628, 628, 628, 628, 628, 628, 628, 628, 628, 628, 628, 628, 628, 628, 628, 628, 628, 628, 628, 628, 628, 628, 628, 628, 628, 628, 628, 628, 628, 628, 628, 628, 628, 628, 628, 628, 628, 628, 628, 628, 628, 628, 628, 628, 628, 628, 628, 628, 628, 628, 628, 628, 628, 628, 628, 628, 628, 628, 628, 628, 628, 628, 628, 628, 628, 628, 628, 628, 628, 628, 628, 628, 628, 628, 628, 628, 628, 628, 628, 628, 628, 628, 628, 628, 628, 628, 628, 628, 628, 628, 628, 628, 628, 628, 628, 628, 628, 628, 628, 628, 628, 628, 628, 628, 628], data-id-mode=3, data-length=64, max-delta-counter-init=14, crc-offset=0, counter-offset=8, data-id-nibble-offset=12}, end-to-end-protection-i-signal-i-pdu{data-offset=0, i-signal-group=sigGroup_ENSU_SFY, i-signal-i-pdu=ENSU_SFY}
      endToEndProt_OFFS_QUAD_EPS: end-to-end-profile={category=PROFILE_01, data-ids=[229, 229, 229, 229, 229, 229, 229, 229, 229, 229, 229, 229, 229, 229, 229, 229, 229, 229, 229, 229, 229, 229, 229, 229, 229, 229, 229, 229, 229, 229, 229, 229, 229, 229, 229, 229, 229, 229, 229, 229, 229, 229, 229, 229, 229, 229, 229, 229, 229, 229, 229, 229, 229, 229, 229, 229, 229, 229, 229, 229, 229, 229, 229, 229, 229, 229, 229, 229, 229, 229, 229, 229, 229, 229, 229, 229, 229, 229, 229, 229, 229, 229, 229, 229, 229, 229, 229, 229, 229, 229, 229, 229, 229, 229, 229, 229, 229, 229, 229, 229, 229, 229, 229, 229, 229, 229, 229, 229, 229, 229, 229, 229, 229, 229, 229, 229, 229, 229, 229, 229, 229, 229, 229, 229, 229, 229, 229, 229, 229, 229, 229, 229, 229, 229, 229, 229, 229, 229, 229, 229, 229, 229, 229, 229, 229, 229, 229, 229, 229, 229, 229, 229, 229, 229, 229, 229, 229, 229, 229, 229, 229, 229, 229, 229, 229, 229, 229, 229, 229, 229, 229, 229, 229, 229, 229, 229, 229, 229, 229, 229, 229, 229, 229, 229, 229, 229, 229, 229, 229, 229, 229, 229, 229, 229, 229, 229, 229, 229, 229, 229, 229, 229, 229, 229, 229, 229, 229, 229, 229, 229, 229, 229, 229, 229, 229, 229, 229, 229, 229, 229, 229, 229, 229, 229, 229, 229], data-id-mode=0, data-length=40, max-delta-counter-init=14, crc-offset=0, counter-offset=8, data-id-nibble-offset=0}, end-to-end-protection-variable-prototype=receiver=BmwMsgSlot107Bas0Repn1BusFrChA.SystemComponentPrototype.sigGroup_OFFS_QUAD_EPS.sigGroup_OFFS_QUAD_EPS
      endToEndProt_ST_EST: end-to-end-profile={category=PROFILE_01, data-ids=[112, 112, 112, 112, 112, 112, 112, 112, 112, 112, 112, 112, 112, 112, 112, 112, 112, 112, 112, 112, 112, 112, 112, 112, 112, 112, 112, 112, 112, 112, 112, 112, 112, 112, 112, 112, 112, 112, 112, 112, 112, 112, 112, 112, 112, 112, 112, 112, 112, 112, 112, 112, 112, 112, 112, 112, 112, 112, 112, 112, 112, 112, 112, 112, 112, 112, 112, 112, 112, 112, 112, 112, 112, 112, 112, 112, 112, 112, 112, 112, 112, 112, 112, 112, 112, 112, 112, 112, 112, 112, 112, 112, 112, 112, 112, 112, 112, 112, 112, 112, 112, 112, 112, 112, 112, 112, 112, 112, 112, 112, 112, 112, 112, 112, 112, 112, 112, 112, 112, 112, 112, 112, 112, 112, 112, 112, 112, 112, 112, 112, 112, 112, 112, 112, 112, 112, 112, 112, 112, 112, 112, 112, 112, 112, 112, 112, 112, 112, 112, 112, 112, 112, 112, 112, 112, 112, 112, 112, 112, 112, 112, 112, 112, 112, 112, 112, 112, 112, 112, 112, 112, 112, 112, 112, 112, 112, 112, 112, 112, 112, 112, 112, 112, 112, 112, 112, 112, 112, 112, 112, 112, 112, 112, 112, 112, 112, 112, 112, 112, 112, 112, 112, 112, 112, 112, 112, 112, 112, 112, 112, 112, 112, 112, 112, 112, 112, 112, 112, 112, 112, 112, 112, 112, 112, 112, 112, 112, 112, 112, 112, 112, 112, 112, 112, 112, 112, 112, 112, 112, 112, 112, 112, 112, 112, 112, 112, 112, 112, 112, 112, 112, 112, 112, 112, 112, 112, 112, 112, 112, 112, 112, 112, 112, 112, 112, 112, 112, 112, 112, 112, 112, 112, 112, 112, 112, 112, 112, 112, 112, 112, 112, 112, 112, 112, 112, 112, 112, 112, 112, 112, 112, 112, 112, 112, 112, 112, 112, 112, 112, 112], data-id-mode=0, data-length=40, max-delta-counter-init=14, crc-offset=0, counter-offset=8, data-id-nibble-offset=0}, end-to-end-protection-variable-prototype=BmwMsgSlot234Bas1Repn2BusFrChA.SystemComponentPrototype.sigGroup_ST_EST.sigGroup_ST_EST
      endToEndProt_SU_EPS: end-to-end-profile={category=PROFILE_01, data-ids=[131, 131, 131, 131, 131, 131, 131, 131, 131, 131, 131, 131, 131, 131, 131, 131, 131, 131, 131, 131, 131, 131, 131, 131, 131, 131, 131, 131, 131, 131, 131, 131, 131, 131, 131, 131, 131, 131, 131, 131, 131, 131, 131, 131, 131, 131, 131, 131, 131, 131, 131, 131, 131, 131, 131, 131, 131, 131, 131, 131, 131, 131, 131, 131, 131, 131, 131, 131, 131, 131, 131, 131, 131, 131, 131, 131, 131, 131, 131, 131, 131, 131, 131, 131, 131, 131, 131, 131, 131, 131, 131, 131, 131, 131, 131, 131, 131, 131, 131, 131, 131, 131, 131, 131, 131, 131, 131, 131, 131, 131, 131, 131, 131, 131, 131, 131, 131, 131, 131, 131, 131, 131, 131, 131, 131, 131, 131, 131, 131, 131, 131, 131, 131, 131, 131, 131, 131, 131, 131, 131, 131, 131, 131, 131, 131, 131, 131, 131, 131, 131, 131, 131, 131, 131, 131, 131, 131, 131, 131, 131, 131, 131, 131, 131, 131, 131, 131, 131, 131, 131, 131, 131, 131, 131, 131, 131, 131, 131, 131, 131, 131, 131, 131, 131, 131, 131, 131, 131, 131, 131, 131, 131, 131, 131, 131, 131, 131, 131, 131, 131, 131, 131, 131, 131, 131, 131, 131, 131, 131, 131, 131, 131, 131, 131, 131, 131, 131, 131, 131, 131, 131, 131, 131, 131, 131, 131, 131, 131, 131, 131, 131, 131, 131, 131, 131, 131, 131, 131, 131, 131, 131, 131, 131, 131, 131, 131, 131, 131, 131, 131, 131, 131, 131, 131, 131, 131, 131, 131, 131, 131, 131, 131, 131, 131, 131, 131, 131, 131, 131, 131, 131, 131, 131, 131, 131, 131, 131, 131, 131, 131, 131, 131, 131, 131, 131, 131, 131, 131, 131, 131, 131, 131, 131, 131, 131, 131, 131, 131, 131, 131], data-id-mode=0, data-length=64, max-delta-counter-init=14, crc-offset=56, counter-offset=52, data-id-nibble-offset=0}, end-to-end-protection-variable-prototype=BmwMsgSlot274Bas0Repn8BusFrChA.SystemComponentPrototype.sigGroup_SU_EPS.sigGroup_SU_EPS
      endToEndProt_TAR_ESTP_VIRT_FTAX: end-to-end-profile={category=PROFILE_01, data-ids=[52, 52, 52, 52, 52, 52, 52, 52, 52, 52, 52, 52, 52, 52, 52, 52, 52, 52, 52, 52, 52, 52, 52, 52, 52, 52, 52, 52, 52, 52, 52, 52, 52, 52, 52, 52, 52, 52, 52, 52, 52, 52, 52, 52, 52, 52, 52, 52, 52, 52, 52, 52, 52, 52, 52, 52, 52, 52, 52, 52, 52, 52, 52, 52, 52, 52, 52, 52, 52, 52, 52, 52, 52, 52, 52, 52, 52, 52, 52, 52, 52, 52, 52, 52, 52, 52, 52, 52, 52, 52, 52, 52, 52, 52, 52, 52, 52, 52, 52, 52, 52, 52, 52, 52, 52, 52, 52, 52, 52, 52, 52, 52, 52, 52, 52, 52, 52, 52, 52, 52, 52, 52, 52, 52, 52, 52, 52, 52, 52, 52, 52, 52, 52, 52, 52, 52, 52, 52, 52, 52, 52, 52, 52, 52, 52, 52, 52, 52, 52, 52, 52, 52, 52, 52, 52, 52, 52, 52, 52, 52, 52, 52, 52, 52, 52, 52, 52, 52, 52, 52, 52, 52, 52, 52, 52, 52, 52, 52, 52, 52, 52, 52, 52, 52, 52, 52, 52, 52, 52, 52, 52, 52, 52, 52, 52, 52, 52, 52, 52, 52, 52, 52, 52, 52, 52, 52, 52, 52, 52, 52, 52, 52, 52, 52, 52, 52, 52, 52, 52, 52, 52, 52, 52, 52, 52, 52, 52, 52, 52, 52, 52, 52, 52, 52, 52, 52, 52, 52, 52, 52, 52, 52, 52, 52, 52, 52, 52, 52, 52, 52, 52, 52, 52, 52, 52, 52, 52, 52, 52, 52, 52, 52, 52, 52, 52, 52, 52, 52, 52, 52, 52, 52, 52, 52, 52, 52, 52, 52, 52, 52, 52, 52, 52, 52, 52, 52, 52, 52, 52, 52, 52, 52, 52, 52, 52, 52, 52, 52, 52, 52], data-id-mode=0, data-length=64, max-delta-counter-init=14, crc-offset=0, counter-offset=8, data-id-nibble-offset=0}, end-to-end-protection-i-signal-i-pdu{data-offset=0, i-signal-group=sigGroup_TAR_ESTP_VIRT_FTAX, i-signal-i-pdu=TAR_ESTP_VIRT_FTAX}
      endToEndProt_TAR_QTA_STRMOM_DV: end-to-end-profile={category=PROFILE_01, data-ids=[109, 109, 109, 109, 109, 109, 109, 109, 109, 109, 109, 109, 109, 109, 109, 109, 109, 109, 109, 109, 109, 109, 109, 109, 109, 109, 109, 109, 109, 109, 109, 109, 109, 109, 109, 109, 109, 109, 109, 109, 109, 109, 109, 109, 109, 109, 109, 109, 109, 109, 109, 109, 109, 109, 109, 109, 109, 109, 109, 109, 109, 109, 109, 109, 109, 109, 109, 109, 109, 109, 109, 109, 109, 109, 109, 109, 109, 109, 109, 109, 109, 109, 109, 109, 109, 109, 109, 109, 109, 109, 109, 109, 109, 109, 109, 109, 109, 109, 109, 109, 109, 109, 109, 109, 109, 109, 109, 109, 109, 109, 109, 109, 109, 109, 109, 109, 109, 109, 109, 109, 109, 109, 109, 109, 109, 109, 109, 109, 109, 109, 109, 109, 109, 109, 109, 109, 109, 109, 109, 109, 109, 109, 109, 109, 109, 109, 109, 109, 109, 109, 109, 109, 109, 109, 109, 109, 109, 109, 109, 109, 109, 109, 109, 109, 109, 109, 109, 109, 109, 109, 109, 109, 109, 109, 109, 109, 109, 109, 109, 109, 109, 109, 109, 109, 109, 109, 109, 109, 109, 109, 109, 109, 109, 109, 109, 109, 109, 109, 109, 109, 109, 109, 109, 109, 109, 109, 109, 109, 109, 109, 109, 109, 109, 109, 109, 109, 109, 109, 109, 109, 109, 109, 109, 109, 109, 109, 109, 109, 109, 109, 109, 109, 109, 109, 109, 109, 109, 109, 109, 109, 109, 109, 109, 109, 109, 109, 109, 109, 109, 109, 109, 109, 109, 109, 109, 109, 109, 109, 109, 109, 109, 109, 109, 109, 109, 109, 109, 109, 109, 109, 109, 109, 109, 109, 109, 109, 109, 109, 109, 109, 109, 109, 109, 109, 109, 109, 109, 109, 109, 109, 109, 109, 109, 109, 109, 109, 109, 109, 109, 109], data-id-mode=0, data-length=64, max-delta-counter-init=14, crc-offset=0, counter-offset=8, data-id-nibble-offset=0}, end-to-end-protection-variable-prototype=receiver=BmwMsgSlot68Bas0Repn2BusFrChA.SystemComponentPrototype.sigGroup_TAR_QTA_STRMOM_DV.sigGroup_TAR_QTA_STRMOM_DV
      endToEndProt_TAR_STMOM_DV_ACT: end-to-end-profile={category=PROFILE_01, data-ids=[179, 179, 179, 179, 179, 179, 179, 179, 179, 179, 179, 179, 179, 179, 179, 179, 179, 179, 179, 179, 179, 179, 179, 179, 179, 179, 179, 179, 179, 179, 179, 179, 179, 179, 179, 179, 179, 179, 179, 179, 179, 179, 179, 179, 179, 179, 179, 179, 179, 179, 179, 179, 179, 179, 179, 179, 179, 179, 179, 179, 179, 179, 179, 179, 179, 179, 179, 179, 179, 179, 179, 179, 179, 179, 179, 179, 179, 179, 179, 179, 179, 179, 179, 179, 179, 179, 179, 179, 179, 179, 179, 179, 179, 179, 179, 179, 179, 179, 179, 179, 179, 179, 179, 179, 179, 179, 179, 179, 179, 179, 179, 179, 179, 179, 179, 179, 179, 179, 179, 179, 179, 179, 179, 179, 179, 179, 179, 179, 179, 179, 179, 179, 179, 179, 179, 179, 179, 179, 179, 179, 179, 179, 179, 179, 179, 179, 179, 179, 179, 179, 179, 179, 179, 179, 179, 179, 179, 179, 179, 179, 179, 179, 179, 179, 179, 179, 179, 179, 179, 179, 179, 179, 179, 179, 179, 179, 179, 179, 179, 179, 179, 179, 179, 179, 179, 179, 179, 179, 179, 179, 179, 179, 179, 179, 179, 179, 179, 179, 179, 179, 179, 179, 179, 179, 179, 179, 179, 179, 179, 179, 179, 179, 179, 179, 179, 179, 179, 179, 179, 179, 179, 179, 179, 179, 179, 179, 179, 179, 179, 179, 179, 179, 179, 179, 179, 179, 179, 179, 179, 179, 179, 179, 179, 179, 179, 179, 179, 179, 179, 179, 179, 179, 179, 179, 179, 179, 179, 179, 179, 179, 179, 179, 179, 179, 179, 179, 179, 179, 179, 179, 179, 179, 179, 179, 179, 179, 179, 179, 179, 179, 179, 179, 179, 179, 179, 179, 179, 179, 179, 179, 179, 179, 179, 179, 179, 179, 179, 179, 179, 179], data-id-mode=0, data-length=64, max-delta-counter-init=14, crc-offset=0, counter-offset=8, data-id-nibble-offset=0}, end-to-end-protection-variable-prototype=receiver=BmwMsgSlot68Bas0Repn2BusFrChA.SystemComponentPrototype.sigGroup_TAR_STMOM_DV_ACT.sigGroup_TAR_STMOM_DV_ACT
      endToEndProt_V_VEH: end-to-end-profile={category=PROFILE_01, data-ids=[12, 12, 12, 12, 12, 12, 12, 12, 12, 12, 12, 12, 12, 12, 12, 12, 12, 12, 12, 12, 12, 12, 12, 12, 12, 12, 12, 12, 12, 12, 12, 12, 12, 12, 12, 12, 12, 12, 12, 12, 12, 12, 12, 12, 12, 12, 12, 12, 12, 12, 12, 12, 12, 12, 12, 12, 12, 12, 12, 12, 12, 12, 12, 12, 12, 12, 12, 12, 12, 12, 12, 12, 12, 12, 12, 12, 12, 12, 12, 12, 12, 12, 12, 12, 12, 12, 12, 12, 12, 12, 12, 12, 12, 12, 12, 12, 12, 12, 12, 12, 12, 12, 12, 12, 12, 12, 12, 12, 12, 12, 12, 12, 12, 12, 12, 12, 12, 12, 12, 12, 12, 12, 12, 12, 12, 12, 12, 12, 12, 12, 12, 12, 12, 12, 12, 12, 12, 12, 12, 12, 12, 12, 12, 12, 12, 12, 12, 12, 12, 12, 12, 12, 12, 12, 12, 12, 12, 12, 12, 12, 12, 12, 12, 12, 12, 12, 12, 12, 12, 12, 12, 12, 12, 12, 12, 12, 12, 12, 12, 12, 12, 12, 12, 12, 12, 12, 12, 12, 12, 12, 12, 12, 12, 12, 12, 12, 12, 12, 12, 12, 12, 12, 12, 12, 12, 12, 12, 12, 12, 12, 12, 12, 12, 12, 12, 12, 12, 12, 12, 12, 12, 12, 12, 12, 12, 12], data-id-mode=0, data-length=40, max-delta-counter-init=14, crc-offset=0, counter-offset=8, data-id-nibble-offset=0}, end-to-end-protection-variable-prototype=receiver=BmwMsgSlot55Bas3Repn4BusFrChA.SystemComponentPrototype.sigGroup_V_VEH.sigGroup_V_VEH
      endToEndProt_VYAW_VEH: end-to-end-profile={category=PROFILE_01, data-ids=[14, 14, 14, 14, 14, 14, 14, 14, 14, 14, 14, 14, 14, 14, 14, 14, 14, 14, 14, 14, 14, 14, 14, 14, 14, 14, 14, 14, 14, 14, 14, 14, 14, 14, 14, 14, 14, 14, 14, 14, 14, 14, 14, 14, 14, 14, 14, 14, 14, 14, 14, 14, 14, 14, 14, 14, 14, 14, 14, 14, 14, 14, 14, 14, 14, 14, 14, 14, 14, 14, 14, 14, 14, 14, 14, 14, 14, 14, 14, 14, 14, 14, 14, 14, 14, 14, 14, 14, 14, 14, 14, 14, 14, 14, 14, 14, 14, 14, 14, 14, 14, 14, 14, 14, 14, 14, 14, 14, 14, 14, 14, 14, 14, 14, 14, 14, 14, 14, 14, 14, 14, 14, 14, 14, 14, 14, 14, 14, 14, 14, 14, 14, 14, 14, 14, 14, 14, 14, 14, 14, 14, 14, 14, 14, 14, 14, 14, 14, 14, 14, 14, 14, 14, 14, 14, 14, 14, 14, 14, 14, 14, 14, 14, 14, 14, 14, 14, 14, 14, 14, 14, 14, 14, 14, 14, 14, 14, 14, 14, 14, 14, 14, 14, 14, 14, 14, 14, 14, 14, 14, 14, 14, 14, 14, 14, 14, 14, 14, 14, 14, 14, 14, 14, 14, 14, 14, 14, 14, 14, 14, 14, 14, 14, 14, 14, 14, 14, 14, 14, 14, 14, 14, 14, 14, 14, 14, 14, 14, 14, 14, 14, 14, 14, 14, 14, 14, 14, 14, 14, 14, 14, 14, 14, 14, 14, 14, 14, 14, 14, 14, 14, 14, 14, 14, 14, 14, 14, 14, 14, 14, 14, 14, 14, 14, 14, 14, 14, 14, 14, 14, 14, 14, 14, 14, 14, 14, 14, 14, 14, 14, 14, 14, 14, 14, 14, 14, 14, 14, 14, 14, 14, 14, 14, 14, 14, 14, 14, 14, 14, 14], data-id-mode=0, data-length=48, max-delta-counter-init=14, crc-offset=0, counter-offset=8, data-id-nibble-offset=0}, end-to-end-protection-variable-prototype=receiver=BmwMsgSlot56Bas0Repn2BusFrChA.SystemComponentPrototype.sigGroup_VYAW_VEH.sigGroup_VYAW_VEH
