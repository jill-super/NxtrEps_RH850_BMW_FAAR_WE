[part 4 of 4: package /ActiveEcuC]
AUTOSAR XML (schema 4-3-0)
package /ActiveEcuC  (continued)
  module config Rte: implementation-config-variant=VARIANT-PRE-COMPILE, module-description=Rte_Impl  (continued)
    BmwTunSetHndlr_EcuSwComposition (RteSwComponentInstance): RteSoftwareComponentInstanceRef=BmwTunSetHndlr
      NvmBlock_BmwTunSetHndlr_NvmBmwDesIninIdx (RteNvRamAllocation):
        RteNvmRamBlockLocationSymbol = Rte_BmwTunSetHndlr_BmwDesIninIdx
        RteNvmRomBlockLocationSymbol = Rte_BmwDesIninIdxDft
        RteNvmBlockRef = Rte_NvmBlock_BmwTunSetHndlr_BmwDesIninIdx
        RteSwNvRamMappingRef = NvmBmwDesIninIdx
      4 x RteEventToTaskMapping, all with RteImmediateRestart=false:
        BmwTunSetHndlr_InitEvent: RtePositionInTask=104, RteEventRef=BmwTunSetHndlr_InitEvent, RteMappedToTaskRef=Task_Init_Appl10
        TMT_BmwTunSetHndlrPer1: RtePositionInTask=7, RteEventRef=TMT_BmwTunSetHndlrPer1, RteMappedToTaskRef=Task_10ms_Appl10, RteUsedOsEventRef=Rte_Ev_Cyclic_Task_10ms_Appl10_0_10ms, RteUsedOsAlarmRef=Rte_Al_TE_Task_10ms_Appl10_0_10ms
        OIT_TunVrntRead_Oper_TunVrntRead_Oper: RteEventRef=OIT_TunVrntRead_Oper_TunVrntRead_Oper
        OIT_TunVrntWr_Oper_TunVrntWr_Oper: RteEventRef=OIT_TunVrntWr_Oper_TunVrntWr_Oper
      NvmBlock_BmwTunSetHndlr_NvmBmwDesIninOptSetAIdx (RteNvRamAllocation):
        RteNvmRamBlockLocationSymbol = Rte_BmwTunSetHndlr_BmwDesIninOptSetAIdx
        RteNvmRomBlockLocationSymbol = Rte_BmwDesIninOptSetAIdxDft
        RteNvmBlockRef = Rte_NvmBlock_BmwTunSetHndlr_NvmBmwDesIninOptSetAIdx
        RteSwNvRamMappingRef = NvmBmwDesIninOptSetAIdx
      OIT_MotVrntWr_Oper_MotVrntWr_Oper (RteEventToTaskMapping): RteImmediateRestart=false, RteEventRef=OIT_MotVrntWr_Oper_MotVrntWr_Oper
      OIT_MotVrntRead_Oper_MotVrntRead_Oper (RteEventToTaskMapping): RteImmediateRestart=false, RteEventRef=OIT_MotVrntRead_Oper_MotVrntRead_Oper
    BmwTunSetHndlr (RteSwComponentType): RteComponentTypeRef=BmwTunSetHndlr, RteImplementationRef=BmwTunSetHndlr_Implementation
      ComponentTypeCalibration (RteComponentTypeCalibration): RteCalibrationSupportEnabled=true
    ProgMfgSrv (RteSwComponentType): RteComponentTypeRef=ProgMfgSrv, RteImplementationRef=ProgMfgSrv_Implementation
      ComponentTypeCalibration (RteComponentTypeCalibration): RteCalibrationSupportEnabled=true
    9 x RteSwComponentInstance:
      CDD_MotAg3Meas_EcuSwComposition: RteSoftwareComponentInstanceRef=CDD_MotAg3Meas
        OIT_GetMotAg3Mecl_Oper_GetMotAg3Mecl_Oper (RteEventToTaskMapping): RteImmediateRestart=false, RteEventRef=OIT_GetMotAg3Mecl_Oper_GetMotAg3Mecl_Oper
        CDD_MotAg3Meas_InitEvent (RteEventToTaskMapping): RteImmediateRestart=false, RtePositionInTask=31, RteEventRef=CDD_MotAg3Meas_InitEvent, RteMappedToTaskRef=Task_Init_Appl10
      Effort_EcuSwComposition: RteSoftwareComponentInstanceRef=Effort
        Effort_InitEvent (RteEventToTaskMapping): RteImmediateRestart=false, RtePositionInTask=2, RteEventRef=Effort_InitEvent, RteMappedToTaskRef=Task_Init_Appl7
        TMT_EffortPer1 (RteEventToTaskMapping):
          RteImmediateRestart = false
          RtePositionInTask = 7
          RteEventRef = TMT_EffortPer1
          RteMappedToTaskRef = Task_2ms_Appl7
          RteUsedOsAlarmRef = Rte_Al_TE_Task_2ms_Appl7_0_2ms
      SysKineAndEff_EcuSwComposition: RteSoftwareComponentInstanceRef=SysKineAndEff
        SysKineAndEff_InitEvent (RteEventToTaskMapping): RteImmediateRestart=false, RtePositionInTask=6, RteEventRef=SysKineAndEff_InitEvent, RteMappedToTaskRef=Task_Init_Appl7
        TMT_SysKineAndEffPer1 (RteEventToTaskMapping):
          RteImmediateRestart = false
          RtePositionInTask = 3
          RteEventRef = TMT_SysKineAndEffPer1
          RteMappedToTaskRef = Task_2ms_Appl7
          RteUsedOsAlarmRef = Rte_Al_TE_Task_2ms_Appl7_0_2ms
      HwRefTqSum_EcuSwComposition: RteSoftwareComponentInstanceRef=HwRefTqSum
        HwRefTqSum_InitEvent (RteEventToTaskMapping): RteImmediateRestart=false, RtePositionInTask=14, RteEventRef=HwRefTqSum_InitEvent, RteMappedToTaskRef=Task_Init_Appl7
        TMT_HwRefTqSumPer1 (RteEventToTaskMapping):
          RteImmediateRestart = false
          RtePositionInTask = 13
          RteEventRef = TMT_HwRefTqSumPer1
          RteMappedToTaskRef = Task_2ms_Appl7
          RteUsedOsAlarmRef = Rte_Al_TE_Task_2ms_Appl7_0_2ms
      HwTqTrakgCtrl_EcuSwComposition: RteSoftwareComponentInstanceRef=HwTqTrakgCtrl
        HwTqTrakgCtrl_InitEvent (RteEventToTaskMapping): RteImmediateRestart=false, RtePositionInTask=43, RteEventRef=HwTqTrakgCtrl_InitEvent, RteMappedToTaskRef=Task_Init_Appl10
        TMT_HwTqTrakgCtrlPer1 (RteEventToTaskMapping):
          RteImmediateRestart = false
          RtePositionInTask = 10
          RteEventRef = TMT_HwTqTrakgCtrlPer1
          RteMappedToTaskRef = Task_2msB_Appl10
          RteUsedOsAlarmRef = Rte_Al_TE_Task_2msB_Appl10_0_2ms
      MotTqCalcd_EcuSwComposition: RteSoftwareComponentInstanceRef=MotTqCalcd
        MotTqCalcd_InitEvent (RteEventToTaskMapping): RteImmediateRestart=false, RtePositionInTask=40, RteEventRef=MotTqCalcd_InitEvent, RteMappedToTaskRef=Task_Init_Appl10
        TMT_MotTqCalcdPer1 (RteEventToTaskMapping):
          RteImmediateRestart = false
          RtePositionInTask = 31
          RteEventRef = TMT_MotTqCalcdPer1
          RteMappedToTaskRef = Task_2msA_Appl10
          RteUsedOsAlarmRef = Rte_Al_TE_Task_2msA_Appl10_0_2ms
      CDD_MotAg4Meas_EcuSwComposition: RteSoftwareComponentInstanceRef=CDD_MotAg4Meas
        OIT_GetMotAg4Mecl_Oper_GetMotAg4Mecl_Oper (RteEventToTaskMapping): RteImmediateRestart=false, RteEventRef=OIT_GetMotAg4Mecl_Oper_GetMotAg4Mecl_Oper
        CDD_MotAg4Meas_InitEvent (RteEventToTaskMapping): RteImmediateRestart=false, RtePositionInTask=32, RteEventRef=CDD_MotAg4Meas_InitEvent, RteMappedToTaskRef=Task_Init_Appl10
      ClsdLoopDampg_EcuSwComposition: RteSoftwareComponentInstanceRef=ClsdLoopDampg
        ClsdLoopDampg_InitEvent (RteEventToTaskMapping): RteImmediateRestart=false, RtePositionInTask=9, RteEventRef=ClsdLoopDampg_InitEvent, RteMappedToTaskRef=Task_Init_Appl7
        TMT_ClsdLoopDampgPer1 (RteEventToTaskMapping):
          RteImmediateRestart = false
          RtePositionInTask = 8
          RteEventRef = TMT_ClsdLoopDampgPer1
          RteMappedToTaskRef = Task_2ms_Appl7
          RteUsedOsAlarmRef = Rte_Al_TE_Task_2ms_Appl7_0_2ms
      TqOscn_EcuSwComposition: RteSoftwareComponentInstanceRef=TqOscn
        TqOscn_InitEvent (RteEventToTaskMapping): RteImmediateRestart=false, RtePositionInTask=39, RteEventRef=TqOscn_InitEvent, RteMappedToTaskRef=Task_Init_Appl10
        TMT_TqOscnPer1 (RteEventToTaskMapping):
          RteImmediateRestart = false
          RtePositionInTask = 6
          RteEventRef = TMT_TqOscnPer1
          RteMappedToTaskRef = Task_2msB_Appl10
          RteUsedOsAlarmRef = Rte_Al_TE_Task_2msB_Appl10_0_2ms
    9 x RteSwComponentType:
      MotTqCalcd: RteComponentTypeRef=MotTqCalcd, RteImplementationRef=MotTqCalcd_Implementation
        ComponentTypeCalibration (RteComponentTypeCalibration): RteCalibrationSupportEnabled=true
      CDD_MotAg3Meas: RteComponentTypeRef=CDD_MotAg3Meas, RteImplementationRef=CDD_MotAg3Meas_Implementation
        ComponentTypeCalibration (RteComponentTypeCalibration): RteCalibrationSupportEnabled=true
      SysKineAndEff: RteComponentTypeRef=SysKineAndEff, RteImplementationRef=SysKineAndEff_Implementation
        ComponentTypeCalibration (RteComponentTypeCalibration): RteCalibrationSupportEnabled=true
      Effort: RteComponentTypeRef=Effort, RteImplementationRef=Effort_Implementation
        ComponentTypeCalibration (RteComponentTypeCalibration): RteCalibrationSupportEnabled=true
      HwTqTrakgCtrl: RteComponentTypeRef=HwTqTrakgCtrl, RteImplementationRef=HwTqTrakgCtrl_Implementation
        ComponentTypeCalibration (RteComponentTypeCalibration): RteCalibrationSupportEnabled=true
      ClsdLoopDampg: RteComponentTypeRef=ClsdLoopDampg, RteImplementationRef=ClsdLoopDampg_Implementation
        ComponentTypeCalibration (RteComponentTypeCalibration): RteCalibrationSupportEnabled=true
      CDD_MotAg4Meas: RteComponentTypeRef=CDD_MotAg4Meas, RteImplementationRef=CDD_MotAg4Meas_Implementation
        ComponentTypeCalibration (RteComponentTypeCalibration): RteCalibrationSupportEnabled=true
      TqOscn: RteComponentTypeRef=TqOscn, RteImplementationRef=TqOscn_Implementation
        ComponentTypeCalibration (RteComponentTypeCalibration): RteCalibrationSupportEnabled=true
      HwRefTqSum: RteComponentTypeRef=HwRefTqSum, RteImplementationRef=HwRefTqSum_Implementation
        ComponentTypeCalibration (RteComponentTypeCalibration): RteCalibrationSupportEnabled=true
    EpsStEstimn_EcuSwComposition (RteSwComponentInstance): RteSoftwareComponentInstanceRef=EpsStEstimn
      EpsStEstimn_InitEvent (RteEventToTaskMapping): RteImmediateRestart=false, RtePositionInTask=8, RteEventRef=EpsStEstimn_InitEvent, RteMappedToTaskRef=Task_Init_Appl7
      TMT_EpsStEstimnPer1 (RteEventToTaskMapping):
        RteImmediateRestart = false
        RtePositionInTask = 6
        RteEventRef = TMT_EpsStEstimnPer1
        RteMappedToTaskRef = Task_2ms_Appl7
        RteUsedOsAlarmRef = Rte_Al_TE_Task_2ms_Appl7_0_2ms
    EpsStEstimn (RteSwComponentType): RteComponentTypeRef=EpsStEstimn, RteImplementationRef=EpsStEstimn_Implementation
      ComponentTypeCalibration (RteComponentTypeCalibration): RteCalibrationSupportEnabled=true
    7 x RteSwComponentInstance:
      BmwMsgSlot274Bas0Repn8BusFrChA_EcuSwComposition: RteSoftwareComponentInstanceRef=BmwMsgSlot274Bas0Repn8BusFrChA
        3 x RteEventToTaskMapping, all with RteImmediateRestart=false:
          BmwMsgSlot274Bas0Repn8BusFrChA_InitEvent: RtePositionInTask=90, RteEventRef=BmwMsgSlot274Bas0Repn8BusFrChA_InitEvent, RteMappedToTaskRef=Task_Init_Appl10
          TMT_BmwMsgSlot274Bas0Repn8BusFrChAPer1: RtePositionInTask=6, RteEventRef=TMT_BmwMsgSlot274Bas0Repn8BusFrChAPer1, RteMappedToTaskRef=Task_ComBsw_Appl10, RteUsedOsEventRef=Rte_Ev_Cyclic_Task_ComBsw_Appl10_0_10ms, RteUsedOsAlarmRef=Rte_Al_TE_Task_ComBsw_Appl10_0_10ms
          OIT_CfgMsgTxReq_Oper_CfgMsgTxReq_Oper: RteEventRef=OIT_CfgMsgTxReq_Oper_CfgMsgTxReq_Oper
      BmwMsgSlot55Bas0Repn2BusFrChA_EcuSwComposition: RteSoftwareComponentInstanceRef=BmwMsgSlot55Bas0Repn2BusFrChA
        3 x RteEventToTaskMapping, all with RteImmediateRestart=false:
          DRET_ACLNY_MASSCNTR_Missing_Oper_sigGroup_ACLNY_MASSCNTR_sigGroup_ACLNY_MASSCNTR: RtePositionInTask=12, RteEventRef=DRET_ACLNY_MASSCNTR_Missing_Oper_sigGroup_ACLNY_MASSCNTR_sigGroup_ACLNY_MASSCNTR, RteMappedToTaskRef=Task_10ms_Appl10, RteUsedOsEventRef=Rte_Ev_Run_BmwMsgSlot55Bas0Repn2BusFrChA_ACLNY_MASSCNTR_Missing_Oper
          DRT_ACLNY_MASSCNTR_Received_Oper_sigGroup_ACLNY_MASSCNTR_sigGroup_ACLNY_MASSCNTR: RtePositionInTask=13, RteEventRef=DRT_ACLNY_MASSCNTR_Received_Oper_sigGroup_ACLNY_MASSCNTR_sigGroup_ACLNY_MASSCNTR, RteMappedToTaskRef=Task_10ms_Appl10, RteUsedOsEventRef=Rte_Ev_Run_BmwMsgSlot55Bas0Repn2BusFrChA_ACLNY_MASSCNTR_Received_Oper
          BmwMsgSlot55Bas0Repn2BusFrChA_InitEvent: RtePositionInTask=93, RteEventRef=BmwMsgSlot55Bas0Repn2BusFrChA_InitEvent, RteMappedToTaskRef=Task_Init_Appl10
      BmwMsgSlot276Bas4Repn8BusFrChA_EcuSwComposition: RteSoftwareComponentInstanceRef=BmwMsgSlot276Bas4Repn8BusFrChA
        3 x RteEventToTaskMapping, all with RteImmediateRestart=false:
          BmwMsgSlot276Bas4Repn8BusFrChA_InitEvent: RtePositionInTask=91, RteEventRef=BmwMsgSlot276Bas4Repn8BusFrChA_InitEvent, RteMappedToTaskRef=Task_Init_Appl10
          DRET_MILE_KM_Missing_Oper_MILE_KM_MILE_KM: RtePositionInTask=23, RteEventRef=DRET_MILE_KM_Missing_Oper_MILE_KM_MILE_KM, RteMappedToTaskRef=Task_10ms_Appl10, RteUsedOsEventRef=Rte_Ev_Run_BmwMsgSlot276Bas4Repn8BusFrChA_MILE_KM_Missing_Oper
          DRT_MILE_KM_Received_Oper_MILE_KM_MILE_KM: RtePositionInTask=26, RteEventRef=DRT_MILE_KM_Received_Oper_MILE_KM_MILE_KM, RteMappedToTaskRef=Task_10ms_Appl10, RteUsedOsEventRef=Rte_Ev_Run_BmwMsgSlot276Bas4Repn8BusFrChA_MILE_KM_Received_Oper
      BmwMsgSlot68Bas0Repn2BusFrChA_EcuSwComposition: RteSoftwareComponentInstanceRef=BmwMsgSlot68Bas0Repn2BusFrChA
        5 x RteEventToTaskMapping, all with RteImmediateRestart=false:
          BmwMsgSlot68Bas0Repn2BusFrChA_InitEvent: RtePositionInTask=96, RteEventRef=BmwMsgSlot68Bas0Repn2BusFrChA_InitEvent, RteMappedToTaskRef=Task_Init_Appl10
          DRET_TAR_QTA_STRMOM_DV_Miss_sigGroup_TAR_QTA_STRMOM_DV_sigGroup_TAR_QTA_STRMOM_DV: RtePositionInTask=37, RteEventRef=DRET_TAR_QTA_STRMOM_DV_Miss_sigGroup_TAR_QTA_STRMOM_DV_sigGroup_TAR_QTA_STRMOM_DV, RteMappedToTaskRef=Task_10ms_Appl10, RteUsedOsEventRef=Rte_Ev_Run_BmwMsgSlot68Bas0Repn2BusFrChA_TAR_QTA_STRMOM_DV_Miss
          DRT_TAR_QTA_STRMOM_DV_Rxd_sigGroup_TAR_QTA_STRMOM_DV_sigGroup_TAR_QTA_STRMOM_DV: RtePositionInTask=44, RteEventRef=DRT_TAR_QTA_STRMOM_DV_Rxd_sigGroup_TAR_QTA_STRMOM_DV_sigGroup_TAR_QTA_STRMOM_DV, RteMappedToTaskRef=Task_10ms_Appl10, RteUsedOsEventRef=Rte_Ev_Run_BmwMsgSlot68Bas0Repn2BusFrChA_TAR_QTA_STRMOM_DV_Rxd
          DRET_TAR_STMOM_DV_ACT_Miss_sigGroup_TAR_STMOM_DV_ACT_sigGroup_TAR_STMOM_DV_ACT: RtePositionInTask=45, RteEventRef=DRET_TAR_STMOM_DV_ACT_Miss_sigGroup_TAR_STMOM_DV_ACT_sigGroup_TAR_STMOM_DV_ACT, RteMappedToTaskRef=Task_10ms_Appl10, RteUsedOsEventRef=Rte_Ev_Run_BmwMsgSlot68Bas0Repn2BusFrChA_TAR_STMOM_DV_ACT_Miss
          DRT_TAR_STMOM_DV_ACT_Rxd_sigGroup_TAR_STMOM_DV_ACT_sigGroup_TAR_STMOM_DV_ACT: RtePositionInTask=46, RteEventRef=DRT_TAR_STMOM_DV_ACT_Rxd_sigGroup_TAR_STMOM_DV_ACT_sigGroup_TAR_STMOM_DV_ACT, RteMappedToTaskRef=Task_10ms_Appl10, RteUsedOsEventRef=Rte_Ev_Run_BmwMsgSlot68Bas0Repn2BusFrChA_TAR_STMOM_DV_ACT_Rxd
      BmwMsgSlot56Bas0Repn2BusFrChA_EcuSwComposition: RteSoftwareComponentInstanceRef=BmwMsgSlot56Bas0Repn2BusFrChA
        3 x RteEventToTaskMapping, all with RteImmediateRestart=false:
          BmwMsgSlot56Bas0Repn2BusFrChA_InitEvent: RtePositionInTask=94, RteEventRef=BmwMsgSlot56Bas0Repn2BusFrChA_InitEvent, RteMappedToTaskRef=Task_Init_Appl10
          DRET_VYAW_VEH_Missing_Oper_sigGroup_VYAW_VEH_sigGroup_VYAW_VEH: RtePositionInTask=24, RteEventRef=DRET_VYAW_VEH_Missing_Oper_sigGroup_VYAW_VEH_sigGroup_VYAW_VEH, RteMappedToTaskRef=Task_10ms_Appl10, RteUsedOsEventRef=Rte_Ev_Run_BmwMsgSlot56Bas0Repn2BusFrChA_VYAW_VEH_Missing_Oper
          DRT_VYAW_VEH_Received_Oper_sigGroup_VYAW_VEH_sigGroup_VYAW_VEH: RtePositionInTask=25, RteEventRef=DRT_VYAW_VEH_Received_Oper_sigGroup_VYAW_VEH_sigGroup_VYAW_VEH, RteMappedToTaskRef=Task_10ms_Appl10, RteUsedOsEventRef=Rte_Ev_Run_BmwMsgSlot56Bas0Repn2BusFrChA_VYAW_VEH_Received_Oper
      BmwMsgSlot234Bas1Repn2BusFrChA_EcuSwComposition: RteSoftwareComponentInstanceRef=BmwMsgSlot234Bas1Repn2BusFrChA
        BmwMsgSlot234Bas1Repn2BusFrChA_InitEvent (RteEventToTaskMapping): RteImmediateRestart=false, RtePositionInTask=89, RteEventRef=BmwMsgSlot234Bas1Repn2BusFrChA_InitEvent, RteMappedToTaskRef=Task_Init_Appl10
        TMT_BmwMsgSlot234Bas1Repn2BusFrChAPer1 (RteEventToTaskMapping):
          RteImmediateRestart = false
          RtePositionInTask = 2
          RteEventRef = TMT_BmwMsgSlot234Bas1Repn2BusFrChAPer1
          RteMappedToTaskRef = Task_ComBsw_Appl10
          RteUsedOsEventRef = Rte_Ev_Cyclic_Task_ComBsw_Appl10_0_10ms
          RteUsedOsAlarmRef = Rte_Al_TE_Task_ComBsw_Appl10_0_10ms
      BmwMsgSlot53Bas3Repn8BusFrChA_EcuSwComposition: RteSoftwareComponentInstanceRef=BmwMsgSlot53Bas3Repn8BusFrChA
        5 x RteEventToTaskMapping, all with RteImmediateRestart=false:
          BmwMsgSlot53Bas3Repn8BusFrChAInit1_InitEvent: RtePositionInTask=92, RteEventRef=BmwMsgSlot53Bas3Repn8BusFrChAInit1_InitEvent, RteMappedToTaskRef=Task_Init_Appl10
          DRET_SU_CLE_DRDY_DXP_Miss_FACT_MO_STE_SO_DXP_FACT_MO_STE_SO_DXP: RtePositionInTask=27, RteEventRef=DRET_SU_CLE_DRDY_DXP_Miss_FACT_MO_STE_SO_DXP_FACT_MO_STE_SO_DXP, RteMappedToTaskRef=Task_10ms_Appl10, RteUsedOsEventRef=Rte_Ev_Run_BmwMsgSlot53Bas3Repn8BusFrChA_SU_CLE_DRDY_DXP_Miss
          DRET_SU_CLE_DRDY_DXP_Miss_SU_CLU_STMOM_SFE_DXP_SU_CLU_STMOM_SFE_DXP: RtePositionInTask=27, RteEventRef=DRET_SU_CLE_DRDY_DXP_Miss_SU_CLU_STMOM_SFE_DXP_SU_CLU_STMOM_SFE_DXP, RteMappedToTaskRef=Task_10ms_Appl10, RteUsedOsEventRef=Rte_Ev_Run_BmwMsgSlot53Bas3Repn8BusFrChA_SU_CLE_DRDY_DXP_Miss
          DRT_SU_CLE_DRDY_DXP_Rxd_FACT_MO_STE_SO_DXP_FACT_MO_STE_SO_DXP: RtePositionInTask=28, RteEventRef=DRT_SU_CLE_DRDY_DXP_Rxd_FACT_MO_STE_SO_DXP_FACT_MO_STE_SO_DXP, RteMappedToTaskRef=Task_10ms_Appl10, RteUsedOsEventRef=Rte_Ev_Run_BmwMsgSlot53Bas3Repn8BusFrChA_SU_CLE_DRDY_DXP_Rxd
          DRT_SU_CLE_DRDY_DXP_Rxd_SU_CLU_STMOM_SFE_DXP_SU_CLU_STMOM_SFE_DXP: RtePositionInTask=28, RteEventRef=DRT_SU_CLE_DRDY_DXP_Rxd_SU_CLU_STMOM_SFE_DXP_SU_CLU_STMOM_SFE_DXP, RteMappedToTaskRef=Task_10ms_Appl10, RteUsedOsEventRef=Rte_Ev_Run_BmwMsgSlot53Bas3Repn8BusFrChA_SU_CLE_DRDY_DXP_Rxd
    7 x RteSwComponentType:
      BmwMsgSlot274Bas0Repn8BusFrChA: RteComponentTypeRef=BmwMsgSlot274Bas0Repn8BusFrChA, RteImplementationRef=BmwMsgSlot274Bas0Repn8BusFrChA_Implementation
        ComponentTypeCalibration (RteComponentTypeCalibration): RteCalibrationSupportEnabled=true
      BmwMsgSlot68Bas0Repn2BusFrChA: RteComponentTypeRef=BmwMsgSlot68Bas0Repn2BusFrChA, RteImplementationRef=BmwMsgSlot68Bas0Repn2BusFrChA_Implementation
        ComponentTypeCalibration (RteComponentTypeCalibration): RteCalibrationSupportEnabled=true
      BmwMsgSlot234Bas1Repn2BusFrChA: RteComponentTypeRef=BmwMsgSlot234Bas1Repn2BusFrChA, RteImplementationRef=BmwMsgSlot234Bas1Repn2BusFrChA_Implementation
        ComponentTypeCalibration (RteComponentTypeCalibration): RteCalibrationSupportEnabled=true
      BmwMsgSlot276Bas4Repn8BusFrChA: RteComponentTypeRef=BmwMsgSlot276Bas4Repn8BusFrChA, RteImplementationRef=BmwMsgSlot276Bas4Repn8BusFrChA_Implementation
        ComponentTypeCalibration (RteComponentTypeCalibration): RteCalibrationSupportEnabled=true
      BmwMsgSlot55Bas0Repn2BusFrChA: RteComponentTypeRef=BmwMsgSlot55Bas0Repn2BusFrChA, RteImplementationRef=BmwMsgSlot55Bas0Repn2BusFrChA_Implementation
        ComponentTypeCalibration (RteComponentTypeCalibration): RteCalibrationSupportEnabled=true
      BmwMsgSlot53Bas3Repn8BusFrChA: RteComponentTypeRef=BmwMsgSlot53Bas3Repn8BusFrChA, RteImplementationRef=BmwMsgSlot53Bas3Repn8BusFrChA_Implementation
        ComponentTypeCalibration (RteComponentTypeCalibration): RteCalibrationSupportEnabled=true
      BmwMsgSlot56Bas0Repn2BusFrChA: RteComponentTypeRef=BmwMsgSlot56Bas0Repn2BusFrChA, RteImplementationRef=BmwMsgSlot56Bas0Repn2BusFrChA_Implementation
        ComponentTypeCalibration (RteComponentTypeCalibration): RteCalibrationSupportEnabled=true
    BmwMsgSlot108Bas0Repn2BusFrChA_EcuSwComposition (RteSwComponentInstance): RteSoftwareComponentInstanceRef=BmwMsgSlot108Bas0Repn2BusFrChA
      3 x RteEventToTaskMapping, all with RteImmediateRestart=false:
        BmwMsgSlot108Bas0Repn2BusFrChA_InitEvent: RtePositionInTask=97, RteEventRef=BmwMsgSlot108Bas0Repn2BusFrChA_InitEvent, RteMappedToTaskRef=Task_Init_Appl10
        DRET_STEA_OFFS_Missing_Oper_AVL_STEA_PNI_OFFS_AVL_STEA_PNI_OFFS: RtePositionInTask=47, RteEventRef=DRET_STEA_OFFS_Missing_Oper_AVL_STEA_PNI_OFFS_AVL_STEA_PNI_OFFS, RteMappedToTaskRef=Task_10ms_Appl10, RteUsedOsEventRef=Rte_Ev_Run_BmwMsgSlot108Bas0Repn2BusFrChA_STEA_OFFS_Missing_Oper
        DRT_STEA_OFFS_Received_Oper_AVL_STEA_PNI_OFFS_AVL_STEA_PNI_OFFS: RtePositionInTask=48, RteEventRef=DRT_STEA_OFFS_Received_Oper_AVL_STEA_PNI_OFFS_AVL_STEA_PNI_OFFS, RteMappedToTaskRef=Task_10ms_Appl10, RteUsedOsEventRef=Rte_Ev_Run_BmwMsgSlot108Bas0Repn2BusFrChA_STEA_OFFS_Received_Oper
    GlbLimr_EcuSwComposition (RteSwComponentInstance): RteSoftwareComponentInstanceRef=GlbLimr
      GlbLimr_InitEvent (RteEventToTaskMapping): RteImmediateRestart=false, RtePositionInTask=44, RteEventRef=GlbLimr_InitEvent, RteMappedToTaskRef=Task_Init_Appl10
      TMT_GlbLimrPer1 (RteEventToTaskMapping):
        RteImmediateRestart = false
        RtePositionInTask = 11
        RteEventRef = TMT_GlbLimrPer1
        RteMappedToTaskRef = Task_2msB_Appl10
        RteUsedOsAlarmRef = Rte_Al_TE_Task_2msB_Appl10_0_2ms
    BmwMsgSlot108Bas0Repn2BusFrChA (RteSwComponentType): RteComponentTypeRef=BmwMsgSlot108Bas0Repn2BusFrChA, RteImplementationRef=BmwMsgSlot108Bas0Repn2BusFrChA_Implementation
      ComponentTypeCalibration (RteComponentTypeCalibration): RteCalibrationSupportEnabled=true
    GlbLimr (RteSwComponentType): RteComponentTypeRef=GlbLimr, RteImplementationRef=GlbLimr_Implementation
      ComponentTypeCalibration (RteComponentTypeCalibration): RteCalibrationSupportEnabled=true
    3 x RteSwComponentInstance:
      BmwMsgSlot68Bas1Repn2BusFrChA_EcuSwComposition: RteSoftwareComponentInstanceRef=BmwMsgSlot68Bas1Repn2BusFrChA
        3 x RteEventToTaskMapping, all with RteImmediateRestart=false:
          BmwMsgSlot68Bas1Repn2BusFrChA_InitEvent: RtePositionInTask=99, RteEventRef=BmwMsgSlot68Bas1Repn2BusFrChA_InitEvent, RteMappedToTaskRef=Task_Init_Appl10
          DRET_ENERG_DGR_DRDY_Missing_Oper_sigGroup_ENERG_DGR_DRDY_sigGroup_ENERG_DGR_DRDY: RtePositionInTask=51, RteEventRef=DRET_ENERG_DGR_DRDY_Missing_Oper_sigGroup_ENERG_DGR_DRDY_sigGroup_ENERG_DGR_DRDY, RteMappedToTaskRef=Task_10ms_Appl10, RteUsedOsEventRef=Rte_Ev_Run_BmwMsgSlot68Bas1Repn2BusFrChA_ENERG_DGR_DRDY_Missing_Oper
          DRT_ENERG_DGR_DRDY_Received_Oper_sigGroup_ENERG_DGR_DRDY_sigGroup_ENERG_DGR_DRDY: RtePositionInTask=52, RteEventRef=DRT_ENERG_DGR_DRDY_Received_Oper_sigGroup_ENERG_DGR_DRDY_sigGroup_ENERG_DGR_DRDY, RteMappedToTaskRef=Task_10ms_Appl10, RteUsedOsEventRef=Rte_Ev_Run_BmwMsgSlot68Bas1Repn2BusFrChA_ENERG_DGR_DRDY_Received_Oper
      BmwMsgSlot269Bas2Repn4BusFrChA_EcuSwComposition: RteSoftwareComponentInstanceRef=BmwMsgSlot269Bas2Repn4BusFrChA
        7 x RteEventToTaskMapping, all with RteImmediateRestart=false:
          BmwMsgSlot269Bas2Repn4BusFrChA_InitEvent: RtePositionInTask=98, RteEventRef=BmwMsgSlot269Bas2Repn4BusFrChA_InitEvent, RteMappedToTaskRef=Task_Init_Appl10
          DRET_CTR_VIB_STW_DISP_EXMI_SP2015_Missing_CTR_WARN_DIR_VIB_EPS_CTR_WARN_DIR_VIB_EPS: RtePositionInTask=49, RteEventRef=DRET_CTR_VIB_STW_DISP_EXMI_SP2015_Missing_CTR_WARN_DIR_VIB_EPS_CTR_WARN_DIR_VIB_EPS, RteMappedToTaskRef=Task_10ms_Appl10, RteUsedOsEventRef=Rte_Ev_Run_BmwMsgSlot269Bas2Repn4BusFrChA_CTR_VIB_STW_DISP_EXMI_SP2015_Missing
          DRET_CTR_VIB_STW_DISP_EXMI_SP2015_Missing_CTR_WARN_ILVL_VIB_EPS_CTR_WARN_ILVL_VIB_EPS: RtePositionInTask=49, RteEventRef=DRET_CTR_VIB_STW_DISP_EXMI_SP2015_Missing_CTR_WARN_ILVL_VIB_EPS_CTR_WARN_ILVL_VIB_EPS, RteMappedToTaskRef=Task_10ms_Appl10, RteUsedOsEventRef=Rte_Ev_Run_BmwMsgSlot269Bas2Repn4BusFrChA_CTR_VIB_STW_DISP_EXMI_SP2015_Missing
          DRET_CTR_VIB_STW_DISP_EXMI_SP2015_Missing_CTR_WARN_PTRN_VIB_EPS_CTR_WARN_PTRN_VIB_EPS: RtePositionInTask=49, RteEventRef=DRET_CTR_VIB_STW_DISP_EXMI_SP2015_Missing_CTR_WARN_PTRN_VIB_EPS_CTR_WARN_PTRN_VIB_EPS, RteMappedToTaskRef=Task_10ms_Appl10, RteUsedOsEventRef=Rte_Ev_Run_BmwMsgSlot269Bas2Repn4BusFrChA_CTR_VIB_STW_DISP_EXMI_SP2015_Missing
          DRT_CTR_VIB_STW_DISP_EXMI_SP2015_Received_CTR_WARN_DIR_VIB_EPS_CTR_WARN_DIR_VIB_EPS: RtePositionInTask=50, RteEventRef=DRT_CTR_VIB_STW_DISP_EXMI_SP2015_Received_CTR_WARN_DIR_VIB_EPS_CTR_WARN_DIR_VIB_EPS, RteMappedToTaskRef=Task_10ms_Appl10, RteUsedOsEventRef=Rte_Ev_Run_BmwMsgSlot269Bas2Repn4BusFrChA_CTR_VIB_STW_DISP_EXMI_SP2015_Received
          DRT_CTR_VIB_STW_DISP_EXMI_SP2015_Received_CTR_WARN_ILVL_VIB_EPS_CTR_WARN_ILVL_VIB_EPS: RtePositionInTask=50, RteEventRef=DRT_CTR_VIB_STW_DISP_EXMI_SP2015_Received_CTR_WARN_ILVL_VIB_EPS_CTR_WARN_ILVL_VIB_EPS, RteMappedToTaskRef=Task_10ms_Appl10, RteUsedOsEventRef=Rte_Ev_Run_BmwMsgSlot269Bas2Repn4BusFrChA_CTR_VIB_STW_DISP_EXMI_SP2015_Received
          DRT_CTR_VIB_STW_DISP_EXMI_SP2015_Received_CTR_WARN_PTRN_VIB_EPS_CTR_WARN_PTRN_VIB_EPS: RtePositionInTask=50, RteEventRef=DRT_CTR_VIB_STW_DISP_EXMI_SP2015_Received_CTR_WARN_PTRN_VIB_EPS_CTR_WARN_PTRN_VIB_EPS, RteMappedToTaskRef=Task_10ms_Appl10, RteUsedOsEventRef=Rte_Ev_Run_BmwMsgSlot269Bas2Repn4BusFrChA_CTR_VIB_STW_DISP_EXMI_SP2015_Received
      BmwMsgSlot49Bas1Repn2BusFrChA_EcuSwComposition: RteSoftwareComponentInstanceRef=BmwMsgSlot49Bas1Repn2BusFrChA
        BmwMsgSlot49Bas1Repn2BusFrChA_InitEvent (RteEventToTaskMapping): RteImmediateRestart=false, RtePositionInTask=100, RteEventRef=BmwMsgSlot49Bas1Repn2BusFrChA_InitEvent, RteMappedToTaskRef=Task_Init_Appl10
        TMT_BmwMsgSlot49Bas1Repn2BusFrChA_Per1 (RteEventToTaskMapping):
          RteImmediateRestart = false
          RtePositionInTask = 3
          RteEventRef = TMT_BmwMsgSlot49Bas1Repn2BusFrChA_Per1
          RteMappedToTaskRef = Task_ComBsw_Appl10
          RteUsedOsEventRef = Rte_Ev_Cyclic_Task_ComBsw_Appl10_0_10ms
          RteUsedOsAlarmRef = Rte_Al_TE_Task_ComBsw_Appl10_0_10ms
    3 x RteSwComponentType:
      BmwMsgSlot68Bas1Repn2BusFrChA: RteComponentTypeRef=BmwMsgSlot68Bas1Repn2BusFrChA, RteImplementationRef=BmwMsgSlot68Bas1Repn2BusFrChA_Implementation
        ComponentTypeCalibration (RteComponentTypeCalibration): RteCalibrationSupportEnabled=true
      BmwMsgSlot269Bas2Repn4BusFrChA: RteComponentTypeRef=BmwMsgSlot269Bas2Repn4BusFrChA, RteImplementationRef=BmwMsgSlot269Bas2Repn4BusFrChA_Implementation
        ComponentTypeCalibration (RteComponentTypeCalibration): RteCalibrationSupportEnabled=true
      BmwMsgSlot49Bas1Repn2BusFrChA: RteComponentTypeRef=BmwMsgSlot49Bas1Repn2BusFrChA, RteImplementationRef=BmwMsgSlot49Bas1Repn2BusFrChA_Implementation
        ComponentTypeCalibration (RteComponentTypeCalibration): RteCalibrationSupportEnabled=true
    6 x RteSwComponentInstance:
      BmwMotTqOvrlArbn_EcuSwComposition: RteSoftwareComponentInstanceRef=BmwMotTqOvrlArbn
        BmwMotTqOvrlArbn_InitEvent (RteEventToTaskMapping): RteImmediateRestart=false, RtePositionInTask=42, RteEventRef=BmwMotTqOvrlArbn_InitEvent, RteMappedToTaskRef=Task_Init_Appl10
        TMT_BmwMotTqOvrlArbnPer1 (RteEventToTaskMapping):
          RteImmediateRestart = false
          RtePositionInTask = 9
          RteEventRef = TMT_BmwMotTqOvrlArbnPer1
          RteMappedToTaskRef = Task_2msB_Appl10
          RteUsedOsAlarmRef = Rte_Al_TE_Task_2msB_Appl10_0_2ms
      BmwDrvgDynStMac_EcuSwComposition: RteSoftwareComponentInstanceRef=BmwDrvgDynStMac
        BmwDrvgDynStMac_InitEvent (RteEventToTaskMapping): RteImmediateRestart=false, RtePositionInTask=111, RteEventRef=BmwDrvgDynStMac_InitEvent, RteMappedToTaskRef=Task_Init_Appl10
        TMT_BmwDrvgDynStMacPer1 (RteEventToTaskMapping):
          RteImmediateRestart = false
          RtePositionInTask = 7
          RteEventRef = TMT_BmwDrvgDynStMacPer1
          RteMappedToTaskRef = Task_2msB_Appl10
          RteUsedOsAlarmRef = Rte_Al_TE_Task_2msB_Appl10_0_2ms
      BmwTqOvrlCdngAndDrvgDynFac_EcuSwComposition: RteSoftwareComponentInstanceRef=BmwTqOvrlCdngAndDrvgDynFac
        BmwTqOvrlCdngAndDrvgDynFacInit1_InitEvent (RteEventToTaskMapping): RteImmediateRestart=false, RtePositionInTask=41, RteEventRef=BmwTqOvrlCdngAndDrvgDynFacInit1_InitEvent, RteMappedToTaskRef=Task_Init_Appl10
        TMT_BmwTqOvrlCdngAndDrvgDynFacPer1 (RteEventToTaskMapping):
          RteImmediateRestart = false
          RtePositionInTask = 8
          RteEventRef = TMT_BmwTqOvrlCdngAndDrvgDynFacPer1
          RteMappedToTaskRef = Task_2msB_Appl10
          RteUsedOsAlarmRef = Rte_Al_TE_Task_2msB_Appl10_0_2ms
      BmwMsgSlot49Bas0Repn2BusFrChA_EcuSwComposition: RteSoftwareComponentInstanceRef=BmwMsgSlot49Bas0Repn2BusFrChA
        BmwMsgSlot49Bas0Repn2BusFrChA_InitEvent (RteEventToTaskMapping): RteImmediateRestart=false, RtePositionInTask=101, RteEventRef=BmwMsgSlot49Bas0Repn2BusFrChA_InitEvent, RteMappedToTaskRef=Task_Init_Appl10
        TMT_BmwMsgSlot49Bas0Repn2BusFrChA_Per1 (RteEventToTaskMapping):
          RteImmediateRestart = false
          RtePositionInTask = 4
          RteEventRef = TMT_BmwMsgSlot49Bas0Repn2BusFrChA_Per1
          RteMappedToTaskRef = Task_ComBsw_Appl10
          RteUsedOsEventRef = Rte_Ev_Cyclic_Task_ComBsw_Appl10_0_10ms
          RteUsedOsAlarmRef = Rte_Al_TE_Task_ComBsw_Appl10_0_10ms
      BmwTrfcJamAssiDampg_EcuSwComposition: RteSoftwareComponentInstanceRef=BmwTrfcJamAssiDampg
        BmwTrfcJamAssiDampg_InitEvent (RteEventToTaskMapping): RteImmediateRestart=false, RtePositionInTask=16, RteEventRef=BmwTrfcJamAssiDampg_InitEvent, RteMappedToTaskRef=Task_Init_Appl7
        TMT_BmwTrfcJamAssiDampgPer1 (RteEventToTaskMapping):
          RteImmediateRestart = false
          RtePositionInTask = 15
          RteEventRef = TMT_BmwTrfcJamAssiDampgPer1
          RteMappedToTaskRef = Task_2ms_Appl7
          RteUsedOsAlarmRef = Rte_Al_TE_Task_2ms_Appl7_0_2ms
      BmwHwTqOvrlArbn_EcuSwComposition: RteSoftwareComponentInstanceRef=BmwHwTqOvrlArbn
        BmwHwTqOvrlArbn_InitEvent (RteEventToTaskMapping): RteImmediateRestart=false, RtePositionInTask=12, RteEventRef=BmwHwTqOvrlArbn_InitEvent, RteMappedToTaskRef=Task_Init_Appl7
        TMT_BmwHwTqOvrlArbnPer1 (RteEventToTaskMapping):
          RteImmediateRestart = false
          RtePositionInTask = 11
          RteEventRef = TMT_BmwHwTqOvrlArbnPer1
          RteMappedToTaskRef = Task_2ms_Appl7
          RteUsedOsAlarmRef = Rte_Al_TE_Task_2ms_Appl7_0_2ms
    6 x RteSwComponentType:
      BmwHwTqOvrlArbn: RteComponentTypeRef=BmwHwTqOvrlArbn, RteImplementationRef=BmwHwTqOvrlArbn_Implementation
        ComponentTypeCalibration (RteComponentTypeCalibration): RteCalibrationSupportEnabled=true
      BmwMotTqOvrlArbn: RteComponentTypeRef=BmwMotTqOvrlArbn, RteImplementationRef=BmwMotTqOvrlArbn_Implementation
        ComponentTypeCalibration (RteComponentTypeCalibration): RteCalibrationSupportEnabled=true
      BmwDrvgDynStMac: RteComponentTypeRef=BmwDrvgDynStMac, RteImplementationRef=BmwDrvgDynStMac_Implementation
        ComponentTypeCalibration (RteComponentTypeCalibration): RteCalibrationSupportEnabled=true
      BmwTqOvrlCdngAndDrvgDynFac: RteComponentTypeRef=BmwTqOvrlCdngAndDrvgDynFac, RteImplementationRef=BmwTqOvrlCdngAndDrvgDynFac_Implementation
        ComponentTypeCalibration (RteComponentTypeCalibration): RteCalibrationSupportEnabled=true
      BmwMsgSlot49Bas0Repn2BusFrChA: RteComponentTypeRef=BmwMsgSlot49Bas0Repn2BusFrChA, RteImplementationRef=BmwMsgSlot49Bas0Repn2BusFrChA_Implementation
        ComponentTypeCalibration (RteComponentTypeCalibration): RteCalibrationSupportEnabled=true
      BmwTrfcJamAssiDampg: RteComponentTypeRef=BmwTrfcJamAssiDampg, RteImplementationRef=BmwTrfcJamAssiDampg_Implementation
        ComponentTypeCalibration (RteComponentTypeCalibration): RteCalibrationSupportEnabled=true
    SteerCmdArbnAndLim_EcuSwComposition (RteSwComponentInstance): RteSoftwareComponentInstanceRef=SteerCmdArbnAndLim
      3 x RteEventToTaskMapping, all with RteImmediateRestart=false:
        OIT_SetManTqCmd_Oper_SetManTqCmd_Oper: RteEventRef=OIT_SetManTqCmd_Oper_SetManTqCmd_Oper
        SteerCmdArbnAndLim_InitEvent: RtePositionInTask=46, RteEventRef=SteerCmdArbnAndLim_InitEvent, RteMappedToTaskRef=Task_Init_Appl10
        TMT_SteerCmdArbnAndLimPer1: RtePositionInTask=13, RteEventRef=TMT_SteerCmdArbnAndLimPer1, RteMappedToTaskRef=Task_2msB_Appl10, RteUsedOsAlarmRef=Rte_Al_TE_Task_2msB_Appl10_0_2ms
    FalbckAssi_EcuSwComposition (RteSwComponentInstance): RteSoftwareComponentInstanceRef=FalbckAssi
      FalbckAssi_InitEvent (RteEventToTaskMapping): RteImmediateRestart=false, RtePositionInTask=45, RteEventRef=FalbckAssi_InitEvent, RteMappedToTaskRef=Task_Init_Appl10
      TMT_FalbckAssiPer1 (RteEventToTaskMapping):
        RteImmediateRestart = false
        RtePositionInTask = 12
        RteEventRef = TMT_FalbckAssiPer1
        RteMappedToTaskRef = Task_2msB_Appl10
        RteUsedOsAlarmRef = Rte_Al_TE_Task_2msB_Appl10_0_2ms
    FalbckAssi (RteSwComponentType): RteComponentTypeRef=FalbckAssi, RteImplementationRef=FalbckAssi_Implementation
      ComponentTypeCalibration (RteComponentTypeCalibration): RteCalibrationSupportEnabled=true
    SteerCmdArbnAndLim (RteSwComponentType): RteComponentTypeRef=SteerCmdArbnAndLim, RteImplementationRef=SteerCmdArbnAndLim_Implementation
      ComponentTypeCalibration (RteComponentTypeCalibration): RteCalibrationSupportEnabled=true
    ClsdLoopHys_EcuSwComposition (RteSwComponentInstance): RteSoftwareComponentInstanceRef=ClsdLoopHys
      ClsdLoopHys_InitEvent (RteEventToTaskMapping): RteImmediateRestart=false, RtePositionInTask=10, RteEventRef=ClsdLoopHys_InitEvent, RteMappedToTaskRef=Task_Init_Appl7
      TMT_ClsdLoopHysPer1 (RteEventToTaskMapping):
        RteImmediateRestart = false
        RtePositionInTask = 9
        RteEventRef = TMT_ClsdLoopHysPer1
        RteMappedToTaskRef = Task_2ms_Appl7
        RteUsedOsAlarmRef = Rte_Al_TE_Task_2ms_Appl7_0_2ms
    ClsdLoopHys (RteSwComponentType): RteComponentTypeRef=ClsdLoopHys, RteImplementationRef=ClsdLoopHys_Implementation
      ComponentTypeCalibration (RteComponentTypeCalibration): RteCalibrationSupportEnabled=true
    36 x RteSwComponentInstance:
      AAACalRegn02Rt03GroupA_Dummy_EcuSwComposition: RteSoftwareComponentInstanceRef=AAACalRegn02Rt03GroupA_Dummy
        AAACalRegn02Rt01GroupA_Dummy_InitEvent (RteEventToTaskMapping): RteImmediateRestart=false, RtePositionInTask=126, RteEventRef=AAACalRegn02Rt01GroupA_Dummy_InitEvent, RteMappedToTaskRef=Task_Init_Appl10
      AAACalRegn02Rt03_Dummy_EcuSwComposition: RteSoftwareComponentInstanceRef=AAACalRegn02Rt03_Dummy
        AAACalRegn02Rt01_Dummy_InitEvent (RteEventToTaskMapping): RteImmediateRestart=false, RtePositionInTask=125, RteEventRef=AAACalRegn02Rt01_Dummy_InitEvent, RteMappedToTaskRef=Task_Init_Appl10
      AAACalRegn01IninOptSetA03_Dummy_EcuSwComposition: RteSoftwareComponentInstanceRef=AAACalRegn01IninOptSetA03_Dummy
        AAACalRegn01IninOptSetA01_Dummy_InitEvent (RteEventToTaskMapping): RteImmediateRestart=false, RtePositionInTask=115, RteEventRef=AAACalRegn01IninOptSetA01_Dummy_InitEvent, RteMappedToTaskRef=Task_Init_Appl10
      CalRegn02Rt00GroupC_EcuSwComposition: RteSoftwareComponentInstanceRef=CalRegn02Rt00GroupC
      CalRegn02Rt00GroupA_EcuSwComposition: RteSoftwareComponentInstanceRef=CalRegn02Rt00GroupA
      CalRegn02Rt01GroupC_EcuSwComposition: RteSoftwareComponentInstanceRef=CalRegn02Rt01GroupC
      CalRegn01IninOptSetA02_EcuSwComposition: RteSoftwareComponentInstanceRef=CalRegn01IninOptSetA02
      AAACalRegn02Rt00GroupA_Dummy_EcuSwComposition: RteSoftwareComponentInstanceRef=AAACalRegn02Rt00GroupA_Dummy
        AAACalRegn02Rt01GroupA_Dummy_InitEvent (RteEventToTaskMapping): RteImmediateRestart=false, RtePositionInTask=117, RteEventRef=AAACalRegn02Rt01GroupA_Dummy_InitEvent, RteMappedToTaskRef=Task_Init_Appl10
      CalRegn02Rt03GroupC_EcuSwComposition: RteSoftwareComponentInstanceRef=CalRegn02Rt03GroupC
      CalRegn01Cmn_EcuSwComposition: RteSoftwareComponentInstanceRef=CalRegn01Cmn
      AAACalRegn01IninOptSetA01_Dummy_EcuSwComposition: RteSoftwareComponentInstanceRef=AAACalRegn01IninOptSetA01_Dummy
        AAACalRegn01IninOptSetA01_Dummy_InitEvent (RteEventToTaskMapping): RteImmediateRestart=false, RtePositionInTask=113, RteEventRef=AAACalRegn01IninOptSetA01_Dummy_InitEvent, RteMappedToTaskRef=Task_Init_Appl10
      CalRegn02Rt02_EcuSwComposition: RteSoftwareComponentInstanceRef=CalRegn02Rt02
      AAACalRegn02Rt02_Dummy_EcuSwComposition: RteSoftwareComponentInstanceRef=AAACalRegn02Rt02_Dummy
        AAACalRegn02Rt01_Dummy_InitEvent (RteEventToTaskMapping): RteImmediateRestart=false, RtePositionInTask=122, RteEventRef=AAACalRegn02Rt01_Dummy_InitEvent, RteMappedToTaskRef=Task_Init_Appl10
      AAACalRegn02Rt02GroupA_Dummy_EcuSwComposition: RteSoftwareComponentInstanceRef=AAACalRegn02Rt02GroupA_Dummy
        AAACalRegn02Rt01GroupA_Dummy_InitEvent (RteEventToTaskMapping): RteImmediateRestart=false, RtePositionInTask=123, RteEventRef=AAACalRegn02Rt01GroupA_Dummy_InitEvent, RteMappedToTaskRef=Task_Init_Appl10
      AAACalRegn01IninOptSetA02_Dummy_EcuSwComposition: RteSoftwareComponentInstanceRef=AAACalRegn01IninOptSetA02_Dummy
        AAACalRegn01IninOptSetA01_Dummy_InitEvent (RteEventToTaskMapping): RteImmediateRestart=false, RtePositionInTask=114, RteEventRef=AAACalRegn01IninOptSetA01_Dummy_InitEvent, RteMappedToTaskRef=Task_Init_Appl10
      AAACalRegn02Rt01GroupC_Dummy_EcuSwComposition: RteSoftwareComponentInstanceRef=AAACalRegn02Rt01GroupC_Dummy
        AAACalRegn02Rt01GroupC_Dummy_InitEvent (RteEventToTaskMapping): RteImmediateRestart=false, RtePositionInTask=121, RteEventRef=AAACalRegn02Rt01GroupC_Dummy_InitEvent, RteMappedToTaskRef=Task_Init_Appl10
      CalRegn01IninOptSetA01_EcuSwComposition: RteSoftwareComponentInstanceRef=CalRegn01IninOptSetA01
      AAACalRegn02Rt00GroupC_Dummy_EcuSwComposition: RteSoftwareComponentInstanceRef=AAACalRegn02Rt00GroupC_Dummy
        AAACalRegn02Rt01GroupC_Dummy_InitEvent (RteEventToTaskMapping): RteImmediateRestart=false, RtePositionInTask=118, RteEventRef=AAACalRegn02Rt01GroupC_Dummy_InitEvent, RteMappedToTaskRef=Task_Init_Appl10
      AAACalRegn02Rt01GroupA_Dummy_EcuSwComposition: RteSoftwareComponentInstanceRef=AAACalRegn02Rt01GroupA_Dummy
        AAACalRegn02Rt01GroupA_Dummy_InitEvent (RteEventToTaskMapping): RteImmediateRestart=false, RtePositionInTask=120, RteEventRef=AAACalRegn02Rt01GroupA_Dummy_InitEvent, RteMappedToTaskRef=Task_Init_Appl10
      CalRegn01IninOptSetA00_EcuSwComposition: RteSoftwareComponentInstanceRef=CalRegn01IninOptSetA00
      AAACalRegn02Rt00_Dummy_EcuSwComposition: RteSoftwareComponentInstanceRef=AAACalRegn02Rt00_Dummy
        AAACalRegn02Rt01_Dummy_InitEvent (RteEventToTaskMapping): RteImmediateRestart=false, RtePositionInTask=116, RteEventRef=AAACalRegn02Rt01_Dummy_InitEvent, RteMappedToTaskRef=Task_Init_Appl10
      AAACalRegn02Rt03GroupC_Dummy_EcuSwComposition: RteSoftwareComponentInstanceRef=AAACalRegn02Rt03GroupC_Dummy
        AAACalRegn02Rt01GroupC_Dummy_InitEvent (RteEventToTaskMapping): RteImmediateRestart=false, RtePositionInTask=127, RteEventRef=AAACalRegn02Rt01GroupC_Dummy_InitEvent, RteMappedToTaskRef=Task_Init_Appl10
      CalRegn01CmnGroupD_EcuSwComposition: RteSoftwareComponentInstanceRef=CalRegn01CmnGroupD
      CalRegn02Rt03GroupA_EcuSwComposition: RteSoftwareComponentInstanceRef=CalRegn02Rt03GroupA
      CalRegn01CmnGroupA_EcuSwComposition: RteSoftwareComponentInstanceRef=CalRegn01CmnGroupA
      CalRegn02Rt00_EcuSwComposition: RteSoftwareComponentInstanceRef=CalRegn02Rt00
      CalRegn02Rt01GroupA_EcuSwComposition: RteSoftwareComponentInstanceRef=CalRegn02Rt01GroupA
      CalRegn01CmnGroupC_EcuSwComposition: RteSoftwareComponentInstanceRef=CalRegn01CmnGroupC
      AAACalRegn02Rt02GroupC_Dummy_EcuSwComposition: RteSoftwareComponentInstanceRef=AAACalRegn02Rt02GroupC_Dummy
        AAACalRegn02Rt01GroupC_Dummy_InitEvent (RteEventToTaskMapping): RteImmediateRestart=false, RtePositionInTask=124, RteEventRef=AAACalRegn02Rt01GroupC_Dummy_InitEvent, RteMappedToTaskRef=Task_Init_Appl10
      CalRegn02Rt02GroupA_EcuSwComposition: RteSoftwareComponentInstanceRef=CalRegn02Rt02GroupA
      AAACalRegn02Rt01_Dummy_EcuSwComposition: RteSoftwareComponentInstanceRef=AAACalRegn02Rt01_Dummy
        AAACalRegn02Rt01_Dummy_InitEvent (RteEventToTaskMapping): RteImmediateRestart=false, RtePositionInTask=119, RteEventRef=AAACalRegn02Rt01_Dummy_InitEvent, RteMappedToTaskRef=Task_Init_Appl10
      AAACalRegn01IninOptSetA00_Dummy_EcuSwComposition: RteSoftwareComponentInstanceRef=AAACalRegn01IninOptSetA00_Dummy
        AAACalRegn01IninOptSetA01_Dummy_InitEvent (RteEventToTaskMapping): RteImmediateRestart=false, RtePositionInTask=112, RteEventRef=AAACalRegn01IninOptSetA01_Dummy_InitEvent, RteMappedToTaskRef=Task_Init_Appl10
      CalRegn02Rt03_EcuSwComposition: RteSoftwareComponentInstanceRef=CalRegn02Rt03
      CalRegn01IninOptSetA03_EcuSwComposition: RteSoftwareComponentInstanceRef=CalRegn01IninOptSetA03
      CalRegn02Rt02GroupC_EcuSwComposition: RteSoftwareComponentInstanceRef=CalRegn02Rt02GroupC
      CalRegn02Rt01_EcuSwComposition: RteSoftwareComponentInstanceRef=CalRegn02Rt01
    24 x RteSwComponentType:
      CalRegn02Rt02GroupC: RteComponentTypeRef=CalRegn02Rt02GroupC
        ComponentTypeCalibration (RteComponentTypeCalibration): RteCalibrationSupportEnabled=true
      CalRegn02Rt00: RteComponentTypeRef=CalRegn02Rt00
        ComponentTypeCalibration (RteComponentTypeCalibration): RteCalibrationSupportEnabled=true
      CalRegn02Rt01: RteComponentTypeRef=CalRegn02Rt01
        ComponentTypeCalibration (RteComponentTypeCalibration): RteCalibrationSupportEnabled=true
      AAACalRegn02Rt01GroupA_Dummy: RteComponentTypeRef=AAACalRegn02Rt01GroupA_Dummy, RteImplementationRef=AAACalRegn02Rt00GroupA_Dummy_Implementation
        ComponentTypeCalibration (RteComponentTypeCalibration): RteCalibrationSupportEnabled=true
      CalRegn02Rt01GroupA: RteComponentTypeRef=CalRegn02Rt01GroupA
        ComponentTypeCalibration (RteComponentTypeCalibration): RteCalibrationSupportEnabled=true
      CalRegn01CmnGroupC: RteComponentTypeRef=CalRegn01CmnGroupC
        ComponentTypeCalibration (RteComponentTypeCalibration): RteCalibrationSupportEnabled=true
      CalRegn01IninOptSetA02: RteComponentTypeRef=CalRegn01IninOptSetA02
        ComponentTypeCalibration (RteComponentTypeCalibration): RteCalibrationSupportEnabled=true
      AAACalRegn02Rt01_Dummy: RteComponentTypeRef=AAACalRegn02Rt01_Dummy, RteImplementationRef=AAACalRegn02Rt00_Dummy_Implementation
        ComponentTypeCalibration (RteComponentTypeCalibration): RteCalibrationSupportEnabled=true
      CalRegn02Rt01GroupC: RteComponentTypeRef=CalRegn02Rt01GroupC
        ComponentTypeCalibration (RteComponentTypeCalibration): RteCalibrationSupportEnabled=true
      CalRegn02Rt00GroupA: RteComponentTypeRef=CalRegn02Rt00GroupA
        ComponentTypeCalibration (RteComponentTypeCalibration): RteCalibrationSupportEnabled=true
      AAACalRegn02Rt01GroupC_Dummy: RteComponentTypeRef=AAACalRegn02Rt01GroupC_Dummy, RteImplementationRef=AAACalRegn02Rt00GroupC_Dummy_Implementation
        ComponentTypeCalibration (RteComponentTypeCalibration): RteCalibrationSupportEnabled=true
      CalRegn02Rt03GroupA: RteComponentTypeRef=CalRegn02Rt03GroupA
        ComponentTypeCalibration (RteComponentTypeCalibration): RteCalibrationSupportEnabled=true
      CalRegn02Rt03: RteComponentTypeRef=CalRegn02Rt03
        ComponentTypeCalibration (RteComponentTypeCalibration): RteCalibrationSupportEnabled=true
      CalRegn01Cmn: RteComponentTypeRef=CalRegn01Cmn
        ComponentTypeCalibration (RteComponentTypeCalibration): RteCalibrationSupportEnabled=true
      CalRegn01CmnGroupD: RteComponentTypeRef=CalRegn01CmnGroupD
        ComponentTypeCalibration (RteComponentTypeCalibration): RteCalibrationSupportEnabled=true
      CalRegn02Rt00GroupC: RteComponentTypeRef=CalRegn02Rt00GroupC
        ComponentTypeCalibration (RteComponentTypeCalibration): RteCalibrationSupportEnabled=true
      CalRegn01IninOptSetA03: RteComponentTypeRef=CalRegn01IninOptSetA03
        ComponentTypeCalibration (RteComponentTypeCalibration): RteCalibrationSupportEnabled=true
      CalRegn01IninOptSetA00: RteComponentTypeRef=CalRegn01IninOptSetA00
        ComponentTypeCalibration (RteComponentTypeCalibration): RteCalibrationSupportEnabled=true
      CalRegn02Rt02: RteComponentTypeRef=CalRegn02Rt02
        ComponentTypeCalibration (RteComponentTypeCalibration): RteCalibrationSupportEnabled=true
      AAACalRegn01IninOptSetA01_Dummy: RteComponentTypeRef=AAACalRegn01IninOptSetA01_Dummy, RteImplementationRef=AAACalRegn01IninOptSetA00_Dummy_Implementation
        ComponentTypeCalibration (RteComponentTypeCalibration): RteCalibrationSupportEnabled=true
      CalRegn01IninOptSetA01: RteComponentTypeRef=CalRegn01IninOptSetA01
        ComponentTypeCalibration (RteComponentTypeCalibration): RteCalibrationSupportEnabled=true
      CalRegn02Rt03GroupC: RteComponentTypeRef=CalRegn02Rt03GroupC
        ComponentTypeCalibration (RteComponentTypeCalibration): RteCalibrationSupportEnabled=true
      CalRegn01CmnGroupA: RteComponentTypeRef=CalRegn01CmnGroupA
        ComponentTypeCalibration (RteComponentTypeCalibration): RteCalibrationSupportEnabled=true
      CalRegn02Rt02GroupA: RteComponentTypeRef=CalRegn02Rt02GroupA
        ComponentTypeCalibration (RteComponentTypeCalibration): RteCalibrationSupportEnabled=true
    BmwMsgSlot315Bas0Repn1BusFrChA_EcuSwComposition (RteSwComponentInstance): RteSoftwareComponentInstanceRef=BmwMsgSlot315Bas0Repn1BusFrChA
      BmwMsgSlot315Bas0Repn1BusFrChA_InitEvent (RteEventToTaskMapping): RteImmediateRestart=false, RtePositionInTask=128, RteEventRef=BmwMsgSlot315Bas0Repn1BusFrChA_InitEvent, RteMappedToTaskRef=Task_Init_Appl10
      TMT_BmwMsgSlot315Bas0Repn1BusFrChA_Per1 (RteEventToTaskMapping):
        RteImmediateRestart = false
        RtePositionInTask = 5
        RteEventRef = TMT_BmwMsgSlot315Bas0Repn1BusFrChA_Per1
        RteMappedToTaskRef = Task_ComBsw_Appl10
        RteUsedOsEventRef = Rte_Ev_Cyclic_Task_ComBsw_Appl10_0_10ms
        RteUsedOsAlarmRef = Rte_Al_TE_Task_ComBsw_Appl10_0_10ms
    BmwMsgSlot315Bas0Repn1BusFrChA (RteSwComponentType): RteComponentTypeRef=BmwMsgSlot315Bas0Repn1BusFrChA, RteImplementationRef=BmwMsgSlot315Bas0Repn1BusFrChA_Implementation
      ComponentTypeCalibration (RteComponentTypeCalibration): RteCalibrationSupportEnabled=true
    3 x RteSwComponentInstance:
      NxtrCalIds_EcuSwComposition: RteSoftwareComponentInstanceRef=NxtrCalIds
        3 x RteEventToTaskMapping, all with RteImmediateRestart=false:
          OIT_NxtrCalIdsCalDevlpRd_Oper_NxtrCalIdsCalDevlpRd_Oper: RteEventRef=OIT_NxtrCalIdsCalDevlpRd_Oper_NxtrCalIdsCalDevlpRd_Oper
          OIT_NxtrCalIdsCalRelRd_Oper_NxtrCalIdsCalRelRd_Oper: RteEventRef=OIT_NxtrCalIdsCalRelRd_Oper_NxtrCalIdsCalRelRd_Oper
          CmnMfgSrv_InitEvent: RtePositionInTask=95, RteEventRef=CmnMfgSrv_InitEvent, RteMappedToTaskRef=Task_Init_Appl10
      BmwSplyCurrLim_EcuSwComposition: RteSoftwareComponentInstanceRef=BmwSplyCurrLim
        BmwSplyCurrLim_InitEvent (RteEventToTaskMapping): RteImmediateRestart=false, RtePositionInTask=1, RteEventRef=BmwSplyCurrLim_InitEvent, RteMappedToTaskRef=Task_Init_Appl9
        TMT_BmwSplyCurrLimPer1 (RteEventToTaskMapping):
          RteImmediateRestart = false
          RtePositionInTask = 2
          RteEventRef = TMT_BmwSplyCurrLimPer1
          RteMappedToTaskRef = Task_2ms_Appl9
          RteUsedOsAlarmRef = Rte_Al_TE_Task_2ms_Appl9_0_2ms
      BmwHaptcFb_EcuSwComposition: RteSoftwareComponentInstanceRef=BmwHaptcFb
        BmwHaptcFb_InitEvent (RteEventToTaskMapping): RteImmediateRestart=false, RtePositionInTask=15, RteEventRef=BmwHaptcFb_InitEvent, RteMappedToTaskRef=Task_Init_Appl7
        TMT_BmwHaptcFbPer1 (RteEventToTaskMapping):
          RteImmediateRestart = false
          RtePositionInTask = 14
          RteEventRef = TMT_BmwHaptcFbPer1
          RteMappedToTaskRef = Task_2ms_Appl7
          RteUsedOsAlarmRef = Rte_Al_TE_Task_2ms_Appl7_0_2ms
    3 x RteSwComponentType:
      NxtrCalIds: RteComponentTypeRef=NxtrCalIds, RteImplementationRef=NxtrCalIds_Implementation
        ComponentTypeCalibration (RteComponentTypeCalibration): RteCalibrationSupportEnabled=true
      BmwHaptcFb: RteComponentTypeRef=BmwHaptcFb, RteImplementationRef=BmwHaptcFb_Implementation
        ComponentTypeCalibration (RteComponentTypeCalibration): RteCalibrationSupportEnabled=true
      BmwSplyCurrLim: RteComponentTypeRef=BmwSplyCurrLim, RteImplementationRef=BmwSplyCurrLim_Implementation
        ComponentTypeCalibration (RteComponentTypeCalibration): RteCalibrationSupportEnabled=true
    CalRegn01CmnGroupB_EcuSwComposition (RteSwComponentInstance): RteSoftwareComponentInstanceRef=CalRegn01CmnGroupB
    CalRegn01CmnGroupB (RteSwComponentType): RteComponentTypeRef=CalRegn01CmnGroupB
      ComponentTypeCalibration (RteComponentTypeCalibration): RteCalibrationSupportEnabled=true
    3 x RteSwComponentInstance:
      InertiaCmpVel_EcuSwComposition: RteSoftwareComponentInstanceRef=InertiaCmpVel
        InertiaCmpVelInit1_InitEvent (RteEventToTaskMapping): RteImmediateRestart=false, RtePositionInTask=5, RteEventRef=InertiaCmpVelInit1_InitEvent, RteMappedToTaskRef=Task_Init_Appl7
        TMT_InertiaCmpVelPer1 (RteEventToTaskMapping):
          RteImmediateRestart = false
          RtePositionInTask = 5
          RteEventRef = TMT_InertiaCmpVelPer1
          RteMappedToTaskRef = Task_2ms_Appl7
          RteUsedOsAlarmRef = Rte_Al_TE_Task_2ms_Appl7_0_2ms
      PullCmpActv_EcuSwComposition: RteSoftwareComponentInstanceRef=PullCmpActv
        NvmBlock_PullCmpActv_NvmPullCmpLongTerm (RteNvRamAllocation):
          RteNvmRamBlockLocationSymbol = Rte_PullCmpActv_PullCmpLongTerm
          RteNvmRomBlockLocationSymbol = Rte_PullCmpLongTermDft
          RteNvmBlockRef = Rte_NvmBlock_PullCmpActv_PullCmpLongTerm
          RteSwNvRamMappingRef = NvmPullCmpLongTerm
        7 x RteEventToTaskMapping, all with RteImmediateRestart=false:
          OIT_GetPullCmpPrm_Oper_GetPullCmpPrm_Oper: RteEventRef=OIT_GetPullCmpPrm_Oper_GetPullCmpPrm_Oper
          PullCmpActv_InitEvent: RtePositionInTask=8, RteEventRef=PullCmpActv_InitEvent, RteMappedToTaskRef=Task_Init_Appl10
          TMT_PullCmpActvPer1: RtePositionInTask=5, RteEventRef=TMT_PullCmpActvPer1, RteMappedToTaskRef=Task_2msB_Appl10, RteUsedOsAlarmRef=Rte_Al_TE_Task_2msB_Appl10_0_2ms
          TMT_PullCmpActvPer2: RtePositionInTask=2, RteEventRef=TMT_PullCmpActvPer2, RteMappedToTaskRef=Task_100ms_Appl10, RteUsedOsEventRef=Rte_Ev_Cyclic_Task_100ms_Appl10_0_100ms, RteUsedOsAlarmRef=Rte_Al_TE_Task_100ms_Appl10_0_100ms
          OIT_RstPullCmp_Oper_RstPullCmp_Oper: RteEventRef=OIT_RstPullCmp_Oper_RstPullCmp_Oper
          OIT_SetPullCmpLongTerm_Oper_SetPullCmpLongTerm_Oper: RteEventRef=OIT_SetPullCmpLongTerm_Oper_SetPullCmpLongTerm_Oper
          OIT_SetPullCmpShoTerm_Oper_SetPullCmpShoTerm_Oper: RteEventRef=OIT_SetPullCmpShoTerm_Oper_SetPullCmpShoTerm_Oper
      BmwPwrPrkgDampg_EcuSwComposition: RteSoftwareComponentInstanceRef=BmwPwrPrkgDampg
        BmwPwrPrkgDampg_InitEvent (RteEventToTaskMapping): RteImmediateRestart=false, RtePositionInTask=13, RteEventRef=BmwPwrPrkgDampg_InitEvent, RteMappedToTaskRef=Task_Init_Appl7
        TMT_BmwPwrPrkgDampgPer1 (RteEventToTaskMapping):
          RteImmediateRestart = false
          RtePositionInTask = 12
          RteEventRef = TMT_BmwPwrPrkgDampgPer1
          RteMappedToTaskRef = Task_2ms_Appl7
          RteUsedOsAlarmRef = Rte_Al_TE_Task_2ms_Appl7_0_2ms
    3 x RteSwComponentType:
      BmwPwrPrkgDampg: RteComponentTypeRef=BmwPwrPrkgDampg, RteImplementationRef=BmwPwrPrkgDampg_Implementation
        ComponentTypeCalibration (RteComponentTypeCalibration): RteCalibrationSupportEnabled=true
      InertiaCmpVel: RteComponentTypeRef=InertiaCmpVel, RteImplementationRef=InertiaCmpVel_Implementation
        ComponentTypeCalibration (RteComponentTypeCalibration): RteCalibrationSupportEnabled=true
      PullCmpActv: RteComponentTypeRef=PullCmpActv, RteImplementationRef=PullCmpActv_Implementation
        ComponentTypeCalibration (RteComponentTypeCalibration): RteCalibrationSupportEnabled=true
    65 x RteSwComponentInstance:
      AAACalRegn01Inin01GroupD_Dummy_EcuSwComposition: RteSoftwareComponentInstanceRef=AAACalRegn01Inin01GroupD_Dummy
        AAACalRegn01Inin01GroupD_Dummy_InitEvent (RteEventToTaskMapping): RteImmediateRestart=false, RtePositionInTask=136, RteEventRef=AAACalRegn01Inin01GroupD_Dummy_InitEvent, RteMappedToTaskRef=Task_Init_Appl10
      CalRegn01Inin01GroupD_EcuSwComposition: RteSoftwareComponentInstanceRef=CalRegn01Inin01GroupD
      CalRegn01Inin03GroupA_EcuSwComposition: RteSoftwareComponentInstanceRef=CalRegn01Inin03GroupA
      AAACalRegn01Inin06GroupD_Dummy_EcuSwComposition: RteSoftwareComponentInstanceRef=AAACalRegn01Inin06GroupD_Dummy
        AAACalRegn01Inin01GroupD_Dummy_InitEvent (RteEventToTaskMapping): RteImmediateRestart=false, RtePositionInTask=156, RteEventRef=AAACalRegn01Inin01GroupD_Dummy_InitEvent, RteMappedToTaskRef=Task_Init_Appl10
      CalRegn01Inin01_EcuSwComposition: RteSoftwareComponentInstanceRef=CalRegn01Inin01
      AAACalRegn01Inin04_Dummy_EcuSwComposition: RteSoftwareComponentInstanceRef=AAACalRegn01Inin04_Dummy
        AAACalRegn01Inin01_Dummy_InitEvent (RteEventToTaskMapping): RteImmediateRestart=false, RtePositionInTask=145, RteEventRef=AAACalRegn01Inin01_Dummy_InitEvent, RteMappedToTaskRef=Task_Init_Appl10
      CalRegn02Rt01GroupD_EcuSwComposition: RteSoftwareComponentInstanceRef=CalRegn02Rt01GroupD
      AAACalRegn01Inin03GroupC_Dummy_EcuSwComposition: RteSoftwareComponentInstanceRef=AAACalRegn01Inin03GroupC_Dummy
        AAACalRegn01Inin01GroupC_Dummy_InitEvent (RteEventToTaskMapping): RteImmediateRestart=false, RtePositionInTask=143, RteEventRef=AAACalRegn01Inin01GroupC_Dummy_InitEvent, RteMappedToTaskRef=Task_Init_Appl10
      CalRegn01Inin05_EcuSwComposition: RteSoftwareComponentInstanceRef=CalRegn01Inin05
      CalRegn01Inin04GroupC_EcuSwComposition: RteSoftwareComponentInstanceRef=CalRegn01Inin04GroupC
      AAACalRegn01Inin02GroupA_Dummy_EcuSwComposition: RteSoftwareComponentInstanceRef=AAACalRegn01Inin02GroupA_Dummy
        AAACalRegn01Inin01GroupA_Dummy_InitEvent (RteEventToTaskMapping): RteImmediateRestart=false, RtePositionInTask=138, RteEventRef=AAACalRegn01Inin01GroupA_Dummy_InitEvent, RteMappedToTaskRef=Task_Init_Appl10
      AAACalRegn01Inin00GroupD_Dummy_EcuSwComposition: RteSoftwareComponentInstanceRef=AAACalRegn01Inin00GroupD_Dummy
        AAACalRegn01Inin01GroupD_Dummy_InitEvent (RteEventToTaskMapping): RteImmediateRestart=false, RtePositionInTask=132, RteEventRef=AAACalRegn01Inin01GroupD_Dummy_InitEvent, RteMappedToTaskRef=Task_Init_Appl10
      AAACalRegn01Inin02GroupD_Dummy_EcuSwComposition: RteSoftwareComponentInstanceRef=AAACalRegn01Inin02GroupD_Dummy
        AAACalRegn01Inin01GroupD_Dummy_InitEvent (RteEventToTaskMapping): RteImmediateRestart=false, RtePositionInTask=140, RteEventRef=AAACalRegn01Inin01GroupD_Dummy_InitEvent, RteMappedToTaskRef=Task_Init_Appl10
      CalRegn01Inin06GroupC_EcuSwComposition: RteSoftwareComponentInstanceRef=CalRegn01Inin06GroupC
      CalRegn01Inin00GroupA_EcuSwComposition: RteSoftwareComponentInstanceRef=CalRegn01Inin00GroupA
      CalRegn01Inin04GroupA_EcuSwComposition: RteSoftwareComponentInstanceRef=CalRegn01Inin04GroupA
      CalRegn01Inin04GroupD_EcuSwComposition: RteSoftwareComponentInstanceRef=CalRegn01Inin04GroupD
      AAACalRegn01Inin02_Dummy_EcuSwComposition: RteSoftwareComponentInstanceRef=AAACalRegn01Inin02_Dummy
        AAACalRegn01Inin01_Dummy_InitEvent (RteEventToTaskMapping): RteImmediateRestart=false, RtePositionInTask=137, RteEventRef=AAACalRegn01Inin01_Dummy_InitEvent, RteMappedToTaskRef=Task_Init_Appl10
      AAACalRegn01Inin05_Dummy_EcuSwComposition: RteSoftwareComponentInstanceRef=AAACalRegn01Inin05_Dummy
        AAACalRegn01Inin01_Dummy_InitEvent (RteEventToTaskMapping): RteImmediateRestart=false, RtePositionInTask=149, RteEventRef=AAACalRegn01Inin01_Dummy_InitEvent, RteMappedToTaskRef=Task_Init_Appl10
      AAACalRegn01Inin01GroupC_Dummy_EcuSwComposition: RteSoftwareComponentInstanceRef=AAACalRegn01Inin01GroupC_Dummy
        AAACalRegn01Inin01GroupC_Dummy_InitEvent (RteEventToTaskMapping): RteImmediateRestart=false, RtePositionInTask=135, RteEventRef=AAACalRegn01Inin01GroupC_Dummy_InitEvent, RteMappedToTaskRef=Task_Init_Appl10
      CalRegn01Inin00GroupC_EcuSwComposition: RteSoftwareComponentInstanceRef=CalRegn01Inin00GroupC
      AAACalRegn01Inin00GroupC_Dummy_EcuSwComposition: RteSoftwareComponentInstanceRef=AAACalRegn01Inin00GroupC_Dummy
        AAACalRegn01Inin01GroupC_Dummy_InitEvent (RteEventToTaskMapping): RteImmediateRestart=false, RtePositionInTask=131, RteEventRef=AAACalRegn01Inin01GroupC_Dummy_InitEvent, RteMappedToTaskRef=Task_Init_Appl10
      AAACalRegn01Inin06_Dummy_EcuSwComposition: RteSoftwareComponentInstanceRef=AAACalRegn01Inin06_Dummy
        AAACalRegn01Inin01_Dummy_InitEvent (RteEventToTaskMapping): RteImmediateRestart=false, RtePositionInTask=153, RteEventRef=AAACalRegn01Inin01_Dummy_InitEvent, RteMappedToTaskRef=Task_Init_Appl10
      AAACalRegn01Inin06GroupA_Dummy_EcuSwComposition: RteSoftwareComponentInstanceRef=AAACalRegn01Inin06GroupA_Dummy
        AAACalRegn01Inin01GroupA_Dummy_InitEvent (RteEventToTaskMapping): RteImmediateRestart=false, RtePositionInTask=154, RteEventRef=AAACalRegn01Inin01GroupA_Dummy_InitEvent, RteMappedToTaskRef=Task_Init_Appl10
      AAACalRegn01Inin04GroupD_Dummy_EcuSwComposition: RteSoftwareComponentInstanceRef=AAACalRegn01Inin04GroupD_Dummy
        AAACalRegn01Inin01GroupD_Dummy_InitEvent (RteEventToTaskMapping): RteImmediateRestart=false, RtePositionInTask=148, RteEventRef=AAACalRegn01Inin01GroupD_Dummy_InitEvent, RteMappedToTaskRef=Task_Init_Appl10
      CalRegn02Rt00GroupD_EcuSwComposition: RteSoftwareComponentInstanceRef=CalRegn02Rt00GroupD
      CalRegn01Inin02_EcuSwComposition: RteSoftwareComponentInstanceRef=CalRegn01Inin02
      CalRegn02Rt03GroupD_EcuSwComposition: RteSoftwareComponentInstanceRef=CalRegn02Rt03GroupD
      CalRegn01Inin05GroupA_EcuSwComposition: RteSoftwareComponentInstanceRef=CalRegn01Inin05GroupA
      AAACalRegn01Inin04GroupA_Dummy_EcuSwComposition: RteSoftwareComponentInstanceRef=AAACalRegn01Inin04GroupA_Dummy
        AAACalRegn01Inin01GroupA_Dummy_InitEvent (RteEventToTaskMapping): RteImmediateRestart=false, RtePositionInTask=146, RteEventRef=AAACalRegn01Inin01GroupA_Dummy_InitEvent, RteMappedToTaskRef=Task_Init_Appl10
      CalRegn01Inin03_EcuSwComposition: RteSoftwareComponentInstanceRef=CalRegn01Inin03
      AAACalRegn01Inin03_Dummy_EcuSwComposition: RteSoftwareComponentInstanceRef=AAACalRegn01Inin03_Dummy
        AAACalRegn01Inin01_Dummy_InitEvent (RteEventToTaskMapping): RteImmediateRestart=false, RtePositionInTask=141, RteEventRef=AAACalRegn01Inin01_Dummy_InitEvent, RteMappedToTaskRef=Task_Init_Appl10
      CalRegn01Inin02GroupD_EcuSwComposition: RteSoftwareComponentInstanceRef=CalRegn01Inin02GroupD
      AAACalRegn02Rt00GroupD_Dummy_EcuSwComposition: RteSoftwareComponentInstanceRef=AAACalRegn02Rt00GroupD_Dummy
        AAACalRegn02Rt01GroupD_Dummy_InitEvent (RteEventToTaskMapping): RteImmediateRestart=false, RtePositionInTask=157, RteEventRef=AAACalRegn02Rt01GroupD_Dummy_InitEvent, RteMappedToTaskRef=Task_Init_Appl10
      AAACalRegn01Inin01_Dummy_EcuSwComposition: RteSoftwareComponentInstanceRef=AAACalRegn01Inin01_Dummy
        AAACalRegn01Inin01_Dummy_InitEvent (RteEventToTaskMapping): RteImmediateRestart=false, RtePositionInTask=133, RteEventRef=AAACalRegn01Inin01_Dummy_InitEvent, RteMappedToTaskRef=Task_Init_Appl10
      AAACalRegn01Inin06GroupC_Dummy_EcuSwComposition: RteSoftwareComponentInstanceRef=AAACalRegn01Inin06GroupC_Dummy
        AAACalRegn01Inin01GroupC_Dummy_InitEvent (RteEventToTaskMapping): RteImmediateRestart=false, RtePositionInTask=155, RteEventRef=AAACalRegn01Inin01GroupC_Dummy_InitEvent, RteMappedToTaskRef=Task_Init_Appl10
      CalRegn01Inin03GroupC_EcuSwComposition: RteSoftwareComponentInstanceRef=CalRegn01Inin03GroupC
      CalRegn01Inin00_EcuSwComposition: RteSoftwareComponentInstanceRef=CalRegn01Inin00
      AAACalRegn02Rt02GroupD_Dummy_EcuSwComposition: RteSoftwareComponentInstanceRef=AAACalRegn02Rt02GroupD_Dummy
        AAACalRegn02Rt01GroupD_Dummy_InitEvent (RteEventToTaskMapping): RteImmediateRestart=false, RtePositionInTask=159, RteEventRef=AAACalRegn02Rt01GroupD_Dummy_InitEvent, RteMappedToTaskRef=Task_Init_Appl10
      AAACalRegn01Inin05GroupC_Dummy_EcuSwComposition: RteSoftwareComponentInstanceRef=AAACalRegn01Inin05GroupC_Dummy
        AAACalRegn01Inin01GroupC_Dummy_InitEvent (RteEventToTaskMapping): RteImmediateRestart=false, RtePositionInTask=151, RteEventRef=AAACalRegn01Inin01GroupC_Dummy_InitEvent, RteMappedToTaskRef=Task_Init_Appl10
      AAACalRegn01Inin05GroupA_Dummy_EcuSwComposition: RteSoftwareComponentInstanceRef=AAACalRegn01Inin05GroupA_Dummy
        AAACalRegn01Inin01GroupA_Dummy_InitEvent (RteEventToTaskMapping): RteImmediateRestart=false, RtePositionInTask=150, RteEventRef=AAACalRegn01Inin01GroupA_Dummy_InitEvent, RteMappedToTaskRef=Task_Init_Appl10
      AAACalRegn02Rt01GroupD_Dummy_EcuSwComposition: RteSoftwareComponentInstanceRef=AAACalRegn02Rt01GroupD_Dummy
        AAACalRegn02Rt01GroupD_Dummy_InitEvent (RteEventToTaskMapping): RteImmediateRestart=false, RtePositionInTask=158, RteEventRef=AAACalRegn02Rt01GroupD_Dummy_InitEvent, RteMappedToTaskRef=Task_Init_Appl10
      CalRegn01Inin05GroupD_EcuSwComposition: RteSoftwareComponentInstanceRef=CalRegn01Inin05GroupD
      CalRegn01Inin01GroupC_EcuSwComposition: RteSoftwareComponentInstanceRef=CalRegn01Inin01GroupC
      CalRegn01Inin03GroupD_EcuSwComposition: RteSoftwareComponentInstanceRef=CalRegn01Inin03GroupD
      CalRegn01Inin02GroupC_EcuSwComposition: RteSoftwareComponentInstanceRef=CalRegn01Inin02GroupC
      CalRegn01Inin04_EcuSwComposition: RteSoftwareComponentInstanceRef=CalRegn01Inin04
      CalRegn01Inin05GroupC_EcuSwComposition: RteSoftwareComponentInstanceRef=CalRegn01Inin05GroupC
      CalRegn02Rt02GroupD_EcuSwComposition: RteSoftwareComponentInstanceRef=CalRegn02Rt02GroupD
      AAACalRegn01Inin03GroupA_Dummy_EcuSwComposition: RteSoftwareComponentInstanceRef=AAACalRegn01Inin03GroupA_Dummy
        AAACalRegn01Inin01GroupA_Dummy_InitEvent (RteEventToTaskMapping): RteImmediateRestart=false, RtePositionInTask=142, RteEventRef=AAACalRegn01Inin01GroupA_Dummy_InitEvent, RteMappedToTaskRef=Task_Init_Appl10
      CalRegn01Inin00GroupD_EcuSwComposition: RteSoftwareComponentInstanceRef=CalRegn01Inin00GroupD
      AAACalRegn01Inin05GroupD_Dummy_EcuSwComposition: RteSoftwareComponentInstanceRef=AAACalRegn01Inin05GroupD_Dummy
        AAACalRegn01Inin01GroupD_Dummy_InitEvent (RteEventToTaskMapping): RteImmediateRestart=false, RtePositionInTask=152, RteEventRef=AAACalRegn01Inin01GroupD_Dummy_InitEvent, RteMappedToTaskRef=Task_Init_Appl10
      AAACalRegn01Inin04GroupC_Dummy_EcuSwComposition: RteSoftwareComponentInstanceRef=AAACalRegn01Inin04GroupC_Dummy
        AAACalRegn01Inin01GroupC_Dummy_InitEvent (RteEventToTaskMapping): RteImmediateRestart=false, RtePositionInTask=147, RteEventRef=AAACalRegn01Inin01GroupC_Dummy_InitEvent, RteMappedToTaskRef=Task_Init_Appl10
      AAACalRegn01Inin03GroupD_Dummy_EcuSwComposition: RteSoftwareComponentInstanceRef=AAACalRegn01Inin03GroupD_Dummy
        AAACalRegn01Inin01GroupD_Dummy_InitEvent (RteEventToTaskMapping): RteImmediateRestart=false, RtePositionInTask=144, RteEventRef=AAACalRegn01Inin01GroupD_Dummy_InitEvent, RteMappedToTaskRef=Task_Init_Appl10
      AAACalRegn01Inin02GroupC_Dummy_EcuSwComposition: RteSoftwareComponentInstanceRef=AAACalRegn01Inin02GroupC_Dummy
        AAACalRegn01Inin01GroupC_Dummy_InitEvent (RteEventToTaskMapping): RteImmediateRestart=false, RtePositionInTask=139, RteEventRef=AAACalRegn01Inin01GroupC_Dummy_InitEvent, RteMappedToTaskRef=Task_Init_Appl10
      AAACalRegn01Inin00_Dummy_EcuSwComposition: RteSoftwareComponentInstanceRef=AAACalRegn01Inin00_Dummy
        AAACalRegn01Inin01_Dummy_InitEvent (RteEventToTaskMapping): RteImmediateRestart=false, RtePositionInTask=129, RteEventRef=AAACalRegn01Inin01_Dummy_InitEvent, RteMappedToTaskRef=Task_Init_Appl10
      CalRegn01Inin01GroupA_EcuSwComposition: RteSoftwareComponentInstanceRef=CalRegn01Inin01GroupA
      AAACalRegn02Rt03GroupD_Dummy_EcuSwComposition: RteSoftwareComponentInstanceRef=AAACalRegn02Rt03GroupD_Dummy
        AAACalRegn02Rt01GroupD_Dummy_InitEvent (RteEventToTaskMapping): RteImmediateRestart=false, RtePositionInTask=160, RteEventRef=AAACalRegn02Rt01GroupD_Dummy_InitEvent, RteMappedToTaskRef=Task_Init_Appl10
      CalRegn01Inin06GroupA_EcuSwComposition: RteSoftwareComponentInstanceRef=CalRegn01Inin06GroupA
      CalRegn01Inin02GroupA_EcuSwComposition: RteSoftwareComponentInstanceRef=CalRegn01Inin02GroupA
      CalRegn01Inin06_EcuSwComposition: RteSoftwareComponentInstanceRef=CalRegn01Inin06
      CalRegn01Inin06GroupD_EcuSwComposition: RteSoftwareComponentInstanceRef=CalRegn01Inin06GroupD
      BmwSwFctDi_EcuSwComposition: RteSoftwareComponentInstanceRef=BmwSwFctDi
        BmwSwFctDi_InitEvent (RteEventToTaskMapping): RteImmediateRestart=false, RtePositionInTask=107, RteEventRef=BmwSwFctDi_InitEvent, RteMappedToTaskRef=Task_Init_Appl10
        TMT_BmwSwFctDiPer1 (RteEventToTaskMapping):
          RteImmediateRestart = false
          RtePositionInTask = 10
          RteEventRef = TMT_BmwSwFctDiPer1
          RteMappedToTaskRef = Task_10ms_Appl10
          RteUsedOsEventRef = Rte_Ev_Cyclic_Task_10ms_Appl10_0_10ms
          RteUsedOsAlarmRef = Rte_Al_TE_Task_10ms_Appl10_0_10ms
      AAACalRegn01Inin01GroupA_Dummy_EcuSwComposition: RteSoftwareComponentInstanceRef=AAACalRegn01Inin01GroupA_Dummy
        AAACalRegn01Inin01GroupA_Dummy_InitEvent (RteEventToTaskMapping): RteImmediateRestart=false, RtePositionInTask=134, RteEventRef=AAACalRegn01Inin01GroupA_Dummy_InitEvent, RteMappedToTaskRef=Task_Init_Appl10
      AAACalRegn01Inin00GroupA_Dummy_EcuSwComposition: RteSoftwareComponentInstanceRef=AAACalRegn01Inin00GroupA_Dummy
        AAACalRegn01Inin01GroupA_Dummy_InitEvent (RteEventToTaskMapping): RteImmediateRestart=false, RtePositionInTask=130, RteEventRef=AAACalRegn01Inin01GroupA_Dummy_InitEvent, RteMappedToTaskRef=Task_Init_Appl10
    38 x RteSwComponentType:
      CalRegn02Rt03GroupD: RteComponentTypeRef=CalRegn02Rt03GroupD
        ComponentTypeCalibration (RteComponentTypeCalibration): RteCalibrationSupportEnabled=true
      CalRegn01Inin05GroupA: RteComponentTypeRef=CalRegn01Inin05GroupA
        ComponentTypeCalibration (RteComponentTypeCalibration): RteCalibrationSupportEnabled=true
      CalRegn01Inin02GroupA: RteComponentTypeRef=CalRegn01Inin02GroupA
        ComponentTypeCalibration (RteComponentTypeCalibration): RteCalibrationSupportEnabled=true
      AAACalRegn01Inin01GroupC_Dummy: RteComponentTypeRef=AAACalRegn01Inin01GroupC_Dummy, RteImplementationRef=AAACalRegn01Inin00GroupC_Dummy_Implementation
        ComponentTypeCalibration (RteComponentTypeCalibration): RteCalibrationSupportEnabled=true
      CalRegn01Inin01GroupC: RteComponentTypeRef=CalRegn01Inin01GroupC
        ComponentTypeCalibration (RteComponentTypeCalibration): RteCalibrationSupportEnabled=true
      AAACalRegn01Inin01GroupD_Dummy: RteComponentTypeRef=AAACalRegn01Inin01GroupD_Dummy, RteImplementationRef=AAACalRegn01Inin00GroupD_Dummy_Implementation
        ComponentTypeCalibration (RteComponentTypeCalibration): RteCalibrationSupportEnabled=true
      CalRegn01Inin03GroupA: RteComponentTypeRef=CalRegn01Inin03GroupA
        ComponentTypeCalibration (RteComponentTypeCalibration): RteCalibrationSupportEnabled=true
      AAACalRegn02Rt01GroupD_Dummy: RteComponentTypeRef=AAACalRegn02Rt01GroupD_Dummy, RteImplementationRef=AAACalRegn02Rt00GroupD_Dummy_Implementation
        ComponentTypeCalibration (RteComponentTypeCalibration): RteCalibrationSupportEnabled=true
      CalRegn01Inin02GroupC: RteComponentTypeRef=CalRegn01Inin02GroupC
        ComponentTypeCalibration (RteComponentTypeCalibration): RteCalibrationSupportEnabled=true
      BmwSwFctDi: RteComponentTypeRef=BmwSwFctDi, RteImplementationRef=BmwSwFctDi_Implementation
        ComponentTypeCalibration (RteComponentTypeCalibration): RteCalibrationSupportEnabled=true
      CalRegn01Inin04: RteComponentTypeRef=CalRegn01Inin04
        ComponentTypeCalibration (RteComponentTypeCalibration): RteCalibrationSupportEnabled=true
      CalRegn01Inin06GroupC: RteComponentTypeRef=CalRegn01Inin06GroupC
        ComponentTypeCalibration (RteComponentTypeCalibration): RteCalibrationSupportEnabled=true
      CalRegn01Inin03GroupC: RteComponentTypeRef=CalRegn01Inin03GroupC
        ComponentTypeCalibration (RteComponentTypeCalibration): RteCalibrationSupportEnabled=true
      AAACalRegn01Inin01GroupA_Dummy: RteComponentTypeRef=AAACalRegn01Inin01GroupA_Dummy, RteImplementationRef=AAACalRegn01Inin00GroupA_Dummy_Implementation
        ComponentTypeCalibration (RteComponentTypeCalibration): RteCalibrationSupportEnabled=true
      CalRegn01Inin05GroupC: RteComponentTypeRef=CalRegn01Inin05GroupC
        ComponentTypeCalibration (RteComponentTypeCalibration): RteCalibrationSupportEnabled=true
      CalRegn01Inin02: RteComponentTypeRef=CalRegn01Inin02
        ComponentTypeCalibration (RteComponentTypeCalibration): RteCalibrationSupportEnabled=true
      CalRegn01Inin00GroupA: RteComponentTypeRef=CalRegn01Inin00GroupA
        ComponentTypeCalibration (RteComponentTypeCalibration): RteCalibrationSupportEnabled=true
      CalRegn01Inin05: RteComponentTypeRef=CalRegn01Inin05
        ComponentTypeCalibration (RteComponentTypeCalibration): RteCalibrationSupportEnabled=true
      CalRegn01Inin04GroupA: RteComponentTypeRef=CalRegn01Inin04GroupA
        ComponentTypeCalibration (RteComponentTypeCalibration): RteCalibrationSupportEnabled=true
      CalRegn01Inin06GroupA: RteComponentTypeRef=CalRegn01Inin06GroupA
        ComponentTypeCalibration (RteComponentTypeCalibration): RteCalibrationSupportEnabled=true
      CalRegn01Inin04GroupC: RteComponentTypeRef=CalRegn01Inin04GroupC
        ComponentTypeCalibration (RteComponentTypeCalibration): RteCalibrationSupportEnabled=true
      CalRegn01Inin06GroupD: RteComponentTypeRef=CalRegn01Inin06GroupD
        ComponentTypeCalibration (RteComponentTypeCalibration): RteCalibrationSupportEnabled=true
      CalRegn01Inin01: RteComponentTypeRef=CalRegn01Inin01
        ComponentTypeCalibration (RteComponentTypeCalibration): RteCalibrationSupportEnabled=true
      CalRegn01Inin03GroupD: RteComponentTypeRef=CalRegn01Inin03GroupD
        ComponentTypeCalibration (RteComponentTypeCalibration): RteCalibrationSupportEnabled=true
      CalRegn01Inin03: RteComponentTypeRef=CalRegn01Inin03
        ComponentTypeCalibration (RteComponentTypeCalibration): RteCalibrationSupportEnabled=true
      CalRegn01Inin01GroupA: RteComponentTypeRef=CalRegn01Inin01GroupA
        ComponentTypeCalibration (RteComponentTypeCalibration): RteCalibrationSupportEnabled=true
      CalRegn01Inin00GroupC: RteComponentTypeRef=CalRegn01Inin00GroupC
        ComponentTypeCalibration (RteComponentTypeCalibration): RteCalibrationSupportEnabled=true
      CalRegn01Inin00: RteComponentTypeRef=CalRegn01Inin00
        ComponentTypeCalibration (RteComponentTypeCalibration): RteCalibrationSupportEnabled=true
      CalRegn02Rt00GroupD: RteComponentTypeRef=CalRegn02Rt00GroupD
        ComponentTypeCalibration (RteComponentTypeCalibration): RteCalibrationSupportEnabled=true
      CalRegn02Rt02GroupD: RteComponentTypeRef=CalRegn02Rt02GroupD
        ComponentTypeCalibration (RteComponentTypeCalibration): RteCalibrationSupportEnabled=true
      AAACalRegn01Inin01_Dummy: RteComponentTypeRef=AAACalRegn01Inin01_Dummy, RteImplementationRef=AAACalRegn01Inin00_Dummy_Implementation
        ComponentTypeCalibration (RteComponentTypeCalibration): RteCalibrationSupportEnabled=true
      CalRegn01Inin04GroupD: RteComponentTypeRef=CalRegn01Inin04GroupD
        ComponentTypeCalibration (RteComponentTypeCalibration): RteCalibrationSupportEnabled=true
      CalRegn01Inin01GroupD: RteComponentTypeRef=CalRegn01Inin01GroupD
        ComponentTypeCalibration (RteComponentTypeCalibration): RteCalibrationSupportEnabled=true
      CalRegn01Inin02GroupD: RteComponentTypeRef=CalRegn01Inin02GroupD
        ComponentTypeCalibration (RteComponentTypeCalibration): RteCalibrationSupportEnabled=true
      CalRegn01Inin05GroupD: RteComponentTypeRef=CalRegn01Inin05GroupD
        ComponentTypeCalibration (RteComponentTypeCalibration): RteCalibrationSupportEnabled=true
      CalRegn02Rt01GroupD: RteComponentTypeRef=CalRegn02Rt01GroupD
        ComponentTypeCalibration (RteComponentTypeCalibration): RteCalibrationSupportEnabled=true
      CalRegn01Inin06: RteComponentTypeRef=CalRegn01Inin06
        ComponentTypeCalibration (RteComponentTypeCalibration): RteCalibrationSupportEnabled=true
      CalRegn01Inin00GroupD: RteComponentTypeRef=CalRegn01Inin00GroupD
        ComponentTypeCalibration (RteComponentTypeCalibration): RteCalibrationSupportEnabled=true
