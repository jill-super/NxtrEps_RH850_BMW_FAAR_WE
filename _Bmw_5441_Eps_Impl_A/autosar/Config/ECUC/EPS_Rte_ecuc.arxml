[part 1 of 4: package /ActiveEcuC]
AUTOSAR XML (schema 4-3-0)
package /ActiveEcuC
  module config Rte: implementation-config-variant=VARIANT-PRE-COMPILE, module-description=Rte_Impl
    RteOsInteraction
      21 x RteUsedOsActivation, all with RteExpectedActivationOffset=0, RteExpectedTickDuration=0:
        Rte_Al_TE2_Task_10msBsw_Appl10_0_10ms: RteActivationOsAlarmRef=Rte_Al_TE2_Task_10msBsw_Appl10_0_10ms, RteActivationOsTaskRef=Task_10msBsw_Appl10
        Rte_Al_TE2_Task_4msBsw_Appl10_0_4ms: RteActivationOsAlarmRef=Rte_Al_TE2_Task_4msBsw_Appl10_0_4ms, RteActivationOsTaskRef=Task_4msBsw_Appl10
        Rte_Al_TE_Task_100ms_Appl10_0_100ms: RteActivationOsAlarmRef=Rte_Al_TE_Task_100ms_Appl10_0_100ms, RteActivationOsTaskRef=Task_100ms_Appl10
        Rte_Al_TE_Task_10ms_Appl10_0_10ms: RteActivationOsAlarmRef=Rte_Al_TE_Task_10ms_Appl10_0_10ms, RteActivationOsTaskRef=Task_10ms_Appl10
        Rte_Al_TE_Task_4ms_Appl10_0_4ms: RteActivationOsAlarmRef=Rte_Al_TE_Task_4ms_Appl10_0_4ms, RteActivationOsTaskRef=Task_4ms_Appl10
        Rte_Al_TE_Darh_QueueHandler: RteActivationOsAlarmRef=Rte_Al_TE_Darh_QueueHandler, RteActivationOsTaskRef=Task_100ms_Appl10
        Rte_Al_TE2_Task_5msBsw_Appl10_0_5ms: RteActivationOsAlarmRef=Rte_Al_TE2_Task_5msBsw_Appl10_0_5ms, RteActivationOsTaskRef=Task_5msBsw_Appl10
        Rte_Al_TE_Task_2msTmplMonr_Appl10_0_2ms: RteActivationOsAlarmRef=Rte_Al_TE_Task_2msTmplMonr_Appl10_0_2ms, RteActivationOsTaskRef=Task_2msTmplMonr_Appl10
        Rte_Al_TE_Task_100ms_Appl7_0_100ms: RteActivationOsAlarmRef=Rte_Al_TE_Task_100ms_Appl7_0_100ms, RteActivationOsTaskRef=Task_100ms_Appl7
        Rte_Al_TE_Task_100ms_Appl9_0_100ms: RteActivationOsAlarmRef=Rte_Al_TE_Task_100ms_Appl9_0_100ms, RteActivationOsTaskRef=Task_100ms_Appl9
        Rte_Al_TE_Task_10ms_Appl{7..9}_0_10ms: RteActivationOsAlarmRef=Rte_Al_TE_Task_10ms_Appl{7..9}_0_10ms, RteActivationOsTaskRef=Task_10ms_Appl{7..9}
        Rte_Al_TE_Task_2ms_Appl{7..9}_0_2ms: RteActivationOsAlarmRef=Rte_Al_TE_Task_2ms_Appl{7..9}_0_2ms, RteActivationOsTaskRef=Task_2ms_Appl{7..9}
        Rte_Al_TE_Task_4ms_Appl7_0_4ms: RteActivationOsAlarmRef=Rte_Al_TE_Task_4ms_Appl7_0_4ms, RteActivationOsTaskRef=Task_4ms_Appl7
        Rte_Al_TE_Task_2msA_Appl10_0_2ms: RteActivationOsAlarmRef=Rte_Al_TE_Task_2msA_Appl10_0_2ms, RteActivationOsTaskRef=Task_2msA_Appl10
        Rte_Al_TE_Task_2msB_Appl10_0_2ms: RteActivationOsAlarmRef=Rte_Al_TE_Task_2msB_Appl10_0_2ms, RteActivationOsTaskRef=Task_2msB_Appl10
        Rte_Al_TE2_Task_ComBsw_Appl10_0_5ms: RteActivationOsAlarmRef=Rte_Al_TE2_Task_ComBsw_Appl10_0_5ms, RteActivationOsTaskRef=Task_ComBsw_Appl10
        Rte_Al_TE_Task_ComBsw_Appl10_0_10ms: RteActivationOsAlarmRef=Rte_Al_TE_Task_ComBsw_Appl10_0_10ms, RteActivationOsTaskRef=Task_ComBsw_Appl10
    RteGeneration:
      RteGenerationMode = COMPATIBILITY_MODE
      RteIocInteractionReturnValue = RTE_IOC
      RteValueRangeCheckEnabled = false
      RteCalibrationSupport = DOUBLE_POINTERED
      RteCodeVendorId = 30
      RteDevErrorDetect = true
      RteDevErrorDetectUninit = false
      RteMeasurementSupport = true
      RteOptimizationMode = MEMORY
      RteVfbTraceEnabled = false
      RteA2LVersion = V160
    RteInitializationBehavior: RteInitializationStrategy=RTE_INITIALIZATION_STRATEGY_AT_DATA_DECLARATION, RteSectionInitializationPolicy=INIT
    RteBswGeneral: RteSchMVersionInfoApi=false, RteUseComShadowSignalApi=false
    5 x RteBswModuleInstance:
      BswM: RteBswImplementationRef=BswM_Impl, RteBswModuleConfigurationRef=BswM
        BSWM_EXCLUSIVE_AREA_0 (RteBswExclusiveAreaImpl): RteExclusiveAreaImplMechanism=OS_INTERRUPT_BLOCKING, RteExclusiveAreaOptimization=false, RteBswExclusiveAreaRef=BSWM_EXCLUSIVE_AREA_0
        BswM_MainFunctionTimingEvent0 (RteBswEventToTaskMapping):
          RteBswImmediateRestart = false
          RteBswPositionInTask = 4
          RteBswEventRef = BswM_MainFunctionTimingEvent0
          RteBswMappedToTaskRef = Task_10msBsw_Appl10
          RteBswUsedOsAlarmRef = Rte_Al_TE2_Task_10msBsw_Appl10_0_10ms
      Det: RteBswImplementationRef=Det_Impl, RteBswModuleConfigurationRef=Det
        DET_EXCLUSIVE_AREA_0 (RteBswExclusiveAreaImpl): RteExclusiveAreaImplMechanism=OS_INTERRUPT_BLOCKING, RteExclusiveAreaOptimization=false, RteBswExclusiveAreaRef=DET_EXCLUSIVE_AREA_0
      EcuM: RteBswImplementationRef=EcuM_Impl, RteBswModuleConfigurationRef=EcuM
        EcuM_MainFunctionTimingEvent0 (RteBswEventToTaskMapping):
          RteBswImmediateRestart = false
          RteBswPositionInTask = 3
          RteBswEventRef = EcuM_MainFunctionTimingEvent0
          RteBswMappedToTaskRef = Task_10msBsw_Appl10
          RteBswUsedOsAlarmRef = Rte_Al_TE2_Task_10msBsw_Appl10_0_10ms
        3 x RteBswExclusiveAreaImpl, all with RteExclusiveAreaImplMechanism=OS_INTERRUPT_BLOCKING, RteExclusiveAreaOptimization=false:
          ECUM_EXCLUSIVE_AREA_{0..2}: RteBswExclusiveAreaRef=ECUM_EXCLUSIVE_AREA_{0..2}
      Mcu: RteBswImplementationRef=Mcu_Impl, RteBswModuleConfigurationRef=Mcu
        MCU_REGISTER_PROTECTION (RteBswExclusiveAreaImpl): RteExclusiveAreaImplMechanism=OS_INTERRUPT_BLOCKING, RteExclusiveAreaOptimization=false, RteBswExclusiveAreaRef=MCU_REGISTER_PROTECTION
        MCU_VARIABLE_PROTECTION (RteBswExclusiveAreaImpl): RteExclusiveAreaImplMechanism=ALL_INTERRUPT_BLOCKING, RteExclusiveAreaOptimization=false, RteBswExclusiveAreaRef=MCU_VARIABLE_PROTECTION
      Rte: RteBswImplementationRef=Rte_Impl, RteBswModuleConfigurationRef=Rte
        Rte_ComSendSignalProxyPeriodicTimingEvent0 (RteBswEventToTaskMapping):
          RteBswImmediateRestart = false
          RteBswPositionInTask = 7
          RteBswEventRef = Rte_ComSendSignalProxyPeriodicTimingEvent0
          RteBswMappedToTaskRef = Task_ComBsw_Appl10
    4 x RteSwComponentInstance:
      BswM_EcuSwComposition: RteSoftwareComponentInstanceRef=BswM
        Timer_BswM_MainFunction (RteEventToTaskMapping):
          RteImmediateRestart = false
          RtePositionInTask = 4
          RteEventRef = Timer_BswM_MainFunction
          RteMappedToTaskRef = Task_10msBsw_Appl10
          RteUsedOsAlarmRef = Rte_Al_TE2_Task_10msBsw_Appl10_0_10ms
        DataReceivedEvent_BswM_Read_StdDiag_ComControlModeRequest_Request_StdDiag_ComControlModeRequest_requestedMode (RteEventToTaskMapping):
          RteImmediateRestart = false
          RtePositionInTask = 29
          RteEventRef = DataReceivedEvent_BswM_Read_StdDiag_ComControlModeRequest_Request_StdDiag_ComControlModeRequest_requestedMode
          RteMappedToTaskRef = Task_10ms_Appl10
          RteUsedOsEventRef = Rte_Ev_Run_BswM_BswM_Read_StdDiag_ComControlModeRequest
      Det_EcuSwComposition: RteSoftwareComponentInstanceRef=Det
        OpEventReportError_ReportError_DetModule_DetModuleInstance (RteEventToTaskMapping):
          RteImmediateRestart = false
          RtePositionInTask = 9
          RteEventRef = OpEventReportError_ReportError_DetModule_DetModuleInstance
          RteMappedToTaskRef = Task_10msBsw_Appl10
        OpEventReportRuntimeError_ReportRuntimeError_DetModule_DetModuleInstance (RteEventToTaskMapping):
          RteImmediateRestart = false
          RtePositionInTask = 10
          RteEventRef = OpEventReportRuntimeError_ReportRuntimeError_DetModule_DetModuleInstance
          RteMappedToTaskRef = Task_10msBsw_Appl10
      EcuM_EcuSwComposition: RteSoftwareComponentInstanceRef=EcuM
        8 x RteEventToTaskMapping, all with RteImmediateRestart=false:
          Timer_EcuM_MainFunction: RtePositionInTask=3, RteEventRef=Timer_EcuM_MainFunction, RteMappedToTaskRef=Task_10msBsw_Appl10, RteUsedOsAlarmRef=Rte_Al_TE2_Task_10msBsw_Appl10_0_10ms
          OpEventSelectShutdownTarget_SelectShutdownTarget_EcuM_ShutdownTarget: RteEventRef=OpEventSelectShutdownTarget_SelectShutdownTarget_EcuM_ShutdownTarget
          OpEventGetShutdownTarget_GetShutdownTarget_EcuM_ShutdownTarget: RteEventRef=OpEventGetShutdownTarget_GetShutdownTarget_EcuM_ShutdownTarget
          OpEventGetLastShutdownTarget_GetLastShutdownTarget_EcuM_ShutdownTarget: RteEventRef=OpEventGetLastShutdownTarget_GetLastShutdownTarget_EcuM_ShutdownTarget
          OpEventSelectShutdownCause_SelectShutdownCause_EcuM_ShutdownTarget: RteEventRef=OpEventSelectShutdownCause_SelectShutdownCause_EcuM_ShutdownTarget
          OpEventGetShutdownCause_GetShutdownCause_EcuM_ShutdownTarget: RteEventRef=OpEventGetShutdownCause_GetShutdownCause_EcuM_ShutdownTarget
          OpEventSelectBootTarget_SelectBootTarget_EcuM_BootTarget: RteEventRef=OpEventSelectBootTarget_SelectBootTarget_EcuM_BootTarget
          OpEventGetBootTarget_GetBootTarget_EcuM_BootTarget: RteEventRef=OpEventGetBootTarget_GetBootTarget_EcuM_BootTarget
      Os_OsCore_CORE0_swc_EcuSwComposition: RteSoftwareComponentInstanceRef=Os_OsCore_CORE0_swc
        4 x RteEventToTaskMapping, all with RteImmediateRestart=false:
          OpEventGetCounterValue_GetCounterValue_OsService_OsCounter: RtePositionInTask=83, RteEventRef=OpEventGetCounterValue_GetCounterValue_OsService_OsCounter, RteMappedToTaskRef=Task_Init_Appl10
          OpEventGetElapsedValue_GetElapsedValue_OsService_OsCounter: RteEventRef=OpEventGetElapsedValue_GetElapsedValue_OsService_OsCounter
          OpEventGetCounterValue_GetCounterValue_OsService_FrCycleCounter: RteEventRef=OpEventGetCounterValue_GetCounterValue_OsService_FrCycleCounter
          OpEventGetElapsedValue_GetElapsedValue_OsService_FrCycleCounter: RteEventRef=OpEventGetElapsedValue_GetElapsedValue_OsService_FrCycleCounter
    7 x RteBswModuleInstance:
      Dio: RteBswImplementationRef=Dio_Impl, RteBswModuleConfigurationRef=Dio
        DIO_REGISTER_PROTECTION (RteBswExclusiveAreaImpl): RteExclusiveAreaImplMechanism=OS_INTERRUPT_BLOCKING, RteExclusiveAreaOptimization=false, RteBswExclusiveAreaRef=DIO_REGISTER_PROTECTION
      Fls: RteBswImplementationRef=Fls_Impl, RteBswModuleConfigurationRef=Fls
        3 x RteBswExclusiveAreaImpl, all with RteExclusiveAreaOptimization=false:
          FLS_DRIVERSTATE_DATA_PROTECTION: RteExclusiveAreaImplMechanism=OS_INTERRUPT_BLOCKING, RteBswExclusiveAreaRef=FLS_DRIVERSTATE_DATA_PROTECTION
          FLS_REGISTER_PROTECTION: RteExclusiveAreaImplMechanism=OS_INTERRUPT_BLOCKING, RteBswExclusiveAreaRef=FLS_REGISTER_PROTECTION
          FLS_CODE_FLASH_DISABLED: RteExclusiveAreaImplMechanism=ALL_INTERRUPT_BLOCKING, RteBswExclusiveAreaRef=FLS_CODE_FLASH_DISABLED
        Fls_MainFunctionTimingEvent0 (RteBswEventToTaskMapping):
          RteBswImmediateRestart = false
          RteBswPositionInTask = 8
          RteBswEventRef = Fls_MainFunctionTimingEvent0
          RteBswMappedToTaskRef = Task_10msBsw_Appl10
          RteBswUsedOsAlarmRef = Rte_Al_TE2_Task_10msBsw_Appl10_0_10ms
      Spi: RteBswImplementationRef=Spi_Impl, RteBswModuleConfigurationRef=Spi
        Spi_MainFunction_HandlingTimingEvent0 (RteBswEventToTaskMapping): RteBswImmediateRestart=false, RteBswEventRef=Spi_MainFunction_HandlingTimingEvent0
        SPI_RAM_DATA_PROTECTION (RteBswExclusiveAreaImpl): RteExclusiveAreaImplMechanism=OS_INTERRUPT_BLOCKING, RteExclusiveAreaOptimization=false, RteBswExclusiveAreaRef=SPI_RAM_DATA_PROTECTION
        SPI_CHIP_SELECT_PROTECTION (RteBswExclusiveAreaImpl): RteExclusiveAreaImplMechanism=OS_INTERRUPT_BLOCKING, RteExclusiveAreaOptimization=false, RteBswExclusiveAreaRef=SPI_CHIP_SELECT_PROTECTION
      Wdg: RteBswImplementationRef=Wdg_Impl, RteBswModuleConfigurationRef=Wdg
        MODE_SWITCH_PROTECTION (RteBswExclusiveAreaImpl): RteExclusiveAreaImplMechanism=OS_INTERRUPT_BLOCKING, RteExclusiveAreaOptimization=false, RteBswExclusiveAreaRef=MODE_SWITCH_PROTECTION
        TRIGG_PROTECTION (RteBswExclusiveAreaImpl): RteExclusiveAreaImplMechanism=ALL_INTERRUPT_BLOCKING, RteExclusiveAreaOptimization=false, RteBswExclusiveAreaRef=TRIGG_PROTECTION
      Fee: RteBswImplementationRef=Fee_Impl, RteBswModuleConfigurationRef=Fee
        Fee_30_SmallSector_MainFunctionTimingEvent0 (RteBswEventToTaskMapping):
          RteBswImmediateRestart = false
          RteBswPositionInTask = 7
          RteBswEventRef = Fee_30_SmallSector_MainFunctionTimingEvent0
          RteBswMappedToTaskRef = Task_10msBsw_Appl10
          RteBswUsedOsAlarmRef = Rte_Al_TE2_Task_10msBsw_Appl10_0_10ms
      NvM: RteBswImplementationRef=NvM_Impl, RteBswModuleConfigurationRef=NvM
        NvM_MainFunctionTimingEvent0 (RteBswEventToTaskMapping):
          RteBswImmediateRestart = false
          RteBswPositionInTask = 6
          RteBswEventRef = NvM_MainFunctionTimingEvent0
          RteBswMappedToTaskRef = Task_10msBsw_Appl10
          RteBswUsedOsAlarmRef = Rte_Al_TE2_Task_10msBsw_Appl10_0_10ms
        NVM_EXCLUSIVE_AREA_0 (RteBswExclusiveAreaImpl): RteExclusiveAreaImplMechanism=OS_INTERRUPT_BLOCKING, RteExclusiveAreaOptimization=false, RteBswExclusiveAreaRef=NVM_EXCLUSIVE_AREA_0
      WdgM: RteBswImplementationRef=WdgM_Impl, RteBswModuleConfigurationRef=WdgM
        WDGM_EXCLUSIVE_AREA_0 (RteBswExclusiveAreaImpl): RteExclusiveAreaImplMechanism=OS_INTERRUPT_BLOCKING, RteExclusiveAreaOptimization=false, RteBswExclusiveAreaRef=WDGM_EXCLUSIVE_AREA_0
        WdgM_MainFunctionTimingEvent0 (RteBswEventToTaskMapping):
          RteBswImmediateRestart = false
          RteBswPositionInTask = 0
          RteBswEventRef = WdgM_MainFunctionTimingEvent0
          RteBswMappedToTaskRef = Task_4msBsw_Appl10
          RteBswUsedOsAlarmRef = Rte_Al_TE2_Task_4msBsw_Appl10_0_4ms
    11 x RteSwComponentInstance:
      NvM_EcuSwComposition: RteSoftwareComponentInstanceRef=NvM
        394 x RteEventToTaskMapping, all with RteImmediateRestart=false:
          Timer_NvM_MainFunction: RtePositionInTask=6, RteEventRef=Timer_NvM_MainFunction, RteMappedToTaskRef=Task_10msBsw_Appl10, RteUsedOsAlarmRef=Rte_Al_TE2_Task_10msBsw_Appl10_0_10ms
          OpEventSetBlockProtection_SetBlockProtection_PAdmin_Rte_NvmBlock_CmnMfgSrv_NxtrMfgEnaCntr: RteEventRef=OpEventSetBlockProtection_SetBlockProtection_PAdmin_Rte_NvmBlock_CmnMfgSrv_NxtrMfgEnaCntr
          OpEventReadBlock_ReadBlock_PS_Rte_NvmBlock_CmnMfgSrv_NxtrMfgEnaCntr: RteEventRef=OpEventReadBlock_ReadBlock_PS_Rte_NvmBlock_CmnMfgSrv_NxtrMfgEnaCntr
          OpEventWriteBlock_WriteBlock_PS_Rte_NvmBlock_CmnMfgSrv_DiRestore: RteEventRef=OpEventWriteBlock_WriteBlock_PS_Rte_NvmBlock_CmnMfgSrv_DiRestore
          OpEventInvalidateNvBlock_InvalidateNvBlock_PS_Rte_NvmBlock_CmnMfgSrv_DiRestore: RteEventRef=OpEventInvalidateNvBlock_InvalidateNvBlock_PS_Rte_NvmBlock_CmnMfgSrv_DiRestore
          OpEventSetRamBlockStatus_SetRamBlockStatus_PS_Rte_NvmBlock_CmnMfgSrv_SeedKey: RteEventRef=OpEventSetRamBlockStatus_SetRamBlockStatus_PS_Rte_NvmBlock_CmnMfgSrv_SeedKey
          OpEventReadBlock_ReadBlock_PS_Rte_NvmBlock_CmnMfgSrv_MfgTmpBuf0: RteEventRef=OpEventReadBlock_ReadBlock_PS_Rte_NvmBlock_CmnMfgSrv_MfgTmpBuf0
          OpEventWriteBlock_WriteBlock_PS_Rte_NvmBlock_CmnMfgSrv_MfgTmpBuf0: RteEventRef=OpEventWriteBlock_WriteBlock_PS_Rte_NvmBlock_CmnMfgSrv_MfgTmpBuf0
          OpEventSetBlockProtection_SetBlockProtection_PAdmin_Rte_NvmBlock_CmnMfgSrv_MfgTmpBuf3: RteEventRef=OpEventSetBlockProtection_SetBlockProtection_PAdmin_Rte_NvmBlock_CmnMfgSrv_MfgTmpBuf3
          OpEventEraseBlock_EraseBlock_PS_Rte_NvmBlock_CmnMfgSrv_SeedKey: RteEventRef=OpEventEraseBlock_EraseBlock_PS_Rte_NvmBlock_CmnMfgSrv_SeedKey
          OpEventReadBlock_ReadBlock_PS_Rte_NvmBlock_CmnMfgSrv_MfgTmpBuf3: RteEventRef=OpEventReadBlock_ReadBlock_PS_Rte_NvmBlock_CmnMfgSrv_MfgTmpBuf3
          OpEventGetErrorStatus_GetErrorStatus_PS_Rte_NvmBlock_CmnMfgSrv_MfgTmpBuf3: RteEventRef=OpEventGetErrorStatus_GetErrorStatus_PS_Rte_NvmBlock_CmnMfgSrv_MfgTmpBuf3
          OpEventSetRamBlockStatus_SetRamBlockStatus_PS_Rte_NvmBlock_CmnMfgSrv_MfgTmpBuf3: RteEventRef=OpEventSetRamBlockStatus_SetRamBlockStatus_PS_Rte_NvmBlock_CmnMfgSrv_MfgTmpBuf3
          OpEventInvalidateNvBlock_InvalidateNvBlock_PS_Rte_NvmBlock_CmnMfgSrv_CcaHwPartNr: RteEventRef=OpEventInvalidateNvBlock_InvalidateNvBlock_PS_Rte_NvmBlock_CmnMfgSrv_CcaHwPartNr
          OpEventWriteBlock_WriteBlock_PS_Rte_NvmBlock_CmnMfgSrv_CcaHwPartNr: RteEventRef=OpEventWriteBlock_WriteBlock_PS_Rte_NvmBlock_CmnMfgSrv_CcaHwPartNr
          OpEventEraseBlock_EraseBlock_PS_Rte_NvmBlock_CmnMfgSrv_NxtrMfgEnaCntr: RteEventRef=OpEventEraseBlock_EraseBlock_PS_Rte_NvmBlock_CmnMfgSrv_NxtrMfgEnaCntr
          OpEventInvalidateNvBlock_InvalidateNvBlock_PS_Rte_NvmBlock_CmnMfgSrv_MfgTmpBuf3: RteEventRef=OpEventInvalidateNvBlock_InvalidateNvBlock_PS_Rte_NvmBlock_CmnMfgSrv_MfgTmpBuf3
          OpEventSetRamBlockStatus_SetRamBlockStatus_PS_Rte_NvmBlock_CmnMfgSrv_MfgTmpBuf1: RteEventRef=OpEventSetRamBlockStatus_SetRamBlockStatus_PS_Rte_NvmBlock_CmnMfgSrv_MfgTmpBuf1
          OpEventGetErrorStatus_GetErrorStatus_PS_Rte_NvmBlock_CmnMfgSrv_MfgTmpBuf0: RteEventRef=OpEventGetErrorStatus_GetErrorStatus_PS_Rte_NvmBlock_CmnMfgSrv_MfgTmpBuf0
          OpEventWriteBlock_WriteBlock_PS_Rte_NvmBlock_CmnMfgSrv_EpsSysSerlNr: RteEventRef=OpEventWriteBlock_WriteBlock_PS_Rte_NvmBlock_CmnMfgSrv_EpsSysSerlNr
          OpEventSetBlockProtection_SetBlockProtection_PAdmin_Rte_NvmBlock_CmnMfgSrv_MfgTmpBuf2: RteEventRef=OpEventSetBlockProtection_SetBlockProtection_PAdmin_Rte_NvmBlock_CmnMfgSrv_MfgTmpBuf2
          OpEventInvalidateNvBlock_InvalidateNvBlock_PS_Rte_NvmBlock_CmnMfgSrv_MfgTmpBuf2: RteEventRef=OpEventInvalidateNvBlock_InvalidateNvBlock_PS_Rte_NvmBlock_CmnMfgSrv_MfgTmpBuf2
          OpEventGetErrorStatus_GetErrorStatus_PS_Rte_NvmBlock_CmnMfgSrv_CcaHwPartNr: RteEventRef=OpEventGetErrorStatus_GetErrorStatus_PS_Rte_NvmBlock_CmnMfgSrv_CcaHwPartNr
          OpEventEraseBlock_EraseBlock_PS_Rte_NvmBlock_CmnMfgSrv_DiRestore: RteEventRef=OpEventEraseBlock_EraseBlock_PS_Rte_NvmBlock_CmnMfgSrv_DiRestore
          OpEventGetErrorStatus_GetErrorStatus_PS_Rte_NvmBlock_CmnMfgSrv_NxtrMfgEnaCntr: RteEventRef=OpEventGetErrorStatus_GetErrorStatus_PS_Rte_NvmBlock_CmnMfgSrv_NxtrMfgEnaCntr
          OpEventSetBlockProtection_SetBlockProtection_PAdmin_Rte_NvmBlock_CmnMfgSrv_CcaHwPartNr: RteEventRef=OpEventSetBlockProtection_SetBlockProtection_PAdmin_Rte_NvmBlock_CmnMfgSrv_CcaHwPartNr
          OpEventGetErrorStatus_GetErrorStatus_PS_Rte_NvmBlock_CmnMfgSrv_MfgTmpBuf1: RteEventRef=OpEventGetErrorStatus_GetErrorStatus_PS_Rte_NvmBlock_CmnMfgSrv_MfgTmpBuf1
          OpEventSetRamBlockStatus_SetRamBlockStatus_PS_Rte_NvmBlock_CmnMfgSrv_MfgTmpBuf4: RteEventRef=OpEventSetRamBlockStatus_SetRamBlockStatus_PS_Rte_NvmBlock_CmnMfgSrv_MfgTmpBuf4
          OpEventWriteBlock_WriteBlock_PS_Rte_NvmBlock_CmnMfgSrv_NxtrMfgEnaCntr: RteEventRef=OpEventWriteBlock_WriteBlock_PS_Rte_NvmBlock_CmnMfgSrv_NxtrMfgEnaCntr
          OpEventReadBlock_ReadBlock_PS_Rte_NvmBlock_CmnMfgSrv_EpsSysSerlNr: RteEventRef=OpEventReadBlock_ReadBlock_PS_Rte_NvmBlock_CmnMfgSrv_EpsSysSerlNr
          OpEventReadBlock_ReadBlock_PS_Rte_NvmBlock_CmnMfgSrv_MfgTmpBuf4: RteEventRef=OpEventReadBlock_ReadBlock_PS_Rte_NvmBlock_CmnMfgSrv_MfgTmpBuf4
          OpEventReadBlock_ReadBlock_PS_Rte_NvmBlock_CmnMfgSrv_SeedKey: RteEventRef=OpEventReadBlock_ReadBlock_PS_Rte_NvmBlock_CmnMfgSrv_SeedKey
          OpEventSetBlockProtection_SetBlockProtection_PAdmin_Rte_NvmBlock_CmnMfgSrv_MfgTmpBuf0: RteEventRef=OpEventSetBlockProtection_SetBlockProtection_PAdmin_Rte_NvmBlock_CmnMfgSrv_MfgTmpBuf0
          OpEventReadBlock_ReadBlock_PS_Rte_NvmBlock_CmnMfgSrv_CcaHwPartNr: RteEventRef=OpEventReadBlock_ReadBlock_PS_Rte_NvmBlock_CmnMfgSrv_CcaHwPartNr
          OpEventGetErrorStatus_GetErrorStatus_PS_Rte_NvmBlock_CmnMfgSrv_MfgTmpBuf2: RteEventRef=OpEventGetErrorStatus_GetErrorStatus_PS_Rte_NvmBlock_CmnMfgSrv_MfgTmpBuf2
          OpEventSetRamBlockStatus_SetRamBlockStatus_PS_Rte_NvmBlock_CmnMfgSrv_NxtrMfgEnaCntr: RteEventRef=OpEventSetRamBlockStatus_SetRamBlockStatus_PS_Rte_NvmBlock_CmnMfgSrv_NxtrMfgEnaCntr
          OpEventGetErrorStatus_GetErrorStatus_PS_Rte_NvmBlock_CmnMfgSrv_SeedKey: RteEventRef=OpEventGetErrorStatus_GetErrorStatus_PS_Rte_NvmBlock_CmnMfgSrv_SeedKey
          OpEventSetRamBlockStatus_SetRamBlockStatus_PS_Rte_NvmBlock_CmnMfgSrv_CcaHwPartNr: RteEventRef=OpEventSetRamBlockStatus_SetRamBlockStatus_PS_Rte_NvmBlock_CmnMfgSrv_CcaHwPartNr
          OpEventRestoreBlockDefaults_RestoreBlockDefaults_PS_Rte_NvmBlock_CmnMfgSrv_NxtrMfgEnaCntr: RteEventRef=OpEventRestoreBlockDefaults_RestoreBlockDefaults_PS_Rte_NvmBlock_CmnMfgSrv_NxtrMfgEnaCntr
          OpEventEraseBlock_EraseBlock_PS_Rte_NvmBlock_CmnMfgSrv_EpsSysSerlNr: RteEventRef=OpEventEraseBlock_EraseBlock_PS_Rte_NvmBlock_CmnMfgSrv_EpsSysSerlNr
          OpEventSetRamBlockStatus_SetRamBlockStatus_PS_Rte_NvmBlock_CmnMfgSrv_MfgTmpBuf0: RteEventRef=OpEventSetRamBlockStatus_SetRamBlockStatus_PS_Rte_NvmBlock_CmnMfgSrv_MfgTmpBuf0
          OpEventEraseBlock_EraseBlock_PS_Rte_NvmBlock_CmnMfgSrv_MfgTmpBuf2: RteEventRef=OpEventEraseBlock_EraseBlock_PS_Rte_NvmBlock_CmnMfgSrv_MfgTmpBuf2
          OpEventInvalidateNvBlock_InvalidateNvBlock_PS_Rte_NvmBlock_CmnMfgSrv_NxtrMfgEnaCntr: RteEventRef=OpEventInvalidateNvBlock_InvalidateNvBlock_PS_Rte_NvmBlock_CmnMfgSrv_NxtrMfgEnaCntr
          OpEventSetBlockProtection_SetBlockProtection_PAdmin_Rte_NvmBlock_CmnMfgSrv_MfgTmpBuf4: RteEventRef=OpEventSetBlockProtection_SetBlockProtection_PAdmin_Rte_NvmBlock_CmnMfgSrv_MfgTmpBuf4
          OpEventWriteBlock_WriteBlock_PS_Rte_NvmBlock_CmnMfgSrv_MfgTmpBuf3: RteEventRef=OpEventWriteBlock_WriteBlock_PS_Rte_NvmBlock_CmnMfgSrv_MfgTmpBuf3
          OpEventSetRamBlockStatus_SetRamBlockStatus_PS_Rte_NvmBlock_CmnMfgSrv_MfgTmpBuf2: RteEventRef=OpEventSetRamBlockStatus_SetRamBlockStatus_PS_Rte_NvmBlock_CmnMfgSrv_MfgTmpBuf2
          OpEventSetBlockProtection_SetBlockProtection_PAdmin_Rte_NvmBlock_CmnMfgSrv_DiRestore: RteEventRef=OpEventSetBlockProtection_SetBlockProtection_PAdmin_Rte_NvmBlock_CmnMfgSrv_DiRestore
          OpEventWriteBlock_WriteBlock_PS_Rte_NvmBlock_CmnMfgSrv_MfgTmpBuf1: RteEventRef=OpEventWriteBlock_WriteBlock_PS_Rte_NvmBlock_CmnMfgSrv_MfgTmpBuf1
          OpEventSetBlockProtection_SetBlockProtection_PAdmin_Rte_NvmBlock_CmnMfgSrv_MfgTmpBuf1: RteEventRef=OpEventSetBlockProtection_SetBlockProtection_PAdmin_Rte_NvmBlock_CmnMfgSrv_MfgTmpBuf1
          OpEventWriteBlock_WriteBlock_PS_Rte_NvmBlock_CmnMfgSrv_MfgTmpBuf2: RteEventRef=OpEventWriteBlock_WriteBlock_PS_Rte_NvmBlock_CmnMfgSrv_MfgTmpBuf2
          OpEventSetBlockProtection_SetBlockProtection_PAdmin_Rte_NvmBlock_CmnMfgSrv_SeedKey: RteEventRef=OpEventSetBlockProtection_SetBlockProtection_PAdmin_Rte_NvmBlock_CmnMfgSrv_SeedKey
          OpEventRestoreBlockDefaults_RestoreBlockDefaults_PS_Rte_NvmBlock_CmnMfgSrv_SeedKey: RteEventRef=OpEventRestoreBlockDefaults_RestoreBlockDefaults_PS_Rte_NvmBlock_CmnMfgSrv_SeedKey
          OpEventGetErrorStatus_GetErrorStatus_PS_Rte_NvmBlock_CmnMfgSrv_EpsSysSerlNr: RteEventRef=OpEventGetErrorStatus_GetErrorStatus_PS_Rte_NvmBlock_CmnMfgSrv_EpsSysSerlNr
          OpEventReadBlock_ReadBlock_PS_Rte_NvmBlock_CmnMfgSrv_MfgTmpBuf1: RteEventRef=OpEventReadBlock_ReadBlock_PS_Rte_NvmBlock_CmnMfgSrv_MfgTmpBuf1
          OpEventEraseBlock_EraseBlock_PS_Rte_NvmBlock_CmnMfgSrv_MfgTmpBuf1: RteEventRef=OpEventEraseBlock_EraseBlock_PS_Rte_NvmBlock_CmnMfgSrv_MfgTmpBuf1
          OpEventEraseBlock_EraseBlock_PS_Rte_NvmBlock_CmnMfgSrv_MfgTmpBuf0: RteEventRef=OpEventEraseBlock_EraseBlock_PS_Rte_NvmBlock_CmnMfgSrv_MfgTmpBuf0
          OpEventWriteBlock_WriteBlock_PS_Rte_NvmBlock_CmnMfgSrv_MfgTmpBuf4: RteEventRef=OpEventWriteBlock_WriteBlock_PS_Rte_NvmBlock_CmnMfgSrv_MfgTmpBuf4
          OpEventGetErrorStatus_GetErrorStatus_PS_Rte_NvmBlock_CmnMfgSrv_DiRestore: RteEventRef=OpEventGetErrorStatus_GetErrorStatus_PS_Rte_NvmBlock_CmnMfgSrv_DiRestore
          OpEventEraseBlock_EraseBlock_PS_Rte_NvmBlock_CmnMfgSrv_MfgTmpBuf4: RteEventRef=OpEventEraseBlock_EraseBlock_PS_Rte_NvmBlock_CmnMfgSrv_MfgTmpBuf4
          OpEventInvalidateNvBlock_InvalidateNvBlock_PS_Rte_NvmBlock_CmnMfgSrv_MfgTmpBuf0: RteEventRef=OpEventInvalidateNvBlock_InvalidateNvBlock_PS_Rte_NvmBlock_CmnMfgSrv_MfgTmpBuf0
          OpEventEraseBlock_EraseBlock_PS_Rte_NvmBlock_CmnMfgSrv_MfgTmpBuf3: RteEventRef=OpEventEraseBlock_EraseBlock_PS_Rte_NvmBlock_CmnMfgSrv_MfgTmpBuf3
          OpEventGetErrorStatus_GetErrorStatus_PS_Rte_NvmBlock_CmnMfgSrv_MfgTmpBuf4: RteEventRef=OpEventGetErrorStatus_GetErrorStatus_PS_Rte_NvmBlock_CmnMfgSrv_MfgTmpBuf4
          OpEventInvalidateNvBlock_InvalidateNvBlock_PS_Rte_NvmBlock_CmnMfgSrv_MfgTmpBuf1: RteEventRef=OpEventInvalidateNvBlock_InvalidateNvBlock_PS_Rte_NvmBlock_CmnMfgSrv_MfgTmpBuf1
          OpEventEraseBlock_EraseBlock_PS_Rte_NvmBlock_CmnMfgSrv_CcaHwPartNr: RteEventRef=OpEventEraseBlock_EraseBlock_PS_Rte_NvmBlock_CmnMfgSrv_CcaHwPartNr
          OpEventWriteBlock_WriteBlock_PS_Rte_NvmBlock_CmnMfgSrv_SeedKey: RteEventRef=OpEventWriteBlock_WriteBlock_PS_Rte_NvmBlock_CmnMfgSrv_SeedKey
          OpEventSetBlockProtection_SetBlockProtection_PAdmin_Rte_NvmBlock_CmnMfgSrv_EpsSysSerlNr: RteEventRef=OpEventSetBlockProtection_SetBlockProtection_PAdmin_Rte_NvmBlock_CmnMfgSrv_EpsSysSerlNr
          OpEventSetRamBlockStatus_SetRamBlockStatus_PS_Rte_NvmBlock_CmnMfgSrv_EpsSysSerlNr: RteEventRef=OpEventSetRamBlockStatus_SetRamBlockStatus_PS_Rte_NvmBlock_CmnMfgSrv_EpsSysSerlNr
          OpEventInvalidateNvBlock_InvalidateNvBlock_PS_Rte_NvmBlock_CmnMfgSrv_EpsSysSerlNr: RteEventRef=OpEventInvalidateNvBlock_InvalidateNvBlock_PS_Rte_NvmBlock_CmnMfgSrv_EpsSysSerlNr
          OpEventReadBlock_ReadBlock_PS_Rte_NvmBlock_CmnMfgSrv_DiRestore: RteEventRef=OpEventReadBlock_ReadBlock_PS_Rte_NvmBlock_CmnMfgSrv_DiRestore
          OpEventInvalidateNvBlock_InvalidateNvBlock_PS_Rte_NvmBlock_CmnMfgSrv_SeedKey: RteEventRef=OpEventInvalidateNvBlock_InvalidateNvBlock_PS_Rte_NvmBlock_CmnMfgSrv_SeedKey
          OpEventSetRamBlockStatus_SetRamBlockStatus_PS_Rte_NvmBlock_CmnMfgSrv_DiRestore: RteEventRef=OpEventSetRamBlockStatus_SetRamBlockStatus_PS_Rte_NvmBlock_CmnMfgSrv_DiRestore
          OpEventReadBlock_ReadBlock_PS_Rte_NvmBlock_CmnMfgSrv_MfgTmpBuf2: RteEventRef=OpEventReadBlock_ReadBlock_PS_Rte_NvmBlock_CmnMfgSrv_MfgTmpBuf2
          OpEventInvalidateNvBlock_InvalidateNvBlock_PS_Rte_NvmBlock_CmnMfgSrv_MfgTmpBuf4: RteEventRef=OpEventInvalidateNvBlock_InvalidateNvBlock_PS_Rte_NvmBlock_CmnMfgSrv_MfgTmpBuf4
          OpEventSetRamBlockStatus_SetRamBlockStatus_PS_Rte_NvmBlock_CmnMfgSrv_CcaSerlNr: RteEventRef=OpEventSetRamBlockStatus_SetRamBlockStatus_PS_Rte_NvmBlock_CmnMfgSrv_CcaSerlNr
          OpEventInvalidateNvBlock_InvalidateNvBlock_PS_Rte_NvmBlock_CmnMfgSrv_CcaSerlNr: RteEventRef=OpEventInvalidateNvBlock_InvalidateNvBlock_PS_Rte_NvmBlock_CmnMfgSrv_CcaSerlNr
          OpEventWriteBlock_WriteBlock_PS_Rte_NvmBlock_CmnMfgSrv_CcaSerlNr: RteEventRef=OpEventWriteBlock_WriteBlock_PS_Rte_NvmBlock_CmnMfgSrv_CcaSerlNr
          OpEventReadBlock_ReadBlock_PS_Rte_NvmBlock_CmnMfgSrv_CcaSerlNr: RteEventRef=OpEventReadBlock_ReadBlock_PS_Rte_NvmBlock_CmnMfgSrv_CcaSerlNr
          OpEventEraseBlock_EraseBlock_PS_Rte_NvmBlock_CmnMfgSrv_CcaSerlNr: RteEventRef=OpEventEraseBlock_EraseBlock_PS_Rte_NvmBlock_CmnMfgSrv_CcaSerlNr
          OpEventSetBlockProtection_SetBlockProtection_PAdmin_Rte_NvmBlock_CmnMfgSrv_CcaSerlNr: RteEventRef=OpEventSetBlockProtection_SetBlockProtection_PAdmin_Rte_NvmBlock_CmnMfgSrv_CcaSerlNr
          OpEventGetErrorStatus_GetErrorStatus_PS_Rte_NvmBlock_CmnMfgSrv_CcaSerlNr: RteEventRef=OpEventGetErrorStatus_GetErrorStatus_PS_Rte_NvmBlock_CmnMfgSrv_CcaSerlNr
          OpEventWriteBlock_WriteBlock_PS_Rte_NvmBlock_CmnMfgSrv_IgnCntr: RteEventRef=OpEventWriteBlock_WriteBlock_PS_Rte_NvmBlock_CmnMfgSrv_IgnCntr
          OpEventRestoreBlockDefaults_RestoreBlockDefaults_PS_Rte_NvmBlock_CmnMfgSrv_IgnCntr: RteEventRef=OpEventRestoreBlockDefaults_RestoreBlockDefaults_PS_Rte_NvmBlock_CmnMfgSrv_IgnCntr
          OpEventReadBlock_ReadBlock_PS_Rte_NvmBlock_CmnMfgSrv_IgnCntr: RteEventRef=OpEventReadBlock_ReadBlock_PS_Rte_NvmBlock_CmnMfgSrv_IgnCntr
          OpEventInvalidateNvBlock_InvalidateNvBlock_PS_Rte_NvmBlock_CmnMfgSrv_IgnCntr: RteEventRef=OpEventInvalidateNvBlock_InvalidateNvBlock_PS_Rte_NvmBlock_CmnMfgSrv_IgnCntr
          OpEventGetErrorStatus_GetErrorStatus_PS_Rte_NvmBlock_CmnMfgSrv_IgnCntr: RteEventRef=OpEventGetErrorStatus_GetErrorStatus_PS_Rte_NvmBlock_CmnMfgSrv_IgnCntr
          OpEventSetRamBlockStatus_SetRamBlockStatus_PS_Rte_NvmBlock_CmnMfgSrv_IgnCntr: RteEventRef=OpEventSetRamBlockStatus_SetRamBlockStatus_PS_Rte_NvmBlock_CmnMfgSrv_IgnCntr
          OpEventSetBlockProtection_SetBlockProtection_PAdmin_Rte_NvmBlock_CmnMfgSrv_IgnCntr: RteEventRef=OpEventSetBlockProtection_SetBlockProtection_PAdmin_Rte_NvmBlock_CmnMfgSrv_IgnCntr
          OpEventEraseBlock_EraseBlock_PS_Rte_NvmBlock_CmnMfgSrv_IgnCntr: RteEventRef=OpEventEraseBlock_EraseBlock_PS_Rte_NvmBlock_CmnMfgSrv_IgnCntr
          OpEventInvalidateNvBlock_InvalidateNvBlock_PS_Rte_NvmBlock_CDD_MotAg0Meas_MotAg0CoeffTbl: RteEventRef=OpEventInvalidateNvBlock_InvalidateNvBlock_PS_Rte_NvmBlock_CDD_MotAg0Meas_MotAg0CoeffTbl
          OpEventEraseBlock_EraseBlock_PS_Rte_NvmBlock_CDD_HwTq4Meas_HwTq4Sca_MirrorBlock: RteEventRef=OpEventEraseBlock_EraseBlock_PS_Rte_NvmBlock_CDD_HwTq4Meas_HwTq4Sca_MirrorBlock
          OpEventInvalidateNvBlock_InvalidateNvBlock_PS_Rte_NvmBlock_CDD_HwTq4Meas_HwTq4Offs_MirrorBlock: RteEventRef=OpEventInvalidateNvBlock_InvalidateNvBlock_PS_Rte_NvmBlock_CDD_HwTq4Meas_HwTq4Offs_MirrorBlock
          OpEventGetErrorStatus_GetErrorStatus_PS_Rte_NvmBlock_CDD_HwTq5Meas_HwTq5Offs_MirrorBlock: RteEventRef=OpEventGetErrorStatus_GetErrorStatus_PS_Rte_NvmBlock_CDD_HwTq5Meas_HwTq5Offs_MirrorBlock
          OpEventReadBlock_ReadBlock_PS_Rte_NvmBlock_CDD_HwTq5Meas_HwTq5Offs_MirrorBlock: RteEventRef=OpEventReadBlock_ReadBlock_PS_Rte_NvmBlock_CDD_HwTq5Meas_HwTq5Offs_MirrorBlock
          OpEventSetBlockProtection_SetBlockProtection_PAdmin_Rte_NvmBlock_CDD_MotAg0Meas_MotAg0CoeffTbl: RteEventRef=OpEventSetBlockProtection_SetBlockProtection_PAdmin_Rte_NvmBlock_CDD_MotAg0Meas_MotAg0CoeffTbl
          OpEventSetRamBlockStatus_SetRamBlockStatus_PS_Rte_NvmBlock_CDD_HwTq4Meas_HwTq4Sca_MirrorBlock: RteEventRef=OpEventSetRamBlockStatus_SetRamBlockStatus_PS_Rte_NvmBlock_CDD_HwTq4Meas_HwTq4Sca_MirrorBlock
          OpEventWriteBlock_WriteBlock_PS_Rte_NvmBlock_CDD_HwTq5Meas_HwTq5Sca_MirrorBlock: RteEventRef=OpEventWriteBlock_WriteBlock_PS_Rte_NvmBlock_CDD_HwTq5Meas_HwTq5Sca_MirrorBlock
          OpEventGetErrorStatus_GetErrorStatus_PS_Rte_NvmBlock_CDD_HwTq4Meas_HwTq4Offs_MirrorBlock: RteEventRef=OpEventGetErrorStatus_GetErrorStatus_PS_Rte_NvmBlock_CDD_HwTq4Meas_HwTq4Offs_MirrorBlock
          OpEventInvalidateNvBlock_InvalidateNvBlock_PS_Rte_NvmBlock_CDD_HwTq4Meas_HwTq4Sca_MirrorBlock: RteEventRef=OpEventInvalidateNvBlock_InvalidateNvBlock_PS_Rte_NvmBlock_CDD_HwTq4Meas_HwTq4Sca_MirrorBlock
          OpEventWriteBlock_WriteBlock_PS_Rte_NvmBlock_CDD_MotAg1Meas_MotAg1CoeffTbl: RteEventRef=OpEventWriteBlock_WriteBlock_PS_Rte_NvmBlock_CDD_MotAg1Meas_MotAg1CoeffTbl
          OpEventEraseBlock_EraseBlock_PS_Rte_NvmBlock_CDD_HwTq5Meas_HwTq5Offs_MirrorBlock: RteEventRef=OpEventEraseBlock_EraseBlock_PS_Rte_NvmBlock_CDD_HwTq5Meas_HwTq5Offs_MirrorBlock
          OpEventGetErrorStatus_GetErrorStatus_PS_Rte_NvmBlock_CDD_HwTq5Meas_HwTq5Sca_MirrorBlock: RteEventRef=OpEventGetErrorStatus_GetErrorStatus_PS_Rte_NvmBlock_CDD_HwTq5Meas_HwTq5Sca_MirrorBlock
          OpEventSetBlockProtection_SetBlockProtection_PAdmin_Rte_NvmBlock_CDD_HwTq5Meas_HwTq5Sca_MirrorBlock: RteEventRef=OpEventSetBlockProtection_SetBlockProtection_PAdmin_Rte_NvmBlock_CDD_HwTq5Meas_HwTq5Sca_MirrorBlock
          OpEventWriteBlock_WriteBlock_PS_Rte_NvmBlock_CDD_HwTq4Meas_HwTq4Sca_MirrorBlock: RteEventRef=OpEventWriteBlock_WriteBlock_PS_Rte_NvmBlock_CDD_HwTq4Meas_HwTq4Sca_MirrorBlock
          OpEventWriteBlock_WriteBlock_PS_Rte_NvmBlock_CDD_HwTq4Meas_HwTq4Offs_MirrorBlock: RteEventRef=OpEventWriteBlock_WriteBlock_PS_Rte_NvmBlock_CDD_HwTq4Meas_HwTq4Offs_MirrorBlock
          OpEventReadBlock_ReadBlock_PS_Rte_NvmBlock_CDD_HwTq5Meas_HwTq5Sca_MirrorBlock: RteEventRef=OpEventReadBlock_ReadBlock_PS_Rte_NvmBlock_CDD_HwTq5Meas_HwTq5Sca_MirrorBlock
          OpEventEraseBlock_EraseBlock_PS_Rte_NvmBlock_CDD_MotAg0Meas_MotAg0CoeffTbl: RteEventRef=OpEventEraseBlock_EraseBlock_PS_Rte_NvmBlock_CDD_MotAg0Meas_MotAg0CoeffTbl
          OpEventReadBlock_ReadBlock_PS_Rte_NvmBlock_CDD_HwTq4Meas_HwTq4Offs_MirrorBlock: RteEventRef=OpEventReadBlock_ReadBlock_PS_Rte_NvmBlock_CDD_HwTq4Meas_HwTq4Offs_MirrorBlock
          OpEventReadBlock_ReadBlock_PS_Rte_NvmBlock_CDD_MotAg0Meas_MotAg0CoeffTbl: RteEventRef=OpEventReadBlock_ReadBlock_PS_Rte_NvmBlock_CDD_MotAg0Meas_MotAg0CoeffTbl
          OpEventSetBlockProtection_SetBlockProtection_PAdmin_Rte_NvmBlock_CDD_HwTq5Meas_HwTq5Offs_MirrorBlock: RteEventRef=OpEventSetBlockProtection_SetBlockProtection_PAdmin_Rte_NvmBlock_CDD_HwTq5Meas_HwTq5Offs_MirrorBlock
          OpEventSetRamBlockStatus_SetRamBlockStatus_PS_Rte_NvmBlock_CDD_HwTq5Meas_HwTq5Offs_MirrorBlock: RteEventRef=OpEventSetRamBlockStatus_SetRamBlockStatus_PS_Rte_NvmBlock_CDD_HwTq5Meas_HwTq5Offs_MirrorBlock
          OpEventInvalidateNvBlock_InvalidateNvBlock_PS_Rte_NvmBlock_CDD_MotAg1Meas_MotAg1CoeffTbl: RteEventRef=OpEventInvalidateNvBlock_InvalidateNvBlock_PS_Rte_NvmBlock_CDD_MotAg1Meas_MotAg1CoeffTbl
          OpEventReadBlock_ReadBlock_PS_Rte_NvmBlock_CDD_HwTq4Meas_HwTq4Sca_MirrorBlock: RteEventRef=OpEventReadBlock_ReadBlock_PS_Rte_NvmBlock_CDD_HwTq4Meas_HwTq4Sca_MirrorBlock
          OpEventSetRamBlockStatus_SetRamBlockStatus_PS_Rte_NvmBlock_CDD_HwTq5Meas_HwTq5Sca_MirrorBlock: RteEventRef=OpEventSetRamBlockStatus_SetRamBlockStatus_PS_Rte_NvmBlock_CDD_HwTq5Meas_HwTq5Sca_MirrorBlock
          OpEventInvalidateNvBlock_InvalidateNvBlock_PS_Rte_NvmBlock_CDD_HwTq5Meas_HwTq5Sca_MirrorBlock: RteEventRef=OpEventInvalidateNvBlock_InvalidateNvBlock_PS_Rte_NvmBlock_CDD_HwTq5Meas_HwTq5Sca_MirrorBlock
          OpEventGetErrorStatus_GetErrorStatus_PS_Rte_NvmBlock_CDD_HwTq4Meas_HwTq4Sca_MirrorBlock: RteEventRef=OpEventGetErrorStatus_GetErrorStatus_PS_Rte_NvmBlock_CDD_HwTq4Meas_HwTq4Sca_MirrorBlock
          OpEventInvalidateNvBlock_InvalidateNvBlock_PS_Rte_NvmBlock_CDD_HwTq5Meas_HwTq5Offs_MirrorBlock: RteEventRef=OpEventInvalidateNvBlock_InvalidateNvBlock_PS_Rte_NvmBlock_CDD_HwTq5Meas_HwTq5Offs_MirrorBlock
          OpEventGetErrorStatus_GetErrorStatus_PS_Rte_NvmBlock_CDD_MotAg1Meas_MotAg1CoeffTbl: RteEventRef=OpEventGetErrorStatus_GetErrorStatus_PS_Rte_NvmBlock_CDD_MotAg1Meas_MotAg1CoeffTbl
          OpEventSetRamBlockStatus_SetRamBlockStatus_PS_Rte_NvmBlock_CDD_HwTq4Meas_HwTq4Offs_MirrorBlock: RteEventRef=OpEventSetRamBlockStatus_SetRamBlockStatus_PS_Rte_NvmBlock_CDD_HwTq4Meas_HwTq4Offs_MirrorBlock
          OpEventEraseBlock_EraseBlock_PS_Rte_NvmBlock_CDD_HwTq5Meas_HwTq5Sca_MirrorBlock: RteEventRef=OpEventEraseBlock_EraseBlock_PS_Rte_NvmBlock_CDD_HwTq5Meas_HwTq5Sca_MirrorBlock
          OpEventGetErrorStatus_GetErrorStatus_PS_Rte_NvmBlock_CDD_MotAg0Meas_MotAg0CoeffTbl: RteEventRef=OpEventGetErrorStatus_GetErrorStatus_PS_Rte_NvmBlock_CDD_MotAg0Meas_MotAg0CoeffTbl
          OpEventSetBlockProtection_SetBlockProtection_PAdmin_Rte_NvmBlock_CDD_HwTq4Meas_HwTq4Sca_MirrorBlock: RteEventRef=OpEventSetBlockProtection_SetBlockProtection_PAdmin_Rte_NvmBlock_CDD_HwTq4Meas_HwTq4Sca_MirrorBlock
          OpEventEraseBlock_EraseBlock_PS_Rte_NvmBlock_CDD_HwTq4Meas_HwTq4Offs_MirrorBlock: RteEventRef=OpEventEraseBlock_EraseBlock_PS_Rte_NvmBlock_CDD_HwTq4Meas_HwTq4Offs_MirrorBlock
          OpEventReadBlock_ReadBlock_PS_Rte_NvmBlock_CDD_MotAg1Meas_MotAg1CoeffTbl: RteEventRef=OpEventReadBlock_ReadBlock_PS_Rte_NvmBlock_CDD_MotAg1Meas_MotAg1CoeffTbl
          OpEventSetBlockProtection_SetBlockProtection_PAdmin_Rte_NvmBlock_CDD_HwTq4Meas_HwTq4Offs_MirrorBlock: RteEventRef=OpEventSetBlockProtection_SetBlockProtection_PAdmin_Rte_NvmBlock_CDD_HwTq4Meas_HwTq4Offs_MirrorBlock
          OpEventWriteBlock_WriteBlock_PS_Rte_NvmBlock_CDD_MotAg0Meas_MotAg0CoeffTbl: RteEventRef=OpEventWriteBlock_WriteBlock_PS_Rte_NvmBlock_CDD_MotAg0Meas_MotAg0CoeffTbl
          OpEventWriteBlock_WriteBlock_PS_Rte_NvmBlock_CDD_HwTq5Meas_HwTq5Offs_MirrorBlock: RteEventRef=OpEventWriteBlock_WriteBlock_PS_Rte_NvmBlock_CDD_HwTq5Meas_HwTq5Offs_MirrorBlock
          OpEventSetRamBlockStatus_SetRamBlockStatus_PS_Rte_NvmBlock_CDD_MotAg1Meas_MotAg1CoeffTbl: RteEventRef=OpEventSetRamBlockStatus_SetRamBlockStatus_PS_Rte_NvmBlock_CDD_MotAg1Meas_MotAg1CoeffTbl
          OpEventSetRamBlockStatus_SetRamBlockStatus_PS_Rte_NvmBlock_CDD_MotAg0Meas_MotAg0CoeffTbl: RteEventRef=OpEventSetRamBlockStatus_SetRamBlockStatus_PS_Rte_NvmBlock_CDD_MotAg0Meas_MotAg0CoeffTbl
          OpEventEraseBlock_EraseBlock_PS_Rte_NvmBlock_CDD_MotAg1Meas_MotAg1CoeffTbl: RteEventRef=OpEventEraseBlock_EraseBlock_PS_Rte_NvmBlock_CDD_MotAg1Meas_MotAg1CoeffTbl
          OpEventSetBlockProtection_SetBlockProtection_PAdmin_Rte_NvmBlock_CDD_MotAg1Meas_MotAg1CoeffTbl: RteEventRef=OpEventSetBlockProtection_SetBlockProtection_PAdmin_Rte_NvmBlock_CDD_MotAg1Meas_MotAg1CoeffTbl
          OpEventGetErrorStatus_GetErrorStatus_PS_Rte_NvmBlock_DutyCycThermProtn_FilStVal: RteEventRef=OpEventGetErrorStatus_GetErrorStatus_PS_Rte_NvmBlock_DutyCycThermProtn_FilStVal
          OpEventReadBlock_ReadBlock_PS_Rte_NvmBlock_DutyCycThermProtn_FilStVal: RteEventRef=OpEventReadBlock_ReadBlock_PS_Rte_NvmBlock_DutyCycThermProtn_FilStVal
          OpEventSetRamBlockStatus_SetRamBlockStatus_PS_Rte_NvmBlock_DutyCycThermProtn_FilStVal: RteEventRef=OpEventSetRamBlockStatus_SetRamBlockStatus_PS_Rte_NvmBlock_DutyCycThermProtn_FilStVal
          OpEventSetBlockProtection_SetBlockProtection_PAdmin_Rte_NvmBlock_DutyCycThermProtn_FilStVal: RteEventRef=OpEventSetBlockProtection_SetBlockProtection_PAdmin_Rte_NvmBlock_DutyCycThermProtn_FilStVal
          OpEventWriteBlock_WriteBlock_PS_Rte_NvmBlock_DutyCycThermProtn_FilStVal: RteEventRef=OpEventWriteBlock_WriteBlock_PS_Rte_NvmBlock_DutyCycThermProtn_FilStVal
          OpEventInvalidateNvBlock_InvalidateNvBlock_PS_Rte_NvmBlock_DutyCycThermProtn_FilStVal: RteEventRef=OpEventInvalidateNvBlock_InvalidateNvBlock_PS_Rte_NvmBlock_DutyCycThermProtn_FilStVal
          OpEventEraseBlock_EraseBlock_PS_Rte_NvmBlock_DutyCycThermProtn_FilStVal: RteEventRef=OpEventEraseBlock_EraseBlock_PS_Rte_NvmBlock_DutyCycThermProtn_FilStVal
          OpEventWriteBlock_WriteBlock_PS_Rte_NvmBlock_MotCtrlPrmEstimn_MotPrmNom: RteEventRef=OpEventWriteBlock_WriteBlock_PS_Rte_NvmBlock_MotCtrlPrmEstimn_MotPrmNom
          OpEventSetBlockProtection_SetBlockProtection_PAdmin_Rte_NvmBlock_MotCtrlPrmEstimn_MotPrmNom: RteEventRef=OpEventSetBlockProtection_SetBlockProtection_PAdmin_Rte_NvmBlock_MotCtrlPrmEstimn_MotPrmNom
          OpEventEraseBlock_EraseBlock_PS_Rte_NvmBlock_MotCtrlPrmEstimn_MotPrmNom: RteEventRef=OpEventEraseBlock_EraseBlock_PS_Rte_NvmBlock_MotCtrlPrmEstimn_MotPrmNom
          OpEventSetRamBlockStatus_SetRamBlockStatus_PS_Rte_NvmBlock_MotCtrlPrmEstimn_MotPrmNom: RteEventRef=OpEventSetRamBlockStatus_SetRamBlockStatus_PS_Rte_NvmBlock_MotCtrlPrmEstimn_MotPrmNom
          OpEventInvalidateNvBlock_InvalidateNvBlock_PS_Rte_NvmBlock_MotCtrlPrmEstimn_MotPrmNom: RteEventRef=OpEventInvalidateNvBlock_InvalidateNvBlock_PS_Rte_NvmBlock_MotCtrlPrmEstimn_MotPrmNom
          OpEventGetErrorStatus_GetErrorStatus_PS_Rte_NvmBlock_MotCtrlPrmEstimn_MotPrmNom: RteEventRef=OpEventGetErrorStatus_GetErrorStatus_PS_Rte_NvmBlock_MotCtrlPrmEstimn_MotPrmNom
          OpEventReadBlock_ReadBlock_PS_Rte_NvmBlock_MotCtrlPrmEstimn_MotPrmNom: RteEventRef=OpEventReadBlock_ReadBlock_PS_Rte_NvmBlock_MotCtrlPrmEstimn_MotPrmNom
          OpEventEraseBlock_EraseBlock_PS_Rte_NvmBlock_CDD_CurrMeas_CurrMeasEolGainCalSetABC: RteEventRef=OpEventEraseBlock_EraseBlock_PS_Rte_NvmBlock_CDD_CurrMeas_CurrMeasEolGainCalSetABC
          OpEventSetBlockProtection_SetBlockProtection_PAdmin_Rte_NvmBlock_CDD_CurrMeas_CurrMeasEolOffsCalSetABC: RteEventRef=OpEventSetBlockProtection_SetBlockProtection_PAdmin_Rte_NvmBlock_CDD_CurrMeas_CurrMeasEolOffsCalSetABC
          OpEventRestoreBlockDefaults_RestoreBlockDefaults_PS_Rte_NvmBlock_CDD_CurrMeas_CurrMeasEolGainCalSetABC: RteEventRef=OpEventRestoreBlockDefaults_RestoreBlockDefaults_PS_Rte_NvmBlock_CDD_CurrMeas_CurrMeasEolGainCalSetABC
          OpEventWriteBlock_WriteBlock_PS_Rte_NvmBlock_CDD_CurrMeas_CurrMeasEolGainCalSetABC: RteEventRef=OpEventWriteBlock_WriteBlock_PS_Rte_NvmBlock_CDD_CurrMeas_CurrMeasEolGainCalSetABC
          OpEventSetBlockProtection_SetBlockProtection_PAdmin_Rte_NvmBlock_CDD_CurrMeas_CurrMeasEolGainCalSetABC: RteEventRef=OpEventSetBlockProtection_SetBlockProtection_PAdmin_Rte_NvmBlock_CDD_CurrMeas_CurrMeasEolGainCalSetABC
          OpEventReadBlock_ReadBlock_PS_Rte_NvmBlock_CDD_CurrMeas_CurrMeasEolOffsCalSetABC: RteEventRef=OpEventReadBlock_ReadBlock_PS_Rte_NvmBlock_CDD_CurrMeas_CurrMeasEolOffsCalSetABC
          OpEventRestoreBlockDefaults_RestoreBlockDefaults_PS_Rte_NvmBlock_CDD_CurrMeas_CurrMeasEolOffsCalSetABC: RteEventRef=OpEventRestoreBlockDefaults_RestoreBlockDefaults_PS_Rte_NvmBlock_CDD_CurrMeas_CurrMeasEolOffsCalSetABC
          OpEventReadBlock_ReadBlock_PS_Rte_NvmBlock_CDD_CurrMeas_CurrMeasEolGainCalSetABC: RteEventRef=OpEventReadBlock_ReadBlock_PS_Rte_NvmBlock_CDD_CurrMeas_CurrMeasEolGainCalSetABC
          OpEventGetErrorStatus_GetErrorStatus_PS_Rte_NvmBlock_CDD_CurrMeas_CurrMeasEolGainCalSetABC: RteEventRef=OpEventGetErrorStatus_GetErrorStatus_PS_Rte_NvmBlock_CDD_CurrMeas_CurrMeasEolGainCalSetABC
          OpEventSetRamBlockStatus_SetRamBlockStatus_PS_Rte_NvmBlock_CDD_CurrMeas_CurrMeasEolGainCalSetABC: RteEventRef=OpEventSetRamBlockStatus_SetRamBlockStatus_PS_Rte_NvmBlock_CDD_CurrMeas_CurrMeasEolGainCalSetABC
          OpEventInvalidateNvBlock_InvalidateNvBlock_PS_Rte_NvmBlock_CDD_CurrMeas_CurrMeasEolGainCalSetABC: RteEventRef=OpEventInvalidateNvBlock_InvalidateNvBlock_PS_Rte_NvmBlock_CDD_CurrMeas_CurrMeasEolGainCalSetABC
          OpEventGetErrorStatus_GetErrorStatus_PS_Rte_NvmBlock_CDD_CurrMeas_CurrMeasEolOffsCalSetABC: RteEventRef=OpEventGetErrorStatus_GetErrorStatus_PS_Rte_NvmBlock_CDD_CurrMeas_CurrMeasEolOffsCalSetABC
          OpEventEraseBlock_EraseBlock_PS_Rte_NvmBlock_CDD_CurrMeas_CurrMeasEolOffsCalSetABC: RteEventRef=OpEventEraseBlock_EraseBlock_PS_Rte_NvmBlock_CDD_CurrMeas_CurrMeasEolOffsCalSetABC
          OpEventWriteBlock_WriteBlock_PS_Rte_NvmBlock_CDD_CurrMeas_CurrMeasEolOffsCalSetABC: RteEventRef=OpEventWriteBlock_WriteBlock_PS_Rte_NvmBlock_CDD_CurrMeas_CurrMeasEolOffsCalSetABC
          OpEventSetRamBlockStatus_SetRamBlockStatus_PS_Rte_NvmBlock_CDD_CurrMeas_CurrMeasEolOffsCalSetABC: RteEventRef=OpEventSetRamBlockStatus_SetRamBlockStatus_PS_Rte_NvmBlock_CDD_CurrMeas_CurrMeasEolOffsCalSetABC
          OpEventInvalidateNvBlock_InvalidateNvBlock_PS_Rte_NvmBlock_CDD_CurrMeas_CurrMeasEolOffsCalSetABC: RteEventRef=OpEventInvalidateNvBlock_InvalidateNvBlock_PS_Rte_NvmBlock_CDD_CurrMeas_CurrMeasEolOffsCalSetABC
          OpEventInvalidateNvBlock_InvalidateNvBlock_PS_Rte_NvmBlock_DiagcMgr_DiagcMgrNtcFltAry: RteEventRef=OpEventInvalidateNvBlock_InvalidateNvBlock_PS_Rte_NvmBlock_DiagcMgr_DiagcMgrNtcFltAry
          OpEventSetBlockProtection_SetBlockProtection_PAdmin_Rte_NvmBlock_MotTqCmdSca_MotTqScaFac: RteEventRef=OpEventSetBlockProtection_SetBlockProtection_PAdmin_Rte_NvmBlock_MotTqCmdSca_MotTqScaFac
          OpEventWriteBlock_WriteBlock_PS_Rte_NvmBlock_DiagcMgr_DiagcMgrApplCrc: RteEventRef=OpEventWriteBlock_WriteBlock_PS_Rte_NvmBlock_DiagcMgr_DiagcMgrApplCrc
          OpEventEraseBlock_EraseBlock_PS_Rte_NvmBlock_DiagcMgr_DiagcMgrLtchCntrAry: RteEventRef=OpEventEraseBlock_EraseBlock_PS_Rte_NvmBlock_DiagcMgr_DiagcMgrLtchCntrAry
          OpEventGetErrorStatus_GetErrorStatus_PS_Rte_NvmBlock_DiagcMgr_DiagcMgrNtcFltAry: RteEventRef=OpEventGetErrorStatus_GetErrorStatus_PS_Rte_NvmBlock_DiagcMgr_DiagcMgrNtcFltAry
          OpEventInvalidateNvBlock_InvalidateNvBlock_PS_Rte_NvmBlock_DiagcMgr_DiagcMgrLtchCntrAry: RteEventRef=OpEventInvalidateNvBlock_InvalidateNvBlock_PS_Rte_NvmBlock_DiagcMgr_DiagcMgrLtchCntrAry
          OpEventSetBlockProtection_SetBlockProtection_PAdmin_Rte_NvmBlock_DiagcMgr_DiagcMgrLtchCntrAry: RteEventRef=OpEventSetBlockProtection_SetBlockProtection_PAdmin_Rte_NvmBlock_DiagcMgr_DiagcMgrLtchCntrAry
          OpEventInvalidateNvBlock_InvalidateNvBlock_PS_Rte_NvmBlock_DiagcMgr_DiagcMgrApplCrc: RteEventRef=OpEventInvalidateNvBlock_InvalidateNvBlock_PS_Rte_NvmBlock_DiagcMgr_DiagcMgrApplCrc
          OpEventReadBlock_ReadBlock_PS_Rte_NvmBlock_CDD_NvMProxy_ShtdwnClsChk: RteEventRef=OpEventReadBlock_ReadBlock_PS_Rte_NvmBlock_CDD_NvMProxy_ShtdwnClsChk
          OpEventInvalidateNvBlock_InvalidateNvBlock_PS_Rte_NvmBlock_CDD_MotAgCmp_MotAgCmpMotAgBackEmf: RteEventRef=OpEventInvalidateNvBlock_InvalidateNvBlock_PS_Rte_NvmBlock_CDD_MotAgCmp_MotAgCmpMotAgBackEmf
          OpEventEraseBlock_EraseBlock_PS_Rte_NvmBlock_DiagcMgr_DiagcMgrNtcFltAry: RteEventRef=OpEventEraseBlock_EraseBlock_PS_Rte_NvmBlock_DiagcMgr_DiagcMgrNtcFltAry
          OpEventGetErrorStatus_GetErrorStatus_PS_Rte_NvmBlock_HwTqCorrln_HwTqChACmnModCmpLpFilSt: RteEventRef=OpEventGetErrorStatus_GetErrorStatus_PS_Rte_NvmBlock_HwTqCorrln_HwTqChACmnModCmpLpFilSt
          OpEventGetErrorStatus_GetErrorStatus_PS_Rte_NvmBlock_CDD_NvMProxy_ShtdwnClsChk: RteEventRef=OpEventGetErrorStatus_GetErrorStatus_PS_Rte_NvmBlock_CDD_NvMProxy_ShtdwnClsChk
          OpEventInvalidateNvBlock_InvalidateNvBlock_PS_Rte_NvmBlock_PolarityCfg_PolarityCfgSaved: RteEventRef=OpEventInvalidateNvBlock_InvalidateNvBlock_PS_Rte_NvmBlock_PolarityCfg_PolarityCfgSaved
          OpEventEraseBlock_EraseBlock_PS_Rte_NvmBlock_HwTqCorrln_HwTqChACmnModCmpLpFilSt: RteEventRef=OpEventEraseBlock_EraseBlock_PS_Rte_NvmBlock_HwTqCorrln_HwTqChACmnModCmpLpFilSt
          OpEventEraseBlock_EraseBlock_PS_Rte_NvmBlock_MotTqCmdSca_MotTqScaFac: RteEventRef=OpEventEraseBlock_EraseBlock_PS_Rte_NvmBlock_MotTqCmdSca_MotTqScaFac
          OpEventWriteBlock_WriteBlock_PS_Rte_NvmBlock_DiagcMgr_DiagcMgrLtchCntrAry: RteEventRef=OpEventWriteBlock_WriteBlock_PS_Rte_NvmBlock_DiagcMgr_DiagcMgrLtchCntrAry
          OpEventGetErrorStatus_GetErrorStatus_PS_Rte_NvmBlock_MotTqCmdSca_MotTqScaFac: RteEventRef=OpEventGetErrorStatus_GetErrorStatus_PS_Rte_NvmBlock_MotTqCmdSca_MotTqScaFac
          OpEventReadBlock_ReadBlock_PS_Rte_NvmBlock_DiagcMgr_DiagcMgrNtcFltAry: RteEventRef=OpEventReadBlock_ReadBlock_PS_Rte_NvmBlock_DiagcMgr_DiagcMgrNtcFltAry
          OpEventEraseBlock_EraseBlock_PS_Rte_NvmBlock_DiagcMgr_DiagcMgrApplCrc: RteEventRef=OpEventEraseBlock_EraseBlock_PS_Rte_NvmBlock_DiagcMgr_DiagcMgrApplCrc
          OpEventEraseBlock_EraseBlock_PS_Rte_NvmBlock_CDD_NvMProxy_ShtdwnClsChk: RteEventRef=OpEventEraseBlock_EraseBlock_PS_Rte_NvmBlock_CDD_NvMProxy_ShtdwnClsChk
          OpEventSetRamBlockStatus_SetRamBlockStatus_PS_Rte_NvmBlock_DiagcMgr_DiagcMgrApplCrc: RteEventRef=OpEventSetRamBlockStatus_SetRamBlockStatus_PS_Rte_NvmBlock_DiagcMgr_DiagcMgrApplCrc
          OpEventSetRamBlockStatus_SetRamBlockStatus_PS_Rte_NvmBlock_CDD_NvMProxy_ShtdwnClsChk: RteEventRef=OpEventSetRamBlockStatus_SetRamBlockStatus_PS_Rte_NvmBlock_CDD_NvMProxy_ShtdwnClsChk
          OpEventSetBlockProtection_SetBlockProtection_PAdmin_Rte_NvmBlock_CDD_MotAgCmp_MotAgCmpMotAgBackEmf: RteEventRef=OpEventSetBlockProtection_SetBlockProtection_PAdmin_Rte_NvmBlock_CDD_MotAgCmp_MotAgCmpMotAgBackEmf
          OpEventSetRamBlockStatus_SetRamBlockStatus_PS_Rte_NvmBlock_HwTqCorrln_HwTqChACmnModCmpLpFilSt: RteEventRef=OpEventSetRamBlockStatus_SetRamBlockStatus_PS_Rte_NvmBlock_HwTqCorrln_HwTqChACmnModCmpLpFilSt
          OpEventInvalidateNvBlock_InvalidateNvBlock_PS_Rte_NvmBlock_HwTqCorrln_HwTqChACmnModCmpLpFilSt: RteEventRef=OpEventInvalidateNvBlock_InvalidateNvBlock_PS_Rte_NvmBlock_HwTqCorrln_HwTqChACmnModCmpLpFilSt
          OpEventWriteBlock_WriteBlock_PS_Rte_NvmBlock_HwTqCorrln_HwTqChACmnModCmpLpFilSt: RteEventRef=OpEventWriteBlock_WriteBlock_PS_Rte_NvmBlock_HwTqCorrln_HwTqChACmnModCmpLpFilSt
          OpEventWriteBlock_WriteBlock_PS_Rte_NvmBlock_CDD_NvMProxy_ShtdwnClsChk: RteEventRef=OpEventWriteBlock_WriteBlock_PS_Rte_NvmBlock_CDD_NvMProxy_ShtdwnClsChk
          OpEventInvalidateNvBlock_InvalidateNvBlock_PS_Rte_NvmBlock_CDD_NvMProxy_ShtdwnClsChk: RteEventRef=OpEventInvalidateNvBlock_InvalidateNvBlock_PS_Rte_NvmBlock_CDD_NvMProxy_ShtdwnClsChk
          OpEventGetErrorStatus_GetErrorStatus_PS_Rte_NvmBlock_CDD_MotAgCmp_MotAgCmpMotAgBackEmf: RteEventRef=OpEventGetErrorStatus_GetErrorStatus_PS_Rte_NvmBlock_CDD_MotAgCmp_MotAgCmpMotAgBackEmf
          OpEventGetErrorStatus_GetErrorStatus_PS_Rte_NvmBlock_PolarityCfg_PolarityCfgSaved: RteEventRef=OpEventGetErrorStatus_GetErrorStatus_PS_Rte_NvmBlock_PolarityCfg_PolarityCfgSaved
          OpEventEraseBlock_EraseBlock_PS_Rte_NvmBlock_PolarityCfg_PolarityCfgSaved: RteEventRef=OpEventEraseBlock_EraseBlock_PS_Rte_NvmBlock_PolarityCfg_PolarityCfgSaved
          OpEventWriteBlock_WriteBlock_PS_Rte_NvmBlock_PolarityCfg_PolarityCfgSaved: RteEventRef=OpEventWriteBlock_WriteBlock_PS_Rte_NvmBlock_PolarityCfg_PolarityCfgSaved
          OpEventSetBlockProtection_SetBlockProtection_PAdmin_Rte_NvmBlock_DiagcMgr_DiagcMgrNtcFltAry: RteEventRef=OpEventSetBlockProtection_SetBlockProtection_PAdmin_Rte_NvmBlock_DiagcMgr_DiagcMgrNtcFltAry
          OpEventSetRamBlockStatus_SetRamBlockStatus_PS_Rte_NvmBlock_DiagcMgr_DiagcMgrNtcFltAry: RteEventRef=OpEventSetRamBlockStatus_SetRamBlockStatus_PS_Rte_NvmBlock_DiagcMgr_DiagcMgrNtcFltAry
          OpEventReadBlock_ReadBlock_PS_Rte_NvmBlock_HwTqCorrln_HwTqChACmnModCmpLpFilSt: RteEventRef=OpEventReadBlock_ReadBlock_PS_Rte_NvmBlock_HwTqCorrln_HwTqChACmnModCmpLpFilSt
          OpEventReadBlock_ReadBlock_PS_Rte_NvmBlock_DiagcMgr_DiagcMgrLtchCntrAry: RteEventRef=OpEventReadBlock_ReadBlock_PS_Rte_NvmBlock_DiagcMgr_DiagcMgrLtchCntrAry
          OpEventSetBlockProtection_SetBlockProtection_PAdmin_Rte_NvmBlock_PolarityCfg_PolarityCfgSaved: RteEventRef=OpEventSetBlockProtection_SetBlockProtection_PAdmin_Rte_NvmBlock_PolarityCfg_PolarityCfgSaved
          OpEventReadBlock_ReadBlock_PS_Rte_NvmBlock_MotTqCmdSca_MotTqScaFac: RteEventRef=OpEventReadBlock_ReadBlock_PS_Rte_NvmBlock_MotTqCmdSca_MotTqScaFac
          OpEventWriteBlock_WriteBlock_PS_Rte_NvmBlock_DiagcMgr_DiagcMgrNtcFltAry: RteEventRef=OpEventWriteBlock_WriteBlock_PS_Rte_NvmBlock_DiagcMgr_DiagcMgrNtcFltAry
          OpEventSetRamBlockStatus_SetRamBlockStatus_PS_Rte_NvmBlock_CDD_MotAgCmp_MotAgCmpMotAgBackEmf: RteEventRef=OpEventSetRamBlockStatus_SetRamBlockStatus_PS_Rte_NvmBlock_CDD_MotAgCmp_MotAgCmpMotAgBackEmf
          OpEventSetRamBlockStatus_SetRamBlockStatus_PS_Rte_NvmBlock_MotTqCmdSca_MotTqScaFac: RteEventRef=OpEventSetRamBlockStatus_SetRamBlockStatus_PS_Rte_NvmBlock_MotTqCmdSca_MotTqScaFac
          OpEventRestoreBlockDefaults_RestoreBlockDefaults_PS_Rte_NvmBlock_PolarityCfg_PolarityCfgSaved: RteEventRef=OpEventRestoreBlockDefaults_RestoreBlockDefaults_PS_Rte_NvmBlock_PolarityCfg_PolarityCfgSaved
          OpEventReadBlock_ReadBlock_PS_Rte_NvmBlock_PolarityCfg_PolarityCfgSaved: RteEventRef=OpEventReadBlock_ReadBlock_PS_Rte_NvmBlock_PolarityCfg_PolarityCfgSaved
          OpEventEraseBlock_EraseBlock_PS_Rte_NvmBlock_CDD_MotAgCmp_MotAgCmpMotAgBackEmf: RteEventRef=OpEventEraseBlock_EraseBlock_PS_Rte_NvmBlock_CDD_MotAgCmp_MotAgCmpMotAgBackEmf
          OpEventGetErrorStatus_GetErrorStatus_PS_Rte_NvmBlock_DiagcMgr_DiagcMgrApplCrc: RteEventRef=OpEventGetErrorStatus_GetErrorStatus_PS_Rte_NvmBlock_DiagcMgr_DiagcMgrApplCrc
          OpEventSetRamBlockStatus_SetRamBlockStatus_PS_Rte_NvmBlock_DiagcMgr_DiagcMgrLtchCntrAry: RteEventRef=OpEventSetRamBlockStatus_SetRamBlockStatus_PS_Rte_NvmBlock_DiagcMgr_DiagcMgrLtchCntrAry
          OpEventInvalidateNvBlock_InvalidateNvBlock_PS_Rte_NvmBlock_MotTqCmdSca_MotTqScaFac: RteEventRef=OpEventInvalidateNvBlock_InvalidateNvBlock_PS_Rte_NvmBlock_MotTqCmdSca_MotTqScaFac
          OpEventReadBlock_ReadBlock_PS_Rte_NvmBlock_DiagcMgr_DiagcMgrApplCrc: RteEventRef=OpEventReadBlock_ReadBlock_PS_Rte_NvmBlock_DiagcMgr_DiagcMgrApplCrc
          OpEventWriteBlock_WriteBlock_PS_Rte_NvmBlock_CDD_MotAgCmp_MotAgCmpMotAgBackEmf: RteEventRef=OpEventWriteBlock_WriteBlock_PS_Rte_NvmBlock_CDD_MotAgCmp_MotAgCmpMotAgBackEmf
          OpEventSetBlockProtection_SetBlockProtection_PAdmin_Rte_NvmBlock_CDD_NvMProxy_ShtdwnClsChk: RteEventRef=OpEventSetBlockProtection_SetBlockProtection_PAdmin_Rte_NvmBlock_CDD_NvMProxy_ShtdwnClsChk
          OpEventRestoreBlockDefaults_RestoreBlockDefaults_PS_Rte_NvmBlock_DiagcMgr_DiagcMgrApplCrc: RteEventRef=OpEventRestoreBlockDefaults_RestoreBlockDefaults_PS_Rte_NvmBlock_DiagcMgr_DiagcMgrApplCrc
          OpEventWriteBlock_WriteBlock_PS_Rte_NvmBlock_MotTqCmdSca_MotTqScaFac: RteEventRef=OpEventWriteBlock_WriteBlock_PS_Rte_NvmBlock_MotTqCmdSca_MotTqScaFac
          OpEventRestoreBlockDefaults_RestoreBlockDefaults_PS_Rte_NvmBlock_HwTqCorrln_HwTqChACmnModCmpLpFilSt: RteEventRef=OpEventRestoreBlockDefaults_RestoreBlockDefaults_PS_Rte_NvmBlock_HwTqCorrln_HwTqChACmnModCmpLpFilSt
          OpEventRestoreBlockDefaults_RestoreBlockDefaults_PS_Rte_NvmBlock_CDD_MotAgCmp_MotAgCmpMotAgBackEmf: RteEventRef=OpEventRestoreBlockDefaults_RestoreBlockDefaults_PS_Rte_NvmBlock_CDD_MotAgCmp_MotAgCmpMotAgBackEmf
          OpEventGetErrorStatus_GetErrorStatus_PS_Rte_NvmBlock_DiagcMgr_DiagcMgrLtchCntrAry: RteEventRef=OpEventGetErrorStatus_GetErrorStatus_PS_Rte_NvmBlock_DiagcMgr_DiagcMgrLtchCntrAry
          OpEventSetRamBlockStatus_SetRamBlockStatus_PS_Rte_NvmBlock_PolarityCfg_PolarityCfgSaved: RteEventRef=OpEventSetRamBlockStatus_SetRamBlockStatus_PS_Rte_NvmBlock_PolarityCfg_PolarityCfgSaved
          OpEventReadBlock_ReadBlock_PS_Rte_NvmBlock_CDD_MotAgCmp_MotAgCmpMotAgBackEmf: RteEventRef=OpEventReadBlock_ReadBlock_PS_Rte_NvmBlock_CDD_MotAgCmp_MotAgCmpMotAgBackEmf
          OpEventSetBlockProtection_SetBlockProtection_PAdmin_Rte_NvmBlock_DiagcMgr_DiagcMgrApplCrc: RteEventRef=OpEventSetBlockProtection_SetBlockProtection_PAdmin_Rte_NvmBlock_DiagcMgr_DiagcMgrApplCrc
          OpEventSetBlockProtection_SetBlockProtection_PAdmin_Rte_NvmBlock_HwTqCorrln_HwTqChACmnModCmpLpFilSt: RteEventRef=OpEventSetBlockProtection_SetBlockProtection_PAdmin_Rte_NvmBlock_HwTqCorrln_HwTqChACmnModCmpLpFilSt
          OpEventRestoreBlockDefaults_RestoreBlockDefaults_PS_Rte_NvmBlock_Vin: RteEventRef=OpEventRestoreBlockDefaults_RestoreBlockDefaults_PS_Rte_NvmBlock_Vin
          OpEventGetErrorStatus_GetErrorStatus_PS_NVM_BLOCK_BOOT_PROG_COUNTER: RteEventRef=OpEventGetErrorStatus_GetErrorStatus_PS_NVM_BLOCK_BOOT_PROG_COUNTER
          OpEventSetBlockProtection_SetBlockProtection_PAdmin_Rte_NvmBlock_Omc: RteEventRef=OpEventSetBlockProtection_SetBlockProtection_PAdmin_Rte_NvmBlock_Omc
          OpEventSetRamBlockStatus_SetRamBlockStatus_PS_Rte_NvmBlock_Vin: RteEventRef=OpEventSetRamBlockStatus_SetRamBlockStatus_PS_Rte_NvmBlock_Vin
          OpEventWriteBlock_WriteBlock_PS_Rte_NvmBlock_Omc: RteEventRef=OpEventWriteBlock_WriteBlock_PS_Rte_NvmBlock_Omc
          OpEventGetErrorStatus_GetErrorStatus_PS_Rte_NvmBlock_Omc: RteEventRef=OpEventGetErrorStatus_GetErrorStatus_PS_Rte_NvmBlock_Omc
          OpEventEraseBlock_EraseBlock_PS_Rte_NvmBlock_Vin: RteEventRef=OpEventEraseBlock_EraseBlock_PS_Rte_NvmBlock_Vin
          OpEventGetErrorStatus_GetErrorStatus_PS_Rte_NvmBlock_Vin: RteEventRef=OpEventGetErrorStatus_GetErrorStatus_PS_Rte_NvmBlock_Vin
          OpEventSetRamBlockStatus_SetRamBlockStatus_PS_Rte_NvmBlock_Omc: RteEventRef=OpEventSetRamBlockStatus_SetRamBlockStatus_PS_Rte_NvmBlock_Omc
          OpEventReadBlock_ReadBlock_PS_NVM_BLOCK_BOOT_PROG_COUNTER: RteEventRef=OpEventReadBlock_ReadBlock_PS_NVM_BLOCK_BOOT_PROG_COUNTER
          OpEventInvalidateNvBlock_InvalidateNvBlock_PS_NVM_BLOCK_BOOT_PROG_COUNTER: RteEventRef=OpEventInvalidateNvBlock_InvalidateNvBlock_PS_NVM_BLOCK_BOOT_PROG_COUNTER
          OpEventWriteBlock_WriteBlock_PS_NVM_BLOCK_BOOT_PROG_COUNTER: RteEventRef=OpEventWriteBlock_WriteBlock_PS_NVM_BLOCK_BOOT_PROG_COUNTER
          OpEventWriteBlock_WriteBlock_PS_Rte_NvmBlock_Vin: RteEventRef=OpEventWriteBlock_WriteBlock_PS_Rte_NvmBlock_Vin
          OpEventEraseBlock_EraseBlock_PS_NVM_BLOCK_BOOT_PROG_COUNTER: RteEventRef=OpEventEraseBlock_EraseBlock_PS_NVM_BLOCK_BOOT_PROG_COUNTER
          OpEventRestoreBlockDefaults_RestoreBlockDefaults_PS_NVM_BLOCK_BOOT_PROG_COUNTER: RteEventRef=OpEventRestoreBlockDefaults_RestoreBlockDefaults_PS_NVM_BLOCK_BOOT_PROG_COUNTER
          OpEventSetBlockProtection_SetBlockProtection_PAdmin_NVM_BLOCK_BOOT_PROG_COUNTER: RteEventRef=OpEventSetBlockProtection_SetBlockProtection_PAdmin_NVM_BLOCK_BOOT_PROG_COUNTER
          OpEventSetRamBlockStatus_SetRamBlockStatus_PS_NVM_BLOCK_BOOT_PROG_COUNTER: RteEventRef=OpEventSetRamBlockStatus_SetRamBlockStatus_PS_NVM_BLOCK_BOOT_PROG_COUNTER
          OpEventInvalidateNvBlock_InvalidateNvBlock_PS_Rte_NvmBlock_Omc: RteEventRef=OpEventInvalidateNvBlock_InvalidateNvBlock_PS_Rte_NvmBlock_Omc
          OpEventReadBlock_ReadBlock_PS_Rte_NvmBlock_Vin: RteEventRef=OpEventReadBlock_ReadBlock_PS_Rte_NvmBlock_Vin
          OpEventSetBlockProtection_SetBlockProtection_PAdmin_Rte_NvmBlock_Vin: RteEventRef=OpEventSetBlockProtection_SetBlockProtection_PAdmin_Rte_NvmBlock_Vin
          OpEventReadBlock_ReadBlock_PS_Rte_NvmBlock_Omc: RteEventRef=OpEventReadBlock_ReadBlock_PS_Rte_NvmBlock_Omc
          OpEventEraseBlock_EraseBlock_PS_Rte_NvmBlock_Omc: RteEventRef=OpEventEraseBlock_EraseBlock_PS_Rte_NvmBlock_Omc
          OpEventRestoreBlockDefaults_RestoreBlockDefaults_PS_Rte_NvmBlock_Omc: RteEventRef=OpEventRestoreBlockDefaults_RestoreBlockDefaults_PS_Rte_NvmBlock_Omc
          OpEventInvalidateNvBlock_InvalidateNvBlock_PS_Rte_NvmBlock_Vin: RteEventRef=OpEventInvalidateNvBlock_InvalidateNvBlock_PS_Rte_NvmBlock_Vin
          OpEventSetBlockProtection_SetBlockProtection_PAdmin_NVM_BLOCK_BOOT_SVK_HISTORY: RteEventRef=OpEventSetBlockProtection_SetBlockProtection_PAdmin_NVM_BLOCK_BOOT_SVK_HISTORY
          OpEventInvalidateNvBlock_InvalidateNvBlock_PS_NVM_BLOCK_BOOT_PROG_DATA: RteEventRef=OpEventInvalidateNvBlock_InvalidateNvBlock_PS_NVM_BLOCK_BOOT_PROG_DATA
          OpEventWriteBlock_WriteBlock_PS_NVM_BLOCK_BOOT_SVK_HISTORY: RteEventRef=OpEventWriteBlock_WriteBlock_PS_NVM_BLOCK_BOOT_SVK_HISTORY
          OpEventInvalidateNvBlock_InvalidateNvBlock_PS_NVM_BLOCK_BOOT_SVK_HISTORY: RteEventRef=OpEventInvalidateNvBlock_InvalidateNvBlock_PS_NVM_BLOCK_BOOT_SVK_HISTORY
          OpEventSetRamBlockStatus_SetRamBlockStatus_PS_NVM_BLOCK_BOOT_PROG_DATA: RteEventRef=OpEventSetRamBlockStatus_SetRamBlockStatus_PS_NVM_BLOCK_BOOT_PROG_DATA
          OpEventReadBlock_ReadBlock_PS_NVM_BLOCK_BOOT_PROG_DATA: RteEventRef=OpEventReadBlock_ReadBlock_PS_NVM_BLOCK_BOOT_PROG_DATA
          OpEventGetErrorStatus_GetErrorStatus_PS_NVM_BLOCK_BOOT_SVK_HISTORY: RteEventRef=OpEventGetErrorStatus_GetErrorStatus_PS_NVM_BLOCK_BOOT_SVK_HISTORY
          OpEventWriteBlock_WriteBlock_PS_NVM_BLOCK_BOOT_PROG_DATA: RteEventRef=OpEventWriteBlock_WriteBlock_PS_NVM_BLOCK_BOOT_PROG_DATA
          OpEventEraseBlock_EraseBlock_PS_NVM_BLOCK_BOOT_SVK_HISTORY: RteEventRef=OpEventEraseBlock_EraseBlock_PS_NVM_BLOCK_BOOT_SVK_HISTORY
          OpEventSetRamBlockStatus_SetRamBlockStatus_PS_NVM_BLOCK_BOOT_SVK_HISTORY: RteEventRef=OpEventSetRamBlockStatus_SetRamBlockStatus_PS_NVM_BLOCK_BOOT_SVK_HISTORY
          OpEventSetBlockProtection_SetBlockProtection_PAdmin_NVM_BLOCK_BOOT_PROG_DATA: RteEventRef=OpEventSetBlockProtection_SetBlockProtection_PAdmin_NVM_BLOCK_BOOT_PROG_DATA
          OpEventReadBlock_ReadBlock_PS_NVM_BLOCK_BOOT_SVK_HISTORY: RteEventRef=OpEventReadBlock_ReadBlock_PS_NVM_BLOCK_BOOT_SVK_HISTORY
          OpEventEraseBlock_EraseBlock_PS_NVM_BLOCK_BOOT_PROG_DATA: RteEventRef=OpEventEraseBlock_EraseBlock_PS_NVM_BLOCK_BOOT_PROG_DATA
          OpEventGetErrorStatus_GetErrorStatus_PS_NVM_BLOCK_BOOT_PROG_DATA: RteEventRef=OpEventGetErrorStatus_GetErrorStatus_PS_NVM_BLOCK_BOOT_PROG_DATA
          OpEventInvalidateNvBlock_InvalidateNvBlock_PS_NVM_BLOCK_DLOG_SVK_SYS_SUPP: RteEventRef=OpEventInvalidateNvBlock_InvalidateNvBlock_PS_NVM_BLOCK_DLOG_SVK_SYS_SUPP
          OpEventReadBlock_ReadBlock_PS_NVM_BLOCK_DLOG_SVK_SYS_SUPP: RteEventRef=OpEventReadBlock_ReadBlock_PS_NVM_BLOCK_DLOG_SVK_SYS_SUPP
          OpEventSetBlockProtection_SetBlockProtection_PAdmin_NVM_BLOCK_DLOG_SVK_PLANT: RteEventRef=OpEventSetBlockProtection_SetBlockProtection_PAdmin_NVM_BLOCK_DLOG_SVK_PLANT
          OpEventReadBlock_ReadBlock_PS_NVM_BLOCK_DLOG_SVK_PLANT: RteEventRef=OpEventReadBlock_ReadBlock_PS_NVM_BLOCK_DLOG_SVK_PLANT
          OpEventSetRamBlockStatus_SetRamBlockStatus_PS_NVM_BLOCK_DLOG_SVK_PLANT: RteEventRef=OpEventSetRamBlockStatus_SetRamBlockStatus_PS_NVM_BLOCK_DLOG_SVK_PLANT
          OpEventEraseBlock_EraseBlock_PS_NVM_BLOCK_DLOG_SVK_PLANT: RteEventRef=OpEventEraseBlock_EraseBlock_PS_NVM_BLOCK_DLOG_SVK_PLANT
          OpEventSetRamBlockStatus_SetRamBlockStatus_PS_NVM_BLOCK_DLOG_SVK_SYS_SUPP: RteEventRef=OpEventSetRamBlockStatus_SetRamBlockStatus_PS_NVM_BLOCK_DLOG_SVK_SYS_SUPP
          OpEventInvalidateNvBlock_InvalidateNvBlock_PS_NVM_BLOCK_DLOG_SVK_PLANT: RteEventRef=OpEventInvalidateNvBlock_InvalidateNvBlock_PS_NVM_BLOCK_DLOG_SVK_PLANT
          OpEventEraseBlock_EraseBlock_PS_NVM_BLOCK_DLOG_SVK_SYS_SUPP: RteEventRef=OpEventEraseBlock_EraseBlock_PS_NVM_BLOCK_DLOG_SVK_SYS_SUPP
          OpEventWriteBlock_WriteBlock_PS_NVM_BLOCK_DLOG_SVK_PLANT: RteEventRef=OpEventWriteBlock_WriteBlock_PS_NVM_BLOCK_DLOG_SVK_PLANT
          OpEventGetErrorStatus_GetErrorStatus_PS_NVM_BLOCK_DLOG_SVK_PLANT: RteEventRef=OpEventGetErrorStatus_GetErrorStatus_PS_NVM_BLOCK_DLOG_SVK_PLANT
          OpEventWriteBlock_WriteBlock_PS_NVM_BLOCK_DLOG_SVK_SYS_SUPP: RteEventRef=OpEventWriteBlock_WriteBlock_PS_NVM_BLOCK_DLOG_SVK_SYS_SUPP
          OpEventSetBlockProtection_SetBlockProtection_PAdmin_NVM_BLOCK_DLOG_SVK_SYS_SUPP: RteEventRef=OpEventSetBlockProtection_SetBlockProtection_PAdmin_NVM_BLOCK_DLOG_SVK_SYS_SUPP
          OpEventGetErrorStatus_GetErrorStatus_PS_NVM_BLOCK_DLOG_SVK_SYS_SUPP: RteEventRef=OpEventGetErrorStatus_GetErrorStatus_PS_NVM_BLOCK_DLOG_SVK_SYS_SUPP
          OpEventEraseBlock_EraseBlock_PS_Rte_NvmBlock_Darh_ErrorQueue: RteEventRef=OpEventEraseBlock_EraseBlock_PS_Rte_NvmBlock_Darh_ErrorQueue
          OpEventSetRamBlockStatus_SetRamBlockStatus_PS_Rte_NvmBlock_Darh_ErrorQueue: RteEventRef=OpEventSetRamBlockStatus_SetRamBlockStatus_PS_Rte_NvmBlock_Darh_ErrorQueue
          OpEventGetErrorStatus_GetErrorStatus_PS_Rte_NvmBlock_Darh_ErrorQueue: RteEventRef=OpEventGetErrorStatus_GetErrorStatus_PS_Rte_NvmBlock_Darh_ErrorQueue
          OpEventSetBlockProtection_SetBlockProtection_PAdmin_Rte_NvmBlock_Darh_ErrorQueue: RteEventRef=OpEventSetBlockProtection_SetBlockProtection_PAdmin_Rte_NvmBlock_Darh_ErrorQueue
          OpEventReadBlock_ReadBlock_PS_Rte_NvmBlock_Darh_ErrorQueue: RteEventRef=OpEventReadBlock_ReadBlock_PS_Rte_NvmBlock_Darh_ErrorQueue
          OpEventWriteBlock_WriteBlock_PS_Rte_NvmBlock_Darh_ErrorQueue: RteEventRef=OpEventWriteBlock_WriteBlock_PS_Rte_NvmBlock_Darh_ErrorQueue
          OpEventInvalidateNvBlock_InvalidateNvBlock_PS_Rte_NvmBlock_Darh_ErrorQueue: RteEventRef=OpEventInvalidateNvBlock_InvalidateNvBlock_PS_Rte_NvmBlock_Darh_ErrorQueue
          OpEventWriteBlock_WriteBlock_PS_Rte_NvmBlock_CDD_VrfyCritReg_MCalReadVrfyCritRegFltInfo: RteEventRef=OpEventWriteBlock_WriteBlock_PS_Rte_NvmBlock_CDD_VrfyCritReg_MCalReadVrfyCritRegFltInfo
          OpEventSetRamBlockStatus_SetRamBlockStatus_PS_Rte_NvmBlock_CDD_VrfyCritReg_MCalReadVrfyCritRegFltInfo: RteEventRef=OpEventSetRamBlockStatus_SetRamBlockStatus_PS_Rte_NvmBlock_CDD_VrfyCritReg_MCalReadVrfyCritRegFltInfo
          OpEventSetBlockProtection_SetBlockProtection_PAdmin_Rte_NvmBlock_CDD_VrfyCritReg_MCalReadVrfyCritRegFltInfo: RteEventRef=OpEventSetBlockProtection_SetBlockProtection_PAdmin_Rte_NvmBlock_CDD_VrfyCritReg_MCalReadVrfyCritRegFltInfo
          OpEventGetErrorStatus_GetErrorStatus_PS_Rte_NvmBlock_CDD_VrfyCritReg_MCalReadVrfyCritRegFltInfo: RteEventRef=OpEventGetErrorStatus_GetErrorStatus_PS_Rte_NvmBlock_CDD_VrfyCritReg_MCalReadVrfyCritRegFltInfo
          OpEventEraseBlock_EraseBlock_PS_Rte_NvmBlock_CDD_VrfyCritReg_MCalReadVrfyCritRegFltInfo: RteEventRef=OpEventEraseBlock_EraseBlock_PS_Rte_NvmBlock_CDD_VrfyCritReg_MCalReadVrfyCritRegFltInfo
          OpEventReadBlock_ReadBlock_PS_Rte_NvmBlock_CDD_VrfyCritReg_MCalReadVrfyCritRegFltInfo: RteEventRef=OpEventReadBlock_ReadBlock_PS_Rte_NvmBlock_CDD_VrfyCritReg_MCalReadVrfyCritRegFltInfo
          OpEventInvalidateNvBlock_InvalidateNvBlock_PS_Rte_NvmBlock_CDD_VrfyCritReg_MCalReadVrfyCritRegFltInfo: RteEventRef=OpEventInvalidateNvBlock_InvalidateNvBlock_PS_Rte_NvmBlock_CDD_VrfyCritReg_MCalReadVrfyCritRegFltInfo
          OpEventSetBlockProtection_SetBlockProtection_PAdmin_Rte_NvmBlock_BmwHwAgArbnAndEotPosn_BmwVehCentrOffs: RteEventRef=OpEventSetBlockProtection_SetBlockProtection_PAdmin_Rte_NvmBlock_BmwHwAgArbnAndEotPosn_BmwVehCentrOffs
          OpEventReadBlock_ReadBlock_PS_Rte_NvmBlock_BmwHwAgArbnAndEotPosn_BmwVehCentrOffs: RteEventRef=OpEventReadBlock_ReadBlock_PS_Rte_NvmBlock_BmwHwAgArbnAndEotPosn_BmwVehCentrOffs
          OpEventEraseBlock_EraseBlock_PS_Rte_NvmBlock_BmwHwAgArbnAndEotPosn_BmwVehCentrOffs: RteEventRef=OpEventEraseBlock_EraseBlock_PS_Rte_NvmBlock_BmwHwAgArbnAndEotPosn_BmwVehCentrOffs
          OpEventSetRamBlockStatus_SetRamBlockStatus_PS_Rte_NvmBlock_BmwHwAgArbnAndEotPosn_BmwVehCentrOffs: RteEventRef=OpEventSetRamBlockStatus_SetRamBlockStatus_PS_Rte_NvmBlock_BmwHwAgArbnAndEotPosn_BmwVehCentrOffs
          OpEventWriteBlock_WriteBlock_PS_Rte_NvmBlock_BmwHwAgArbnAndEotPosn_BmwVehCentrOffs: RteEventRef=OpEventWriteBlock_WriteBlock_PS_Rte_NvmBlock_BmwHwAgArbnAndEotPosn_BmwVehCentrOffs
          OpEventGetErrorStatus_GetErrorStatus_PS_Rte_NvmBlock_BmwHwAgArbnAndEotPosn_BmwVehCentrOffs: RteEventRef=OpEventGetErrorStatus_GetErrorStatus_PS_Rte_NvmBlock_BmwHwAgArbnAndEotPosn_BmwVehCentrOffs
          OpEventInvalidateNvBlock_InvalidateNvBlock_PS_Rte_NvmBlock_BmwHwAgArbnAndEotPosn_BmwVehCentrOffs: RteEventRef=OpEventInvalidateNvBlock_InvalidateNvBlock_PS_Rte_NvmBlock_BmwHwAgArbnAndEotPosn_BmwVehCentrOffs
          OpEventGetErrorStatus_GetErrorStatus_PS_Rte_NvmBlock_LrndRackCentr_LrndRackCentr: RteEventRef=OpEventGetErrorStatus_GetErrorStatus_PS_Rte_NvmBlock_LrndRackCentr_LrndRackCentr
          OpEventInvalidateNvBlock_InvalidateNvBlock_PS_Rte_NvmBlock_LrndRackCentr_LrndRackCentr: RteEventRef=OpEventInvalidateNvBlock_InvalidateNvBlock_PS_Rte_NvmBlock_LrndRackCentr_LrndRackCentr
          OpEventSetRamBlockStatus_SetRamBlockStatus_PS_Rte_NvmBlock_LrndRackCentr_LrndRackCentr: RteEventRef=OpEventSetRamBlockStatus_SetRamBlockStatus_PS_Rte_NvmBlock_LrndRackCentr_LrndRackCentr
          OpEventWriteBlock_WriteBlock_PS_Rte_NvmBlock_LrndRackCentr_LrndRackCentr: RteEventRef=OpEventWriteBlock_WriteBlock_PS_Rte_NvmBlock_LrndRackCentr_LrndRackCentr
          OpEventSetBlockProtection_SetBlockProtection_PAdmin_Rte_NvmBlock_LrndRackCentr_LrndRackCentr: RteEventRef=OpEventSetBlockProtection_SetBlockProtection_PAdmin_Rte_NvmBlock_LrndRackCentr_LrndRackCentr
          OpEventEraseBlock_EraseBlock_PS_Rte_NvmBlock_LrndRackCentr_LrndRackCentr: RteEventRef=OpEventEraseBlock_EraseBlock_PS_Rte_NvmBlock_LrndRackCentr_LrndRackCentr
          OpEventReadBlock_ReadBlock_PS_Rte_NvmBlock_LrndRackCentr_LrndRackCentr: RteEventRef=OpEventReadBlock_ReadBlock_PS_Rte_NvmBlock_LrndRackCentr_LrndRackCentr
          OpEventWriteBlock_WriteBlock_PS_Rte_NvmBlock_ExcpnHndlg_McuDiagcData: RteEventRef=OpEventWriteBlock_WriteBlock_PS_Rte_NvmBlock_ExcpnHndlg_McuDiagcData
          OpEventEraseBlock_EraseBlock_PS_Rte_NvmBlock_ExcpnHndlg_McuDiagcData: RteEventRef=OpEventEraseBlock_EraseBlock_PS_Rte_NvmBlock_ExcpnHndlg_McuDiagcData
          OpEventSetBlockProtection_SetBlockProtection_PAdmin_Rte_NvmBlock_ExcpnHndlg_McuDiagcData: RteEventRef=OpEventSetBlockProtection_SetBlockProtection_PAdmin_Rte_NvmBlock_ExcpnHndlg_McuDiagcData
          OpEventRestoreBlockDefaults_RestoreBlockDefaults_PS_Rte_NvmBlock_ExcpnHndlg_McuDiagcData: RteEventRef=OpEventRestoreBlockDefaults_RestoreBlockDefaults_PS_Rte_NvmBlock_ExcpnHndlg_McuDiagcData
          OpEventSetRamBlockStatus_SetRamBlockStatus_PS_Rte_NvmBlock_ExcpnHndlg_McuDiagcData: RteEventRef=OpEventSetRamBlockStatus_SetRamBlockStatus_PS_Rte_NvmBlock_ExcpnHndlg_McuDiagcData
          OpEventInvalidateNvBlock_InvalidateNvBlock_PS_Rte_NvmBlock_ExcpnHndlg_McuDiagcData: RteEventRef=OpEventInvalidateNvBlock_InvalidateNvBlock_PS_Rte_NvmBlock_ExcpnHndlg_McuDiagcData
          OpEventReadBlock_ReadBlock_PS_Rte_NvmBlock_ExcpnHndlg_McuDiagcData: RteEventRef=OpEventReadBlock_ReadBlock_PS_Rte_NvmBlock_ExcpnHndlg_McuDiagcData
          OpEventGetErrorStatus_GetErrorStatus_PS_Rte_NvmBlock_ExcpnHndlg_McuDiagcData: RteEventRef=OpEventGetErrorStatus_GetErrorStatus_PS_Rte_NvmBlock_ExcpnHndlg_McuDiagcData
          OpEventGetErrorStatus_GetErrorStatus_PS_Rte_NvmBlock_TEstimn_TFilStVal: RteEventRef=OpEventGetErrorStatus_GetErrorStatus_PS_Rte_NvmBlock_TEstimn_TFilStVal
          OpEventInvalidateNvBlock_InvalidateNvBlock_PS_Rte_NvmBlock_TEstimn_TFilStVal: RteEventRef=OpEventInvalidateNvBlock_InvalidateNvBlock_PS_Rte_NvmBlock_TEstimn_TFilStVal
          OpEventSetRamBlockStatus_SetRamBlockStatus_PS_Rte_NvmBlock_TEstimn_TFilStVal: RteEventRef=OpEventSetRamBlockStatus_SetRamBlockStatus_PS_Rte_NvmBlock_TEstimn_TFilStVal
          OpEventWriteBlock_WriteBlock_PS_Rte_NvmBlock_TEstimn_TFilStVal: RteEventRef=OpEventWriteBlock_WriteBlock_PS_Rte_NvmBlock_TEstimn_TFilStVal
          OpEventEraseBlock_EraseBlock_PS_Rte_NvmBlock_TEstimn_TFilStVal: RteEventRef=OpEventEraseBlock_EraseBlock_PS_Rte_NvmBlock_TEstimn_TFilStVal
          OpEventSetBlockProtection_SetBlockProtection_PAdmin_Rte_NvmBlock_TEstimn_TFilStVal: RteEventRef=OpEventSetBlockProtection_SetBlockProtection_PAdmin_Rte_NvmBlock_TEstimn_TFilStVal
          OpEventReadBlock_ReadBlock_PS_Rte_NvmBlock_TEstimn_TFilStVal: RteEventRef=OpEventReadBlock_ReadBlock_PS_Rte_NvmBlock_TEstimn_TFilStVal
          OpEventWriteBlock_WriteBlock_PS_NVM_BLOCK_DLOG_SVK_ENTRY: RteEventRef=OpEventWriteBlock_WriteBlock_PS_NVM_BLOCK_DLOG_SVK_ENTRY
          OpEventGetErrorStatus_GetErrorStatus_PS_NVM_BLOCK_DLOG_SVK_ENTRY: RteEventRef=OpEventGetErrorStatus_GetErrorStatus_PS_NVM_BLOCK_DLOG_SVK_ENTRY
          OpEventSetDataIndex_SetDataIndex_PS_NVM_BLOCK_DLOG_SVK_ENTRY: RteEventRef=OpEventSetDataIndex_SetDataIndex_PS_NVM_BLOCK_DLOG_SVK_ENTRY
          OpEventInvalidateNvBlock_InvalidateNvBlock_PS_NVM_BLOCK_DLOG_SVK_ENTRY: RteEventRef=OpEventInvalidateNvBlock_InvalidateNvBlock_PS_NVM_BLOCK_DLOG_SVK_ENTRY
          OpEventSetBlockProtection_SetBlockProtection_PAdmin_NVM_BLOCK_DLOG_SVK_ENTRY: RteEventRef=OpEventSetBlockProtection_SetBlockProtection_PAdmin_NVM_BLOCK_DLOG_SVK_ENTRY
          OpEventEraseBlock_EraseBlock_PS_NVM_BLOCK_DLOG_SVK_ENTRY: RteEventRef=OpEventEraseBlock_EraseBlock_PS_NVM_BLOCK_DLOG_SVK_ENTRY
          OpEventSetRamBlockStatus_SetRamBlockStatus_PS_NVM_BLOCK_DLOG_SVK_ENTRY: RteEventRef=OpEventSetRamBlockStatus_SetRamBlockStatus_PS_NVM_BLOCK_DLOG_SVK_ENTRY
          OpEventReadBlock_ReadBlock_PS_NVM_BLOCK_DLOG_SVK_ENTRY: RteEventRef=OpEventReadBlock_ReadBlock_PS_NVM_BLOCK_DLOG_SVK_ENTRY
          OpEventGetDataIndex_GetDataIndex_PS_NVM_BLOCK_DLOG_SVK_ENTRY: RteEventRef=OpEventGetDataIndex_GetDataIndex_PS_NVM_BLOCK_DLOG_SVK_ENTRY
          OpEventRestoreBlockDefaults_RestoreBlockDefaults_PS_NVM_BLOCK_BOOT_SVK_HISTORY: RteEventRef=OpEventRestoreBlockDefaults_RestoreBlockDefaults_PS_NVM_BLOCK_BOOT_SVK_HISTORY
          OpEventRestoreBlockDefaults_RestoreBlockDefaults_PS_NVM_BLOCK_BOOT_PROG_DATA: RteEventRef=OpEventRestoreBlockDefaults_RestoreBlockDefaults_PS_NVM_BLOCK_BOOT_PROG_DATA
          OpEventGetErrorStatus_GetErrorStatus_PS_Rte_NvmBlock_Darh_DiagnoseMasterEnable: RteEventRef=OpEventGetErrorStatus_GetErrorStatus_PS_Rte_NvmBlock_Darh_DiagnoseMasterEnable
          OpEventSetBlockProtection_SetBlockProtection_PAdmin_Rte_NvmBlock_Darh_DiagnoseMasterEnable: RteEventRef=OpEventSetBlockProtection_SetBlockProtection_PAdmin_Rte_NvmBlock_Darh_DiagnoseMasterEnable
          OpEventWriteBlock_WriteBlock_PS_Rte_NvmBlock_Darh_DiagnoseMasterEnable: RteEventRef=OpEventWriteBlock_WriteBlock_PS_Rte_NvmBlock_Darh_DiagnoseMasterEnable
          OpEventInvalidateNvBlock_InvalidateNvBlock_PS_Rte_NvmBlock_Darh_DiagnoseMasterEnable: RteEventRef=OpEventInvalidateNvBlock_InvalidateNvBlock_PS_Rte_NvmBlock_Darh_DiagnoseMasterEnable
          OpEventSetRamBlockStatus_SetRamBlockStatus_PS_Rte_NvmBlock_Darh_DiagnoseMasterEnable: RteEventRef=OpEventSetRamBlockStatus_SetRamBlockStatus_PS_Rte_NvmBlock_Darh_DiagnoseMasterEnable
          OpEventReadBlock_ReadBlock_PS_Rte_NvmBlock_Darh_DiagnoseMasterEnable: RteEventRef=OpEventReadBlock_ReadBlock_PS_Rte_NvmBlock_Darh_DiagnoseMasterEnable
          OpEventEraseBlock_EraseBlock_PS_Rte_NvmBlock_Darh_DiagnoseMasterEnable: RteEventRef=OpEventEraseBlock_EraseBlock_PS_Rte_NvmBlock_Darh_DiagnoseMasterEnable
          OpEventSetRamBlockStatus_SetRamBlockStatus_PS_Rte_NvmBlock_BmwTunSetHndlr_BmwDesIninIdx: RteEventRef=OpEventSetRamBlockStatus_SetRamBlockStatus_PS_Rte_NvmBlock_BmwTunSetHndlr_BmwDesIninIdx
          OpEventInvalidateNvBlock_InvalidateNvBlock_PS_Rte_NvmBlock_BmwTunSetHndlr_BmwDesIninIdx: RteEventRef=OpEventInvalidateNvBlock_InvalidateNvBlock_PS_Rte_NvmBlock_BmwTunSetHndlr_BmwDesIninIdx
          OpEventReadBlock_ReadBlock_PS_Rte_NvmBlock_BmwTunSetHndlr_BmwDesIninIdx: RteEventRef=OpEventReadBlock_ReadBlock_PS_Rte_NvmBlock_BmwTunSetHndlr_BmwDesIninIdx
          OpEventWriteBlock_WriteBlock_PS_Rte_NvmBlock_BmwTunSetHndlr_BmwDesIninIdx: RteEventRef=OpEventWriteBlock_WriteBlock_PS_Rte_NvmBlock_BmwTunSetHndlr_BmwDesIninIdx
          OpEventGetErrorStatus_GetErrorStatus_PS_Rte_NvmBlock_BmwTunSetHndlr_BmwDesIninIdx: RteEventRef=OpEventGetErrorStatus_GetErrorStatus_PS_Rte_NvmBlock_BmwTunSetHndlr_BmwDesIninIdx
          OpEventSetBlockProtection_SetBlockProtection_PAdmin_Rte_NvmBlock_BmwTunSetHndlr_BmwDesIninIdx: RteEventRef=OpEventSetBlockProtection_SetBlockProtection_PAdmin_Rte_NvmBlock_BmwTunSetHndlr_BmwDesIninIdx
          OpEventEraseBlock_EraseBlock_PS_Rte_NvmBlock_BmwTunSetHndlr_BmwDesIninIdx: RteEventRef=OpEventEraseBlock_EraseBlock_PS_Rte_NvmBlock_BmwTunSetHndlr_BmwDesIninIdx
          OpEventRestoreBlockDefaults_RestoreBlockDefaults_PS_Rte_NvmBlock_BmwTunSetHndlr_BmwDesIninIdx: RteEventRef=OpEventRestoreBlockDefaults_RestoreBlockDefaults_PS_Rte_NvmBlock_BmwTunSetHndlr_BmwDesIninIdx
          OpEventRestoreBlockDefaults_RestoreBlockDefaults_PS_Rte_NvmBlock_Coding_CodingData: RteEventRef=OpEventRestoreBlockDefaults_RestoreBlockDefaults_PS_Rte_NvmBlock_Coding_CodingData
          OpEventGetErrorStatus_GetErrorStatus_PS_Rte_NvmBlock_Coding_CodingData: RteEventRef=OpEventGetErrorStatus_GetErrorStatus_PS_Rte_NvmBlock_Coding_CodingData
          OpEventReadBlock_ReadBlock_PS_Rte_NvmBlock_Coding_CodingData: RteEventRef=OpEventReadBlock_ReadBlock_PS_Rte_NvmBlock_Coding_CodingData
          OpEventEraseBlock_EraseBlock_PS_Rte_NvmBlock_Coding_CodingData: RteEventRef=OpEventEraseBlock_EraseBlock_PS_Rte_NvmBlock_Coding_CodingData
          OpEventWriteBlock_WriteBlock_PS_Rte_NvmBlock_Coding_CodingData: RteEventRef=OpEventWriteBlock_WriteBlock_PS_Rte_NvmBlock_Coding_CodingData
          OpEventSetRamBlockStatus_SetRamBlockStatus_PS_Rte_NvmBlock_Coding_CodingData: RteEventRef=OpEventSetRamBlockStatus_SetRamBlockStatus_PS_Rte_NvmBlock_Coding_CodingData
          OpEventSetBlockProtection_SetBlockProtection_PAdmin_Rte_NvmBlock_Coding_CodingData: RteEventRef=OpEventSetBlockProtection_SetBlockProtection_PAdmin_Rte_NvmBlock_Coding_CodingData
          OpEventInvalidateNvBlock_InvalidateNvBlock_PS_Rte_NvmBlock_Coding_CodingData: RteEventRef=OpEventInvalidateNvBlock_InvalidateNvBlock_PS_Rte_NvmBlock_Coding_CodingData
          OpEventSetBlockProtection_SetBlockProtection_PAdmin_Rte_NvmBlock_BmwTunSetHndlr_NvmBmwDesIninOptSetAIdx: RteEventRef=OpEventSetBlockProtection_SetBlockProtection_PAdmin_Rte_NvmBlock_BmwTunSetHndlr_NvmBmwDesIninOptSetAIdx
          OpEventInvalidateNvBlock_InvalidateNvBlock_PS_Rte_NvmBlock_BmwTunSetHndlr_NvmBmwDesIninOptSetAIdx: RteEventRef=OpEventInvalidateNvBlock_InvalidateNvBlock_PS_Rte_NvmBlock_BmwTunSetHndlr_NvmBmwDesIninOptSetAIdx
          OpEventSetRamBlockStatus_SetRamBlockStatus_PS_Rte_NvmBlock_BmwTunSetHndlr_NvmBmwDesIninOptSetAIdx: RteEventRef=OpEventSetRamBlockStatus_SetRamBlockStatus_PS_Rte_NvmBlock_BmwTunSetHndlr_NvmBmwDesIninOptSetAIdx
          OpEventReadBlock_ReadBlock_PS_Rte_NvmBlock_BmwTunSetHndlr_NvmBmwDesIninOptSetAIdx: RteEventRef=OpEventReadBlock_ReadBlock_PS_Rte_NvmBlock_BmwTunSetHndlr_NvmBmwDesIninOptSetAIdx
          OpEventWriteBlock_WriteBlock_PS_Rte_NvmBlock_BmwTunSetHndlr_NvmBmwDesIninOptSetAIdx: RteEventRef=OpEventWriteBlock_WriteBlock_PS_Rte_NvmBlock_BmwTunSetHndlr_NvmBmwDesIninOptSetAIdx
          OpEventGetErrorStatus_GetErrorStatus_PS_Rte_NvmBlock_BmwTunSetHndlr_NvmBmwDesIninOptSetAIdx: RteEventRef=OpEventGetErrorStatus_GetErrorStatus_PS_Rte_NvmBlock_BmwTunSetHndlr_NvmBmwDesIninOptSetAIdx
          OpEventEraseBlock_EraseBlock_PS_Rte_NvmBlock_BmwTunSetHndlr_NvmBmwDesIninOptSetAIdx: RteEventRef=OpEventEraseBlock_EraseBlock_PS_Rte_NvmBlock_BmwTunSetHndlr_NvmBmwDesIninOptSetAIdx
          OpEventRestoreBlockDefaults_RestoreBlockDefaults_PS_Rte_NvmBlock_BmwTunSetHndlr_NvmBmwDesIninOptSetAIdx: RteEventRef=OpEventRestoreBlockDefaults_RestoreBlockDefaults_PS_Rte_NvmBlock_BmwTunSetHndlr_NvmBmwDesIninOptSetAIdx
          OpEventEraseBlock_EraseBlock_PS_Rte_NvmBlock_BmwDiagcSrvHndlg_MilesKmEeprom: RteEventRef=OpEventEraseBlock_EraseBlock_PS_Rte_NvmBlock_BmwDiagcSrvHndlg_MilesKmEeprom
          OpEventInvalidateNvBlock_InvalidateNvBlock_PS_Rte_NvmBlock_BmwDiagcSrvHndlg_MilesKmEeprom: RteEventRef=OpEventInvalidateNvBlock_InvalidateNvBlock_PS_Rte_NvmBlock_BmwDiagcSrvHndlg_MilesKmEeprom
          OpEventWriteBlock_WriteBlock_PS_Rte_NvmBlock_BmwDiagcSrvHndlg_MilesKmEeprom: RteEventRef=OpEventWriteBlock_WriteBlock_PS_Rte_NvmBlock_BmwDiagcSrvHndlg_MilesKmEeprom
          OpEventSetBlockProtection_SetBlockProtection_PAdmin_Rte_NvmBlock_BmwDiagcSrvHndlg_MilesKmEeprom: RteEventRef=OpEventSetBlockProtection_SetBlockProtection_PAdmin_Rte_NvmBlock_BmwDiagcSrvHndlg_MilesKmEeprom
          OpEventGetErrorStatus_GetErrorStatus_PS_Rte_NvmBlock_BmwDiagcSrvHndlg_MilesKmEeprom: RteEventRef=OpEventGetErrorStatus_GetErrorStatus_PS_Rte_NvmBlock_BmwDiagcSrvHndlg_MilesKmEeprom
          OpEventReadBlock_ReadBlock_PS_Rte_NvmBlock_BmwDiagcSrvHndlg_MilesKmEeprom: RteEventRef=OpEventReadBlock_ReadBlock_PS_Rte_NvmBlock_BmwDiagcSrvHndlg_MilesKmEeprom
          OpEventSetRamBlockStatus_SetRamBlockStatus_PS_Rte_NvmBlock_BmwDiagcSrvHndlg_MilesKmEeprom: RteEventRef=OpEventSetRamBlockStatus_SetRamBlockStatus_PS_Rte_NvmBlock_BmwDiagcSrvHndlg_MilesKmEeprom
          OpEventGetErrorStatus_GetErrorStatus_PS_Rte_NvmBlock_BmwDiagcSrvHndlg_ProgCntr: RteEventRef=OpEventGetErrorStatus_GetErrorStatus_PS_Rte_NvmBlock_BmwDiagcSrvHndlg_ProgCntr
          OpEventInvalidateNvBlock_InvalidateNvBlock_PS_Rte_NvmBlock_BmwDiagcSrvHndlg_ProgCntr: RteEventRef=OpEventInvalidateNvBlock_InvalidateNvBlock_PS_Rte_NvmBlock_BmwDiagcSrvHndlg_ProgCntr
          OpEventSetRamBlockStatus_SetRamBlockStatus_PS_Rte_NvmBlock_BmwDiagcSrvHndlg_ProgCntr: RteEventRef=OpEventSetRamBlockStatus_SetRamBlockStatus_PS_Rte_NvmBlock_BmwDiagcSrvHndlg_ProgCntr
          OpEventEraseBlock_EraseBlock_PS_Rte_NvmBlock_BmwDiagcSrvHndlg_ProgCntr: RteEventRef=OpEventEraseBlock_EraseBlock_PS_Rte_NvmBlock_BmwDiagcSrvHndlg_ProgCntr
          OpEventReadBlock_ReadBlock_PS_Rte_NvmBlock_BmwDiagcSrvHndlg_ProgCntr: RteEventRef=OpEventReadBlock_ReadBlock_PS_Rte_NvmBlock_BmwDiagcSrvHndlg_ProgCntr
          OpEventSetBlockProtection_SetBlockProtection_PAdmin_Rte_NvmBlock_BmwDiagcSrvHndlg_ProgCntr: RteEventRef=OpEventSetBlockProtection_SetBlockProtection_PAdmin_Rte_NvmBlock_BmwDiagcSrvHndlg_ProgCntr
          OpEventWriteBlock_WriteBlock_PS_Rte_NvmBlock_BmwDiagcSrvHndlg_ProgCntr: RteEventRef=OpEventWriteBlock_WriteBlock_PS_Rte_NvmBlock_BmwDiagcSrvHndlg_ProgCntr
          OpEventEraseBlock_EraseBlock_PS_Rte_NvmBlock_BmwDiagcSrvHndlg_ProgCntrMaxVal: RteEventRef=OpEventEraseBlock_EraseBlock_PS_Rte_NvmBlock_BmwDiagcSrvHndlg_ProgCntrMaxVal
          OpEventInvalidateNvBlock_InvalidateNvBlock_PS_Rte_NvmBlock_BmwDiagcSrvHndlg_ProgCntrMaxVal: RteEventRef=OpEventInvalidateNvBlock_InvalidateNvBlock_PS_Rte_NvmBlock_BmwDiagcSrvHndlg_ProgCntrMaxVal
          OpEventReadBlock_ReadBlock_PS_Rte_NvmBlock_BmwDiagcSrvHndlg_ProgCntrMaxVal: RteEventRef=OpEventReadBlock_ReadBlock_PS_Rte_NvmBlock_BmwDiagcSrvHndlg_ProgCntrMaxVal
          OpEventSetBlockProtection_SetBlockProtection_PAdmin_Rte_NvmBlock_BmwDiagcSrvHndlg_ProgCntrMaxVal: RteEventRef=OpEventSetBlockProtection_SetBlockProtection_PAdmin_Rte_NvmBlock_BmwDiagcSrvHndlg_ProgCntrMaxVal
          OpEventWriteBlock_WriteBlock_PS_Rte_NvmBlock_BmwDiagcSrvHndlg_ProgCntrMaxVal: RteEventRef=OpEventWriteBlock_WriteBlock_PS_Rte_NvmBlock_BmwDiagcSrvHndlg_ProgCntrMaxVal
          OpEventSetRamBlockStatus_SetRamBlockStatus_PS_Rte_NvmBlock_BmwDiagcSrvHndlg_ProgCntrMaxVal: RteEventRef=OpEventSetRamBlockStatus_SetRamBlockStatus_PS_Rte_NvmBlock_BmwDiagcSrvHndlg_ProgCntrMaxVal
          OpEventGetErrorStatus_GetErrorStatus_PS_Rte_NvmBlock_BmwDiagcSrvHndlg_ProgCntrMaxVal: RteEventRef=OpEventGetErrorStatus_GetErrorStatus_PS_Rte_NvmBlock_BmwDiagcSrvHndlg_ProgCntrMaxVal
          OpEventRestoreBlockDefaults_RestoreBlockDefaults_PS_Rte_NvmBlock_BmwDiagcSrvHndlg_ProgCntrMaxVal: RteEventRef=OpEventRestoreBlockDefaults_RestoreBlockDefaults_PS_Rte_NvmBlock_BmwDiagcSrvHndlg_ProgCntrMaxVal
          OpEventEraseBlock_EraseBlock_PS_Rte_NvmBlock_BmwDiagcSrvHndlg_TestStamp: RteEventRef=OpEventEraseBlock_EraseBlock_PS_Rte_NvmBlock_BmwDiagcSrvHndlg_TestStamp
          OpEventSetBlockProtection_SetBlockProtection_PAdmin_Rte_NvmBlock_BmwDiagcSrvHndlg_TestStamp: RteEventRef=OpEventSetBlockProtection_SetBlockProtection_PAdmin_Rte_NvmBlock_BmwDiagcSrvHndlg_TestStamp
          OpEventWriteBlock_WriteBlock_PS_Rte_NvmBlock_BmwDiagcSrvHndlg_TestStamp: RteEventRef=OpEventWriteBlock_WriteBlock_PS_Rte_NvmBlock_BmwDiagcSrvHndlg_TestStamp
          OpEventReadBlock_ReadBlock_PS_Rte_NvmBlock_BmwDiagcSrvHndlg_TestStamp: RteEventRef=OpEventReadBlock_ReadBlock_PS_Rte_NvmBlock_BmwDiagcSrvHndlg_TestStamp
          OpEventSetRamBlockStatus_SetRamBlockStatus_PS_Rte_NvmBlock_BmwDiagcSrvHndlg_TestStamp: RteEventRef=OpEventSetRamBlockStatus_SetRamBlockStatus_PS_Rte_NvmBlock_BmwDiagcSrvHndlg_TestStamp
          OpEventInvalidateNvBlock_InvalidateNvBlock_PS_Rte_NvmBlock_BmwDiagcSrvHndlg_TestStamp: RteEventRef=OpEventInvalidateNvBlock_InvalidateNvBlock_PS_Rte_NvmBlock_BmwDiagcSrvHndlg_TestStamp
          OpEventGetErrorStatus_GetErrorStatus_PS_Rte_NvmBlock_BmwDiagcSrvHndlg_TestStamp: RteEventRef=OpEventGetErrorStatus_GetErrorStatus_PS_Rte_NvmBlock_BmwDiagcSrvHndlg_TestStamp
          OpEventEraseBlock_EraseBlock_PS_Rte_NvmBlock_PullCmpActv_PullCmpLongTerm: RteEventRef=OpEventEraseBlock_EraseBlock_PS_Rte_NvmBlock_PullCmpActv_PullCmpLongTerm
          OpEventReadBlock_ReadBlock_PS_Rte_NvmBlock_PullCmpActv_PullCmpLongTerm: RteEventRef=OpEventReadBlock_ReadBlock_PS_Rte_NvmBlock_PullCmpActv_PullCmpLongTerm
          OpEventSetRamBlockStatus_SetRamBlockStatus_PS_Rte_NvmBlock_PullCmpActv_PullCmpLongTerm: RteEventRef=OpEventSetRamBlockStatus_SetRamBlockStatus_PS_Rte_NvmBlock_PullCmpActv_PullCmpLongTerm
          OpEventWriteBlock_WriteBlock_PS_Rte_NvmBlock_PullCmpActv_PullCmpLongTerm: RteEventRef=OpEventWriteBlock_WriteBlock_PS_Rte_NvmBlock_PullCmpActv_PullCmpLongTerm
          OpEventSetBlockProtection_SetBlockProtection_PAdmin_Rte_NvmBlock_PullCmpActv_PullCmpLongTerm: RteEventRef=OpEventSetBlockProtection_SetBlockProtection_PAdmin_Rte_NvmBlock_PullCmpActv_PullCmpLongTerm
          OpEventInvalidateNvBlock_InvalidateNvBlock_PS_Rte_NvmBlock_PullCmpActv_PullCmpLongTerm: RteEventRef=OpEventInvalidateNvBlock_InvalidateNvBlock_PS_Rte_NvmBlock_PullCmpActv_PullCmpLongTerm
          OpEventGetErrorStatus_GetErrorStatus_PS_Rte_NvmBlock_PullCmpActv_PullCmpLongTerm: RteEventRef=OpEventGetErrorStatus_GetErrorStatus_PS_Rte_NvmBlock_PullCmpActv_PullCmpLongTerm
          OpEventRestoreBlockDefaults_RestoreBlockDefaults_PS_Rte_NvmBlock_PullCmpActv_PullCmpLongTerm: RteEventRef=OpEventRestoreBlockDefaults_RestoreBlockDefaults_PS_Rte_NvmBlock_PullCmpActv_PullCmpLongTerm
      WdgM_Appl10_EcuSwComposition: RteSoftwareComponentInstanceRef=WdgM_Appl10
        28 x RteEventToTaskMapping, all with RteImmediateRestart=false:
          OpEventGetFirstExpiredSEID_GetFirstExpiredSEID_general_Core0: RteEventRef=OpEventGetFirstExpiredSEID_GetFirstExpiredSEID_general_Core0
          OpEventGetLocalStatus_GetLocalStatus_localStatus_SE_4ms_Appl10: RteEventRef=OpEventGetLocalStatus_GetLocalStatus_localStatus_SE_4ms_Appl10
          OpEventGetLocalStatus_GetLocalStatus_localStatus_SE_10ms_Appl10: RteEventRef=OpEventGetLocalStatus_GetLocalStatus_localStatus_SE_10ms_Appl10
          OpEventGetLocalStatus_GetLocalStatus_localStatus_SE_100ms_Appl10: RteEventRef=OpEventGetLocalStatus_GetLocalStatus_localStatus_SE_100ms_Appl10
          OpEventGetGlobalStatus_GetGlobalStatus_general_Core0: RteEventRef=OpEventGetGlobalStatus_GetGlobalStatus_general_Core0
          OpEventGetMode_GetMode_general_Core0: RteEventRef=OpEventGetMode_GetMode_general_Core0
          OpEventSetMode_SetMode_general_Core0: RteEventRef=OpEventSetMode_SetMode_general_Core0
          Timer_WdgM_MainFunction: RtePositionInTask=0, RteEventRef=Timer_WdgM_MainFunction, RteMappedToTaskRef=Task_4msBsw_Appl10, RteUsedOsAlarmRef=Rte_Al_TE2_Task_4msBsw_Appl10_0_4ms
          OpEventGetLocalStatus_GetLocalStatus_general_Core0: RteEventRef=OpEventGetLocalStatus_GetLocalStatus_general_Core0
          OpEventGetLocalStatus_GetLocalStatus_localStatus_SE_10msBsw_Appl10: RteEventRef=OpEventGetLocalStatus_GetLocalStatus_localStatus_SE_10msBsw_Appl10
          OpEventPerformReset_PerformReset_general_Core0: RteEventRef=OpEventPerformReset_PerformReset_general_Core0
          OpEventCheckpointReached_CheckpointReached_alive_SE_10msBsw_Appl10_ChkPt_10msBsw_Appl10_Strt: RteEventRef=OpEventCheckpointReached_CheckpointReached_alive_SE_10msBsw_Appl10_ChkPt_10msBsw_Appl10_Strt
          OpEventCheckpointReached_CheckpointReached_alive_SE_10ms_Appl10_ChkPt_10ms_Appl10_Strt: RteEventRef=OpEventCheckpointReached_CheckpointReached_alive_SE_10ms_Appl10_ChkPt_10ms_Appl10_Strt
          OpEventCheckpointReached_CheckpointReached_alive_SE_10ms_Appl10_ChkPt_10ms_Appl10_End: RteEventRef=OpEventCheckpointReached_CheckpointReached_alive_SE_10ms_Appl10_ChkPt_10ms_Appl10_End
          OpEventCheckpointReached_CheckpointReached_alive_SE_100ms_Appl10_ChkPt_100ms_Appl10_Strt: RteEventRef=OpEventCheckpointReached_CheckpointReached_alive_SE_100ms_Appl10_ChkPt_100ms_Appl10_Strt
          OpEventCheckpointReached_CheckpointReached_alive_SE_4ms_Appl10_ChkPt_4ms_Appl10_End: RteEventRef=OpEventCheckpointReached_CheckpointReached_alive_SE_4ms_Appl10_ChkPt_4ms_Appl10_End
          OpEventCheckpointReached_CheckpointReached_alive_SE_100ms_Appl10_ChkPt_100ms_Appl10_End: RteEventRef=OpEventCheckpointReached_CheckpointReached_alive_SE_100ms_Appl10_ChkPt_100ms_Appl10_End
          OpEventCheckpointReached_CheckpointReached_alive_SE_4ms_Appl10_ChkPt_4ms_Appl10_Strt: RteEventRef=OpEventCheckpointReached_CheckpointReached_alive_SE_4ms_Appl10_ChkPt_4ms_Appl10_Strt
          OpEventCheckpointReached_CheckpointReached_alive_SE_10msBsw_Appl10_ChkPt_10msBsw_Appl10_End: RteEventRef=OpEventCheckpointReached_CheckpointReached_alive_SE_10msBsw_Appl10_ChkPt_10msBsw_Appl10_End
          OpEventCheckpointReached_CheckpointReached_alive_SE_2msA_Appl10_ChkPt_2msA_Appl10_End: RteEventRef=OpEventCheckpointReached_CheckpointReached_alive_SE_2msA_Appl10_ChkPt_2msA_Appl10_End
          OpEventGetLocalStatus_GetLocalStatus_localStatus_SE_2msA_Appl10: RteEventRef=OpEventGetLocalStatus_GetLocalStatus_localStatus_SE_2msA_Appl10
          OpEventCheckpointReached_CheckpointReached_alive_SE_2msA_Appl10_ChkPt_2msA_Appl10_Strt: RteEventRef=OpEventCheckpointReached_CheckpointReached_alive_SE_2msA_Appl10_ChkPt_2msA_Appl10_Strt
          OpEventCheckpointReached_CheckpointReached_alive_SE_2msA_Appl10_ChkPt_GblFinal: RteEventRef=OpEventCheckpointReached_CheckpointReached_alive_SE_2msA_Appl10_ChkPt_GblFinal
          OpEventCheckpointReached_CheckpointReached_alive_SE_2msB_Appl10_ChkPt_2msB_Appl10_Strt: RteEventRef=OpEventCheckpointReached_CheckpointReached_alive_SE_2msB_Appl10_ChkPt_2msB_Appl10_Strt
          OpEventGetLocalStatus_GetLocalStatus_localStatus_SE_2msB_Appl10: RteEventRef=OpEventGetLocalStatus_GetLocalStatus_localStatus_SE_2msB_Appl10
          OpEventCheckpointReached_CheckpointReached_alive_SE_2msB_Appl10_ChkPt_2msB_Appl10_End: RteEventRef=OpEventCheckpointReached_CheckpointReached_alive_SE_2msB_Appl10_ChkPt_2msB_Appl10_End
          OpEventActivateSupervisionEntity_ActivateSupervisionEntity_general_Core0: RteEventRef=OpEventActivateSupervisionEntity_ActivateSupervisionEntity_general_Core0
          OpEventDeactivateSupervisionEntity_DeactivateSupervisionEntity_general_Core0: RteEventRef=OpEventDeactivateSupervisionEntity_DeactivateSupervisionEntity_general_Core0
      McalErrHndlg_EcuSwComposition: RteSoftwareComponentInstanceRef=McalErrHndlg
        McalErrHndlg_InitEvent (RteEventToTaskMapping): RteImmediateRestart=false, RtePositionInTask=78, RteEventRef=McalErrHndlg_InitEvent, RteMappedToTaskRef=Task_Init_Appl10
        TMT_McalErrHndlgPer1 (RteEventToTaskMapping):
          RteImmediateRestart = false
          RtePositionInTask = 5
          RteEventRef = TMT_McalErrHndlgPer1
          RteMappedToTaskRef = Task_10ms_Appl10
          RteUsedOsAlarmRef = Rte_Al_TE_Task_10ms_Appl10_0_10ms
          RteUsedOsEventRef = Rte_Ev_Cyclic_Task_10ms_Appl10_0_10ms
      CDD_NxtrTi_EcuSwComposition: RteSoftwareComponentInstanceRef=CDD_NxtrTi
        NxtrTiExclusiveArea (RteExclusiveAreaImplementation): RteExclusiveAreaImplMechanism=OS_INTERRUPT_BLOCKING, RteExclusiveAreaOptimization=false, RteExclusiveAreaRef=NxtrTiExclusiveArea
        6 x RteEventToTaskMapping, all with RteImmediateRestart=false:
          OIT_GetRefTmr1MicroSec32bit_Oper_GetRefTmr1MicroSec32bit_Oper: RteEventRef=OIT_GetRefTmr1MicroSec32bit_Oper_GetRefTmr1MicroSec32bit_Oper
          OIT_GetRefTmr100MicroSec32bit_Oper_GetRefTmr100MicroSec32bit_Oper: RteEventRef=OIT_GetRefTmr100MicroSec32bit_Oper_GetRefTmr100MicroSec32bit_Oper
          OIT_GetTiSpan100MicroSec32bit_Oper_GetTiSpan100MicroSec32bit_Oper: RteEventRef=OIT_GetTiSpan100MicroSec32bit_Oper_GetTiSpan100MicroSec32bit_Oper
          NxtrTiInit1_InitEvent: RtePositionInTask=0, RteEventRef=NxtrTiInit1_InitEvent, RteMappedToTaskRef=Task_Init_Appl10
          TMT_NxtrTiPer1: RtePositionInTask=4, RteEventRef=TMT_NxtrTiPer1, RteMappedToTaskRef=Task_2msA_Appl10, RteUsedOsAlarmRef=Rte_Al_TE_Task_2msA_Appl10_0_2ms
          OIT_GetTiSpan1MicroSec32bit_Oper_GetTiSpan1MicroSec32bit_Oper: RteEventRef=OIT_GetTiSpan1MicroSec32bit_Oper_GetTiSpan1MicroSec32bit_Oper
      NxtrMath_EcuSwComposition: RteSoftwareComponentInstanceRef=NxtrMath
        NxtrMath_InitEvent (RteEventToTaskMapping): RteImmediateRestart=false, RtePositionInTask=73, RteEventRef=NxtrMath_InitEvent, RteMappedToTaskRef=Task_Init_Appl10
        TMT_NxtrMathPer1 (RteEventToTaskMapping):
          RteImmediateRestart = false
          RtePositionInTask = 14
          RteEventRef = TMT_NxtrMathPer1
          RteMappedToTaskRef = Task_100ms_Appl10
          RteUsedOsAlarmRef = Rte_Al_TE_Task_100ms_Appl10_0_100ms
          RteUsedOsEventRef = Rte_Ev_Cyclic_Task_100ms_Appl10_0_100ms
      McuErrInj_EcuSwComposition: RteSoftwareComponentInstanceRef=McuErrInj
        6 x RteEventToTaskMapping, all with RteImmediateRestart=false:
          McuErrInj_InitEvent: RtePositionInTask=76, RteEventRef=McuErrInj_InitEvent, RteMappedToTaskRef=Task_Init_Appl10
          OIT_ReadErrInjReg_Oper_ReadErrInjReg_Oper: RteEventRef=OIT_ReadErrInjReg_Oper_ReadErrInjReg_Oper
          TMT_McuFltInjPer1: RtePositionInTask=7, RteEventRef=TMT_McuFltInjPer1, RteMappedToTaskRef=Task_2msA_Appl10, RteUsedOsAlarmRef=Rte_Al_TE_Task_2msA_Appl10_0_2ms
          OIT_StrtErrInjCntr_Oper_StrtErrInjCntr_Oper: RteEventRef=OIT_StrtErrInjCntr_Oper_StrtErrInjCntr_Oper
          OIT_UpdErrInjReg_Oper_UpdErrInjReg_Oper: RteEventRef=OIT_UpdErrInjReg_Oper_UpdErrInjReg_Oper
          OIT_ClrErrInjReg_Oper_ClrErrInjReg_Oper: RteEventRef=OIT_ClrErrInjReg_Oper_ClrErrInjReg_Oper
      CDD_ExcpnHndlg_EcuSwComposition: RteSoftwareComponentInstanceRef=CDD_ExcpnHndlg
        4 x RteEventToTaskMapping, all with RteImmediateRestart=false:
          TMT_ExcpnHndlgPer1: RtePositionInTask=5, RteEventRef=TMT_ExcpnHndlgPer1, RteMappedToTaskRef=Task_2msA_Appl10, RteUsedOsAlarmRef=Rte_Al_TE_Task_2msA_Appl10_0_2ms
          CDD_ExcpnHndlg_InitEvent: RtePositionInTask=7, RteEventRef=CDD_ExcpnHndlg_InitEvent, RteMappedToTaskRef=Task_Init_Appl10
          OIT_ChkForStrtUpTest_Oper_ChkForStrtUpTest_Oper: RteEventRef=OIT_ChkForStrtUpTest_Oper_ChkForStrtUpTest_Oper
          OIT_GetMcuDiagcSpplData_Oper_GetMcuDiagcSpplData_Oper: RteEventRef=OIT_GetMcuDiagcSpplData_Oper_GetMcuDiagcSpplData_Oper
        NvmBlock_CDD_ExcpnHndlg_NvmMcuDiagcData (RteNvRamAllocation):
          RteNvmRamBlockLocationSymbol = Rte_CDD_ExcpnHndlg_McuDiagcData
          RteNvmRomBlockLocationSymbol = Rte_McuDiagcDataDft
          RteNvmBlockRef = Rte_NvmBlock_ExcpnHndlg_McuDiagcData
          RteSwNvRamMappingRef = NvmMcuDiagcData
      DiagcMgrProxyAppl10_EcuSwComposition: RteSoftwareComponentInstanceRef=DiagcMgrProxyAppl10
        DiagcMgrProxyAppl10 (RteExclusiveAreaImplementation): RteExclusiveAreaImplMechanism=OS_INTERRUPT_BLOCKING, RteExclusiveAreaOptimization=false, RteExclusiveAreaRef=DiagcMgrProxyAppl10
        10 x RteEventToTaskMapping, all with RteImmediateRestart=false:
          OIT_SetNtcSts10_Oper_SetNtcSts10_Oper: RteEventRef=OIT_SetNtcSts10_Oper_SetNtcSts10_Oper
          OIT_GetNtcSts10_Oper_GetNtcSts10_Oper: RteEventRef=OIT_GetNtcSts10_Oper_GetNtcSts10_Oper
          OIT_GetNtcQlfrSts10_Oper_GetNtcQlfrSts10_Oper: RteEventRef=OIT_GetNtcQlfrSts10_Oper_GetNtcQlfrSts10_Oper
          DiagcMgrProxyAppl10_InitEvent: RtePositionInTask=2, RteEventRef=DiagcMgrProxyAppl10_InitEvent, RteMappedToTaskRef=Task_Init_Appl10
          OIT_SetNtcStsAndSnpshtData10_Oper_SetNtcStsAndSnpshtData10_Oper: RteEventRef=OIT_SetNtcStsAndSnpshtData10_Oper_SetNtcStsAndSnpshtData10_Oper
          OIT_GetNtcInfoAppl10_Oper_GetNtcInfoAppl10_Oper: RteEventRef=OIT_GetNtcInfoAppl10_Oper_GetNtcInfoAppl10_Oper
          OIT_GetNtcActv10_Oper_GetNtcActv10_Oper: RteEventRef=OIT_GetNtcActv10_Oper_GetNtcActv10_Oper
          TMT_DiagcMgrProxyAppl10Per1: RtePositionInTask=1, RteEventRef=TMT_DiagcMgrProxyAppl10Per1, RteMappedToTaskRef=Task_10ms_Appl10, RteUsedOsAlarmRef=Rte_Al_TE_Task_10ms_Appl10_0_10ms, RteUsedOsEventRef=Rte_Ev_Cyclic_Task_10ms_Appl10_0_10ms
          OIT_GetDiagcDataAppl10_Oper_GetDiagcDataAppl10_Oper: RteEventRef=OIT_GetDiagcDataAppl10_Oper_GetDiagcDataAppl10_Oper
          OIT_GetNtcDebCntrAppl10_Oper_GetNtcDebCntrAppl10_Oper: RteEventRef=OIT_GetNtcDebCntrAppl10_Oper_GetNtcDebCntrAppl10_Oper
      SysStMod_EcuSwComposition: RteSoftwareComponentInstanceRef=SysStMod
        SysStMod_InitEvent (RteEventToTaskMapping): RteImmediateRestart=false, RtePositionInTask=6, RteEventRef=SysStMod_InitEvent, RteMappedToTaskRef=Task_Init_Appl10
        TMT_SysStModPer1 (RteEventToTaskMapping):
          RteImmediateRestart = false
          RtePositionInTask = 30
          RteEventRef = TMT_SysStModPer1
          RteMappedToTaskRef = Task_2msB_Appl10
          RteUsedOsAlarmRef = Rte_Al_TE_Task_2msB_Appl10_0_2ms
      DiagcMgrStub_EcuSwComposition: RteSoftwareComponentInstanceRef=DiagcMgrStub
        4 x RteEventToTaskMapping, all with RteImmediateRestart=false:
          OIT_GetNtcInfoStub_Oper_GetNtcInfoStub_Oper: RteEventRef=OIT_GetNtcInfoStub_Oper_GetNtcInfoStub_Oper
          DiagcMgrStub_InitEvent: RtePositionInTask=77, RteEventRef=DiagcMgrStub_InitEvent, RteMappedToTaskRef=Task_Init_Appl10
          OIT_GetDiagcDataStub_Oper_GetDiagcDataStub_Oper: RteEventRef=OIT_GetDiagcDataStub_Oper_GetDiagcDataStub_Oper
          OIT_GetNtcDebCntrStub_Oper_GetNtcDebCntrStub_Oper: RteEventRef=OIT_GetNtcDebCntrStub_Oper_GetNtcDebCntrStub_Oper
      DiagcMgr_EcuSwComposition: RteSoftwareComponentInstanceRef=DiagcMgr
        DiagcMgrExclusiveArea (RteExclusiveAreaImplementation): RteExclusiveAreaImplMechanism=OS_INTERRUPT_BLOCKING, RteExclusiveAreaOptimization=false, RteExclusiveAreaRef=DiagcMgrExclusiveArea
        3 x RteNvRamAllocation:
          NvmBlock_DiagcMgr_NvmDiagcMgrNtcFltAry: RteNvmRamBlockLocationSymbol=Rte_DiagcMgr_DiagcMgrNtcFltAry, RteNvmBlockRef=Rte_NvmBlock_DiagcMgr_DiagcMgrNtcFltAry, RteSwNvRamMappingRef=NvmDiagcMgrNtcFltAry
          NvmBlock_DiagcMgr_NvMDiagcMgrApplCrc: RteNvmRamBlockLocationSymbol=Rte_DiagcMgr_DiagcMgrApplCrc, RteNvmRomBlockLocationSymbol=Rte_DiagcMgrApplCrcDft, RteNvmBlockRef=Rte_NvmBlock_DiagcMgr_DiagcMgrApplCrc, RteSwNvRamMappingRef=NvMDiagcMgrApplCrc
          NvmBlock_DiagcMgr_NvmDiagcMgrLtchCntrAry: RteNvmRamBlockLocationSymbol=Rte_DiagcMgr_DiagcMgrLtchCntrAry, RteNvmBlockRef=Rte_NvmBlock_DiagcMgr_DiagcMgrLtchCntrAry, RteSwNvRamMappingRef=NvmDiagcMgrLtchCntrAry
        22 x RteEventToTaskMapping, all with RteImmediateRestart=false:
          OIT_CnvSnpshtData_u08_Oper_CnvSnpshtData_u08_Oper: RteEventRef=OIT_CnvSnpshtData_u08_Oper_CnvSnpshtData_u08_Oper
          OIT_ReadSnpshtData_Oper_ReadSnpshtData_Oper: RteEventRef=OIT_ReadSnpshtData_Oper_ReadSnpshtData_Oper
          OIT_ClrAllDiagc_Oper_ClrAllDiagc_Oper: RteEventRef=OIT_ClrAllDiagc_Oper_ClrAllDiagc_Oper
          OIT_ReadNtcInfoAndDebCntr_Oper_ReadNtcInfoAndDebCntr_Oper: RteEventRef=OIT_ReadNtcInfoAndDebCntr_Oper_ReadNtcInfoAndDebCntr_Oper
          OIT_ClrSnpshtData_Oper_ClrSnpshtData_Oper: RteEventRef=OIT_ClrSnpshtData_Oper_ClrSnpshtData_Oper
          OIT_CnvSnpshtData_s16_Oper_CnvSnpshtData_s16_Oper: RteEventRef=OIT_CnvSnpshtData_s16_Oper_CnvSnpshtData_s16_Oper
          OIT_ReadLtchCntrData_Oper_ReadLtchCntrData_Oper: RteEventRef=OIT_ReadLtchCntrData_Oper_ReadLtchCntrData_Oper
          OIT_CnvSnpshtData_s08_Oper_CnvSnpshtData_s08_Oper: RteEventRef=OIT_CnvSnpshtData_s08_Oper_CnvSnpshtData_s08_Oper
          OIT_GetNtcQlfrStsCore_Oper_GetNtcQlfrStsCore_Oper: RteEventRef=OIT_GetNtcQlfrStsCore_Oper_GetNtcQlfrStsCore_Oper
          OIT_CnvSnpshtData_f32_Oper_CnvSnpshtData_f32_Oper: RteEventRef=OIT_CnvSnpshtData_f32_Oper_CnvSnpshtData_f32_Oper
          OIT_ClrLtchCntrData_Oper_ClrLtchCntrData_Oper: RteEventRef=OIT_ClrLtchCntrData_Oper_ClrLtchCntrData_Oper
          OIT_CnvSnpshtData_u16_Oper_CnvSnpshtData_u16_Oper: RteEventRef=OIT_CnvSnpshtData_u16_Oper_CnvSnpshtData_u16_Oper
          OIT_GetNtcActvCore_Oper_GetNtcActvCore_Oper: RteEventRef=OIT_GetNtcActvCore_Oper_GetNtcActvCore_Oper
          OIT_SetNtcStsCore_Oper_SetNtcStsCore_Oper: RteEventRef=OIT_SetNtcStsCore_Oper_SetNtcStsCore_Oper
          OIT_DiagcMgrIninCore_Oper_DiagcMgrIninCore_Oper: RteEventRef=OIT_DiagcMgrIninCore_Oper_DiagcMgrIninCore_Oper
          TMT_DiagcMgrPer2: RtePositionInTask=9, RteEventRef=TMT_DiagcMgrPer2, RteMappedToTaskRef=Task_100ms_Appl10, RteUsedOsAlarmRef=Rte_Al_TE_Task_100ms_Appl10_0_100ms, RteUsedOsEventRef=Rte_Ev_Cyclic_Task_100ms_Appl10_0_100ms
          OIT_ReadNtcFltAry_Oper_ReadNtcFltAry_Oper: RteEventRef=OIT_ReadNtcFltAry_Oper_ReadNtcFltAry_Oper
          OIT_CnvSnpshtData_s32_Oper_CnvSnpshtData_s32_Oper: RteEventRef=OIT_CnvSnpshtData_s32_Oper_CnvSnpshtData_s32_Oper
          OIT_GetNtcStsCore_Oper_GetNtcStsCore_Oper: RteEventRef=OIT_GetNtcStsCore_Oper_GetNtcStsCore_Oper
          OIT_CnvSnpshtData_logl_Oper_CnvSnpshtData_logl_Oper: RteEventRef=OIT_CnvSnpshtData_logl_Oper_CnvSnpshtData_logl_Oper
          DiagcMgr_InitEvent: RtePositionInTask=1, RteEventRef=DiagcMgr_InitEvent, RteMappedToTaskRef=Task_Init_Appl10
          TMT_DiagcMgrPer1: RtePositionInTask=1, RteEventRef=TMT_DiagcMgrPer1, RteMappedToTaskRef=Task_2msB_Appl10, RteUsedOsAlarmRef=Rte_Al_TE_Task_2msB_Appl10_0_2ms
    NvMProxy (RteBswModuleInstance): RteBswImplementationRef=NvMProxy_Impl, RteBswModuleConfigurationRef=NvMProxy
      NvMProxy_MainFunctionTimingEvent0 (RteBswEventToTaskMapping):
        RteBswImmediateRestart = false
        RteBswPositionInTask = 5
        RteBswEventRef = NvMProxy_MainFunctionTimingEvent0
        RteBswMappedToTaskRef = Task_10msBsw_Appl10
        RteBswUsedOsAlarmRef = Rte_Al_TE2_Task_10msBsw_Appl10_0_10ms
      NvMProxy_EXCLUSIVE_AREA_0 (RteBswExclusiveAreaImpl): RteExclusiveAreaImplMechanism=ALL_INTERRUPT_BLOCKING, RteExclusiveAreaOptimization=false, RteBswExclusiveAreaRef=NvMProxy_EXCLUSIVE_AREA_0
    CDD_NvMProxy_EcuSwComposition (RteSwComponentInstance): RteSoftwareComponentInstanceRef=CDD_NvMProxy
      NvmBlock_CDD_NvMProxy_ShtdwnClsChkBlk (RteNvRamAllocation):
        RteNvmRamBlockLocationSymbol = Rte_CDD_NvMProxy_ShtdwnClsChk
        RteNvmBlockRef = Rte_NvmBlock_CDD_NvMProxy_ShtdwnClsChk
        RteSwNvRamMappingRef = ShtdwnClsChkBlk
      NvMProxy_InitEvent (RteEventToTaskMapping): RteImmediateRestart=false, RtePositionInTask=3, RteEventRef=NvMProxy_InitEvent, RteMappedToTaskRef=Task_Init_Appl10
    NvMProxy_EcuSwComposition (RteSwComponentInstance): RteSoftwareComponentInstanceRef=NvMProxy
      392 x RteEventToTaskMapping, all with RteImmediateRestart=false:
        Timer_NvMProxy_MainFunction: RtePositionInTask=5, RteEventRef=Timer_NvMProxy_MainFunction, RteMappedToTaskRef=Task_10msBsw_Appl10, RteUsedOsAlarmRef=Rte_Al_TE2_Task_10msBsw_Appl10_0_10ms
        OIT_GetErrorStatus_PSProxy_Rte_NvmBlock_DiagcMgr_DiagcMgrApplCrc_GetErrorStatus: RteEventRef=OIT_GetErrorStatus_PSProxy_Rte_NvmBlock_DiagcMgr_DiagcMgrApplCrc_GetErrorStatus
        OIT_SetBlockProtection_PAdminProxy_Rte_NvmBlock_DiagcMgr_DiagcMgrApplCrc_SetBlockProtection: RteEventRef=OIT_SetBlockProtection_PAdminProxy_Rte_NvmBlock_DiagcMgr_DiagcMgrApplCrc_SetBlockProtection
        OIT_ReadBlock_PSProxy_Rte_NvmBlock_DiagcMgr_DiagcMgrApplCrc_ReadBlock: RteEventRef=OIT_ReadBlock_PSProxy_Rte_NvmBlock_DiagcMgr_DiagcMgrApplCrc_ReadBlock
        OIT_InvalidateNvBlock_PSProxy_Rte_NvmBlock_DiagcMgr_DiagcMgrApplCrc_InvalidateNvBlock: RteEventRef=OIT_InvalidateNvBlock_PSProxy_Rte_NvmBlock_DiagcMgr_DiagcMgrApplCrc_InvalidateNvBlock
        OIT_EraseBlock_PSProxy_Rte_NvmBlock_DiagcMgr_DiagcMgrApplCrc_EraseBlock: RteEventRef=OIT_EraseBlock_PSProxy_Rte_NvmBlock_DiagcMgr_DiagcMgrApplCrc_EraseBlock
        OIT_WriteBlock_PSProxy_Rte_NvmBlock_DiagcMgr_DiagcMgrApplCrc_WriteBlock: RteEventRef=OIT_WriteBlock_PSProxy_Rte_NvmBlock_DiagcMgr_DiagcMgrApplCrc_WriteBlock
        OIT_RestoreBlockDefaults_PSProxy_Rte_NvmBlock_DiagcMgr_DiagcMgrApplCrc_RestoreBlockDefaults: RteEventRef=OIT_RestoreBlockDefaults_PSProxy_Rte_NvmBlock_DiagcMgr_DiagcMgrApplCrc_RestoreBlockDefaults
        OIT_SetRamBlockStatus_PSProxy_Rte_NvmBlock_DiagcMgr_DiagcMgrApplCrc_SetRamBlockStatus: RteEventRef=OIT_SetRamBlockStatus_PSProxy_Rte_NvmBlock_DiagcMgr_DiagcMgrApplCrc_SetRamBlockStatus
        OIT_GetErrorStatus_PSProxy_Rte_NvmBlock_CmnMfgSrv_MfgTmpBuf4_GetErrorStatus: RteEventRef=OIT_GetErrorStatus_PSProxy_Rte_NvmBlock_CmnMfgSrv_MfgTmpBuf4_GetErrorStatus
        OIT_InvalidateNvBlock_PSProxy_Rte_NvmBlock_CmnMfgSrv_NxtrMfgEnaCntr_InvalidateNvBlock: RteEventRef=OIT_InvalidateNvBlock_PSProxy_Rte_NvmBlock_CmnMfgSrv_NxtrMfgEnaCntr_InvalidateNvBlock
        OIT_WriteBlock_PSProxy_Rte_NvmBlock_CmnMfgSrv_EpsSysSerlNr_WriteBlock: RteEventRef=OIT_WriteBlock_PSProxy_Rte_NvmBlock_CmnMfgSrv_EpsSysSerlNr_WriteBlock
        OIT_WriteBlock_PSProxy_Rte_NvmBlock_CmnMfgSrv_MfgTmpBuf4_WriteBlock: RteEventRef=OIT_WriteBlock_PSProxy_Rte_NvmBlock_CmnMfgSrv_MfgTmpBuf4_WriteBlock
        OIT_EraseBlock_PSProxy_Rte_NvmBlock_CmnMfgSrv_MfgTmpBuf2_EraseBlock: RteEventRef=OIT_EraseBlock_PSProxy_Rte_NvmBlock_CmnMfgSrv_MfgTmpBuf2_EraseBlock
        OIT_EraseBlock_PSProxy_Rte_NvmBlock_CmnMfgSrv_CcaSerlNr_EraseBlock: RteEventRef=OIT_EraseBlock_PSProxy_Rte_NvmBlock_CmnMfgSrv_CcaSerlNr_EraseBlock
        OIT_WriteBlock_PSProxy_Rte_NvmBlock_CmnMfgSrv_DiRestore_WriteBlock: RteEventRef=OIT_WriteBlock_PSProxy_Rte_NvmBlock_CmnMfgSrv_DiRestore_WriteBlock
        OIT_WriteBlock_PSProxy_Rte_NvmBlock_CmnMfgSrv_MfgTmpBuf3_WriteBlock: RteEventRef=OIT_WriteBlock_PSProxy_Rte_NvmBlock_CmnMfgSrv_MfgTmpBuf3_WriteBlock
        OIT_SetRamBlockStatus_PSProxy_Rte_NvmBlock_CmnMfgSrv_EpsSysSerlNr_SetRamBlockStatus: RteEventRef=OIT_SetRamBlockStatus_PSProxy_Rte_NvmBlock_CmnMfgSrv_EpsSysSerlNr_SetRamBlockStatus
        OIT_WriteBlock_PSProxy_Rte_NvmBlock_CmnMfgSrv_IgnCntr_WriteBlock: RteEventRef=OIT_WriteBlock_PSProxy_Rte_NvmBlock_CmnMfgSrv_IgnCntr_WriteBlock
        OIT_WriteBlock_PSProxy_Rte_NvmBlock_CmnMfgSrv_CcaHwPartNr_WriteBlock: RteEventRef=OIT_WriteBlock_PSProxy_Rte_NvmBlock_CmnMfgSrv_CcaHwPartNr_WriteBlock
        OIT_InvalidateNvBlock_PSProxy_Rte_NvmBlock_CmnMfgSrv_MfgTmpBuf1_InvalidateNvBlock: RteEventRef=OIT_InvalidateNvBlock_PSProxy_Rte_NvmBlock_CmnMfgSrv_MfgTmpBuf1_InvalidateNvBlock
        OIT_RestoreBlockDefaults_PSProxy_Rte_NvmBlock_CmnMfgSrv_SeedKey_RestoreBlockDefaults: RteEventRef=OIT_RestoreBlockDefaults_PSProxy_Rte_NvmBlock_CmnMfgSrv_SeedKey_RestoreBlockDefaults
        OIT_SetRamBlockStatus_PSProxy_Rte_NvmBlock_CmnMfgSrv_CcaHwPartNr_SetRamBlockStatus: RteEventRef=OIT_SetRamBlockStatus_PSProxy_Rte_NvmBlock_CmnMfgSrv_CcaHwPartNr_SetRamBlockStatus
        OIT_GetErrorStatus_PSProxy_Rte_NvmBlock_CmnMfgSrv_IgnCntr_GetErrorStatus: RteEventRef=OIT_GetErrorStatus_PSProxy_Rte_NvmBlock_CmnMfgSrv_IgnCntr_GetErrorStatus
        OIT_SetBlockProtection_PAdminProxy_Rte_NvmBlock_CmnMfgSrv_CcaSerlNr_SetBlockProtection: RteEventRef=OIT_SetBlockProtection_PAdminProxy_Rte_NvmBlock_CmnMfgSrv_CcaSerlNr_SetBlockProtection
        OIT_WriteBlock_PSProxy_Rte_NvmBlock_CmnMfgSrv_CcaSerlNr_WriteBlock: RteEventRef=OIT_WriteBlock_PSProxy_Rte_NvmBlock_CmnMfgSrv_CcaSerlNr_WriteBlock
        OIT_InvalidateNvBlock_PSProxy_Rte_NvmBlock_CmnMfgSrv_MfgTmpBuf3_InvalidateNvBlock: RteEventRef=OIT_InvalidateNvBlock_PSProxy_Rte_NvmBlock_CmnMfgSrv_MfgTmpBuf3_InvalidateNvBlock
        OIT_InvalidateNvBlock_PSProxy_Rte_NvmBlock_CmnMfgSrv_MfgTmpBuf4_InvalidateNvBlock: RteEventRef=OIT_InvalidateNvBlock_PSProxy_Rte_NvmBlock_CmnMfgSrv_MfgTmpBuf4_InvalidateNvBlock
        OIT_SetRamBlockStatus_PSProxy_Rte_NvmBlock_CmnMfgSrv_SeedKey_SetRamBlockStatus: RteEventRef=OIT_SetRamBlockStatus_PSProxy_Rte_NvmBlock_CmnMfgSrv_SeedKey_SetRamBlockStatus
        OIT_ReadBlock_PSProxy_Rte_NvmBlock_CmnMfgSrv_CcaHwPartNr_ReadBlock: RteEventRef=OIT_ReadBlock_PSProxy_Rte_NvmBlock_CmnMfgSrv_CcaHwPartNr_ReadBlock
        OIT_ReadBlock_PSProxy_Rte_NvmBlock_CmnMfgSrv_MfgTmpBuf4_ReadBlock: RteEventRef=OIT_ReadBlock_PSProxy_Rte_NvmBlock_CmnMfgSrv_MfgTmpBuf4_ReadBlock
        OIT_EraseBlock_PSProxy_Rte_NvmBlock_CmnMfgSrv_MfgTmpBuf1_EraseBlock: RteEventRef=OIT_EraseBlock_PSProxy_Rte_NvmBlock_CmnMfgSrv_MfgTmpBuf1_EraseBlock
        OIT_SetBlockProtection_PAdminProxy_Rte_NvmBlock_CmnMfgSrv_EpsSysSerlNr_SetBlockProtection: RteEventRef=OIT_SetBlockProtection_PAdminProxy_Rte_NvmBlock_CmnMfgSrv_EpsSysSerlNr_SetBlockProtection
        OIT_RestoreBlockDefaults_PSProxy_Rte_NvmBlock_CmnMfgSrv_NxtrMfgEnaCntr_RestoreBlockDefaults: RteEventRef=OIT_RestoreBlockDefaults_PSProxy_Rte_NvmBlock_CmnMfgSrv_NxtrMfgEnaCntr_RestoreBlockDefaults
        OIT_ReadBlock_PSProxy_Rte_NvmBlock_CmnMfgSrv_DiRestore_ReadBlock: RteEventRef=OIT_ReadBlock_PSProxy_Rte_NvmBlock_CmnMfgSrv_DiRestore_ReadBlock
        OIT_SetBlockProtection_PAdminProxy_Rte_NvmBlock_CmnMfgSrv_MfgTmpBuf3_SetBlockProtection: RteEventRef=OIT_SetBlockProtection_PAdminProxy_Rte_NvmBlock_CmnMfgSrv_MfgTmpBuf3_SetBlockProtection
        OIT_InvalidateNvBlock_PSProxy_Rte_NvmBlock_CmnMfgSrv_SeedKey_InvalidateNvBlock: RteEventRef=OIT_InvalidateNvBlock_PSProxy_Rte_NvmBlock_CmnMfgSrv_SeedKey_InvalidateNvBlock
        OIT_EraseBlock_PSProxy_Rte_NvmBlock_CmnMfgSrv_EpsSysSerlNr_EraseBlock: RteEventRef=OIT_EraseBlock_PSProxy_Rte_NvmBlock_CmnMfgSrv_EpsSysSerlNr_EraseBlock
        OIT_SetRamBlockStatus_PSProxy_Rte_NvmBlock_CmnMfgSrv_MfgTmpBuf2_SetRamBlockStatus: RteEventRef=OIT_SetRamBlockStatus_PSProxy_Rte_NvmBlock_CmnMfgSrv_MfgTmpBuf2_SetRamBlockStatus
        OIT_WriteBlock_PSProxy_Rte_NvmBlock_CmnMfgSrv_MfgTmpBuf2_WriteBlock: RteEventRef=OIT_WriteBlock_PSProxy_Rte_NvmBlock_CmnMfgSrv_MfgTmpBuf2_WriteBlock
        OIT_EraseBlock_PSProxy_Rte_NvmBlock_CmnMfgSrv_IgnCntr_EraseBlock: RteEventRef=OIT_EraseBlock_PSProxy_Rte_NvmBlock_CmnMfgSrv_IgnCntr_EraseBlock
        OIT_ReadBlock_PSProxy_Rte_NvmBlock_CmnMfgSrv_SeedKey_ReadBlock: RteEventRef=OIT_ReadBlock_PSProxy_Rte_NvmBlock_CmnMfgSrv_SeedKey_ReadBlock
        OIT_WriteBlock_PSProxy_Rte_NvmBlock_CmnMfgSrv_MfgTmpBuf1_WriteBlock: RteEventRef=OIT_WriteBlock_PSProxy_Rte_NvmBlock_CmnMfgSrv_MfgTmpBuf1_WriteBlock
        OIT_EraseBlock_PSProxy_Rte_NvmBlock_CmnMfgSrv_CcaHwPartNr_EraseBlock: RteEventRef=OIT_EraseBlock_PSProxy_Rte_NvmBlock_CmnMfgSrv_CcaHwPartNr_EraseBlock
        OIT_RestoreBlockDefaults_PSProxy_Rte_NvmBlock_CmnMfgSrv_IgnCntr_RestoreBlockDefaults: RteEventRef=OIT_RestoreBlockDefaults_PSProxy_Rte_NvmBlock_CmnMfgSrv_IgnCntr_RestoreBlockDefaults
        OIT_SetRamBlockStatus_PSProxy_Rte_NvmBlock_CmnMfgSrv_MfgTmpBuf4_SetRamBlockStatus: RteEventRef=OIT_SetRamBlockStatus_PSProxy_Rte_NvmBlock_CmnMfgSrv_MfgTmpBuf4_SetRamBlockStatus
        OIT_SetBlockProtection_PAdminProxy_Rte_NvmBlock_CmnMfgSrv_SeedKey_SetBlockProtection: RteEventRef=OIT_SetBlockProtection_PAdminProxy_Rte_NvmBlock_CmnMfgSrv_SeedKey_SetBlockProtection
        OIT_EraseBlock_PSProxy_Rte_NvmBlock_CmnMfgSrv_SeedKey_EraseBlock: RteEventRef=OIT_EraseBlock_PSProxy_Rte_NvmBlock_CmnMfgSrv_SeedKey_EraseBlock
        OIT_SetRamBlockStatus_PSProxy_Rte_NvmBlock_CmnMfgSrv_MfgTmpBuf1_SetRamBlockStatus: RteEventRef=OIT_SetRamBlockStatus_PSProxy_Rte_NvmBlock_CmnMfgSrv_MfgTmpBuf1_SetRamBlockStatus
        OIT_ReadBlock_PSProxy_Rte_NvmBlock_CmnMfgSrv_MfgTmpBuf1_ReadBlock: RteEventRef=OIT_ReadBlock_PSProxy_Rte_NvmBlock_CmnMfgSrv_MfgTmpBuf1_ReadBlock
        OIT_SetBlockProtection_PAdminProxy_Rte_NvmBlock_CmnMfgSrv_MfgTmpBuf0_SetBlockProtection: RteEventRef=OIT_SetBlockProtection_PAdminProxy_Rte_NvmBlock_CmnMfgSrv_MfgTmpBuf0_SetBlockProtection
        OIT_InvalidateNvBlock_PSProxy_Rte_NvmBlock_CmnMfgSrv_CcaHwPartNr_InvalidateNvBlock: RteEventRef=OIT_InvalidateNvBlock_PSProxy_Rte_NvmBlock_CmnMfgSrv_CcaHwPartNr_InvalidateNvBlock
        OIT_InvalidateNvBlock_PSProxy_Rte_NvmBlock_CmnMfgSrv_DiRestore_InvalidateNvBlock: RteEventRef=OIT_InvalidateNvBlock_PSProxy_Rte_NvmBlock_CmnMfgSrv_DiRestore_InvalidateNvBlock
        OIT_SetBlockProtection_PAdminProxy_Rte_NvmBlock_CmnMfgSrv_IgnCntr_SetBlockProtection: RteEventRef=OIT_SetBlockProtection_PAdminProxy_Rte_NvmBlock_CmnMfgSrv_IgnCntr_SetBlockProtection
        OIT_ReadBlock_PSProxy_Rte_NvmBlock_CmnMfgSrv_NxtrMfgEnaCntr_ReadBlock: RteEventRef=OIT_ReadBlock_PSProxy_Rte_NvmBlock_CmnMfgSrv_NxtrMfgEnaCntr_ReadBlock
        OIT_WriteBlock_PSProxy_Rte_NvmBlock_CmnMfgSrv_SeedKey_WriteBlock: RteEventRef=OIT_WriteBlock_PSProxy_Rte_NvmBlock_CmnMfgSrv_SeedKey_WriteBlock
        OIT_GetErrorStatus_PSProxy_Rte_NvmBlock_CmnMfgSrv_DiRestore_GetErrorStatus: RteEventRef=OIT_GetErrorStatus_PSProxy_Rte_NvmBlock_CmnMfgSrv_DiRestore_GetErrorStatus
        OIT_GetErrorStatus_PSProxy_Rte_NvmBlock_CmnMfgSrv_SeedKey_GetErrorStatus: RteEventRef=OIT_GetErrorStatus_PSProxy_Rte_NvmBlock_CmnMfgSrv_SeedKey_GetErrorStatus
        OIT_ReadBlock_PSProxy_Rte_NvmBlock_CmnMfgSrv_MfgTmpBuf3_ReadBlock: RteEventRef=OIT_ReadBlock_PSProxy_Rte_NvmBlock_CmnMfgSrv_MfgTmpBuf3_ReadBlock
        OIT_GetErrorStatus_PSProxy_Rte_NvmBlock_CmnMfgSrv_EpsSysSerlNr_GetErrorStatus: RteEventRef=OIT_GetErrorStatus_PSProxy_Rte_NvmBlock_CmnMfgSrv_EpsSysSerlNr_GetErrorStatus
        OIT_ReadBlock_PSProxy_Rte_NvmBlock_CmnMfgSrv_EpsSysSerlNr_ReadBlock: RteEventRef=OIT_ReadBlock_PSProxy_Rte_NvmBlock_CmnMfgSrv_EpsSysSerlNr_ReadBlock
        OIT_ReadBlock_PSProxy_Rte_NvmBlock_CmnMfgSrv_MfgTmpBuf2_ReadBlock: RteEventRef=OIT_ReadBlock_PSProxy_Rte_NvmBlock_CmnMfgSrv_MfgTmpBuf2_ReadBlock
        OIT_SetBlockProtection_PAdminProxy_Rte_NvmBlock_CmnMfgSrv_MfgTmpBuf1_SetBlockProtection: RteEventRef=OIT_SetBlockProtection_PAdminProxy_Rte_NvmBlock_CmnMfgSrv_MfgTmpBuf1_SetBlockProtection
        OIT_SetRamBlockStatus_PSProxy_Rte_NvmBlock_CmnMfgSrv_NxtrMfgEnaCntr_SetRamBlockStatus: RteEventRef=OIT_SetRamBlockStatus_PSProxy_Rte_NvmBlock_CmnMfgSrv_NxtrMfgEnaCntr_SetRamBlockStatus
        OIT_InvalidateNvBlock_PSProxy_Rte_NvmBlock_CmnMfgSrv_CcaSerlNr_InvalidateNvBlock: RteEventRef=OIT_InvalidateNvBlock_PSProxy_Rte_NvmBlock_CmnMfgSrv_CcaSerlNr_InvalidateNvBlock
        OIT_SetBlockProtection_PAdminProxy_Rte_NvmBlock_CmnMfgSrv_MfgTmpBuf4_SetBlockProtection: RteEventRef=OIT_SetBlockProtection_PAdminProxy_Rte_NvmBlock_CmnMfgSrv_MfgTmpBuf4_SetBlockProtection
        OIT_WriteBlock_PSProxy_Rte_NvmBlock_CmnMfgSrv_MfgTmpBuf0_WriteBlock: RteEventRef=OIT_WriteBlock_PSProxy_Rte_NvmBlock_CmnMfgSrv_MfgTmpBuf0_WriteBlock
        OIT_GetErrorStatus_PSProxy_Rte_NvmBlock_CmnMfgSrv_MfgTmpBuf1_GetErrorStatus: RteEventRef=OIT_GetErrorStatus_PSProxy_Rte_NvmBlock_CmnMfgSrv_MfgTmpBuf1_GetErrorStatus
        OIT_GetErrorStatus_PSProxy_Rte_NvmBlock_CmnMfgSrv_CcaSerlNr_GetErrorStatus: RteEventRef=OIT_GetErrorStatus_PSProxy_Rte_NvmBlock_CmnMfgSrv_CcaSerlNr_GetErrorStatus
        OIT_SetBlockProtection_PAdminProxy_Rte_NvmBlock_CmnMfgSrv_MfgTmpBuf2_SetBlockProtection: RteEventRef=OIT_SetBlockProtection_PAdminProxy_Rte_NvmBlock_CmnMfgSrv_MfgTmpBuf2_SetBlockProtection
        OIT_GetErrorStatus_PSProxy_Rte_NvmBlock_CmnMfgSrv_CcaHwPartNr_GetErrorStatus: RteEventRef=OIT_GetErrorStatus_PSProxy_Rte_NvmBlock_CmnMfgSrv_CcaHwPartNr_GetErrorStatus
        OIT_ReadBlock_PSProxy_Rte_NvmBlock_CmnMfgSrv_CcaSerlNr_ReadBlock: RteEventRef=OIT_ReadBlock_PSProxy_Rte_NvmBlock_CmnMfgSrv_CcaSerlNr_ReadBlock
        OIT_SetRamBlockStatus_PSProxy_Rte_NvmBlock_CmnMfgSrv_MfgTmpBuf0_SetRamBlockStatus: RteEventRef=OIT_SetRamBlockStatus_PSProxy_Rte_NvmBlock_CmnMfgSrv_MfgTmpBuf0_SetRamBlockStatus
        OIT_InvalidateNvBlock_PSProxy_Rte_NvmBlock_CmnMfgSrv_IgnCntr_InvalidateNvBlock: RteEventRef=OIT_InvalidateNvBlock_PSProxy_Rte_NvmBlock_CmnMfgSrv_IgnCntr_InvalidateNvBlock
        OIT_WriteBlock_PSProxy_Rte_NvmBlock_CmnMfgSrv_NxtrMfgEnaCntr_WriteBlock: RteEventRef=OIT_WriteBlock_PSProxy_Rte_NvmBlock_CmnMfgSrv_NxtrMfgEnaCntr_WriteBlock
        OIT_InvalidateNvBlock_PSProxy_Rte_NvmBlock_CmnMfgSrv_MfgTmpBuf2_InvalidateNvBlock: RteEventRef=OIT_InvalidateNvBlock_PSProxy_Rte_NvmBlock_CmnMfgSrv_MfgTmpBuf2_InvalidateNvBlock
        OIT_GetErrorStatus_PSProxy_Rte_NvmBlock_CmnMfgSrv_MfgTmpBuf3_GetErrorStatus: RteEventRef=OIT_GetErrorStatus_PSProxy_Rte_NvmBlock_CmnMfgSrv_MfgTmpBuf3_GetErrorStatus
        OIT_ReadBlock_PSProxy_Rte_NvmBlock_CmnMfgSrv_IgnCntr_ReadBlock: RteEventRef=OIT_ReadBlock_PSProxy_Rte_NvmBlock_CmnMfgSrv_IgnCntr_ReadBlock
        OIT_EraseBlock_PSProxy_Rte_NvmBlock_CmnMfgSrv_MfgTmpBuf3_EraseBlock: RteEventRef=OIT_EraseBlock_PSProxy_Rte_NvmBlock_CmnMfgSrv_MfgTmpBuf3_EraseBlock
        OIT_EraseBlock_PSProxy_Rte_NvmBlock_CmnMfgSrv_MfgTmpBuf4_EraseBlock: RteEventRef=OIT_EraseBlock_PSProxy_Rte_NvmBlock_CmnMfgSrv_MfgTmpBuf4_EraseBlock
        OIT_GetErrorStatus_PSProxy_Rte_NvmBlock_CmnMfgSrv_NxtrMfgEnaCntr_GetErrorStatus: RteEventRef=OIT_GetErrorStatus_PSProxy_Rte_NvmBlock_CmnMfgSrv_NxtrMfgEnaCntr_GetErrorStatus
        OIT_EraseBlock_PSProxy_Rte_NvmBlock_CmnMfgSrv_DiRestore_EraseBlock: RteEventRef=OIT_EraseBlock_PSProxy_Rte_NvmBlock_CmnMfgSrv_DiRestore_EraseBlock
        OIT_SetBlockProtection_PAdminProxy_Rte_NvmBlock_CmnMfgSrv_CcaHwPartNr_SetBlockProtection: RteEventRef=OIT_SetBlockProtection_PAdminProxy_Rte_NvmBlock_CmnMfgSrv_CcaHwPartNr_SetBlockProtection
        OIT_EraseBlock_PSProxy_Rte_NvmBlock_CmnMfgSrv_NxtrMfgEnaCntr_EraseBlock: RteEventRef=OIT_EraseBlock_PSProxy_Rte_NvmBlock_CmnMfgSrv_NxtrMfgEnaCntr_EraseBlock
        OIT_SetBlockProtection_PAdminProxy_Rte_NvmBlock_CmnMfgSrv_NxtrMfgEnaCntr_SetBlockProtection: RteEventRef=OIT_SetBlockProtection_PAdminProxy_Rte_NvmBlock_CmnMfgSrv_NxtrMfgEnaCntr_SetBlockProtection
        OIT_SetRamBlockStatus_PSProxy_Rte_NvmBlock_CmnMfgSrv_CcaSerlNr_SetRamBlockStatus: RteEventRef=OIT_SetRamBlockStatus_PSProxy_Rte_NvmBlock_CmnMfgSrv_CcaSerlNr_SetRamBlockStatus
        OIT_InvalidateNvBlock_PSProxy_Rte_NvmBlock_CmnMfgSrv_MfgTmpBuf0_InvalidateNvBlock: RteEventRef=OIT_InvalidateNvBlock_PSProxy_Rte_NvmBlock_CmnMfgSrv_MfgTmpBuf0_InvalidateNvBlock
        OIT_SetRamBlockStatus_PSProxy_Rte_NvmBlock_CmnMfgSrv_IgnCntr_SetRamBlockStatus: RteEventRef=OIT_SetRamBlockStatus_PSProxy_Rte_NvmBlock_CmnMfgSrv_IgnCntr_SetRamBlockStatus
        OIT_EraseBlock_PSProxy_Rte_NvmBlock_CmnMfgSrv_MfgTmpBuf0_EraseBlock: RteEventRef=OIT_EraseBlock_PSProxy_Rte_NvmBlock_CmnMfgSrv_MfgTmpBuf0_EraseBlock
        OIT_SetRamBlockStatus_PSProxy_Rte_NvmBlock_CmnMfgSrv_DiRestore_SetRamBlockStatus: RteEventRef=OIT_SetRamBlockStatus_PSProxy_Rte_NvmBlock_CmnMfgSrv_DiRestore_SetRamBlockStatus
        OIT_GetErrorStatus_PSProxy_Rte_NvmBlock_CmnMfgSrv_MfgTmpBuf2_GetErrorStatus: RteEventRef=OIT_GetErrorStatus_PSProxy_Rte_NvmBlock_CmnMfgSrv_MfgTmpBuf2_GetErrorStatus
        OIT_SetRamBlockStatus_PSProxy_Rte_NvmBlock_CmnMfgSrv_MfgTmpBuf3_SetRamBlockStatus: RteEventRef=OIT_SetRamBlockStatus_PSProxy_Rte_NvmBlock_CmnMfgSrv_MfgTmpBuf3_SetRamBlockStatus
        OIT_GetErrorStatus_PSProxy_Rte_NvmBlock_CmnMfgSrv_MfgTmpBuf0_GetErrorStatus: RteEventRef=OIT_GetErrorStatus_PSProxy_Rte_NvmBlock_CmnMfgSrv_MfgTmpBuf0_GetErrorStatus
        OIT_ReadBlock_PSProxy_Rte_NvmBlock_CmnMfgSrv_MfgTmpBuf0_ReadBlock: RteEventRef=OIT_ReadBlock_PSProxy_Rte_NvmBlock_CmnMfgSrv_MfgTmpBuf0_ReadBlock
        OIT_SetBlockProtection_PAdminProxy_Rte_NvmBlock_CmnMfgSrv_DiRestore_SetBlockProtection: RteEventRef=OIT_SetBlockProtection_PAdminProxy_Rte_NvmBlock_CmnMfgSrv_DiRestore_SetBlockProtection
        OIT_InvalidateNvBlock_PSProxy_Rte_NvmBlock_CmnMfgSrv_EpsSysSerlNr_InvalidateNvBlock: RteEventRef=OIT_InvalidateNvBlock_PSProxy_Rte_NvmBlock_CmnMfgSrv_EpsSysSerlNr_InvalidateNvBlock
        OIT_SetBlockProtection_PAdminProxy_Rte_NvmBlock_CDD_HwTq5Meas_HwTq5Sca_MirrorBlock_SetBlockProtection: RteEventRef=OIT_SetBlockProtection_PAdminProxy_Rte_NvmBlock_CDD_HwTq5Meas_HwTq5Sca_MirrorBlock_SetBlockProtection
        OIT_EraseBlock_PSProxy_Rte_NvmBlock_CDD_MotAg1Meas_MotAg1CoeffTbl_EraseBlock: RteEventRef=OIT_EraseBlock_PSProxy_Rte_NvmBlock_CDD_MotAg1Meas_MotAg1CoeffTbl_EraseBlock
        OIT_EraseBlock_PSProxy_Rte_NvmBlock_CDD_MotAg0Meas_MotAg0CoeffTbl_EraseBlock: RteEventRef=OIT_EraseBlock_PSProxy_Rte_NvmBlock_CDD_MotAg0Meas_MotAg0CoeffTbl_EraseBlock
        OIT_InvalidateNvBlock_PSProxy_Rte_NvmBlock_CDD_HwTq4Meas_HwTq4Sca_MirrorBlock_InvalidateNvBlock: RteEventRef=OIT_InvalidateNvBlock_PSProxy_Rte_NvmBlock_CDD_HwTq4Meas_HwTq4Sca_MirrorBlock_InvalidateNvBlock
        OIT_GetErrorStatus_PSProxy_Rte_NvmBlock_CDD_HwTq5Meas_HwTq5Offs_MirrorBlock_GetErrorStatus: RteEventRef=OIT_GetErrorStatus_PSProxy_Rte_NvmBlock_CDD_HwTq5Meas_HwTq5Offs_MirrorBlock_GetErrorStatus
        OIT_EraseBlock_PSProxy_Rte_NvmBlock_CDD_HwTq4Meas_HwTq4Offs_MirrorBlock_EraseBlock: RteEventRef=OIT_EraseBlock_PSProxy_Rte_NvmBlock_CDD_HwTq4Meas_HwTq4Offs_MirrorBlock_EraseBlock
        OIT_ReadBlock_PSProxy_Rte_NvmBlock_CDD_HwTq5Meas_HwTq5Offs_MirrorBlock_ReadBlock: RteEventRef=OIT_ReadBlock_PSProxy_Rte_NvmBlock_CDD_HwTq5Meas_HwTq5Offs_MirrorBlock_ReadBlock
        OIT_WriteBlock_PSProxy_Rte_NvmBlock_CDD_HwTq4Meas_HwTq4Sca_MirrorBlock_WriteBlock: RteEventRef=OIT_WriteBlock_PSProxy_Rte_NvmBlock_CDD_HwTq4Meas_HwTq4Sca_MirrorBlock_WriteBlock
        OIT_WriteBlock_PSProxy_Rte_NvmBlock_CDD_MotAg0Meas_MotAg0CoeffTbl_WriteBlock: RteEventRef=OIT_WriteBlock_PSProxy_Rte_NvmBlock_CDD_MotAg0Meas_MotAg0CoeffTbl_WriteBlock
        OIT_GetErrorStatus_PSProxy_Rte_NvmBlock_CDD_MotAg0Meas_MotAg0CoeffTbl_GetErrorStatus: RteEventRef=OIT_GetErrorStatus_PSProxy_Rte_NvmBlock_CDD_MotAg0Meas_MotAg0CoeffTbl_GetErrorStatus
        OIT_InvalidateNvBlock_PSProxy_Rte_NvmBlock_CDD_HwTq5Meas_HwTq5Sca_MirrorBlock_InvalidateNvBlock: RteEventRef=OIT_InvalidateNvBlock_PSProxy_Rte_NvmBlock_CDD_HwTq5Meas_HwTq5Sca_MirrorBlock_InvalidateNvBlock
        OIT_ReadBlock_PSProxy_Rte_NvmBlock_CDD_HwTq4Meas_HwTq4Offs_MirrorBlock_ReadBlock: RteEventRef=OIT_ReadBlock_PSProxy_Rte_NvmBlock_CDD_HwTq4Meas_HwTq4Offs_MirrorBlock_ReadBlock
        OIT_SetBlockProtection_PAdminProxy_Rte_NvmBlock_CDD_HwTq5Meas_HwTq5Offs_MirrorBlock_SetBlockProtection: RteEventRef=OIT_SetBlockProtection_PAdminProxy_Rte_NvmBlock_CDD_HwTq5Meas_HwTq5Offs_MirrorBlock_SetBlockProtection
        OIT_ReadBlock_PSProxy_Rte_NvmBlock_CDD_MotAg0Meas_MotAg0CoeffTbl_ReadBlock: RteEventRef=OIT_ReadBlock_PSProxy_Rte_NvmBlock_CDD_MotAg0Meas_MotAg0CoeffTbl_ReadBlock
        OIT_WriteBlock_PSProxy_Rte_NvmBlock_CDD_MotAg1Meas_MotAg1CoeffTbl_WriteBlock: RteEventRef=OIT_WriteBlock_PSProxy_Rte_NvmBlock_CDD_MotAg1Meas_MotAg1CoeffTbl_WriteBlock
        OIT_InvalidateNvBlock_PSProxy_Rte_NvmBlock_CDD_HwTq5Meas_HwTq5Offs_MirrorBlock_InvalidateNvBlock: RteEventRef=OIT_InvalidateNvBlock_PSProxy_Rte_NvmBlock_CDD_HwTq5Meas_HwTq5Offs_MirrorBlock_InvalidateNvBlock
        OIT_InvalidateNvBlock_PSProxy_Rte_NvmBlock_CDD_MotAg0Meas_MotAg0CoeffTbl_InvalidateNvBlock: RteEventRef=OIT_InvalidateNvBlock_PSProxy_Rte_NvmBlock_CDD_MotAg0Meas_MotAg0CoeffTbl_InvalidateNvBlock
        OIT_GetErrorStatus_PSProxy_Rte_NvmBlock_CDD_HwTq4Meas_HwTq4Offs_MirrorBlock_GetErrorStatus: RteEventRef=OIT_GetErrorStatus_PSProxy_Rte_NvmBlock_CDD_HwTq4Meas_HwTq4Offs_MirrorBlock_GetErrorStatus
        OIT_ReadBlock_PSProxy_Rte_NvmBlock_CDD_HwTq4Meas_HwTq4Sca_MirrorBlock_ReadBlock: RteEventRef=OIT_ReadBlock_PSProxy_Rte_NvmBlock_CDD_HwTq4Meas_HwTq4Sca_MirrorBlock_ReadBlock
        OIT_SetRamBlockStatus_PSProxy_Rte_NvmBlock_CDD_HwTq4Meas_HwTq4Offs_MirrorBlock_SetRamBlockStatus: RteEventRef=OIT_SetRamBlockStatus_PSProxy_Rte_NvmBlock_CDD_HwTq4Meas_HwTq4Offs_MirrorBlock_SetRamBlockStatus
        OIT_SetRamBlockStatus_PSProxy_Rte_NvmBlock_CDD_HwTq5Meas_HwTq5Sca_MirrorBlock_SetRamBlockStatus: RteEventRef=OIT_SetRamBlockStatus_PSProxy_Rte_NvmBlock_CDD_HwTq5Meas_HwTq5Sca_MirrorBlock_SetRamBlockStatus
        OIT_EraseBlock_PSProxy_Rte_NvmBlock_CDD_HwTq4Meas_HwTq4Sca_MirrorBlock_EraseBlock: RteEventRef=OIT_EraseBlock_PSProxy_Rte_NvmBlock_CDD_HwTq4Meas_HwTq4Sca_MirrorBlock_EraseBlock
        OIT_EraseBlock_PSProxy_Rte_NvmBlock_CDD_HwTq5Meas_HwTq5Sca_MirrorBlock_EraseBlock: RteEventRef=OIT_EraseBlock_PSProxy_Rte_NvmBlock_CDD_HwTq5Meas_HwTq5Sca_MirrorBlock_EraseBlock
        OIT_GetErrorStatus_PSProxy_Rte_NvmBlock_CDD_HwTq5Meas_HwTq5Sca_MirrorBlock_GetErrorStatus: RteEventRef=OIT_GetErrorStatus_PSProxy_Rte_NvmBlock_CDD_HwTq5Meas_HwTq5Sca_MirrorBlock_GetErrorStatus
        OIT_GetErrorStatus_PSProxy_Rte_NvmBlock_CDD_MotAg1Meas_MotAg1CoeffTbl_GetErrorStatus: RteEventRef=OIT_GetErrorStatus_PSProxy_Rte_NvmBlock_CDD_MotAg1Meas_MotAg1CoeffTbl_GetErrorStatus
        OIT_ReadBlock_PSProxy_Rte_NvmBlock_CDD_MotAg1Meas_MotAg1CoeffTbl_ReadBlock: RteEventRef=OIT_ReadBlock_PSProxy_Rte_NvmBlock_CDD_MotAg1Meas_MotAg1CoeffTbl_ReadBlock
        OIT_SetRamBlockStatus_PSProxy_Rte_NvmBlock_CDD_MotAg0Meas_MotAg0CoeffTbl_SetRamBlockStatus: RteEventRef=OIT_SetRamBlockStatus_PSProxy_Rte_NvmBlock_CDD_MotAg0Meas_MotAg0CoeffTbl_SetRamBlockStatus
        OIT_InvalidateNvBlock_PSProxy_Rte_NvmBlock_CDD_HwTq4Meas_HwTq4Offs_MirrorBlock_InvalidateNvBlock: RteEventRef=OIT_InvalidateNvBlock_PSProxy_Rte_NvmBlock_CDD_HwTq4Meas_HwTq4Offs_MirrorBlock_InvalidateNvBlock
        OIT_WriteBlock_PSProxy_Rte_NvmBlock_CDD_HwTq4Meas_HwTq4Offs_MirrorBlock_WriteBlock: RteEventRef=OIT_WriteBlock_PSProxy_Rte_NvmBlock_CDD_HwTq4Meas_HwTq4Offs_MirrorBlock_WriteBlock
        OIT_SetBlockProtection_PAdminProxy_Rte_NvmBlock_CDD_MotAg1Meas_MotAg1CoeffTbl_SetBlockProtection: RteEventRef=OIT_SetBlockProtection_PAdminProxy_Rte_NvmBlock_CDD_MotAg1Meas_MotAg1CoeffTbl_SetBlockProtection
        OIT_SetRamBlockStatus_PSProxy_Rte_NvmBlock_CDD_MotAg1Meas_MotAg1CoeffTbl_SetRamBlockStatus: RteEventRef=OIT_SetRamBlockStatus_PSProxy_Rte_NvmBlock_CDD_MotAg1Meas_MotAg1CoeffTbl_SetRamBlockStatus
        OIT_WriteBlock_PSProxy_Rte_NvmBlock_CDD_HwTq5Meas_HwTq5Sca_MirrorBlock_WriteBlock: RteEventRef=OIT_WriteBlock_PSProxy_Rte_NvmBlock_CDD_HwTq5Meas_HwTq5Sca_MirrorBlock_WriteBlock
        OIT_GetErrorStatus_PSProxy_Rte_NvmBlock_CDD_HwTq4Meas_HwTq4Sca_MirrorBlock_GetErrorStatus: RteEventRef=OIT_GetErrorStatus_PSProxy_Rte_NvmBlock_CDD_HwTq4Meas_HwTq4Sca_MirrorBlock_GetErrorStatus
        OIT_SetBlockProtection_PAdminProxy_Rte_NvmBlock_CDD_MotAg0Meas_MotAg0CoeffTbl_SetBlockProtection: RteEventRef=OIT_SetBlockProtection_PAdminProxy_Rte_NvmBlock_CDD_MotAg0Meas_MotAg0CoeffTbl_SetBlockProtection
        OIT_EraseBlock_PSProxy_Rte_NvmBlock_CDD_HwTq5Meas_HwTq5Offs_MirrorBlock_EraseBlock: RteEventRef=OIT_EraseBlock_PSProxy_Rte_NvmBlock_CDD_HwTq5Meas_HwTq5Offs_MirrorBlock_EraseBlock
        OIT_SetBlockProtection_PAdminProxy_Rte_NvmBlock_CDD_HwTq4Meas_HwTq4Offs_MirrorBlock_SetBlockProtection: RteEventRef=OIT_SetBlockProtection_PAdminProxy_Rte_NvmBlock_CDD_HwTq4Meas_HwTq4Offs_MirrorBlock_SetBlockProtection
        OIT_SetRamBlockStatus_PSProxy_Rte_NvmBlock_CDD_HwTq5Meas_HwTq5Offs_MirrorBlock_SetRamBlockStatus: RteEventRef=OIT_SetRamBlockStatus_PSProxy_Rte_NvmBlock_CDD_HwTq5Meas_HwTq5Offs_MirrorBlock_SetRamBlockStatus
        OIT_ReadBlock_PSProxy_Rte_NvmBlock_CDD_HwTq5Meas_HwTq5Sca_MirrorBlock_ReadBlock: RteEventRef=OIT_ReadBlock_PSProxy_Rte_NvmBlock_CDD_HwTq5Meas_HwTq5Sca_MirrorBlock_ReadBlock
        OIT_WriteBlock_PSProxy_Rte_NvmBlock_CDD_HwTq5Meas_HwTq5Offs_MirrorBlock_WriteBlock: RteEventRef=OIT_WriteBlock_PSProxy_Rte_NvmBlock_CDD_HwTq5Meas_HwTq5Offs_MirrorBlock_WriteBlock
        OIT_InvalidateNvBlock_PSProxy_Rte_NvmBlock_CDD_MotAg1Meas_MotAg1CoeffTbl_InvalidateNvBlock: RteEventRef=OIT_InvalidateNvBlock_PSProxy_Rte_NvmBlock_CDD_MotAg1Meas_MotAg1CoeffTbl_InvalidateNvBlock
        OIT_SetRamBlockStatus_PSProxy_Rte_NvmBlock_CDD_HwTq4Meas_HwTq4Sca_MirrorBlock_SetRamBlockStatus: RteEventRef=OIT_SetRamBlockStatus_PSProxy_Rte_NvmBlock_CDD_HwTq4Meas_HwTq4Sca_MirrorBlock_SetRamBlockStatus
        OIT_SetBlockProtection_PAdminProxy_Rte_NvmBlock_CDD_HwTq4Meas_HwTq4Sca_MirrorBlock_SetBlockProtection: RteEventRef=OIT_SetBlockProtection_PAdminProxy_Rte_NvmBlock_CDD_HwTq4Meas_HwTq4Sca_MirrorBlock_SetBlockProtection
        OIT_InvalidateNvBlock_PSProxy_Rte_NvmBlock_DutyCycThermProtn_FilStVal_InvalidateNvBlock: RteEventRef=OIT_InvalidateNvBlock_PSProxy_Rte_NvmBlock_DutyCycThermProtn_FilStVal_InvalidateNvBlock
        OIT_SetRamBlockStatus_PSProxy_Rte_NvmBlock_DutyCycThermProtn_FilStVal_SetRamBlockStatus: RteEventRef=OIT_SetRamBlockStatus_PSProxy_Rte_NvmBlock_DutyCycThermProtn_FilStVal_SetRamBlockStatus
        OIT_EraseBlock_PSProxy_Rte_NvmBlock_DutyCycThermProtn_FilStVal_EraseBlock: RteEventRef=OIT_EraseBlock_PSProxy_Rte_NvmBlock_DutyCycThermProtn_FilStVal_EraseBlock
        OIT_WriteBlock_PSProxy_Rte_NvmBlock_DutyCycThermProtn_FilStVal_WriteBlock: RteEventRef=OIT_WriteBlock_PSProxy_Rte_NvmBlock_DutyCycThermProtn_FilStVal_WriteBlock
        OIT_SetBlockProtection_PAdminProxy_Rte_NvmBlock_DutyCycThermProtn_FilStVal_SetBlockProtection: RteEventRef=OIT_SetBlockProtection_PAdminProxy_Rte_NvmBlock_DutyCycThermProtn_FilStVal_SetBlockProtection
        OIT_GetErrorStatus_PSProxy_Rte_NvmBlock_DutyCycThermProtn_FilStVal_GetErrorStatus: RteEventRef=OIT_GetErrorStatus_PSProxy_Rte_NvmBlock_DutyCycThermProtn_FilStVal_GetErrorStatus
        OIT_ReadBlock_PSProxy_Rte_NvmBlock_DutyCycThermProtn_FilStVal_ReadBlock: RteEventRef=OIT_ReadBlock_PSProxy_Rte_NvmBlock_DutyCycThermProtn_FilStVal_ReadBlock
        OIT_InvalidateNvBlock_PSProxy_Rte_NvmBlock_MotCtrlPrmEstimn_MotPrmNom_InvalidateNvBlock: RteEventRef=OIT_InvalidateNvBlock_PSProxy_Rte_NvmBlock_MotCtrlPrmEstimn_MotPrmNom_InvalidateNvBlock
        OIT_ReadBlock_PSProxy_Rte_NvmBlock_MotCtrlPrmEstimn_MotPrmNom_ReadBlock: RteEventRef=OIT_ReadBlock_PSProxy_Rte_NvmBlock_MotCtrlPrmEstimn_MotPrmNom_ReadBlock
        OIT_SetRamBlockStatus_PSProxy_Rte_NvmBlock_MotCtrlPrmEstimn_MotPrmNom_SetRamBlockStatus: RteEventRef=OIT_SetRamBlockStatus_PSProxy_Rte_NvmBlock_MotCtrlPrmEstimn_MotPrmNom_SetRamBlockStatus
        OIT_SetBlockProtection_PAdminProxy_Rte_NvmBlock_MotCtrlPrmEstimn_MotPrmNom_SetBlockProtection: RteEventRef=OIT_SetBlockProtection_PAdminProxy_Rte_NvmBlock_MotCtrlPrmEstimn_MotPrmNom_SetBlockProtection
        OIT_WriteBlock_PSProxy_Rte_NvmBlock_MotCtrlPrmEstimn_MotPrmNom_WriteBlock: RteEventRef=OIT_WriteBlock_PSProxy_Rte_NvmBlock_MotCtrlPrmEstimn_MotPrmNom_WriteBlock
        OIT_EraseBlock_PSProxy_Rte_NvmBlock_MotCtrlPrmEstimn_MotPrmNom_EraseBlock: RteEventRef=OIT_EraseBlock_PSProxy_Rte_NvmBlock_MotCtrlPrmEstimn_MotPrmNom_EraseBlock
        OIT_GetErrorStatus_PSProxy_Rte_NvmBlock_MotCtrlPrmEstimn_MotPrmNom_GetErrorStatus: RteEventRef=OIT_GetErrorStatus_PSProxy_Rte_NvmBlock_MotCtrlPrmEstimn_MotPrmNom_GetErrorStatus
        OIT_EraseBlock_PSProxy_Rte_NvmBlock_CDD_NvMProxy_ShtdwnClsChk_EraseBlock: RteEventRef=OIT_EraseBlock_PSProxy_Rte_NvmBlock_CDD_NvMProxy_ShtdwnClsChk_EraseBlock
        OIT_InvalidateNvBlock_PSProxy_Rte_NvmBlock_CDD_CurrMeas_CurrMeasEolGainCalSetABC_InvalidateNvBlock: RteEventRef=OIT_InvalidateNvBlock_PSProxy_Rte_NvmBlock_CDD_CurrMeas_CurrMeasEolGainCalSetABC_InvalidateNvBlock
        OIT_EraseBlock_PSProxy_Rte_NvmBlock_CDD_CurrMeas_CurrMeasEolGainCalSetABC_EraseBlock: RteEventRef=OIT_EraseBlock_PSProxy_Rte_NvmBlock_CDD_CurrMeas_CurrMeasEolGainCalSetABC_EraseBlock
        OIT_InvalidateNvBlock_PSProxy_Rte_NvmBlock_CDD_MotAgCmp_MotAgCmpMotAgBackEmf_InvalidateNvBlock: RteEventRef=OIT_InvalidateNvBlock_PSProxy_Rte_NvmBlock_CDD_MotAgCmp_MotAgCmpMotAgBackEmf_InvalidateNvBlock
        OIT_SetBlockProtection_PAdminProxy_Rte_NvmBlock_PolarityCfg_PolarityCfgSaved_SetBlockProtection: RteEventRef=OIT_SetBlockProtection_PAdminProxy_Rte_NvmBlock_PolarityCfg_PolarityCfgSaved_SetBlockProtection
        OIT_SetBlockProtection_PAdminProxy_Rte_NvmBlock_CDD_NvMProxy_ShtdwnClsChk_SetBlockProtection: RteEventRef=OIT_SetBlockProtection_PAdminProxy_Rte_NvmBlock_CDD_NvMProxy_ShtdwnClsChk_SetBlockProtection
        OIT_SetRamBlockStatus_PSProxy_Rte_NvmBlock_DiagcMgr_DiagcMgrLtchCntrAry_SetRamBlockStatus: RteEventRef=OIT_SetRamBlockStatus_PSProxy_Rte_NvmBlock_DiagcMgr_DiagcMgrLtchCntrAry_SetRamBlockStatus
        OIT_GetErrorStatus_PSProxy_Rte_NvmBlock_DiagcMgr_DiagcMgrLtchCntrAry_GetErrorStatus: RteEventRef=OIT_GetErrorStatus_PSProxy_Rte_NvmBlock_DiagcMgr_DiagcMgrLtchCntrAry_GetErrorStatus
        OIT_WriteBlock_PSProxy_Rte_NvmBlock_DiagcMgr_DiagcMgrNtcFltAry_WriteBlock: RteEventRef=OIT_WriteBlock_PSProxy_Rte_NvmBlock_DiagcMgr_DiagcMgrNtcFltAry_WriteBlock
        OIT_ReadBlock_PSProxy_Rte_NvmBlock_HwTqCorrln_HwTqChACmnModCmpLpFilSt_ReadBlock: RteEventRef=OIT_ReadBlock_PSProxy_Rte_NvmBlock_HwTqCorrln_HwTqChACmnModCmpLpFilSt_ReadBlock
        OIT_GetErrorStatus_PSProxy_Rte_NvmBlock_DiagcMgr_DiagcMgrNtcFltAry_GetErrorStatus: RteEventRef=OIT_GetErrorStatus_PSProxy_Rte_NvmBlock_DiagcMgr_DiagcMgrNtcFltAry_GetErrorStatus
        OIT_ReadBlock_PSProxy_Rte_NvmBlock_DiagcMgr_DiagcMgrNtcFltAry_ReadBlock: RteEventRef=OIT_ReadBlock_PSProxy_Rte_NvmBlock_DiagcMgr_DiagcMgrNtcFltAry_ReadBlock
        OIT_InvalidateNvBlock_PSProxy_Rte_NvmBlock_DiagcMgr_DiagcMgrNtcFltAry_InvalidateNvBlock: RteEventRef=OIT_InvalidateNvBlock_PSProxy_Rte_NvmBlock_DiagcMgr_DiagcMgrNtcFltAry_InvalidateNvBlock
        OIT_WriteBlock_PSProxy_Rte_NvmBlock_PolarityCfg_PolarityCfgSaved_WriteBlock: RteEventRef=OIT_WriteBlock_PSProxy_Rte_NvmBlock_PolarityCfg_PolarityCfgSaved_WriteBlock
        OIT_WriteBlock_PSProxy_Rte_NvmBlock_CDD_CurrMeas_CurrMeasEolOffsCalSetABC_WriteBlock: RteEventRef=OIT_WriteBlock_PSProxy_Rte_NvmBlock_CDD_CurrMeas_CurrMeasEolOffsCalSetABC_WriteBlock
        OIT_WriteBlock_PSProxy_Rte_NvmBlock_CDD_CurrMeas_CurrMeasEolGainCalSetABC_WriteBlock: RteEventRef=OIT_WriteBlock_PSProxy_Rte_NvmBlock_CDD_CurrMeas_CurrMeasEolGainCalSetABC_WriteBlock
        OIT_SetRamBlockStatus_PSProxy_Rte_NvmBlock_CDD_CurrMeas_CurrMeasEolGainCalSetABC_SetRamBlockStatus: RteEventRef=OIT_SetRamBlockStatus_PSProxy_Rte_NvmBlock_CDD_CurrMeas_CurrMeasEolGainCalSetABC_SetRamBlockStatus
        OIT_WriteBlock_PSProxy_Rte_NvmBlock_MotTqCmdSca_MotTqScaFac_WriteBlock: RteEventRef=OIT_WriteBlock_PSProxy_Rte_NvmBlock_MotTqCmdSca_MotTqScaFac_WriteBlock
        OIT_ReadBlock_PSProxy_Rte_NvmBlock_CDD_CurrMeas_CurrMeasEolOffsCalSetABC_ReadBlock: RteEventRef=OIT_ReadBlock_PSProxy_Rte_NvmBlock_CDD_CurrMeas_CurrMeasEolOffsCalSetABC_ReadBlock
        OIT_ReadBlock_PSProxy_Rte_NvmBlock_DiagcMgr_DiagcMgrLtchCntrAry_ReadBlock: RteEventRef=OIT_ReadBlock_PSProxy_Rte_NvmBlock_DiagcMgr_DiagcMgrLtchCntrAry_ReadBlock
        OIT_SetBlockProtection_PAdminProxy_Rte_NvmBlock_CDD_CurrMeas_CurrMeasEolOffsCalSetABC_SetBlockProtection: RteEventRef=OIT_SetBlockProtection_PAdminProxy_Rte_NvmBlock_CDD_CurrMeas_CurrMeasEolOffsCalSetABC_SetBlockProtection
        OIT_SetBlockProtection_PAdminProxy_Rte_NvmBlock_CDD_CurrMeas_CurrMeasEolGainCalSetABC_SetBlockProtection: RteEventRef=OIT_SetBlockProtection_PAdminProxy_Rte_NvmBlock_CDD_CurrMeas_CurrMeasEolGainCalSetABC_SetBlockProtection
        OIT_SetRamBlockStatus_PSProxy_Rte_NvmBlock_PolarityCfg_PolarityCfgSaved_SetRamBlockStatus: RteEventRef=OIT_SetRamBlockStatus_PSProxy_Rte_NvmBlock_PolarityCfg_PolarityCfgSaved_SetRamBlockStatus
        OIT_ReadBlock_PSProxy_Rte_NvmBlock_CDD_MotAgCmp_MotAgCmpMotAgBackEmf_ReadBlock: RteEventRef=OIT_ReadBlock_PSProxy_Rte_NvmBlock_CDD_MotAgCmp_MotAgCmpMotAgBackEmf_ReadBlock
        OIT_ReadBlock_PSProxy_Rte_NvmBlock_CDD_CurrMeas_CurrMeasEolGainCalSetABC_ReadBlock: RteEventRef=OIT_ReadBlock_PSProxy_Rte_NvmBlock_CDD_CurrMeas_CurrMeasEolGainCalSetABC_ReadBlock
        OIT_GetErrorStatus_PSProxy_Rte_NvmBlock_CDD_CurrMeas_CurrMeasEolGainCalSetABC_GetErrorStatus: RteEventRef=OIT_GetErrorStatus_PSProxy_Rte_NvmBlock_CDD_CurrMeas_CurrMeasEolGainCalSetABC_GetErrorStatus
        OIT_SetBlockProtection_PAdminProxy_Rte_NvmBlock_MotTqCmdSca_MotTqScaFac_SetBlockProtection: RteEventRef=OIT_SetBlockProtection_PAdminProxy_Rte_NvmBlock_MotTqCmdSca_MotTqScaFac_SetBlockProtection
        OIT_WriteBlock_PSProxy_Rte_NvmBlock_DiagcMgr_DiagcMgrLtchCntrAry_WriteBlock: RteEventRef=OIT_WriteBlock_PSProxy_Rte_NvmBlock_DiagcMgr_DiagcMgrLtchCntrAry_WriteBlock
        OIT_EraseBlock_PSProxy_Rte_NvmBlock_CDD_MotAgCmp_MotAgCmpMotAgBackEmf_EraseBlock: RteEventRef=OIT_EraseBlock_PSProxy_Rte_NvmBlock_CDD_MotAgCmp_MotAgCmpMotAgBackEmf_EraseBlock
        OIT_RestoreBlockDefaults_PSProxy_Rte_NvmBlock_CDD_CurrMeas_CurrMeasEolOffsCalSetABC_RestoreBlockDefaults: RteEventRef=OIT_RestoreBlockDefaults_PSProxy_Rte_NvmBlock_CDD_CurrMeas_CurrMeasEolOffsCalSetABC_RestoreBlockDefaults
        OIT_GetErrorStatus_PSProxy_Rte_NvmBlock_CDD_MotAgCmp_MotAgCmpMotAgBackEmf_GetErrorStatus: RteEventRef=OIT_GetErrorStatus_PSProxy_Rte_NvmBlock_CDD_MotAgCmp_MotAgCmpMotAgBackEmf_GetErrorStatus
        OIT_ReadBlock_PSProxy_Rte_NvmBlock_CDD_NvMProxy_ShtdwnClsChk_ReadBlock: RteEventRef=OIT_ReadBlock_PSProxy_Rte_NvmBlock_CDD_NvMProxy_ShtdwnClsChk_ReadBlock
        OIT_WriteBlock_PSProxy_Rte_NvmBlock_CDD_NvMProxy_ShtdwnClsChk_WriteBlock: RteEventRef=OIT_WriteBlock_PSProxy_Rte_NvmBlock_CDD_NvMProxy_ShtdwnClsChk_WriteBlock
        OIT_InvalidateNvBlock_PSProxy_Rte_NvmBlock_DiagcMgr_DiagcMgrLtchCntrAry_InvalidateNvBlock: RteEventRef=OIT_InvalidateNvBlock_PSProxy_Rte_NvmBlock_DiagcMgr_DiagcMgrLtchCntrAry_InvalidateNvBlock
        OIT_SetRamBlockStatus_PSProxy_Rte_NvmBlock_HwTqCorrln_HwTqChACmnModCmpLpFilSt_SetRamBlockStatus: RteEventRef=OIT_SetRamBlockStatus_PSProxy_Rte_NvmBlock_HwTqCorrln_HwTqChACmnModCmpLpFilSt_SetRamBlockStatus
        OIT_ReadBlock_PSProxy_Rte_NvmBlock_MotTqCmdSca_MotTqScaFac_ReadBlock: RteEventRef=OIT_ReadBlock_PSProxy_Rte_NvmBlock_MotTqCmdSca_MotTqScaFac_ReadBlock
        OIT_SetBlockProtection_PAdminProxy_Rte_NvmBlock_DiagcMgr_DiagcMgrNtcFltAry_SetBlockProtection: RteEventRef=OIT_SetBlockProtection_PAdminProxy_Rte_NvmBlock_DiagcMgr_DiagcMgrNtcFltAry_SetBlockProtection
        OIT_RestoreBlockDefaults_PSProxy_Rte_NvmBlock_PolarityCfg_PolarityCfgSaved_RestoreBlockDefaults: RteEventRef=OIT_RestoreBlockDefaults_PSProxy_Rte_NvmBlock_PolarityCfg_PolarityCfgSaved_RestoreBlockDefaults
        OIT_InvalidateNvBlock_PSProxy_Rte_NvmBlock_CDD_CurrMeas_CurrMeasEolOffsCalSetABC_InvalidateNvBlock: RteEventRef=OIT_InvalidateNvBlock_PSProxy_Rte_NvmBlock_CDD_CurrMeas_CurrMeasEolOffsCalSetABC_InvalidateNvBlock
        OIT_SetBlockProtection_PAdminProxy_Rte_NvmBlock_DiagcMgr_DiagcMgrLtchCntrAry_SetBlockProtection: RteEventRef=OIT_SetBlockProtection_PAdminProxy_Rte_NvmBlock_DiagcMgr_DiagcMgrLtchCntrAry_SetBlockProtection
        OIT_GetErrorStatus_PSProxy_Rte_NvmBlock_HwTqCorrln_HwTqChACmnModCmpLpFilSt_GetErrorStatus: RteEventRef=OIT_GetErrorStatus_PSProxy_Rte_NvmBlock_HwTqCorrln_HwTqChACmnModCmpLpFilSt_GetErrorStatus
        OIT_SetRamBlockStatus_PSProxy_Rte_NvmBlock_CDD_NvMProxy_ShtdwnClsChk_SetRamBlockStatus: RteEventRef=OIT_SetRamBlockStatus_PSProxy_Rte_NvmBlock_CDD_NvMProxy_ShtdwnClsChk_SetRamBlockStatus
        OIT_EraseBlock_PSProxy_Rte_NvmBlock_MotTqCmdSca_MotTqScaFac_EraseBlock: RteEventRef=OIT_EraseBlock_PSProxy_Rte_NvmBlock_MotTqCmdSca_MotTqScaFac_EraseBlock
        OIT_InvalidateNvBlock_PSProxy_Rte_NvmBlock_HwTqCorrln_HwTqChACmnModCmpLpFilSt_InvalidateNvBlock: RteEventRef=OIT_InvalidateNvBlock_PSProxy_Rte_NvmBlock_HwTqCorrln_HwTqChACmnModCmpLpFilSt_InvalidateNvBlock
        OIT_GetErrorStatus_PSProxy_Rte_NvmBlock_CDD_CurrMeas_CurrMeasEolOffsCalSetABC_GetErrorStatus: RteEventRef=OIT_GetErrorStatus_PSProxy_Rte_NvmBlock_CDD_CurrMeas_CurrMeasEolOffsCalSetABC_GetErrorStatus
        OIT_RestoreBlockDefaults_PSProxy_Rte_NvmBlock_CDD_MotAgCmp_MotAgCmpMotAgBackEmf_RestoreBlockDefaults: RteEventRef=OIT_RestoreBlockDefaults_PSProxy_Rte_NvmBlock_CDD_MotAgCmp_MotAgCmpMotAgBackEmf_RestoreBlockDefaults
        OIT_SetBlockProtection_PAdminProxy_Rte_NvmBlock_CDD_MotAgCmp_MotAgCmpMotAgBackEmf_SetBlockProtection: RteEventRef=OIT_SetBlockProtection_PAdminProxy_Rte_NvmBlock_CDD_MotAgCmp_MotAgCmpMotAgBackEmf_SetBlockProtection
        OIT_InvalidateNvBlock_PSProxy_Rte_NvmBlock_PolarityCfg_PolarityCfgSaved_InvalidateNvBlock: RteEventRef=OIT_InvalidateNvBlock_PSProxy_Rte_NvmBlock_PolarityCfg_PolarityCfgSaved_InvalidateNvBlock
        OIT_SetRamBlockStatus_PSProxy_Rte_NvmBlock_CDD_CurrMeas_CurrMeasEolOffsCalSetABC_SetRamBlockStatus: RteEventRef=OIT_SetRamBlockStatus_PSProxy_Rte_NvmBlock_CDD_CurrMeas_CurrMeasEolOffsCalSetABC_SetRamBlockStatus
        OIT_GetErrorStatus_PSProxy_Rte_NvmBlock_PolarityCfg_PolarityCfgSaved_GetErrorStatus: RteEventRef=OIT_GetErrorStatus_PSProxy_Rte_NvmBlock_PolarityCfg_PolarityCfgSaved_GetErrorStatus
        OIT_RestoreBlockDefaults_PSProxy_Rte_NvmBlock_HwTqCorrln_HwTqChACmnModCmpLpFilSt_RestoreBlockDefaults: RteEventRef=OIT_RestoreBlockDefaults_PSProxy_Rte_NvmBlock_HwTqCorrln_HwTqChACmnModCmpLpFilSt_RestoreBlockDefaults
        OIT_WriteBlock_PSProxy_Rte_NvmBlock_HwTqCorrln_HwTqChACmnModCmpLpFilSt_WriteBlock: RteEventRef=OIT_WriteBlock_PSProxy_Rte_NvmBlock_HwTqCorrln_HwTqChACmnModCmpLpFilSt_WriteBlock
        OIT_SetRamBlockStatus_PSProxy_Rte_NvmBlock_MotTqCmdSca_MotTqScaFac_SetRamBlockStatus: RteEventRef=OIT_SetRamBlockStatus_PSProxy_Rte_NvmBlock_MotTqCmdSca_MotTqScaFac_SetRamBlockStatus
        OIT_EraseBlock_PSProxy_Rte_NvmBlock_DiagcMgr_DiagcMgrLtchCntrAry_EraseBlock: RteEventRef=OIT_EraseBlock_PSProxy_Rte_NvmBlock_DiagcMgr_DiagcMgrLtchCntrAry_EraseBlock
        OIT_ReadBlock_PSProxy_Rte_NvmBlock_PolarityCfg_PolarityCfgSaved_ReadBlock: RteEventRef=OIT_ReadBlock_PSProxy_Rte_NvmBlock_PolarityCfg_PolarityCfgSaved_ReadBlock
        OIT_EraseBlock_PSProxy_Rte_NvmBlock_CDD_CurrMeas_CurrMeasEolOffsCalSetABC_EraseBlock: RteEventRef=OIT_EraseBlock_PSProxy_Rte_NvmBlock_CDD_CurrMeas_CurrMeasEolOffsCalSetABC_EraseBlock
        OIT_SetRamBlockStatus_PSProxy_Rte_NvmBlock_CDD_MotAgCmp_MotAgCmpMotAgBackEmf_SetRamBlockStatus: RteEventRef=OIT_SetRamBlockStatus_PSProxy_Rte_NvmBlock_CDD_MotAgCmp_MotAgCmpMotAgBackEmf_SetRamBlockStatus
        OIT_GetErrorStatus_PSProxy_Rte_NvmBlock_MotTqCmdSca_MotTqScaFac_GetErrorStatus: RteEventRef=OIT_GetErrorStatus_PSProxy_Rte_NvmBlock_MotTqCmdSca_MotTqScaFac_GetErrorStatus
        OIT_InvalidateNvBlock_PSProxy_Rte_NvmBlock_CDD_NvMProxy_ShtdwnClsChk_InvalidateNvBlock: RteEventRef=OIT_InvalidateNvBlock_PSProxy_Rte_NvmBlock_CDD_NvMProxy_ShtdwnClsChk_InvalidateNvBlock
        OIT_InvalidateNvBlock_PSProxy_Rte_NvmBlock_MotTqCmdSca_MotTqScaFac_InvalidateNvBlock: RteEventRef=OIT_InvalidateNvBlock_PSProxy_Rte_NvmBlock_MotTqCmdSca_MotTqScaFac_InvalidateNvBlock
        OIT_WriteBlock_PSProxy_Rte_NvmBlock_CDD_MotAgCmp_MotAgCmpMotAgBackEmf_WriteBlock: RteEventRef=OIT_WriteBlock_PSProxy_Rte_NvmBlock_CDD_MotAgCmp_MotAgCmpMotAgBackEmf_WriteBlock
        OIT_EraseBlock_PSProxy_Rte_NvmBlock_PolarityCfg_PolarityCfgSaved_EraseBlock: RteEventRef=OIT_EraseBlock_PSProxy_Rte_NvmBlock_PolarityCfg_PolarityCfgSaved_EraseBlock
        OIT_GetErrorStatus_PSProxy_Rte_NvmBlock_CDD_NvMProxy_ShtdwnClsChk_GetErrorStatus: RteEventRef=OIT_GetErrorStatus_PSProxy_Rte_NvmBlock_CDD_NvMProxy_ShtdwnClsChk_GetErrorStatus
        OIT_EraseBlock_PSProxy_Rte_NvmBlock_DiagcMgr_DiagcMgrNtcFltAry_EraseBlock: RteEventRef=OIT_EraseBlock_PSProxy_Rte_NvmBlock_DiagcMgr_DiagcMgrNtcFltAry_EraseBlock
        OIT_SetRamBlockStatus_PSProxy_Rte_NvmBlock_DiagcMgr_DiagcMgrNtcFltAry_SetRamBlockStatus: RteEventRef=OIT_SetRamBlockStatus_PSProxy_Rte_NvmBlock_DiagcMgr_DiagcMgrNtcFltAry_SetRamBlockStatus
        OIT_SetBlockProtection_PAdminProxy_Rte_NvmBlock_HwTqCorrln_HwTqChACmnModCmpLpFilSt_SetBlockProtection: RteEventRef=OIT_SetBlockProtection_PAdminProxy_Rte_NvmBlock_HwTqCorrln_HwTqChACmnModCmpLpFilSt_SetBlockProtection
        OIT_RestoreBlockDefaults_PSProxy_Rte_NvmBlock_CDD_CurrMeas_CurrMeasEolGainCalSetABC_RestoreBlockDefaults: RteEventRef=OIT_RestoreBlockDefaults_PSProxy_Rte_NvmBlock_CDD_CurrMeas_CurrMeasEolGainCalSetABC_RestoreBlockDefaults
        OIT_EraseBlock_PSProxy_Rte_NvmBlock_HwTqCorrln_HwTqChACmnModCmpLpFilSt_EraseBlock: RteEventRef=OIT_EraseBlock_PSProxy_Rte_NvmBlock_HwTqCorrln_HwTqChACmnModCmpLpFilSt_EraseBlock
        OIT_GetErrorStatus_PSProxy_NVM_BLOCK_BOOT_PROG_COUNTER_GetErrorStatus: RteEventRef=OIT_GetErrorStatus_PSProxy_NVM_BLOCK_BOOT_PROG_COUNTER_GetErrorStatus
        OIT_ReadBlock_PSProxy_Rte_NvmBlock_Vin_ReadBlock: RteEventRef=OIT_ReadBlock_PSProxy_Rte_NvmBlock_Vin_ReadBlock
        OIT_RestoreBlockDefaults_PSProxy_Rte_NvmBlock_Vin_RestoreBlockDefaults: RteEventRef=OIT_RestoreBlockDefaults_PSProxy_Rte_NvmBlock_Vin_RestoreBlockDefaults
        OIT_InvalidateNvBlock_PSProxy_Rte_NvmBlock_Vin_InvalidateNvBlock: RteEventRef=OIT_InvalidateNvBlock_PSProxy_Rte_NvmBlock_Vin_InvalidateNvBlock
        OIT_GetErrorStatus_PSProxy_NVM_BLOCK_BOOT_SVK_HISTORY_GetErrorStatus: RteEventRef=OIT_GetErrorStatus_PSProxy_NVM_BLOCK_BOOT_SVK_HISTORY_GetErrorStatus
        OIT_WriteBlock_PSProxy_Rte_NvmBlock_Vin_WriteBlock: RteEventRef=OIT_WriteBlock_PSProxy_Rte_NvmBlock_Vin_WriteBlock
        OIT_SetRamBlockStatus_PSProxy_NVM_BLOCK_BOOT_PROG_DATA_SetRamBlockStatus: RteEventRef=OIT_SetRamBlockStatus_PSProxy_NVM_BLOCK_BOOT_PROG_DATA_SetRamBlockStatus
        OIT_EraseBlock_PSProxy_NVM_BLOCK_BOOT_SVK_HISTORY_EraseBlock: RteEventRef=OIT_EraseBlock_PSProxy_NVM_BLOCK_BOOT_SVK_HISTORY_EraseBlock
        OIT_ReadBlock_PSProxy_Rte_NvmBlock_Omc_ReadBlock: RteEventRef=OIT_ReadBlock_PSProxy_Rte_NvmBlock_Omc_ReadBlock
        OIT_SetBlockProtection_PAdminProxy_NVM_BLOCK_DLOG_SVK_PLANT_SetBlockProtection: RteEventRef=OIT_SetBlockProtection_PAdminProxy_NVM_BLOCK_DLOG_SVK_PLANT_SetBlockProtection
        OIT_SetRamBlockStatus_PSProxy_Rte_NvmBlock_Darh_ErrorQueue_SetRamBlockStatus: RteEventRef=OIT_SetRamBlockStatus_PSProxy_Rte_NvmBlock_Darh_ErrorQueue_SetRamBlockStatus
        OIT_SetBlockProtection_PAdminProxy_NVM_BLOCK_BOOT_PROG_COUNTER_SetBlockProtection: RteEventRef=OIT_SetBlockProtection_PAdminProxy_NVM_BLOCK_BOOT_PROG_COUNTER_SetBlockProtection
        OIT_SetRamBlockStatus_PSProxy_NVM_BLOCK_DLOG_SVK_PLANT_SetRamBlockStatus: RteEventRef=OIT_SetRamBlockStatus_PSProxy_NVM_BLOCK_DLOG_SVK_PLANT_SetRamBlockStatus
        OIT_GetErrorStatus_PSProxy_Rte_NvmBlock_Vin_GetErrorStatus: RteEventRef=OIT_GetErrorStatus_PSProxy_Rte_NvmBlock_Vin_GetErrorStatus
        OIT_GetErrorStatus_PSProxy_NVM_BLOCK_DLOG_SVK_SYS_SUPP_GetErrorStatus: RteEventRef=OIT_GetErrorStatus_PSProxy_NVM_BLOCK_DLOG_SVK_SYS_SUPP_GetErrorStatus
        OIT_GetErrorStatus_PSProxy_Rte_NvmBlock_Omc_GetErrorStatus: RteEventRef=OIT_GetErrorStatus_PSProxy_Rte_NvmBlock_Omc_GetErrorStatus
        OIT_SetBlockProtection_PAdminProxy_Rte_NvmBlock_Omc_SetBlockProtection: RteEventRef=OIT_SetBlockProtection_PAdminProxy_Rte_NvmBlock_Omc_SetBlockProtection
        OIT_InvalidateNvBlock_PSProxy_NVM_BLOCK_BOOT_SVK_HISTORY_InvalidateNvBlock: RteEventRef=OIT_InvalidateNvBlock_PSProxy_NVM_BLOCK_BOOT_SVK_HISTORY_InvalidateNvBlock
        OIT_SetBlockProtection_PAdminProxy_NVM_BLOCK_BOOT_PROG_DATA_SetBlockProtection: RteEventRef=OIT_SetBlockProtection_PAdminProxy_NVM_BLOCK_BOOT_PROG_DATA_SetBlockProtection
        OIT_WriteBlock_PSProxy_NVM_BLOCK_DLOG_SVK_SYS_SUPP_WriteBlock: RteEventRef=OIT_WriteBlock_PSProxy_NVM_BLOCK_DLOG_SVK_SYS_SUPP_WriteBlock
        OIT_GetErrorStatus_PSProxy_Rte_NvmBlock_Darh_ErrorQueue_GetErrorStatus: RteEventRef=OIT_GetErrorStatus_PSProxy_Rte_NvmBlock_Darh_ErrorQueue_GetErrorStatus
        OIT_GetErrorStatus_PSProxy_NVM_BLOCK_BOOT_PROG_DATA_GetErrorStatus: RteEventRef=OIT_GetErrorStatus_PSProxy_NVM_BLOCK_BOOT_PROG_DATA_GetErrorStatus
        OIT_EraseBlock_PSProxy_Rte_NvmBlock_Omc_EraseBlock: RteEventRef=OIT_EraseBlock_PSProxy_Rte_NvmBlock_Omc_EraseBlock
        OIT_RestoreBlockDefaults_PSProxy_Rte_NvmBlock_Darh_ErrorQueue_RestoreBlockDefaults: RteEventRef=OIT_RestoreBlockDefaults_PSProxy_Rte_NvmBlock_Darh_ErrorQueue_RestoreBlockDefaults
        OIT_EraseBlock_PSProxy_NVM_BLOCK_BOOT_PROG_COUNTER_EraseBlock: RteEventRef=OIT_EraseBlock_PSProxy_NVM_BLOCK_BOOT_PROG_COUNTER_EraseBlock
        OIT_EraseBlock_PSProxy_NVM_BLOCK_DLOG_SVK_PLANT_EraseBlock: RteEventRef=OIT_EraseBlock_PSProxy_NVM_BLOCK_DLOG_SVK_PLANT_EraseBlock
        OIT_SetBlockProtection_PAdminProxy_Rte_NvmBlock_Darh_ErrorQueue_SetBlockProtection: RteEventRef=OIT_SetBlockProtection_PAdminProxy_Rte_NvmBlock_Darh_ErrorQueue_SetBlockProtection
        OIT_WriteBlock_PSProxy_NVM_BLOCK_BOOT_PROG_DATA_WriteBlock: RteEventRef=OIT_WriteBlock_PSProxy_NVM_BLOCK_BOOT_PROG_DATA_WriteBlock
        OIT_ReadBlock_PSProxy_Rte_NvmBlock_Darh_ErrorQueue_ReadBlock: RteEventRef=OIT_ReadBlock_PSProxy_Rte_NvmBlock_Darh_ErrorQueue_ReadBlock
        OIT_SetRamBlockStatus_PSProxy_NVM_BLOCK_DLOG_SVK_SYS_SUPP_SetRamBlockStatus: RteEventRef=OIT_SetRamBlockStatus_PSProxy_NVM_BLOCK_DLOG_SVK_SYS_SUPP_SetRamBlockStatus
        OIT_ReadBlock_PSProxy_NVM_BLOCK_BOOT_PROG_DATA_ReadBlock: RteEventRef=OIT_ReadBlock_PSProxy_NVM_BLOCK_BOOT_PROG_DATA_ReadBlock
        OIT_InvalidateNvBlock_PSProxy_NVM_BLOCK_BOOT_PROG_COUNTER_InvalidateNvBlock: RteEventRef=OIT_InvalidateNvBlock_PSProxy_NVM_BLOCK_BOOT_PROG_COUNTER_InvalidateNvBlock
        OIT_EraseBlock_PSProxy_Rte_NvmBlock_Vin_EraseBlock: RteEventRef=OIT_EraseBlock_PSProxy_Rte_NvmBlock_Vin_EraseBlock
        OIT_ReadBlock_PSProxy_NVM_BLOCK_BOOT_PROG_COUNTER_ReadBlock: RteEventRef=OIT_ReadBlock_PSProxy_NVM_BLOCK_BOOT_PROG_COUNTER_ReadBlock
        OIT_InvalidateNvBlock_PSProxy_Rte_NvmBlock_Darh_ErrorQueue_InvalidateNvBlock: RteEventRef=OIT_InvalidateNvBlock_PSProxy_Rte_NvmBlock_Darh_ErrorQueue_InvalidateNvBlock
        OIT_SetRamBlockStatus_PSProxy_Rte_NvmBlock_Omc_SetRamBlockStatus: RteEventRef=OIT_SetRamBlockStatus_PSProxy_Rte_NvmBlock_Omc_SetRamBlockStatus
        OIT_WriteBlock_PSProxy_Rte_NvmBlock_Darh_ErrorQueue_WriteBlock: RteEventRef=OIT_WriteBlock_PSProxy_Rte_NvmBlock_Darh_ErrorQueue_WriteBlock
        OIT_ReadBlock_PSProxy_NVM_BLOCK_DLOG_SVK_SYS_SUPP_ReadBlock: RteEventRef=OIT_ReadBlock_PSProxy_NVM_BLOCK_DLOG_SVK_SYS_SUPP_ReadBlock
        OIT_SetRamBlockStatus_PSProxy_NVM_BLOCK_BOOT_PROG_COUNTER_SetRamBlockStatus: RteEventRef=OIT_SetRamBlockStatus_PSProxy_NVM_BLOCK_BOOT_PROG_COUNTER_SetRamBlockStatus
        OIT_WriteBlock_PSProxy_NVM_BLOCK_BOOT_PROG_COUNTER_WriteBlock: RteEventRef=OIT_WriteBlock_PSProxy_NVM_BLOCK_BOOT_PROG_COUNTER_WriteBlock
        OIT_WriteBlock_PSProxy_Rte_NvmBlock_Omc_WriteBlock: RteEventRef=OIT_WriteBlock_PSProxy_Rte_NvmBlock_Omc_WriteBlock
        OIT_ReadBlock_PSProxy_NVM_BLOCK_DLOG_SVK_PLANT_ReadBlock: RteEventRef=OIT_ReadBlock_PSProxy_NVM_BLOCK_DLOG_SVK_PLANT_ReadBlock
        OIT_InvalidateNvBlock_PSProxy_NVM_BLOCK_DLOG_SVK_SYS_SUPP_InvalidateNvBlock: RteEventRef=OIT_InvalidateNvBlock_PSProxy_NVM_BLOCK_DLOG_SVK_SYS_SUPP_InvalidateNvBlock
        OIT_WriteBlock_PSProxy_NVM_BLOCK_DLOG_SVK_PLANT_WriteBlock: RteEventRef=OIT_WriteBlock_PSProxy_NVM_BLOCK_DLOG_SVK_PLANT_WriteBlock
        OIT_EraseBlock_PSProxy_NVM_BLOCK_BOOT_PROG_DATA_EraseBlock: RteEventRef=OIT_EraseBlock_PSProxy_NVM_BLOCK_BOOT_PROG_DATA_EraseBlock
        OIT_SetRamBlockStatus_PSProxy_NVM_BLOCK_BOOT_SVK_HISTORY_SetRamBlockStatus: RteEventRef=OIT_SetRamBlockStatus_PSProxy_NVM_BLOCK_BOOT_SVK_HISTORY_SetRamBlockStatus
        OIT_GetErrorStatus_PSProxy_NVM_BLOCK_DLOG_SVK_PLANT_GetErrorStatus: RteEventRef=OIT_GetErrorStatus_PSProxy_NVM_BLOCK_DLOG_SVK_PLANT_GetErrorStatus
        OIT_SetBlockProtection_PAdminProxy_NVM_BLOCK_BOOT_SVK_HISTORY_SetBlockProtection: RteEventRef=OIT_SetBlockProtection_PAdminProxy_NVM_BLOCK_BOOT_SVK_HISTORY_SetBlockProtection
        OIT_SetBlockProtection_PAdminProxy_NVM_BLOCK_DLOG_SVK_SYS_SUPP_SetBlockProtection: RteEventRef=OIT_SetBlockProtection_PAdminProxy_NVM_BLOCK_DLOG_SVK_SYS_SUPP_SetBlockProtection
        OIT_EraseBlock_PSProxy_NVM_BLOCK_DLOG_SVK_SYS_SUPP_EraseBlock: RteEventRef=OIT_EraseBlock_PSProxy_NVM_BLOCK_DLOG_SVK_SYS_SUPP_EraseBlock
        OIT_ReadBlock_PSProxy_NVM_BLOCK_BOOT_SVK_HISTORY_ReadBlock: RteEventRef=OIT_ReadBlock_PSProxy_NVM_BLOCK_BOOT_SVK_HISTORY_ReadBlock
        OIT_SetBlockProtection_PAdminProxy_Rte_NvmBlock_Vin_SetBlockProtection: RteEventRef=OIT_SetBlockProtection_PAdminProxy_Rte_NvmBlock_Vin_SetBlockProtection
        OIT_RestoreBlockDefaults_PSProxy_Rte_NvmBlock_Omc_RestoreBlockDefaults: RteEventRef=OIT_RestoreBlockDefaults_PSProxy_Rte_NvmBlock_Omc_RestoreBlockDefaults
        OIT_SetRamBlockStatus_PSProxy_Rte_NvmBlock_Vin_SetRamBlockStatus: RteEventRef=OIT_SetRamBlockStatus_PSProxy_Rte_NvmBlock_Vin_SetRamBlockStatus
        OIT_InvalidateNvBlock_PSProxy_Rte_NvmBlock_Omc_InvalidateNvBlock: RteEventRef=OIT_InvalidateNvBlock_PSProxy_Rte_NvmBlock_Omc_InvalidateNvBlock
        OIT_InvalidateNvBlock_PSProxy_NVM_BLOCK_DLOG_SVK_PLANT_InvalidateNvBlock: RteEventRef=OIT_InvalidateNvBlock_PSProxy_NVM_BLOCK_DLOG_SVK_PLANT_InvalidateNvBlock
        OIT_InvalidateNvBlock_PSProxy_NVM_BLOCK_BOOT_PROG_DATA_InvalidateNvBlock: RteEventRef=OIT_InvalidateNvBlock_PSProxy_NVM_BLOCK_BOOT_PROG_DATA_InvalidateNvBlock
        OIT_WriteBlock_PSProxy_NVM_BLOCK_BOOT_SVK_HISTORY_WriteBlock: RteEventRef=OIT_WriteBlock_PSProxy_NVM_BLOCK_BOOT_SVK_HISTORY_WriteBlock
        OIT_EraseBlock_PSProxy_Rte_NvmBlock_Darh_ErrorQueue_EraseBlock: RteEventRef=OIT_EraseBlock_PSProxy_Rte_NvmBlock_Darh_ErrorQueue_EraseBlock
        OIT_GetErrorStatus_PSProxy_Rte_NvmBlock_CDD_VrfyCritReg_MCalReadVrfyCritRegFltInfo_GetErrorStatus: RteEventRef=OIT_GetErrorStatus_PSProxy_Rte_NvmBlock_CDD_VrfyCritReg_MCalReadVrfyCritRegFltInfo_GetErrorStatus
        OIT_SetRamBlockStatus_PSProxy_Rte_NvmBlock_CDD_VrfyCritReg_MCalReadVrfyCritRegFltInfo_SetRamBlockStatus: RteEventRef=OIT_SetRamBlockStatus_PSProxy_Rte_NvmBlock_CDD_VrfyCritReg_MCalReadVrfyCritRegFltInfo_SetRamBlockStatus
        OIT_SetBlockProtection_PAdminProxy_Rte_NvmBlock_CDD_VrfyCritReg_MCalReadVrfyCritRegFltInfo_SetBlockProtection: RteEventRef=OIT_SetBlockProtection_PAdminProxy_Rte_NvmBlock_CDD_VrfyCritReg_MCalReadVrfyCritRegFltInfo_SetBlockProtection
        OIT_WriteBlock_PSProxy_Rte_NvmBlock_CDD_VrfyCritReg_MCalReadVrfyCritRegFltInfo_WriteBlock: RteEventRef=OIT_WriteBlock_PSProxy_Rte_NvmBlock_CDD_VrfyCritReg_MCalReadVrfyCritRegFltInfo_WriteBlock
        OIT_EraseBlock_PSProxy_Rte_NvmBlock_CDD_VrfyCritReg_MCalReadVrfyCritRegFltInfo_EraseBlock: RteEventRef=OIT_EraseBlock_PSProxy_Rte_NvmBlock_CDD_VrfyCritReg_MCalReadVrfyCritRegFltInfo_EraseBlock
        OIT_InvalidateNvBlock_PSProxy_Rte_NvmBlock_CDD_VrfyCritReg_MCalReadVrfyCritRegFltInfo_InvalidateNvBlock: RteEventRef=OIT_InvalidateNvBlock_PSProxy_Rte_NvmBlock_CDD_VrfyCritReg_MCalReadVrfyCritRegFltInfo_InvalidateNvBlock
        OIT_ReadBlock_PSProxy_Rte_NvmBlock_CDD_VrfyCritReg_MCalReadVrfyCritRegFltInfo_ReadBlock: RteEventRef=OIT_ReadBlock_PSProxy_Rte_NvmBlock_CDD_VrfyCritReg_MCalReadVrfyCritRegFltInfo_ReadBlock
        OIT_SetBlockProtection_PAdminProxy_Rte_NvmBlock_LrndRackCentr_LrndRackCentr_SetBlockProtection: RteEventRef=OIT_SetBlockProtection_PAdminProxy_Rte_NvmBlock_LrndRackCentr_LrndRackCentr_SetBlockProtection
        OIT_SetBlockProtection_PAdminProxy_Rte_NvmBlock_BmwHwAgArbnAndEotPosn_BmwVehCentrOffs_SetBlockProtection: RteEventRef=OIT_SetBlockProtection_PAdminProxy_Rte_NvmBlock_BmwHwAgArbnAndEotPosn_BmwVehCentrOffs_SetBlockProtection
        OIT_GetErrorStatus_PSProxy_Rte_NvmBlock_LrndRackCentr_LrndRackCentr_GetErrorStatus: RteEventRef=OIT_GetErrorStatus_PSProxy_Rte_NvmBlock_LrndRackCentr_LrndRackCentr_GetErrorStatus
        OIT_WriteBlock_PSProxy_Rte_NvmBlock_LrndRackCentr_LrndRackCentr_WriteBlock: RteEventRef=OIT_WriteBlock_PSProxy_Rte_NvmBlock_LrndRackCentr_LrndRackCentr_WriteBlock
        OIT_SetRamBlockStatus_PSProxy_Rte_NvmBlock_BmwHwAgArbnAndEotPosn_BmwVehCentrOffs_SetRamBlockStatus: RteEventRef=OIT_SetRamBlockStatus_PSProxy_Rte_NvmBlock_BmwHwAgArbnAndEotPosn_BmwVehCentrOffs_SetRamBlockStatus
        OIT_InvalidateNvBlock_PSProxy_Rte_NvmBlock_BmwHwAgArbnAndEotPosn_BmwVehCentrOffs_InvalidateNvBlock: RteEventRef=OIT_InvalidateNvBlock_PSProxy_Rte_NvmBlock_BmwHwAgArbnAndEotPosn_BmwVehCentrOffs_InvalidateNvBlock
        OIT_EraseBlock_PSProxy_Rte_NvmBlock_BmwHwAgArbnAndEotPosn_BmwVehCentrOffs_EraseBlock: RteEventRef=OIT_EraseBlock_PSProxy_Rte_NvmBlock_BmwHwAgArbnAndEotPosn_BmwVehCentrOffs_EraseBlock
        OIT_EraseBlock_PSProxy_Rte_NvmBlock_LrndRackCentr_LrndRackCentr_EraseBlock: RteEventRef=OIT_EraseBlock_PSProxy_Rte_NvmBlock_LrndRackCentr_LrndRackCentr_EraseBlock
        OIT_GetErrorStatus_PSProxy_Rte_NvmBlock_BmwHwAgArbnAndEotPosn_BmwVehCentrOffs_GetErrorStatus: RteEventRef=OIT_GetErrorStatus_PSProxy_Rte_NvmBlock_BmwHwAgArbnAndEotPosn_BmwVehCentrOffs_GetErrorStatus
        OIT_ReadBlock_PSProxy_Rte_NvmBlock_LrndRackCentr_LrndRackCentr_ReadBlock: RteEventRef=OIT_ReadBlock_PSProxy_Rte_NvmBlock_LrndRackCentr_LrndRackCentr_ReadBlock
        OIT_WriteBlock_PSProxy_Rte_NvmBlock_BmwHwAgArbnAndEotPosn_BmwVehCentrOffs_WriteBlock: RteEventRef=OIT_WriteBlock_PSProxy_Rte_NvmBlock_BmwHwAgArbnAndEotPosn_BmwVehCentrOffs_WriteBlock
        OIT_ReadBlock_PSProxy_Rte_NvmBlock_BmwHwAgArbnAndEotPosn_BmwVehCentrOffs_ReadBlock: RteEventRef=OIT_ReadBlock_PSProxy_Rte_NvmBlock_BmwHwAgArbnAndEotPosn_BmwVehCentrOffs_ReadBlock
        OIT_InvalidateNvBlock_PSProxy_Rte_NvmBlock_LrndRackCentr_LrndRackCentr_InvalidateNvBlock: RteEventRef=OIT_InvalidateNvBlock_PSProxy_Rte_NvmBlock_LrndRackCentr_LrndRackCentr_InvalidateNvBlock
        OIT_SetRamBlockStatus_PSProxy_Rte_NvmBlock_LrndRackCentr_LrndRackCentr_SetRamBlockStatus: RteEventRef=OIT_SetRamBlockStatus_PSProxy_Rte_NvmBlock_LrndRackCentr_LrndRackCentr_SetRamBlockStatus
        OIT_EraseBlock_PSProxy_Rte_NvmBlock_ExcpnHndlg_McuDiagcData_EraseBlock: RteEventRef=OIT_EraseBlock_PSProxy_Rte_NvmBlock_ExcpnHndlg_McuDiagcData_EraseBlock
        OIT_ReadBlock_PSProxy_Rte_NvmBlock_ExcpnHndlg_McuDiagcData_ReadBlock: RteEventRef=OIT_ReadBlock_PSProxy_Rte_NvmBlock_ExcpnHndlg_McuDiagcData_ReadBlock
        OIT_WriteBlock_PSProxy_Rte_NvmBlock_ExcpnHndlg_McuDiagcData_WriteBlock: RteEventRef=OIT_WriteBlock_PSProxy_Rte_NvmBlock_ExcpnHndlg_McuDiagcData_WriteBlock
        OIT_InvalidateNvBlock_PSProxy_Rte_NvmBlock_ExcpnHndlg_McuDiagcData_InvalidateNvBlock: RteEventRef=OIT_InvalidateNvBlock_PSProxy_Rte_NvmBlock_ExcpnHndlg_McuDiagcData_InvalidateNvBlock
        OIT_GetErrorStatus_PSProxy_Rte_NvmBlock_ExcpnHndlg_McuDiagcData_GetErrorStatus: RteEventRef=OIT_GetErrorStatus_PSProxy_Rte_NvmBlock_ExcpnHndlg_McuDiagcData_GetErrorStatus
        OIT_RestoreBlockDefaults_PSProxy_Rte_NvmBlock_ExcpnHndlg_McuDiagcData_RestoreBlockDefaults: RteEventRef=OIT_RestoreBlockDefaults_PSProxy_Rte_NvmBlock_ExcpnHndlg_McuDiagcData_RestoreBlockDefaults
        OIT_SetRamBlockStatus_PSProxy_Rte_NvmBlock_ExcpnHndlg_McuDiagcData_SetRamBlockStatus: RteEventRef=OIT_SetRamBlockStatus_PSProxy_Rte_NvmBlock_ExcpnHndlg_McuDiagcData_SetRamBlockStatus
        OIT_SetBlockProtection_PAdminProxy_Rte_NvmBlock_ExcpnHndlg_McuDiagcData_SetBlockProtection: RteEventRef=OIT_SetBlockProtection_PAdminProxy_Rte_NvmBlock_ExcpnHndlg_McuDiagcData_SetBlockProtection
        OIT_SetRamBlockStatus_PSProxy_Rte_NvmBlock_TEstimn_TFilStVal_SetRamBlockStatus: RteEventRef=OIT_SetRamBlockStatus_PSProxy_Rte_NvmBlock_TEstimn_TFilStVal_SetRamBlockStatus
        OIT_EraseBlock_PSProxy_Rte_NvmBlock_TEstimn_TFilStVal_EraseBlock: RteEventRef=OIT_EraseBlock_PSProxy_Rte_NvmBlock_TEstimn_TFilStVal_EraseBlock
        OIT_WriteBlock_PSProxy_Rte_NvmBlock_TEstimn_TFilStVal_WriteBlock: RteEventRef=OIT_WriteBlock_PSProxy_Rte_NvmBlock_TEstimn_TFilStVal_WriteBlock
        OIT_InvalidateNvBlock_PSProxy_Rte_NvmBlock_TEstimn_TFilStVal_InvalidateNvBlock: RteEventRef=OIT_InvalidateNvBlock_PSProxy_Rte_NvmBlock_TEstimn_TFilStVal_InvalidateNvBlock
        OIT_SetBlockProtection_PAdminProxy_Rte_NvmBlock_TEstimn_TFilStVal_SetBlockProtection: RteEventRef=OIT_SetBlockProtection_PAdminProxy_Rte_NvmBlock_TEstimn_TFilStVal_SetBlockProtection
        OIT_ReadBlock_PSProxy_Rte_NvmBlock_TEstimn_TFilStVal_ReadBlock: RteEventRef=OIT_ReadBlock_PSProxy_Rte_NvmBlock_TEstimn_TFilStVal_ReadBlock
        OIT_GetErrorStatus_PSProxy_Rte_NvmBlock_TEstimn_TFilStVal_GetErrorStatus: RteEventRef=OIT_GetErrorStatus_PSProxy_Rte_NvmBlock_TEstimn_TFilStVal_GetErrorStatus
        OIT_GetErrorStatus_PSProxy_NVM_BLOCK_DLOG_SVK_ENTRY_GetErrorStatus: RteEventRef=OIT_GetErrorStatus_PSProxy_NVM_BLOCK_DLOG_SVK_ENTRY_GetErrorStatus
        OIT_WriteBlock_PSProxy_NVM_BLOCK_DLOG_SVK_ENTRY_WriteBlock: RteEventRef=OIT_WriteBlock_PSProxy_NVM_BLOCK_DLOG_SVK_ENTRY_WriteBlock
        OIT_SetBlockProtection_PAdminProxy_NVM_BLOCK_DLOG_SVK_ENTRY_SetBlockProtection: RteEventRef=OIT_SetBlockProtection_PAdminProxy_NVM_BLOCK_DLOG_SVK_ENTRY_SetBlockProtection
        OIT_EraseBlock_PSProxy_NVM_BLOCK_DLOG_SVK_ENTRY_EraseBlock: RteEventRef=OIT_EraseBlock_PSProxy_NVM_BLOCK_DLOG_SVK_ENTRY_EraseBlock
        OIT_InvalidateNvBlock_PSProxy_NVM_BLOCK_DLOG_SVK_ENTRY_InvalidateNvBlock: RteEventRef=OIT_InvalidateNvBlock_PSProxy_NVM_BLOCK_DLOG_SVK_ENTRY_InvalidateNvBlock
        OIT_GetDataIndex_PSProxy_NVM_BLOCK_DLOG_SVK_ENTRY_GetDataIndex: RteEventRef=OIT_GetDataIndex_PSProxy_NVM_BLOCK_DLOG_SVK_ENTRY_GetDataIndex
        OIT_ReadBlock_PSProxy_NVM_BLOCK_DLOG_SVK_ENTRY_ReadBlock: RteEventRef=OIT_ReadBlock_PSProxy_NVM_BLOCK_DLOG_SVK_ENTRY_ReadBlock
        OIT_SetDataIndex_PSProxy_NVM_BLOCK_DLOG_SVK_ENTRY_SetDataIndex: RteEventRef=OIT_SetDataIndex_PSProxy_NVM_BLOCK_DLOG_SVK_ENTRY_SetDataIndex
        OIT_SetRamBlockStatus_PSProxy_NVM_BLOCK_DLOG_SVK_ENTRY_SetRamBlockStatus: RteEventRef=OIT_SetRamBlockStatus_PSProxy_NVM_BLOCK_DLOG_SVK_ENTRY_SetRamBlockStatus
        OIT_EraseBlock_PSProxy_Rte_NvmBlock_Darh_DiagnoseMasterEnable_EraseBlock: RteEventRef=OIT_EraseBlock_PSProxy_Rte_NvmBlock_Darh_DiagnoseMasterEnable_EraseBlock
        OIT_ReadBlock_PSProxy_Rte_NvmBlock_Darh_DiagnoseMasterEnable_ReadBlock: RteEventRef=OIT_ReadBlock_PSProxy_Rte_NvmBlock_Darh_DiagnoseMasterEnable_ReadBlock
        OIT_SetRamBlockStatus_PSProxy_Rte_NvmBlock_Darh_DiagnoseMasterEnable_SetRamBlockStatus: RteEventRef=OIT_SetRamBlockStatus_PSProxy_Rte_NvmBlock_Darh_DiagnoseMasterEnable_SetRamBlockStatus
        OIT_InvalidateNvBlock_PSProxy_Rte_NvmBlock_Darh_DiagnoseMasterEnable_InvalidateNvBlock: RteEventRef=OIT_InvalidateNvBlock_PSProxy_Rte_NvmBlock_Darh_DiagnoseMasterEnable_InvalidateNvBlock
        OIT_SetBlockProtection_PAdminProxy_Rte_NvmBlock_Darh_DiagnoseMasterEnable_SetBlockProtection: RteEventRef=OIT_SetBlockProtection_PAdminProxy_Rte_NvmBlock_Darh_DiagnoseMasterEnable_SetBlockProtection
        OIT_WriteBlock_PSProxy_Rte_NvmBlock_Darh_DiagnoseMasterEnable_WriteBlock: RteEventRef=OIT_WriteBlock_PSProxy_Rte_NvmBlock_Darh_DiagnoseMasterEnable_WriteBlock
        OIT_GetErrorStatus_PSProxy_Rte_NvmBlock_Darh_DiagnoseMasterEnable_GetErrorStatus: RteEventRef=OIT_GetErrorStatus_PSProxy_Rte_NvmBlock_Darh_DiagnoseMasterEnable_GetErrorStatus
        OIT_SetBlockProtection_PAdminProxy_Rte_NvmBlock_BmwTunSetHndlr_BmwDesIninIdx_SetBlockProtection: RteEventRef=OIT_SetBlockProtection_PAdminProxy_Rte_NvmBlock_BmwTunSetHndlr_BmwDesIninIdx_SetBlockProtection
        OIT_GetErrorStatus_PSProxy_Rte_NvmBlock_BmwTunSetHndlr_BmwDesIninIdx_GetErrorStatus: RteEventRef=OIT_GetErrorStatus_PSProxy_Rte_NvmBlock_BmwTunSetHndlr_BmwDesIninIdx_GetErrorStatus
        OIT_SetRamBlockStatus_PSProxy_Rte_NvmBlock_BmwTunSetHndlr_BmwDesIninIdx_SetRamBlockStatus: RteEventRef=OIT_SetRamBlockStatus_PSProxy_Rte_NvmBlock_BmwTunSetHndlr_BmwDesIninIdx_SetRamBlockStatus
        OIT_RestoreBlockDefaults_PSProxy_Rte_NvmBlock_BmwTunSetHndlr_BmwDesIninIdx_RestoreBlockDefaults: RteEventRef=OIT_RestoreBlockDefaults_PSProxy_Rte_NvmBlock_BmwTunSetHndlr_BmwDesIninIdx_RestoreBlockDefaults
        OIT_EraseBlock_PSProxy_Rte_NvmBlock_BmwTunSetHndlr_BmwDesIninIdx_EraseBlock: RteEventRef=OIT_EraseBlock_PSProxy_Rte_NvmBlock_BmwTunSetHndlr_BmwDesIninIdx_EraseBlock
        OIT_WriteBlock_PSProxy_Rte_NvmBlock_BmwTunSetHndlr_BmwDesIninIdx_WriteBlock: RteEventRef=OIT_WriteBlock_PSProxy_Rte_NvmBlock_BmwTunSetHndlr_BmwDesIninIdx_WriteBlock
        OIT_ReadBlock_PSProxy_Rte_NvmBlock_BmwTunSetHndlr_BmwDesIninIdx_ReadBlock: RteEventRef=OIT_ReadBlock_PSProxy_Rte_NvmBlock_BmwTunSetHndlr_BmwDesIninIdx_ReadBlock
        OIT_InvalidateNvBlock_PSProxy_Rte_NvmBlock_BmwTunSetHndlr_BmwDesIninIdx_InvalidateNvBlock: RteEventRef=OIT_InvalidateNvBlock_PSProxy_Rte_NvmBlock_BmwTunSetHndlr_BmwDesIninIdx_InvalidateNvBlock
        OIT_WriteBlock_PSProxy_Rte_NvmBlock_Coding_CodingData_WriteBlock: RteEventRef=OIT_WriteBlock_PSProxy_Rte_NvmBlock_Coding_CodingData_WriteBlock
        OIT_RestoreBlockDefaults_PSProxy_Rte_NvmBlock_Coding_CodingData_RestoreBlockDefaults: RteEventRef=OIT_RestoreBlockDefaults_PSProxy_Rte_NvmBlock_Coding_CodingData_RestoreBlockDefaults
        OIT_ReadBlock_PSProxy_Rte_NvmBlock_Coding_CodingData_ReadBlock: RteEventRef=OIT_ReadBlock_PSProxy_Rte_NvmBlock_Coding_CodingData_ReadBlock
        OIT_SetRamBlockStatus_PSProxy_Rte_NvmBlock_Coding_CodingData_SetRamBlockStatus: RteEventRef=OIT_SetRamBlockStatus_PSProxy_Rte_NvmBlock_Coding_CodingData_SetRamBlockStatus
        OIT_SetBlockProtection_PAdminProxy_Rte_NvmBlock_Coding_CodingData_SetBlockProtection: RteEventRef=OIT_SetBlockProtection_PAdminProxy_Rte_NvmBlock_Coding_CodingData_SetBlockProtection
        OIT_InvalidateNvBlock_PSProxy_Rte_NvmBlock_Coding_CodingData_InvalidateNvBlock: RteEventRef=OIT_InvalidateNvBlock_PSProxy_Rte_NvmBlock_Coding_CodingData_InvalidateNvBlock
        OIT_EraseBlock_PSProxy_Rte_NvmBlock_Coding_CodingData_EraseBlock: RteEventRef=OIT_EraseBlock_PSProxy_Rte_NvmBlock_Coding_CodingData_EraseBlock
        OIT_GetErrorStatus_PSProxy_Rte_NvmBlock_Coding_CodingData_GetErrorStatus: RteEventRef=OIT_GetErrorStatus_PSProxy_Rte_NvmBlock_Coding_CodingData_GetErrorStatus
        OIT_WriteBlock_PSProxy_Rte_NvmBlock_BmwTunSetHndlr_NvmBmwDesIninOptSetAIdx_WriteBlock: RteEventRef=OIT_WriteBlock_PSProxy_Rte_NvmBlock_BmwTunSetHndlr_NvmBmwDesIninOptSetAIdx_WriteBlock
        OIT_SetRamBlockStatus_PSProxy_Rte_NvmBlock_BmwTunSetHndlr_NvmBmwDesIninOptSetAIdx_SetRamBlockStatus: RteEventRef=OIT_SetRamBlockStatus_PSProxy_Rte_NvmBlock_BmwTunSetHndlr_NvmBmwDesIninOptSetAIdx_SetRamBlockStatus
        OIT_ReadBlock_PSProxy_Rte_NvmBlock_BmwTunSetHndlr_NvmBmwDesIninOptSetAIdx_ReadBlock: RteEventRef=OIT_ReadBlock_PSProxy_Rte_NvmBlock_BmwTunSetHndlr_NvmBmwDesIninOptSetAIdx_ReadBlock
        OIT_EraseBlock_PSProxy_Rte_NvmBlock_BmwTunSetHndlr_NvmBmwDesIninOptSetAIdx_EraseBlock: RteEventRef=OIT_EraseBlock_PSProxy_Rte_NvmBlock_BmwTunSetHndlr_NvmBmwDesIninOptSetAIdx_EraseBlock
        OIT_GetErrorStatus_PSProxy_Rte_NvmBlock_BmwTunSetHndlr_NvmBmwDesIninOptSetAIdx_GetErrorStatus: RteEventRef=OIT_GetErrorStatus_PSProxy_Rte_NvmBlock_BmwTunSetHndlr_NvmBmwDesIninOptSetAIdx_GetErrorStatus
        OIT_SetBlockProtection_PAdminProxy_Rte_NvmBlock_BmwTunSetHndlr_NvmBmwDesIninOptSetAIdx_SetBlockProtection: RteEventRef=OIT_SetBlockProtection_PAdminProxy_Rte_NvmBlock_BmwTunSetHndlr_NvmBmwDesIninOptSetAIdx_SetBlockProtection
        OIT_RestoreBlockDefaults_PSProxy_Rte_NvmBlock_BmwTunSetHndlr_NvmBmwDesIninOptSetAIdx_RestoreBlockDefaults: RteEventRef=OIT_RestoreBlockDefaults_PSProxy_Rte_NvmBlock_BmwTunSetHndlr_NvmBmwDesIninOptSetAIdx_RestoreBlockDefaults
        OIT_InvalidateNvBlock_PSProxy_Rte_NvmBlock_BmwTunSetHndlr_NvmBmwDesIninOptSetAIdx_InvalidateNvBlock: RteEventRef=OIT_InvalidateNvBlock_PSProxy_Rte_NvmBlock_BmwTunSetHndlr_NvmBmwDesIninOptSetAIdx_InvalidateNvBlock
        OIT_GetErrorStatus_PSProxy_Rte_NvmBlock_BmwDiagcSrvHndlg_ProgCntrMaxVal_GetErrorStatus: RteEventRef=OIT_GetErrorStatus_PSProxy_Rte_NvmBlock_BmwDiagcSrvHndlg_ProgCntrMaxVal_GetErrorStatus
        OIT_GetErrorStatus_PSProxy_Rte_NvmBlock_BmwDiagcSrvHndlg_MilesKmEeprom_GetErrorStatus: RteEventRef=OIT_GetErrorStatus_PSProxy_Rte_NvmBlock_BmwDiagcSrvHndlg_MilesKmEeprom_GetErrorStatus
        OIT_InvalidateNvBlock_PSProxy_Rte_NvmBlock_BmwDiagcSrvHndlg_ProgCntrMaxVal_InvalidateNvBlock: RteEventRef=OIT_InvalidateNvBlock_PSProxy_Rte_NvmBlock_BmwDiagcSrvHndlg_ProgCntrMaxVal_InvalidateNvBlock
        OIT_ReadBlock_PSProxy_Rte_NvmBlock_BmwDiagcSrvHndlg_MilesKmEeprom_ReadBlock: RteEventRef=OIT_ReadBlock_PSProxy_Rte_NvmBlock_BmwDiagcSrvHndlg_MilesKmEeprom_ReadBlock
        OIT_WriteBlock_PSProxy_Rte_NvmBlock_BmwDiagcSrvHndlg_MilesKmEeprom_WriteBlock: RteEventRef=OIT_WriteBlock_PSProxy_Rte_NvmBlock_BmwDiagcSrvHndlg_MilesKmEeprom_WriteBlock
        OIT_SetRamBlockStatus_PSProxy_Rte_NvmBlock_BmwDiagcSrvHndlg_TestStamp_SetRamBlockStatus: RteEventRef=OIT_SetRamBlockStatus_PSProxy_Rte_NvmBlock_BmwDiagcSrvHndlg_TestStamp_SetRamBlockStatus
        OIT_EraseBlock_PSProxy_Rte_NvmBlock_BmwDiagcSrvHndlg_TestStamp_EraseBlock: RteEventRef=OIT_EraseBlock_PSProxy_Rte_NvmBlock_BmwDiagcSrvHndlg_TestStamp_EraseBlock
        OIT_InvalidateNvBlock_PSProxy_Rte_NvmBlock_BmwDiagcSrvHndlg_TestStamp_InvalidateNvBlock: RteEventRef=OIT_InvalidateNvBlock_PSProxy_Rte_NvmBlock_BmwDiagcSrvHndlg_TestStamp_InvalidateNvBlock
        OIT_WriteBlock_PSProxy_Rte_NvmBlock_BmwDiagcSrvHndlg_ProgCntr_WriteBlock: RteEventRef=OIT_WriteBlock_PSProxy_Rte_NvmBlock_BmwDiagcSrvHndlg_ProgCntr_WriteBlock
        OIT_WriteBlock_PSProxy_Rte_NvmBlock_BmwDiagcSrvHndlg_ProgCntrMaxVal_WriteBlock: RteEventRef=OIT_WriteBlock_PSProxy_Rte_NvmBlock_BmwDiagcSrvHndlg_ProgCntrMaxVal_WriteBlock
        OIT_InvalidateNvBlock_PSProxy_Rte_NvmBlock_BmwDiagcSrvHndlg_ProgCntr_InvalidateNvBlock: RteEventRef=OIT_InvalidateNvBlock_PSProxy_Rte_NvmBlock_BmwDiagcSrvHndlg_ProgCntr_InvalidateNvBlock
        OIT_SetBlockProtection_PAdminProxy_Rte_NvmBlock_BmwDiagcSrvHndlg_MilesKmEeprom_SetBlockProtection: RteEventRef=OIT_SetBlockProtection_PAdminProxy_Rte_NvmBlock_BmwDiagcSrvHndlg_MilesKmEeprom_SetBlockProtection
        OIT_SetRamBlockStatus_PSProxy_Rte_NvmBlock_BmwDiagcSrvHndlg_ProgCntrMaxVal_SetRamBlockStatus: RteEventRef=OIT_SetRamBlockStatus_PSProxy_Rte_NvmBlock_BmwDiagcSrvHndlg_ProgCntrMaxVal_SetRamBlockStatus
        OIT_ReadBlock_PSProxy_Rte_NvmBlock_BmwDiagcSrvHndlg_ProgCntr_ReadBlock: RteEventRef=OIT_ReadBlock_PSProxy_Rte_NvmBlock_BmwDiagcSrvHndlg_ProgCntr_ReadBlock
        OIT_SetRamBlockStatus_PSProxy_Rte_NvmBlock_BmwDiagcSrvHndlg_MilesKmEeprom_SetRamBlockStatus: RteEventRef=OIT_SetRamBlockStatus_PSProxy_Rte_NvmBlock_BmwDiagcSrvHndlg_MilesKmEeprom_SetRamBlockStatus
        OIT_ReadBlock_PSProxy_Rte_NvmBlock_BmwDiagcSrvHndlg_TestStamp_ReadBlock: RteEventRef=OIT_ReadBlock_PSProxy_Rte_NvmBlock_BmwDiagcSrvHndlg_TestStamp_ReadBlock
        OIT_EraseBlock_PSProxy_Rte_NvmBlock_BmwDiagcSrvHndlg_ProgCntr_EraseBlock: RteEventRef=OIT_EraseBlock_PSProxy_Rte_NvmBlock_BmwDiagcSrvHndlg_ProgCntr_EraseBlock
        OIT_SetBlockProtection_PAdminProxy_Rte_NvmBlock_BmwDiagcSrvHndlg_TestStamp_SetBlockProtection: RteEventRef=OIT_SetBlockProtection_PAdminProxy_Rte_NvmBlock_BmwDiagcSrvHndlg_TestStamp_SetBlockProtection
        OIT_RestoreBlockDefaults_PSProxy_Rte_NvmBlock_BmwDiagcSrvHndlg_ProgCntrMaxVal_RestoreBlockDefaults: RteEventRef=OIT_RestoreBlockDefaults_PSProxy_Rte_NvmBlock_BmwDiagcSrvHndlg_ProgCntrMaxVal_RestoreBlockDefaults
        OIT_SetBlockProtection_PAdminProxy_Rte_NvmBlock_BmwDiagcSrvHndlg_ProgCntrMaxVal_SetBlockProtection: RteEventRef=OIT_SetBlockProtection_PAdminProxy_Rte_NvmBlock_BmwDiagcSrvHndlg_ProgCntrMaxVal_SetBlockProtection
        OIT_EraseBlock_PSProxy_Rte_NvmBlock_BmwDiagcSrvHndlg_ProgCntrMaxVal_EraseBlock: RteEventRef=OIT_EraseBlock_PSProxy_Rte_NvmBlock_BmwDiagcSrvHndlg_ProgCntrMaxVal_EraseBlock
        OIT_ReadBlock_PSProxy_Rte_NvmBlock_BmwDiagcSrvHndlg_ProgCntrMaxVal_ReadBlock: RteEventRef=OIT_ReadBlock_PSProxy_Rte_NvmBlock_BmwDiagcSrvHndlg_ProgCntrMaxVal_ReadBlock
        OIT_GetErrorStatus_PSProxy_Rte_NvmBlock_BmwDiagcSrvHndlg_TestStamp_GetErrorStatus: RteEventRef=OIT_GetErrorStatus_PSProxy_Rte_NvmBlock_BmwDiagcSrvHndlg_TestStamp_GetErrorStatus
        OIT_InvalidateNvBlock_PSProxy_Rte_NvmBlock_BmwDiagcSrvHndlg_MilesKmEeprom_InvalidateNvBlock: RteEventRef=OIT_InvalidateNvBlock_PSProxy_Rte_NvmBlock_BmwDiagcSrvHndlg_MilesKmEeprom_InvalidateNvBlock
        OIT_WriteBlock_PSProxy_Rte_NvmBlock_BmwDiagcSrvHndlg_TestStamp_WriteBlock: RteEventRef=OIT_WriteBlock_PSProxy_Rte_NvmBlock_BmwDiagcSrvHndlg_TestStamp_WriteBlock
        OIT_GetErrorStatus_PSProxy_Rte_NvmBlock_BmwDiagcSrvHndlg_ProgCntr_GetErrorStatus: RteEventRef=OIT_GetErrorStatus_PSProxy_Rte_NvmBlock_BmwDiagcSrvHndlg_ProgCntr_GetErrorStatus
        OIT_SetRamBlockStatus_PSProxy_Rte_NvmBlock_BmwDiagcSrvHndlg_ProgCntr_SetRamBlockStatus: RteEventRef=OIT_SetRamBlockStatus_PSProxy_Rte_NvmBlock_BmwDiagcSrvHndlg_ProgCntr_SetRamBlockStatus
        OIT_EraseBlock_PSProxy_Rte_NvmBlock_BmwDiagcSrvHndlg_MilesKmEeprom_EraseBlock: RteEventRef=OIT_EraseBlock_PSProxy_Rte_NvmBlock_BmwDiagcSrvHndlg_MilesKmEeprom_EraseBlock
        OIT_SetBlockProtection_PAdminProxy_Rte_NvmBlock_BmwDiagcSrvHndlg_ProgCntr_SetBlockProtection: RteEventRef=OIT_SetBlockProtection_PAdminProxy_Rte_NvmBlock_BmwDiagcSrvHndlg_ProgCntr_SetBlockProtection
        OIT_InvalidateNvBlock_PSProxy_Rte_NvmBlock_PullCmpActv_PullCmpLongTerm_InvalidateNvBlock: RteEventRef=OIT_InvalidateNvBlock_PSProxy_Rte_NvmBlock_PullCmpActv_PullCmpLongTerm_InvalidateNvBlock
        OIT_SetRamBlockStatus_PSProxy_Rte_NvmBlock_PullCmpActv_PullCmpLongTerm_SetRamBlockStatus: RteEventRef=OIT_SetRamBlockStatus_PSProxy_Rte_NvmBlock_PullCmpActv_PullCmpLongTerm_SetRamBlockStatus
        OIT_SetBlockProtection_PAdminProxy_Rte_NvmBlock_PullCmpActv_PullCmpLongTerm_SetBlockProtection: RteEventRef=OIT_SetBlockProtection_PAdminProxy_Rte_NvmBlock_PullCmpActv_PullCmpLongTerm_SetBlockProtection
        OIT_WriteBlock_PSProxy_Rte_NvmBlock_PullCmpActv_PullCmpLongTerm_WriteBlock: RteEventRef=OIT_WriteBlock_PSProxy_Rte_NvmBlock_PullCmpActv_PullCmpLongTerm_WriteBlock
        OIT_GetErrorStatus_PSProxy_Rte_NvmBlock_PullCmpActv_PullCmpLongTerm_GetErrorStatus: RteEventRef=OIT_GetErrorStatus_PSProxy_Rte_NvmBlock_PullCmpActv_PullCmpLongTerm_GetErrorStatus
        OIT_EraseBlock_PSProxy_Rte_NvmBlock_PullCmpActv_PullCmpLongTerm_EraseBlock: RteEventRef=OIT_EraseBlock_PSProxy_Rte_NvmBlock_PullCmpActv_PullCmpLongTerm_EraseBlock
        OIT_ReadBlock_PSProxy_Rte_NvmBlock_PullCmpActv_PullCmpLongTerm_ReadBlock: RteEventRef=OIT_ReadBlock_PSProxy_Rte_NvmBlock_PullCmpActv_PullCmpLongTerm_ReadBlock
        OIT_RestoreBlockDefaults_PSProxy_Rte_NvmBlock_PullCmpActv_PullCmpLongTerm_RestoreBlockDefaults: RteEventRef=OIT_RestoreBlockDefaults_PSProxy_Rte_NvmBlock_PullCmpActv_PullCmpLongTerm_RestoreBlockDefaults
