[part 3 of 4: package /ActiveEcuC]
AUTOSAR XML (schema 4-3-0)
package /ActiveEcuC  (continued)
  module config Rte: implementation-config-variant=VARIANT-PRE-COMPILE, module-description=Rte_Impl  (continued)
    3 x RteSwComponentInstance:
      DemMaster_0_EcuSwComposition: RteSoftwareComponentInstanceRef=DemMaster_0
        40 x RteEventToTaskMapping, all with RteImmediateRestart=false:
          Timer_Dem_MasterMainFunction: RtePositionInTask=1, RteEventRef=Timer_Dem_MasterMainFunction, RteMappedToTaskRef=Task_10msBsw_Appl10, RteUsedOsAlarmRef=Rte_Al_TE2_Task_10msBsw_Appl10_0_10ms
          OpEventPostRunRequested_GetPostRunRequested_DemServices: RteEventRef=OpEventPostRunRequested_GetPostRunRequested_DemServices
          OpEventGetDTCStatusAvailabilityMask_GetDTCStatusAvailabilityMask_DemServices: RteEventRef=OpEventGetDTCStatusAvailabilityMask_GetDTCStatusAvailabilityMask_DemServices
          OpEventClearDTC_ClearDTC_ClearDTC_DemClient_DCM: RteEventRef=OpEventClearDTC_ClearDTC_ClearDTC_DemClient_DCM
          OpEventClearDTC_ClearDTC_ClearDTC_DemClient_CDD: RteEventRef=OpEventClearDTC_ClearDTC_ClearDTC_DemClient_CDD
          OpEventSelectDTC_SelectDTC_ClearDTC_DemClient_DCM: RteEventRef=OpEventSelectDTC_SelectDTC_ClearDTC_DemClient_DCM
          OpEventSelectDTC_SelectDTC_ClearDTC_DemClient_CDD: RteEventRef=OpEventSelectDTC_SelectDTC_ClearDTC_DemClient_CDD
          OpEventSetEnableCondition_SetEnableCondition_EnableCond_DemEnableCondition_Omc: RteEventRef=OpEventSetEnableCondition_SetEnableCondition_EnableCond_DemEnableCondition_Omc
          OpEventSetEnableCondition_SetEnableCondition_EnableCond_DemEnableCondition_StdDiag: RteEventRef=OpEventSetEnableCondition_SetEnableCondition_EnableCond_DemEnableCondition_StdDiag
          OpEventSetEnableCondition_SetEnableCondition_EnableCond_DemEnableCondition_Stm: RteEventRef=OpEventSetEnableCondition_SetEnableCondition_EnableCond_DemEnableCondition_Stm
          OpEventGetEventMemoryOverflow_GetEventMemoryOverflow_OverflowIndSecondaryMemory_DemClient_DCM: RteEventRef=OpEventGetEventMemoryOverflow_GetEventMemoryOverflow_OverflowIndSecondaryMemory_DemClient_DCM
          OpEventGetEventMemoryOverflow_GetEventMemoryOverflow_OverflowIndSecondaryMemory_DemClient_CDD: RteEventRef=OpEventGetEventMemoryOverflow_GetEventMemoryOverflow_OverflowIndSecondaryMemory_DemClient_CDD
          OpEventGetEventMemoryOverflow_GetEventMemoryOverflow_OverflowIndPrimaryMemory_DemClient_DCM: RteEventRef=OpEventGetEventMemoryOverflow_GetEventMemoryOverflow_OverflowIndPrimaryMemory_DemClient_DCM
          OpEventGetEventMemoryOverflow_GetEventMemoryOverflow_OverflowIndPrimaryMemory_DemClient_CDD: RteEventRef=OpEventGetEventMemoryOverflow_GetEventMemoryOverflow_OverflowIndPrimaryMemory_DemClient_CDD
          OpEventGetNumberOfEventMemoryEntries_GetNumberOfEventMemoryEntries_OverflowIndSecondaryMemory_DemClient_DCM: RteEventRef=OpEventGetNumberOfEventMemoryEntries_GetNumberOfEventMemoryEntries_OverflowIndSecondaryMemory_DemClient_DCM
          OpEventGetNumberOfEventMemoryEntries_GetNumberOfEventMemoryEntries_OverflowIndSecondaryMemory_DemClient_CDD: RteEventRef=OpEventGetNumberOfEventMemoryEntries_GetNumberOfEventMemoryEntries_OverflowIndSecondaryMemory_DemClient_CDD
          OpEventGetNumberOfEventMemoryEntries_GetNumberOfEventMemoryEntries_OverflowIndPrimaryMemory_DemClient_DCM: RteEventRef=OpEventGetNumberOfEventMemoryEntries_GetNumberOfEventMemoryEntries_OverflowIndPrimaryMemory_DemClient_DCM
          OpEventGetNumberOfEventMemoryEntries_GetNumberOfEventMemoryEntries_OverflowIndPrimaryMemory_DemClient_CDD: RteEventRef=OpEventGetNumberOfEventMemoryEntries_GetNumberOfEventMemoryEntries_OverflowIndPrimaryMemory_DemClient_CDD
          OpEventGetEventUdsStatus_GetEventUdsStatus_GeneralEventInfo: RteEventRef=OpEventGetEventUdsStatus_GetEventUdsStatus_GeneralEventInfo
          OpEventGetEventStatus_GetEventStatus_GeneralEventInfo: RteEventRef=OpEventGetEventStatus_GetEventStatus_GeneralEventInfo
          OpEventGetEventFailed_GetEventFailed_GeneralEventInfo: RteEventRef=OpEventGetEventFailed_GetEventFailed_GeneralEventInfo
          OpEventGetEventTested_GetEventTested_GeneralEventInfo: RteEventRef=OpEventGetEventTested_GetEventTested_GeneralEventInfo
          OpEventGetDTCOfEvent_GetDTCOfEvent_GeneralEventInfo: RteEventRef=OpEventGetDTCOfEvent_GetDTCOfEvent_GeneralEventInfo
          OpEventGetFaultDetectionCounter_GetFaultDetectionCounter_GeneralEventInfo: RteEventRef=OpEventGetFaultDetectionCounter_GetFaultDetectionCounter_GeneralEventInfo
          OpEventGetEventFreezeFrameDataEx_GetEventFreezeFrameDataEx_GeneralEventInfo: RteEventRef=OpEventGetEventFreezeFrameDataEx_GetEventFreezeFrameDataEx_GeneralEventInfo
          OpEventGetEventExtendedDataRecordEx_GetEventExtendedDataRecordEx_GeneralEventInfo: RteEventRef=OpEventGetEventExtendedDataRecordEx_GetEventExtendedDataRecordEx_GeneralEventInfo
          OpEventGetEventEnableCondition_GetEventEnableCondition_GeneralEventInfo: RteEventRef=OpEventGetEventEnableCondition_GetEventEnableCondition_GeneralEventInfo
          OpEventGetDebouncingOfEvent_GetDebouncingOfEvent_GeneralEventInfo: RteEventRef=OpEventGetDebouncingOfEvent_GetDebouncingOfEvent_GeneralEventInfo
          OpEventGetMonitorStatus_GetMonitorStatus_GeneralEventInfo: RteEventRef=OpEventGetMonitorStatus_GetMonitorStatus_GeneralEventInfo
          OpEventGetOperationCycleState_GetOperationCycleState_OpCycle_NON_OBD: RteEventRef=OpEventGetOperationCycleState_GetOperationCycleState_OpCycle_NON_OBD
          OpEventSetOperationCycleState_SetOperationCycleState_OpCycle_NON_OBD: RteEventRef=OpEventSetOperationCycleState_SetOperationCycleState_OpCycle_NON_OBD
          OpEventGetNumberOfEventMemoryEntries_GetNumberOfEventMemoryEntries_OverflowIndSecondaryMemory_DiagcMgr: RteEventRef=OpEventGetNumberOfEventMemoryEntries_GetNumberOfEventMemoryEntries_OverflowIndSecondaryMemory_DiagcMgr
          OpEventGetEventMemoryOverflow_GetEventMemoryOverflow_OverflowIndPrimaryMemory_DiagcMgr: RteEventRef=OpEventGetEventMemoryOverflow_GetEventMemoryOverflow_OverflowIndPrimaryMemory_DiagcMgr
          OpEventClearDTC_ClearDTC_ClearDTC_DiagcMgr: RteEventRef=OpEventClearDTC_ClearDTC_ClearDTC_DiagcMgr
          OpEventSelectDTC_SelectDTC_ClearDTC_DiagcMgr: RteEventRef=OpEventSelectDTC_SelectDTC_ClearDTC_DiagcMgr
          OpEventGetNumberOfEventMemoryEntries_GetNumberOfEventMemoryEntries_OverflowIndPrimaryMemory_DiagcMgr: RteEventRef=OpEventGetNumberOfEventMemoryEntries_GetNumberOfEventMemoryEntries_OverflowIndPrimaryMemory_DiagcMgr
          OpEventGetEventMemoryOverflow_GetEventMemoryOverflow_OverflowIndSecondaryMemory_DiagcMgr: RteEventRef=OpEventGetEventMemoryOverflow_GetEventMemoryOverflow_OverflowIndSecondaryMemory_DiagcMgr
          OpEventGetIndicatorStatus_GetIndicatorStatus_IndStatus_NormWarnLamp: RteEventRef=OpEventGetIndicatorStatus_GetIndicatorStatus_IndStatus_NormWarnLamp
          OpEventGetIndicatorStatus_GetIndicatorStatus_IndStatus_ThermWarnLamp: RteEventRef=OpEventGetIndicatorStatus_GetIndicatorStatus_IndStatus_ThermWarnLamp
          OpEventGetIndicatorStatus_GetIndicatorStatus_IndStatus_EptiInspnRlvLamp: RteEventRef=OpEventGetIndicatorStatus_GetIndicatorStatus_IndStatus_EptiInspnRlvLamp
      DemSatellite_0_EcuSwComposition: RteSoftwareComponentInstanceRef=DemSatellite_0
        925 x RteEventToTaskMapping, all with RteImmediateRestart=false:
          Timer_Dem_SatelliteMainFunction: RtePositionInTask=2, RteEventRef=Timer_Dem_SatelliteMainFunction, RteMappedToTaskRef=Task_10msBsw_Appl10, RteUsedOsAlarmRef=Rte_Al_TE2_Task_10msBsw_Appl10_0_10ms
          OpEventGetEventUdsStatus_GetEventUdsStatus_EvtInfo_MCU_E_CLM_SELFDIAG_FAILURE: RteEventRef=OpEventGetEventUdsStatus_GetEventUdsStatus_EvtInfo_MCU_E_CLM_SELFDIAG_FAILURE
          OpEventGetEventUdsStatus_GetEventUdsStatus_EvtInfo_MCU_E_CLOCK_FAILURE: RteEventRef=OpEventGetEventUdsStatus_GetEventUdsStatus_EvtInfo_MCU_E_CLOCK_FAILURE
          OpEventGetEventUdsStatus_GetEventUdsStatus_EvtInfo_MCU_E_CVM_SELFDIAG_FAILURE: RteEventRef=OpEventGetEventUdsStatus_GetEventUdsStatus_EvtInfo_MCU_E_CVM_SELFDIAG_FAILURE
          OpEventGetEventUdsStatus_GetEventUdsStatus_EvtInfo_MCU_E_ECM_SELFDIAG_FAILURE: RteEventRef=OpEventGetEventUdsStatus_GetEventUdsStatus_EvtInfo_MCU_E_ECM_SELFDIAG_FAILURE
          OpEventGetEventUdsStatus_GetEventUdsStatus_EvtInfo_MCU_E_LOCKSTEP_SELFDIAG_FAILURE: RteEventRef=OpEventGetEventUdsStatus_GetEventUdsStatus_EvtInfo_MCU_E_LOCKSTEP_SELFDIAG_FAILURE
          OpEventGetEventUdsStatus_GetEventUdsStatus_EvtInfo_MCU_E_WRITE_TIMEOUT_FAILURE: RteEventRef=OpEventGetEventUdsStatus_GetEventUdsStatus_EvtInfo_MCU_E_WRITE_TIMEOUT_FAILURE
          OpEventGetEventUdsStatus_GetEventUdsStatus_EvtInfo_MCU_E_REG_WRITE_VERIFY: RteEventRef=OpEventGetEventUdsStatus_GetEventUdsStatus_EvtInfo_MCU_E_REG_WRITE_VERIFY
          OpEventGetEventUdsStatus_GetEventUdsStatus_EvtInfo_MCU_E_INT_INCONSISTENT: RteEventRef=OpEventGetEventUdsStatus_GetEventUdsStatus_EvtInfo_MCU_E_INT_INCONSISTENT
          OpEventGetEventUdsStatus_GetEventUdsStatus_EvtInfo_MCU_E_RESETCONTROLLER_STARTUP_FAILURE: RteEventRef=OpEventGetEventUdsStatus_GetEventUdsStatus_EvtInfo_MCU_E_RESETCONTROLLER_STARTUP_FAILURE
          OpEventGetEventUdsStatus_GetEventUdsStatus_EvtInfo_DIO_E_REG_WRITE_VERIFY: RteEventRef=OpEventGetEventUdsStatus_GetEventUdsStatus_EvtInfo_DIO_E_REG_WRITE_VERIFY
          OpEventGetEventUdsStatus_GetEventUdsStatus_EvtInfo_FLS_E_COMPARE_FAILED: RteEventRef=OpEventGetEventUdsStatus_GetEventUdsStatus_EvtInfo_FLS_E_COMPARE_FAILED
          OpEventGetEventUdsStatus_GetEventUdsStatus_EvtInfo_FLS_E_ERASE_FAILED: RteEventRef=OpEventGetEventUdsStatus_GetEventUdsStatus_EvtInfo_FLS_E_ERASE_FAILED
          OpEventGetEventUdsStatus_GetEventUdsStatus_EvtInfo_FLS_E_READ_FAILED: RteEventRef=OpEventGetEventUdsStatus_GetEventUdsStatus_EvtInfo_FLS_E_READ_FAILED
          OpEventGetEventUdsStatus_GetEventUdsStatus_EvtInfo_FLS_E_INT_INCONSISTENT: RteEventRef=OpEventGetEventUdsStatus_GetEventUdsStatus_EvtInfo_FLS_E_INT_INCONSISTENT
          OpEventGetEventUdsStatus_GetEventUdsStatus_EvtInfo_FLS_E_REG_WRITE_VERIFY: RteEventRef=OpEventGetEventUdsStatus_GetEventUdsStatus_EvtInfo_FLS_E_REG_WRITE_VERIFY
          OpEventGetEventUdsStatus_GetEventUdsStatus_EvtInfo_FLS_E_READ_FAILED_DED: RteEventRef=OpEventGetEventUdsStatus_GetEventUdsStatus_EvtInfo_FLS_E_READ_FAILED_DED
          OpEventGetEventUdsStatus_GetEventUdsStatus_EvtInfo_FLS_E_HW_FAILURE: RteEventRef=OpEventGetEventUdsStatus_GetEventUdsStatus_EvtInfo_FLS_E_HW_FAILURE
          OpEventGetEventUdsStatus_GetEventUdsStatus_EvtInfo_FLS_E_ECC_FAILED: RteEventRef=OpEventGetEventUdsStatus_GetEventUdsStatus_EvtInfo_FLS_E_ECC_FAILED
          OpEventGetEventUdsStatus_GetEventUdsStatus_EvtInfo_FLS_E_UNEXPECTED_FLASH_ID: RteEventRef=OpEventGetEventUdsStatus_GetEventUdsStatus_EvtInfo_FLS_E_UNEXPECTED_FLASH_ID
          OpEventGetEventUdsStatus_GetEventUdsStatus_EvtInfo_FLS_E_WRITE_FAILED: RteEventRef=OpEventGetEventUdsStatus_GetEventUdsStatus_EvtInfo_FLS_E_WRITE_FAILED
          OpEventGetEventUdsStatus_GetEventUdsStatus_EvtInfo_SPI_E_DATA_TX_TIMEOUT_FAILURE: RteEventRef=OpEventGetEventUdsStatus_GetEventUdsStatus_EvtInfo_SPI_E_DATA_TX_TIMEOUT_FAILURE
          OpEventGetEventUdsStatus_GetEventUdsStatus_EvtInfo_SPI_E_ECC_SELFTEST_FAILURE: RteEventRef=OpEventGetEventUdsStatus_GetEventUdsStatus_EvtInfo_SPI_E_ECC_SELFTEST_FAILURE
          OpEventGetEventUdsStatus_GetEventUdsStatus_EvtInfo_SPI_E_HARDWARE_ERROR: RteEventRef=OpEventGetEventUdsStatus_GetEventUdsStatus_EvtInfo_SPI_E_HARDWARE_ERROR
          OpEventGetEventUdsStatus_GetEventUdsStatus_EvtInfo_SPI_E_INT_INCONSISTENT: RteEventRef=OpEventGetEventUdsStatus_GetEventUdsStatus_EvtInfo_SPI_E_INT_INCONSISTENT
          OpEventGetEventUdsStatus_GetEventUdsStatus_EvtInfo_SPI_E_LOOPBACK_SELFTEST_FAILURE: RteEventRef=OpEventGetEventUdsStatus_GetEventUdsStatus_EvtInfo_SPI_E_LOOPBACK_SELFTEST_FAILURE
          OpEventGetEventUdsStatus_GetEventUdsStatus_EvtInfo_SPI_E_REG_WRITE_VERIFY: RteEventRef=OpEventGetEventUdsStatus_GetEventUdsStatus_EvtInfo_SPI_E_REG_WRITE_VERIFY
          OpEventGetEventUdsStatus_GetEventUdsStatus_EvtInfo_WDGM_E_IMPROPER_CALLER: RteEventRef=OpEventGetEventUdsStatus_GetEventUdsStatus_EvtInfo_WDGM_E_IMPROPER_CALLER
          OpEventGetEventUdsStatus_GetEventUdsStatus_EvtInfo_WDGM_E_MONITORING: RteEventRef=OpEventGetEventUdsStatus_GetEventUdsStatus_EvtInfo_WDGM_E_MONITORING
          OpEventGetEventUdsStatus_GetEventUdsStatus_EvtInfo_WDGM_E_SET_MODE: RteEventRef=OpEventGetEventUdsStatus_GetEventUdsStatus_EvtInfo_WDGM_E_SET_MODE
          OpEventGetEventUdsStatus_GetEventUdsStatus_EvtInfo_WDG_E_DISABLE_REJECTED: RteEventRef=OpEventGetEventUdsStatus_GetEventUdsStatus_EvtInfo_WDG_E_DISABLE_REJECTED
          OpEventGetEventUdsStatus_GetEventUdsStatus_EvtInfo_WDG_E_INT_INCONSISTENT: RteEventRef=OpEventGetEventUdsStatus_GetEventUdsStatus_EvtInfo_WDG_E_INT_INCONSISTENT
          OpEventGetEventUdsStatus_GetEventUdsStatus_EvtInfo_WDG_E_MODE_FAILED: RteEventRef=OpEventGetEventUdsStatus_GetEventUdsStatus_EvtInfo_WDG_E_MODE_FAILED
          OpEventGetEventUdsStatus_GetEventUdsStatus_EvtInfo_WDG_E_REG_WRITE_VERIFY: RteEventRef=OpEventGetEventUdsStatus_GetEventUdsStatus_EvtInfo_WDG_E_REG_WRITE_VERIFY
          OpEventGetEventUdsStatus_GetEventUdsStatus_EvtInfo_PORT_E_WRITE_TIMEOUT_FAILURE: RteEventRef=OpEventGetEventUdsStatus_GetEventUdsStatus_EvtInfo_PORT_E_WRITE_TIMEOUT_FAILURE
          OpEventGetEventUdsStatus_GetEventUdsStatus_EvtInfo_PORT_E_REG_WRITE_VERIFY: RteEventRef=OpEventGetEventUdsStatus_GetEventUdsStatus_EvtInfo_PORT_E_REG_WRITE_VERIFY
          OpEventGetEventUdsStatus_GetEventUdsStatus_EvtInfo_CodingEventNotCoded: RteEventRef=OpEventGetEventUdsStatus_GetEventUdsStatus_EvtInfo_CodingEventNotCoded
          OpEventGetEventUdsStatus_GetEventUdsStatus_Event_CodingEventNotCoded: RteEventRef=OpEventGetEventUdsStatus_GetEventUdsStatus_Event_CodingEventNotCoded
          OpEventGetEventUdsStatus_GetEventUdsStatus_EvtInfo_CodingEventUnqualifiedData: RteEventRef=OpEventGetEventUdsStatus_GetEventUdsStatus_EvtInfo_CodingEventUnqualifiedData
          OpEventGetEventUdsStatus_GetEventUdsStatus_Event_CodingEventUnqualifiedData: RteEventRef=OpEventGetEventUdsStatus_GetEventUdsStatus_Event_CodingEventUnqualifiedData
          OpEventGetEventUdsStatus_GetEventUdsStatus_EvtInfo_CodingEventWrongVehicle: RteEventRef=OpEventGetEventUdsStatus_GetEventUdsStatus_EvtInfo_CodingEventWrongVehicle
          OpEventGetEventUdsStatus_GetEventUdsStatus_Event_CodingEventWrongVehicle: RteEventRef=OpEventGetEventUdsStatus_GetEventUdsStatus_Event_CodingEventWrongVehicle
          OpEventGetEventUdsStatus_GetEventUdsStatus_EvtInfo_DmTestAppl: RteEventRef=OpEventGetEventUdsStatus_GetEventUdsStatus_EvtInfo_DmTestAppl
          OpEventGetEventUdsStatus_GetEventUdsStatus_Event_DmTestAppl: RteEventRef=OpEventGetEventUdsStatus_GetEventUdsStatus_Event_DmTestAppl
          OpEventGetEventUdsStatus_GetEventUdsStatus_EvtInfo_DmTestCom: RteEventRef=OpEventGetEventUdsStatus_GetEventUdsStatus_EvtInfo_DmTestCom
          OpEventGetEventUdsStatus_GetEventUdsStatus_Event_DmTestCom: RteEventRef=OpEventGetEventUdsStatus_GetEventUdsStatus_Event_DmTestCom
          OpEventGetEventUdsStatus_GetEventUdsStatus_EvtInfo_FrsmEClusterSyncLoss: RteEventRef=OpEventGetEventUdsStatus_GetEventUdsStatus_EvtInfo_FrsmEClusterSyncLoss
          OpEventGetEventUdsStatus_GetEventUdsStatus_Event_FrsmEClusterSyncLoss: RteEventRef=OpEventGetEventUdsStatus_GetEventUdsStatus_Event_FrsmEClusterSyncLoss
          OpEventGetEventUdsStatus_GetEventUdsStatus_EvtInfo_FrtrcvEFrBuserrorTrcv0: RteEventRef=OpEventGetEventUdsStatus_GetEventUdsStatus_EvtInfo_FrtrcvEFrBuserrorTrcv0
          OpEventGetEventUdsStatus_GetEventUdsStatus_Event_FrtrcvEFrBuserrorTrcv0: RteEventRef=OpEventGetEventUdsStatus_GetEventUdsStatus_Event_FrtrcvEFrBuserrorTrcv0
          OpEventGetEventUdsStatus_GetEventUdsStatus_EvtInfo_GlobalOvervoltageExt: RteEventRef=OpEventGetEventUdsStatus_GetEventUdsStatus_EvtInfo_GlobalOvervoltageExt
          OpEventGetEventUdsStatus_GetEventUdsStatus_Event_GlobalOvervoltageExt: RteEventRef=OpEventGetEventUdsStatus_GetEventUdsStatus_Event_GlobalOvervoltageExt
          OpEventGetEventUdsStatus_GetEventUdsStatus_EvtInfo_GlobalOvervoltageInt: RteEventRef=OpEventGetEventUdsStatus_GetEventUdsStatus_EvtInfo_GlobalOvervoltageInt
          OpEventGetEventUdsStatus_GetEventUdsStatus_Event_GlobalOvervoltageInt: RteEventRef=OpEventGetEventUdsStatus_GetEventUdsStatus_Event_GlobalOvervoltageInt
          OpEventGetEventUdsStatus_GetEventUdsStatus_EvtInfo_GlobalUndervoltageExt: RteEventRef=OpEventGetEventUdsStatus_GetEventUdsStatus_EvtInfo_GlobalUndervoltageExt
          OpEventGetEventUdsStatus_GetEventUdsStatus_Event_GlobalUndervoltageExt: RteEventRef=OpEventGetEventUdsStatus_GetEventUdsStatus_Event_GlobalUndervoltageExt
          OpEventGetEventUdsStatus_GetEventUdsStatus_EvtInfo_GlobalUndervoltageInt: RteEventRef=OpEventGetEventUdsStatus_GetEventUdsStatus_EvtInfo_GlobalUndervoltageInt
          OpEventGetEventUdsStatus_GetEventUdsStatus_Event_GlobalUndervoltageInt: RteEventRef=OpEventGetEventUdsStatus_GetEventUdsStatus_Event_GlobalUndervoltageInt
          OpEventGetEventUdsStatus_GetEventUdsStatus_EvtInfo_LocalOvervoltage: RteEventRef=OpEventGetEventUdsStatus_GetEventUdsStatus_EvtInfo_LocalOvervoltage
          OpEventGetEventUdsStatus_GetEventUdsStatus_Event_LocalOvervoltage: RteEventRef=OpEventGetEventUdsStatus_GetEventUdsStatus_Event_LocalOvervoltage
          OpEventGetEventUdsStatus_GetEventUdsStatus_EvtInfo_LocalUndervoltage: RteEventRef=OpEventGetEventUdsStatus_GetEventUdsStatus_EvtInfo_LocalUndervoltage
          OpEventGetEventUdsStatus_GetEventUdsStatus_Event_LocalUndervoltage: RteEventRef=OpEventGetEventUdsStatus_GetEventUdsStatus_Event_LocalUndervoltage
          OpEventGetEventUdsStatus_GetEventUdsStatus_EvtInfo_VsmEventOpmode: RteEventRef=OpEventGetEventUdsStatus_GetEventUdsStatus_EvtInfo_VsmEventOpmode
          OpEventGetEventUdsStatus_GetEventUdsStatus_Event_VsmEventOpmode: RteEventRef=OpEventGetEventUdsStatus_GetEventUdsStatus_Event_VsmEventOpmode
          OpEventGetEventUdsStatus_GetEventUdsStatus_GeneralEventInfo: RteEventRef=OpEventGetEventUdsStatus_GetEventUdsStatus_GeneralEventInfo
          OpEventGetEventStatus_GetEventStatus_EvtInfo_MCU_E_CLM_SELFDIAG_FAILURE: RteEventRef=OpEventGetEventStatus_GetEventStatus_EvtInfo_MCU_E_CLM_SELFDIAG_FAILURE
          OpEventGetEventStatus_GetEventStatus_EvtInfo_MCU_E_CLOCK_FAILURE: RteEventRef=OpEventGetEventStatus_GetEventStatus_EvtInfo_MCU_E_CLOCK_FAILURE
          OpEventGetEventStatus_GetEventStatus_EvtInfo_MCU_E_CVM_SELFDIAG_FAILURE: RteEventRef=OpEventGetEventStatus_GetEventStatus_EvtInfo_MCU_E_CVM_SELFDIAG_FAILURE
          OpEventGetEventStatus_GetEventStatus_EvtInfo_MCU_E_ECM_SELFDIAG_FAILURE: RteEventRef=OpEventGetEventStatus_GetEventStatus_EvtInfo_MCU_E_ECM_SELFDIAG_FAILURE
          OpEventGetEventStatus_GetEventStatus_EvtInfo_MCU_E_LOCKSTEP_SELFDIAG_FAILURE: RteEventRef=OpEventGetEventStatus_GetEventStatus_EvtInfo_MCU_E_LOCKSTEP_SELFDIAG_FAILURE
          OpEventGetEventStatus_GetEventStatus_EvtInfo_MCU_E_WRITE_TIMEOUT_FAILURE: RteEventRef=OpEventGetEventStatus_GetEventStatus_EvtInfo_MCU_E_WRITE_TIMEOUT_FAILURE
          OpEventGetEventStatus_GetEventStatus_EvtInfo_MCU_E_REG_WRITE_VERIFY: RteEventRef=OpEventGetEventStatus_GetEventStatus_EvtInfo_MCU_E_REG_WRITE_VERIFY
          OpEventGetEventStatus_GetEventStatus_EvtInfo_MCU_E_INT_INCONSISTENT: RteEventRef=OpEventGetEventStatus_GetEventStatus_EvtInfo_MCU_E_INT_INCONSISTENT
          OpEventGetEventStatus_GetEventStatus_EvtInfo_MCU_E_RESETCONTROLLER_STARTUP_FAILURE: RteEventRef=OpEventGetEventStatus_GetEventStatus_EvtInfo_MCU_E_RESETCONTROLLER_STARTUP_FAILURE
          OpEventGetEventStatus_GetEventStatus_EvtInfo_DIO_E_REG_WRITE_VERIFY: RteEventRef=OpEventGetEventStatus_GetEventStatus_EvtInfo_DIO_E_REG_WRITE_VERIFY
          OpEventGetEventStatus_GetEventStatus_EvtInfo_FLS_E_COMPARE_FAILED: RteEventRef=OpEventGetEventStatus_GetEventStatus_EvtInfo_FLS_E_COMPARE_FAILED
          OpEventGetEventStatus_GetEventStatus_EvtInfo_FLS_E_ERASE_FAILED: RteEventRef=OpEventGetEventStatus_GetEventStatus_EvtInfo_FLS_E_ERASE_FAILED
          OpEventGetEventStatus_GetEventStatus_EvtInfo_FLS_E_READ_FAILED: RteEventRef=OpEventGetEventStatus_GetEventStatus_EvtInfo_FLS_E_READ_FAILED
          OpEventGetEventStatus_GetEventStatus_EvtInfo_FLS_E_INT_INCONSISTENT: RteEventRef=OpEventGetEventStatus_GetEventStatus_EvtInfo_FLS_E_INT_INCONSISTENT
          OpEventGetEventStatus_GetEventStatus_EvtInfo_FLS_E_REG_WRITE_VERIFY: RteEventRef=OpEventGetEventStatus_GetEventStatus_EvtInfo_FLS_E_REG_WRITE_VERIFY
          OpEventGetEventStatus_GetEventStatus_EvtInfo_FLS_E_READ_FAILED_DED: RteEventRef=OpEventGetEventStatus_GetEventStatus_EvtInfo_FLS_E_READ_FAILED_DED
          OpEventGetEventStatus_GetEventStatus_EvtInfo_FLS_E_HW_FAILURE: RteEventRef=OpEventGetEventStatus_GetEventStatus_EvtInfo_FLS_E_HW_FAILURE
          OpEventGetEventStatus_GetEventStatus_EvtInfo_FLS_E_ECC_FAILED: RteEventRef=OpEventGetEventStatus_GetEventStatus_EvtInfo_FLS_E_ECC_FAILED
          OpEventGetEventStatus_GetEventStatus_EvtInfo_FLS_E_UNEXPECTED_FLASH_ID: RteEventRef=OpEventGetEventStatus_GetEventStatus_EvtInfo_FLS_E_UNEXPECTED_FLASH_ID
          OpEventGetEventStatus_GetEventStatus_EvtInfo_FLS_E_WRITE_FAILED: RteEventRef=OpEventGetEventStatus_GetEventStatus_EvtInfo_FLS_E_WRITE_FAILED
          OpEventGetEventStatus_GetEventStatus_EvtInfo_SPI_E_DATA_TX_TIMEOUT_FAILURE: RteEventRef=OpEventGetEventStatus_GetEventStatus_EvtInfo_SPI_E_DATA_TX_TIMEOUT_FAILURE
          OpEventGetEventStatus_GetEventStatus_EvtInfo_SPI_E_ECC_SELFTEST_FAILURE: RteEventRef=OpEventGetEventStatus_GetEventStatus_EvtInfo_SPI_E_ECC_SELFTEST_FAILURE
          OpEventGetEventStatus_GetEventStatus_EvtInfo_SPI_E_HARDWARE_ERROR: RteEventRef=OpEventGetEventStatus_GetEventStatus_EvtInfo_SPI_E_HARDWARE_ERROR
          OpEventGetEventStatus_GetEventStatus_EvtInfo_SPI_E_INT_INCONSISTENT: RteEventRef=OpEventGetEventStatus_GetEventStatus_EvtInfo_SPI_E_INT_INCONSISTENT
          OpEventGetEventStatus_GetEventStatus_EvtInfo_SPI_E_LOOPBACK_SELFTEST_FAILURE: RteEventRef=OpEventGetEventStatus_GetEventStatus_EvtInfo_SPI_E_LOOPBACK_SELFTEST_FAILURE
          OpEventGetEventStatus_GetEventStatus_EvtInfo_SPI_E_REG_WRITE_VERIFY: RteEventRef=OpEventGetEventStatus_GetEventStatus_EvtInfo_SPI_E_REG_WRITE_VERIFY
          OpEventGetEventStatus_GetEventStatus_EvtInfo_WDGM_E_IMPROPER_CALLER: RteEventRef=OpEventGetEventStatus_GetEventStatus_EvtInfo_WDGM_E_IMPROPER_CALLER
          OpEventGetEventStatus_GetEventStatus_EvtInfo_WDGM_E_MONITORING: RteEventRef=OpEventGetEventStatus_GetEventStatus_EvtInfo_WDGM_E_MONITORING
          OpEventGetEventStatus_GetEventStatus_EvtInfo_WDGM_E_SET_MODE: RteEventRef=OpEventGetEventStatus_GetEventStatus_EvtInfo_WDGM_E_SET_MODE
          OpEventGetEventStatus_GetEventStatus_EvtInfo_WDG_E_DISABLE_REJECTED: RteEventRef=OpEventGetEventStatus_GetEventStatus_EvtInfo_WDG_E_DISABLE_REJECTED
          OpEventGetEventStatus_GetEventStatus_EvtInfo_WDG_E_INT_INCONSISTENT: RteEventRef=OpEventGetEventStatus_GetEventStatus_EvtInfo_WDG_E_INT_INCONSISTENT
          OpEventGetEventStatus_GetEventStatus_EvtInfo_WDG_E_MODE_FAILED: RteEventRef=OpEventGetEventStatus_GetEventStatus_EvtInfo_WDG_E_MODE_FAILED
          OpEventGetEventStatus_GetEventStatus_EvtInfo_WDG_E_REG_WRITE_VERIFY: RteEventRef=OpEventGetEventStatus_GetEventStatus_EvtInfo_WDG_E_REG_WRITE_VERIFY
          OpEventGetEventStatus_GetEventStatus_EvtInfo_PORT_E_WRITE_TIMEOUT_FAILURE: RteEventRef=OpEventGetEventStatus_GetEventStatus_EvtInfo_PORT_E_WRITE_TIMEOUT_FAILURE
          OpEventGetEventStatus_GetEventStatus_EvtInfo_PORT_E_REG_WRITE_VERIFY: RteEventRef=OpEventGetEventStatus_GetEventStatus_EvtInfo_PORT_E_REG_WRITE_VERIFY
          OpEventGetEventStatus_GetEventStatus_EvtInfo_CodingEventNotCoded: RteEventRef=OpEventGetEventStatus_GetEventStatus_EvtInfo_CodingEventNotCoded
          OpEventGetEventStatus_GetEventStatus_Event_CodingEventNotCoded: RteEventRef=OpEventGetEventStatus_GetEventStatus_Event_CodingEventNotCoded
          OpEventGetEventStatus_GetEventStatus_EvtInfo_CodingEventUnqualifiedData: RteEventRef=OpEventGetEventStatus_GetEventStatus_EvtInfo_CodingEventUnqualifiedData
          OpEventGetEventStatus_GetEventStatus_Event_CodingEventUnqualifiedData: RteEventRef=OpEventGetEventStatus_GetEventStatus_Event_CodingEventUnqualifiedData
          OpEventGetEventStatus_GetEventStatus_EvtInfo_CodingEventWrongVehicle: RteEventRef=OpEventGetEventStatus_GetEventStatus_EvtInfo_CodingEventWrongVehicle
          OpEventGetEventStatus_GetEventStatus_Event_CodingEventWrongVehicle: RteEventRef=OpEventGetEventStatus_GetEventStatus_Event_CodingEventWrongVehicle
          OpEventGetEventStatus_GetEventStatus_EvtInfo_DmTestAppl: RteEventRef=OpEventGetEventStatus_GetEventStatus_EvtInfo_DmTestAppl
          OpEventGetEventStatus_GetEventStatus_Event_DmTestAppl: RteEventRef=OpEventGetEventStatus_GetEventStatus_Event_DmTestAppl
          OpEventGetEventStatus_GetEventStatus_EvtInfo_DmTestCom: RteEventRef=OpEventGetEventStatus_GetEventStatus_EvtInfo_DmTestCom
          OpEventGetEventStatus_GetEventStatus_Event_DmTestCom: RteEventRef=OpEventGetEventStatus_GetEventStatus_Event_DmTestCom
          OpEventGetEventStatus_GetEventStatus_EvtInfo_FrsmEClusterSyncLoss: RteEventRef=OpEventGetEventStatus_GetEventStatus_EvtInfo_FrsmEClusterSyncLoss
          OpEventGetEventStatus_GetEventStatus_Event_FrsmEClusterSyncLoss: RteEventRef=OpEventGetEventStatus_GetEventStatus_Event_FrsmEClusterSyncLoss
          OpEventGetEventStatus_GetEventStatus_EvtInfo_FrtrcvEFrBuserrorTrcv0: RteEventRef=OpEventGetEventStatus_GetEventStatus_EvtInfo_FrtrcvEFrBuserrorTrcv0
          OpEventGetEventStatus_GetEventStatus_Event_FrtrcvEFrBuserrorTrcv0: RteEventRef=OpEventGetEventStatus_GetEventStatus_Event_FrtrcvEFrBuserrorTrcv0
          OpEventGetEventStatus_GetEventStatus_EvtInfo_GlobalOvervoltageExt: RteEventRef=OpEventGetEventStatus_GetEventStatus_EvtInfo_GlobalOvervoltageExt
          OpEventGetEventStatus_GetEventStatus_Event_GlobalOvervoltageExt: RteEventRef=OpEventGetEventStatus_GetEventStatus_Event_GlobalOvervoltageExt
          OpEventGetEventStatus_GetEventStatus_EvtInfo_GlobalOvervoltageInt: RteEventRef=OpEventGetEventStatus_GetEventStatus_EvtInfo_GlobalOvervoltageInt
          OpEventGetEventStatus_GetEventStatus_Event_GlobalOvervoltageInt: RteEventRef=OpEventGetEventStatus_GetEventStatus_Event_GlobalOvervoltageInt
          OpEventGetEventStatus_GetEventStatus_EvtInfo_GlobalUndervoltageExt: RteEventRef=OpEventGetEventStatus_GetEventStatus_EvtInfo_GlobalUndervoltageExt
          OpEventGetEventStatus_GetEventStatus_Event_GlobalUndervoltageExt: RteEventRef=OpEventGetEventStatus_GetEventStatus_Event_GlobalUndervoltageExt
          OpEventGetEventStatus_GetEventStatus_EvtInfo_GlobalUndervoltageInt: RteEventRef=OpEventGetEventStatus_GetEventStatus_EvtInfo_GlobalUndervoltageInt
          OpEventGetEventStatus_GetEventStatus_Event_GlobalUndervoltageInt: RteEventRef=OpEventGetEventStatus_GetEventStatus_Event_GlobalUndervoltageInt
          OpEventGetEventStatus_GetEventStatus_EvtInfo_LocalOvervoltage: RteEventRef=OpEventGetEventStatus_GetEventStatus_EvtInfo_LocalOvervoltage
          OpEventGetEventStatus_GetEventStatus_Event_LocalOvervoltage: RteEventRef=OpEventGetEventStatus_GetEventStatus_Event_LocalOvervoltage
          OpEventGetEventStatus_GetEventStatus_EvtInfo_LocalUndervoltage: RteEventRef=OpEventGetEventStatus_GetEventStatus_EvtInfo_LocalUndervoltage
          OpEventGetEventStatus_GetEventStatus_Event_LocalUndervoltage: RteEventRef=OpEventGetEventStatus_GetEventStatus_Event_LocalUndervoltage
          OpEventGetEventStatus_GetEventStatus_EvtInfo_VsmEventOpmode: RteEventRef=OpEventGetEventStatus_GetEventStatus_EvtInfo_VsmEventOpmode
          OpEventGetEventStatus_GetEventStatus_Event_VsmEventOpmode: RteEventRef=OpEventGetEventStatus_GetEventStatus_Event_VsmEventOpmode
          OpEventGetEventStatus_GetEventStatus_GeneralEventInfo: RteEventRef=OpEventGetEventStatus_GetEventStatus_GeneralEventInfo
          OpEventGetEventFailed_GetEventFailed_EvtInfo_MCU_E_CLM_SELFDIAG_FAILURE: RteEventRef=OpEventGetEventFailed_GetEventFailed_EvtInfo_MCU_E_CLM_SELFDIAG_FAILURE
          OpEventGetEventFailed_GetEventFailed_EvtInfo_MCU_E_CLOCK_FAILURE: RteEventRef=OpEventGetEventFailed_GetEventFailed_EvtInfo_MCU_E_CLOCK_FAILURE
          OpEventGetEventFailed_GetEventFailed_EvtInfo_MCU_E_CVM_SELFDIAG_FAILURE: RteEventRef=OpEventGetEventFailed_GetEventFailed_EvtInfo_MCU_E_CVM_SELFDIAG_FAILURE
          OpEventGetEventFailed_GetEventFailed_EvtInfo_MCU_E_ECM_SELFDIAG_FAILURE: RteEventRef=OpEventGetEventFailed_GetEventFailed_EvtInfo_MCU_E_ECM_SELFDIAG_FAILURE
          OpEventGetEventFailed_GetEventFailed_EvtInfo_MCU_E_LOCKSTEP_SELFDIAG_FAILURE: RteEventRef=OpEventGetEventFailed_GetEventFailed_EvtInfo_MCU_E_LOCKSTEP_SELFDIAG_FAILURE
          OpEventGetEventFailed_GetEventFailed_EvtInfo_MCU_E_WRITE_TIMEOUT_FAILURE: RteEventRef=OpEventGetEventFailed_GetEventFailed_EvtInfo_MCU_E_WRITE_TIMEOUT_FAILURE
          OpEventGetEventFailed_GetEventFailed_EvtInfo_MCU_E_REG_WRITE_VERIFY: RteEventRef=OpEventGetEventFailed_GetEventFailed_EvtInfo_MCU_E_REG_WRITE_VERIFY
          OpEventGetEventFailed_GetEventFailed_EvtInfo_MCU_E_INT_INCONSISTENT: RteEventRef=OpEventGetEventFailed_GetEventFailed_EvtInfo_MCU_E_INT_INCONSISTENT
          OpEventGetEventFailed_GetEventFailed_EvtInfo_MCU_E_RESETCONTROLLER_STARTUP_FAILURE: RteEventRef=OpEventGetEventFailed_GetEventFailed_EvtInfo_MCU_E_RESETCONTROLLER_STARTUP_FAILURE
          OpEventGetEventFailed_GetEventFailed_EvtInfo_DIO_E_REG_WRITE_VERIFY: RteEventRef=OpEventGetEventFailed_GetEventFailed_EvtInfo_DIO_E_REG_WRITE_VERIFY
          OpEventGetEventFailed_GetEventFailed_EvtInfo_FLS_E_COMPARE_FAILED: RteEventRef=OpEventGetEventFailed_GetEventFailed_EvtInfo_FLS_E_COMPARE_FAILED
          OpEventGetEventFailed_GetEventFailed_EvtInfo_FLS_E_ERASE_FAILED: RteEventRef=OpEventGetEventFailed_GetEventFailed_EvtInfo_FLS_E_ERASE_FAILED
          OpEventGetEventFailed_GetEventFailed_EvtInfo_FLS_E_READ_FAILED: RteEventRef=OpEventGetEventFailed_GetEventFailed_EvtInfo_FLS_E_READ_FAILED
          OpEventGetEventFailed_GetEventFailed_EvtInfo_FLS_E_INT_INCONSISTENT: RteEventRef=OpEventGetEventFailed_GetEventFailed_EvtInfo_FLS_E_INT_INCONSISTENT
          OpEventGetEventFailed_GetEventFailed_EvtInfo_FLS_E_REG_WRITE_VERIFY: RteEventRef=OpEventGetEventFailed_GetEventFailed_EvtInfo_FLS_E_REG_WRITE_VERIFY
          OpEventGetEventFailed_GetEventFailed_EvtInfo_FLS_E_READ_FAILED_DED: RteEventRef=OpEventGetEventFailed_GetEventFailed_EvtInfo_FLS_E_READ_FAILED_DED
          OpEventGetEventFailed_GetEventFailed_EvtInfo_FLS_E_HW_FAILURE: RteEventRef=OpEventGetEventFailed_GetEventFailed_EvtInfo_FLS_E_HW_FAILURE
          OpEventGetEventFailed_GetEventFailed_EvtInfo_FLS_E_ECC_FAILED: RteEventRef=OpEventGetEventFailed_GetEventFailed_EvtInfo_FLS_E_ECC_FAILED
          OpEventGetEventFailed_GetEventFailed_EvtInfo_FLS_E_UNEXPECTED_FLASH_ID: RteEventRef=OpEventGetEventFailed_GetEventFailed_EvtInfo_FLS_E_UNEXPECTED_FLASH_ID
          OpEventGetEventFailed_GetEventFailed_EvtInfo_FLS_E_WRITE_FAILED: RteEventRef=OpEventGetEventFailed_GetEventFailed_EvtInfo_FLS_E_WRITE_FAILED
          OpEventGetEventFailed_GetEventFailed_EvtInfo_SPI_E_DATA_TX_TIMEOUT_FAILURE: RteEventRef=OpEventGetEventFailed_GetEventFailed_EvtInfo_SPI_E_DATA_TX_TIMEOUT_FAILURE
          OpEventGetEventFailed_GetEventFailed_EvtInfo_SPI_E_ECC_SELFTEST_FAILURE: RteEventRef=OpEventGetEventFailed_GetEventFailed_EvtInfo_SPI_E_ECC_SELFTEST_FAILURE
          OpEventGetEventFailed_GetEventFailed_EvtInfo_SPI_E_HARDWARE_ERROR: RteEventRef=OpEventGetEventFailed_GetEventFailed_EvtInfo_SPI_E_HARDWARE_ERROR
          OpEventGetEventFailed_GetEventFailed_EvtInfo_SPI_E_INT_INCONSISTENT: RteEventRef=OpEventGetEventFailed_GetEventFailed_EvtInfo_SPI_E_INT_INCONSISTENT
          OpEventGetEventFailed_GetEventFailed_EvtInfo_SPI_E_LOOPBACK_SELFTEST_FAILURE: RteEventRef=OpEventGetEventFailed_GetEventFailed_EvtInfo_SPI_E_LOOPBACK_SELFTEST_FAILURE
          OpEventGetEventFailed_GetEventFailed_EvtInfo_SPI_E_REG_WRITE_VERIFY: RteEventRef=OpEventGetEventFailed_GetEventFailed_EvtInfo_SPI_E_REG_WRITE_VERIFY
          OpEventGetEventFailed_GetEventFailed_EvtInfo_WDGM_E_IMPROPER_CALLER: RteEventRef=OpEventGetEventFailed_GetEventFailed_EvtInfo_WDGM_E_IMPROPER_CALLER
          OpEventGetEventFailed_GetEventFailed_EvtInfo_WDGM_E_MONITORING: RteEventRef=OpEventGetEventFailed_GetEventFailed_EvtInfo_WDGM_E_MONITORING
          OpEventGetEventFailed_GetEventFailed_EvtInfo_WDGM_E_SET_MODE: RteEventRef=OpEventGetEventFailed_GetEventFailed_EvtInfo_WDGM_E_SET_MODE
          OpEventGetEventFailed_GetEventFailed_EvtInfo_WDG_E_DISABLE_REJECTED: RteEventRef=OpEventGetEventFailed_GetEventFailed_EvtInfo_WDG_E_DISABLE_REJECTED
          OpEventGetEventFailed_GetEventFailed_EvtInfo_WDG_E_INT_INCONSISTENT: RteEventRef=OpEventGetEventFailed_GetEventFailed_EvtInfo_WDG_E_INT_INCONSISTENT
          OpEventGetEventFailed_GetEventFailed_EvtInfo_WDG_E_MODE_FAILED: RteEventRef=OpEventGetEventFailed_GetEventFailed_EvtInfo_WDG_E_MODE_FAILED
          OpEventGetEventFailed_GetEventFailed_EvtInfo_WDG_E_REG_WRITE_VERIFY: RteEventRef=OpEventGetEventFailed_GetEventFailed_EvtInfo_WDG_E_REG_WRITE_VERIFY
          OpEventGetEventFailed_GetEventFailed_EvtInfo_PORT_E_WRITE_TIMEOUT_FAILURE: RteEventRef=OpEventGetEventFailed_GetEventFailed_EvtInfo_PORT_E_WRITE_TIMEOUT_FAILURE
          OpEventGetEventFailed_GetEventFailed_EvtInfo_PORT_E_REG_WRITE_VERIFY: RteEventRef=OpEventGetEventFailed_GetEventFailed_EvtInfo_PORT_E_REG_WRITE_VERIFY
          OpEventGetEventFailed_GetEventFailed_EvtInfo_CodingEventNotCoded: RteEventRef=OpEventGetEventFailed_GetEventFailed_EvtInfo_CodingEventNotCoded
          OpEventGetEventFailed_GetEventFailed_Event_CodingEventNotCoded: RteEventRef=OpEventGetEventFailed_GetEventFailed_Event_CodingEventNotCoded
          OpEventGetEventFailed_GetEventFailed_EvtInfo_CodingEventUnqualifiedData: RteEventRef=OpEventGetEventFailed_GetEventFailed_EvtInfo_CodingEventUnqualifiedData
          OpEventGetEventFailed_GetEventFailed_Event_CodingEventUnqualifiedData: RteEventRef=OpEventGetEventFailed_GetEventFailed_Event_CodingEventUnqualifiedData
          OpEventGetEventFailed_GetEventFailed_EvtInfo_CodingEventWrongVehicle: RteEventRef=OpEventGetEventFailed_GetEventFailed_EvtInfo_CodingEventWrongVehicle
          OpEventGetEventFailed_GetEventFailed_Event_CodingEventWrongVehicle: RteEventRef=OpEventGetEventFailed_GetEventFailed_Event_CodingEventWrongVehicle
          OpEventGetEventFailed_GetEventFailed_EvtInfo_DmTestAppl: RteEventRef=OpEventGetEventFailed_GetEventFailed_EvtInfo_DmTestAppl
          OpEventGetEventFailed_GetEventFailed_Event_DmTestAppl: RteEventRef=OpEventGetEventFailed_GetEventFailed_Event_DmTestAppl
          OpEventGetEventFailed_GetEventFailed_EvtInfo_DmTestCom: RteEventRef=OpEventGetEventFailed_GetEventFailed_EvtInfo_DmTestCom
          OpEventGetEventFailed_GetEventFailed_Event_DmTestCom: RteEventRef=OpEventGetEventFailed_GetEventFailed_Event_DmTestCom
          OpEventGetEventFailed_GetEventFailed_EvtInfo_FrsmEClusterSyncLoss: RteEventRef=OpEventGetEventFailed_GetEventFailed_EvtInfo_FrsmEClusterSyncLoss
          OpEventGetEventFailed_GetEventFailed_Event_FrsmEClusterSyncLoss: RteEventRef=OpEventGetEventFailed_GetEventFailed_Event_FrsmEClusterSyncLoss
          OpEventGetEventFailed_GetEventFailed_EvtInfo_FrtrcvEFrBuserrorTrcv0: RteEventRef=OpEventGetEventFailed_GetEventFailed_EvtInfo_FrtrcvEFrBuserrorTrcv0
          OpEventGetEventFailed_GetEventFailed_Event_FrtrcvEFrBuserrorTrcv0: RteEventRef=OpEventGetEventFailed_GetEventFailed_Event_FrtrcvEFrBuserrorTrcv0
          OpEventGetEventFailed_GetEventFailed_EvtInfo_GlobalOvervoltageExt: RteEventRef=OpEventGetEventFailed_GetEventFailed_EvtInfo_GlobalOvervoltageExt
          OpEventGetEventFailed_GetEventFailed_Event_GlobalOvervoltageExt: RteEventRef=OpEventGetEventFailed_GetEventFailed_Event_GlobalOvervoltageExt
          OpEventGetEventFailed_GetEventFailed_EvtInfo_GlobalOvervoltageInt: RteEventRef=OpEventGetEventFailed_GetEventFailed_EvtInfo_GlobalOvervoltageInt
          OpEventGetEventFailed_GetEventFailed_Event_GlobalOvervoltageInt: RteEventRef=OpEventGetEventFailed_GetEventFailed_Event_GlobalOvervoltageInt
          OpEventGetEventFailed_GetEventFailed_EvtInfo_GlobalUndervoltageExt: RteEventRef=OpEventGetEventFailed_GetEventFailed_EvtInfo_GlobalUndervoltageExt
          OpEventGetEventFailed_GetEventFailed_Event_GlobalUndervoltageExt: RteEventRef=OpEventGetEventFailed_GetEventFailed_Event_GlobalUndervoltageExt
          OpEventGetEventFailed_GetEventFailed_EvtInfo_GlobalUndervoltageInt: RteEventRef=OpEventGetEventFailed_GetEventFailed_EvtInfo_GlobalUndervoltageInt
          OpEventGetEventFailed_GetEventFailed_Event_GlobalUndervoltageInt: RteEventRef=OpEventGetEventFailed_GetEventFailed_Event_GlobalUndervoltageInt
          OpEventGetEventFailed_GetEventFailed_EvtInfo_LocalOvervoltage: RteEventRef=OpEventGetEventFailed_GetEventFailed_EvtInfo_LocalOvervoltage
          OpEventGetEventFailed_GetEventFailed_Event_LocalOvervoltage: RteEventRef=OpEventGetEventFailed_GetEventFailed_Event_LocalOvervoltage
          OpEventGetEventFailed_GetEventFailed_EvtInfo_LocalUndervoltage: RteEventRef=OpEventGetEventFailed_GetEventFailed_EvtInfo_LocalUndervoltage
          OpEventGetEventFailed_GetEventFailed_Event_LocalUndervoltage: RteEventRef=OpEventGetEventFailed_GetEventFailed_Event_LocalUndervoltage
          OpEventGetEventFailed_GetEventFailed_EvtInfo_VsmEventOpmode: RteEventRef=OpEventGetEventFailed_GetEventFailed_EvtInfo_VsmEventOpmode
          OpEventGetEventFailed_GetEventFailed_Event_VsmEventOpmode: RteEventRef=OpEventGetEventFailed_GetEventFailed_Event_VsmEventOpmode
          OpEventGetEventFailed_GetEventFailed_GeneralEventInfo: RteEventRef=OpEventGetEventFailed_GetEventFailed_GeneralEventInfo
          OpEventGetEventTested_GetEventTested_EvtInfo_MCU_E_CLM_SELFDIAG_FAILURE: RteEventRef=OpEventGetEventTested_GetEventTested_EvtInfo_MCU_E_CLM_SELFDIAG_FAILURE
          OpEventGetEventTested_GetEventTested_EvtInfo_MCU_E_CLOCK_FAILURE: RteEventRef=OpEventGetEventTested_GetEventTested_EvtInfo_MCU_E_CLOCK_FAILURE
          OpEventGetEventTested_GetEventTested_EvtInfo_MCU_E_CVM_SELFDIAG_FAILURE: RteEventRef=OpEventGetEventTested_GetEventTested_EvtInfo_MCU_E_CVM_SELFDIAG_FAILURE
          OpEventGetEventTested_GetEventTested_EvtInfo_MCU_E_ECM_SELFDIAG_FAILURE: RteEventRef=OpEventGetEventTested_GetEventTested_EvtInfo_MCU_E_ECM_SELFDIAG_FAILURE
          OpEventGetEventTested_GetEventTested_EvtInfo_MCU_E_LOCKSTEP_SELFDIAG_FAILURE: RteEventRef=OpEventGetEventTested_GetEventTested_EvtInfo_MCU_E_LOCKSTEP_SELFDIAG_FAILURE
          OpEventGetEventTested_GetEventTested_EvtInfo_MCU_E_WRITE_TIMEOUT_FAILURE: RteEventRef=OpEventGetEventTested_GetEventTested_EvtInfo_MCU_E_WRITE_TIMEOUT_FAILURE
          OpEventGetEventTested_GetEventTested_EvtInfo_MCU_E_REG_WRITE_VERIFY: RteEventRef=OpEventGetEventTested_GetEventTested_EvtInfo_MCU_E_REG_WRITE_VERIFY
          OpEventGetEventTested_GetEventTested_EvtInfo_MCU_E_INT_INCONSISTENT: RteEventRef=OpEventGetEventTested_GetEventTested_EvtInfo_MCU_E_INT_INCONSISTENT
          OpEventGetEventTested_GetEventTested_EvtInfo_MCU_E_RESETCONTROLLER_STARTUP_FAILURE: RteEventRef=OpEventGetEventTested_GetEventTested_EvtInfo_MCU_E_RESETCONTROLLER_STARTUP_FAILURE
          OpEventGetEventTested_GetEventTested_EvtInfo_DIO_E_REG_WRITE_VERIFY: RteEventRef=OpEventGetEventTested_GetEventTested_EvtInfo_DIO_E_REG_WRITE_VERIFY
          OpEventGetEventTested_GetEventTested_EvtInfo_FLS_E_COMPARE_FAILED: RteEventRef=OpEventGetEventTested_GetEventTested_EvtInfo_FLS_E_COMPARE_FAILED
          OpEventGetEventTested_GetEventTested_EvtInfo_FLS_E_ERASE_FAILED: RteEventRef=OpEventGetEventTested_GetEventTested_EvtInfo_FLS_E_ERASE_FAILED
          OpEventGetEventTested_GetEventTested_EvtInfo_FLS_E_READ_FAILED: RteEventRef=OpEventGetEventTested_GetEventTested_EvtInfo_FLS_E_READ_FAILED
          OpEventGetEventTested_GetEventTested_EvtInfo_FLS_E_INT_INCONSISTENT: RteEventRef=OpEventGetEventTested_GetEventTested_EvtInfo_FLS_E_INT_INCONSISTENT
          OpEventGetEventTested_GetEventTested_EvtInfo_FLS_E_REG_WRITE_VERIFY: RteEventRef=OpEventGetEventTested_GetEventTested_EvtInfo_FLS_E_REG_WRITE_VERIFY
          OpEventGetEventTested_GetEventTested_EvtInfo_FLS_E_READ_FAILED_DED: RteEventRef=OpEventGetEventTested_GetEventTested_EvtInfo_FLS_E_READ_FAILED_DED
          OpEventGetEventTested_GetEventTested_EvtInfo_FLS_E_HW_FAILURE: RteEventRef=OpEventGetEventTested_GetEventTested_EvtInfo_FLS_E_HW_FAILURE
          OpEventGetEventTested_GetEventTested_EvtInfo_FLS_E_ECC_FAILED: RteEventRef=OpEventGetEventTested_GetEventTested_EvtInfo_FLS_E_ECC_FAILED
          OpEventGetEventTested_GetEventTested_EvtInfo_FLS_E_UNEXPECTED_FLASH_ID: RteEventRef=OpEventGetEventTested_GetEventTested_EvtInfo_FLS_E_UNEXPECTED_FLASH_ID
          OpEventGetEventTested_GetEventTested_EvtInfo_FLS_E_WRITE_FAILED: RteEventRef=OpEventGetEventTested_GetEventTested_EvtInfo_FLS_E_WRITE_FAILED
          OpEventGetEventTested_GetEventTested_EvtInfo_SPI_E_DATA_TX_TIMEOUT_FAILURE: RteEventRef=OpEventGetEventTested_GetEventTested_EvtInfo_SPI_E_DATA_TX_TIMEOUT_FAILURE
          OpEventGetEventTested_GetEventTested_EvtInfo_SPI_E_ECC_SELFTEST_FAILURE: RteEventRef=OpEventGetEventTested_GetEventTested_EvtInfo_SPI_E_ECC_SELFTEST_FAILURE
          OpEventGetEventTested_GetEventTested_EvtInfo_SPI_E_HARDWARE_ERROR: RteEventRef=OpEventGetEventTested_GetEventTested_EvtInfo_SPI_E_HARDWARE_ERROR
          OpEventGetEventTested_GetEventTested_EvtInfo_SPI_E_INT_INCONSISTENT: RteEventRef=OpEventGetEventTested_GetEventTested_EvtInfo_SPI_E_INT_INCONSISTENT
          OpEventGetEventTested_GetEventTested_EvtInfo_SPI_E_LOOPBACK_SELFTEST_FAILURE: RteEventRef=OpEventGetEventTested_GetEventTested_EvtInfo_SPI_E_LOOPBACK_SELFTEST_FAILURE
          OpEventGetEventTested_GetEventTested_EvtInfo_SPI_E_REG_WRITE_VERIFY: RteEventRef=OpEventGetEventTested_GetEventTested_EvtInfo_SPI_E_REG_WRITE_VERIFY
          OpEventGetEventTested_GetEventTested_EvtInfo_WDGM_E_IMPROPER_CALLER: RteEventRef=OpEventGetEventTested_GetEventTested_EvtInfo_WDGM_E_IMPROPER_CALLER
          OpEventGetEventTested_GetEventTested_EvtInfo_WDGM_E_MONITORING: RteEventRef=OpEventGetEventTested_GetEventTested_EvtInfo_WDGM_E_MONITORING
          OpEventGetEventTested_GetEventTested_EvtInfo_WDGM_E_SET_MODE: RteEventRef=OpEventGetEventTested_GetEventTested_EvtInfo_WDGM_E_SET_MODE
          OpEventGetEventTested_GetEventTested_EvtInfo_WDG_E_DISABLE_REJECTED: RteEventRef=OpEventGetEventTested_GetEventTested_EvtInfo_WDG_E_DISABLE_REJECTED
          OpEventGetEventTested_GetEventTested_EvtInfo_WDG_E_INT_INCONSISTENT: RteEventRef=OpEventGetEventTested_GetEventTested_EvtInfo_WDG_E_INT_INCONSISTENT
          OpEventGetEventTested_GetEventTested_EvtInfo_WDG_E_MODE_FAILED: RteEventRef=OpEventGetEventTested_GetEventTested_EvtInfo_WDG_E_MODE_FAILED
          OpEventGetEventTested_GetEventTested_EvtInfo_WDG_E_REG_WRITE_VERIFY: RteEventRef=OpEventGetEventTested_GetEventTested_EvtInfo_WDG_E_REG_WRITE_VERIFY
          OpEventGetEventTested_GetEventTested_EvtInfo_PORT_E_WRITE_TIMEOUT_FAILURE: RteEventRef=OpEventGetEventTested_GetEventTested_EvtInfo_PORT_E_WRITE_TIMEOUT_FAILURE
          OpEventGetEventTested_GetEventTested_EvtInfo_PORT_E_REG_WRITE_VERIFY: RteEventRef=OpEventGetEventTested_GetEventTested_EvtInfo_PORT_E_REG_WRITE_VERIFY
          OpEventGetEventTested_GetEventTested_EvtInfo_CodingEventNotCoded: RteEventRef=OpEventGetEventTested_GetEventTested_EvtInfo_CodingEventNotCoded
          OpEventGetEventTested_GetEventTested_Event_CodingEventNotCoded: RteEventRef=OpEventGetEventTested_GetEventTested_Event_CodingEventNotCoded
          OpEventGetEventTested_GetEventTested_EvtInfo_CodingEventUnqualifiedData: RteEventRef=OpEventGetEventTested_GetEventTested_EvtInfo_CodingEventUnqualifiedData
          OpEventGetEventTested_GetEventTested_Event_CodingEventUnqualifiedData: RteEventRef=OpEventGetEventTested_GetEventTested_Event_CodingEventUnqualifiedData
          OpEventGetEventTested_GetEventTested_EvtInfo_CodingEventWrongVehicle: RteEventRef=OpEventGetEventTested_GetEventTested_EvtInfo_CodingEventWrongVehicle
          OpEventGetEventTested_GetEventTested_Event_CodingEventWrongVehicle: RteEventRef=OpEventGetEventTested_GetEventTested_Event_CodingEventWrongVehicle
          OpEventGetEventTested_GetEventTested_EvtInfo_DmTestAppl: RteEventRef=OpEventGetEventTested_GetEventTested_EvtInfo_DmTestAppl
          OpEventGetEventTested_GetEventTested_Event_DmTestAppl: RteEventRef=OpEventGetEventTested_GetEventTested_Event_DmTestAppl
          OpEventGetEventTested_GetEventTested_EvtInfo_DmTestCom: RteEventRef=OpEventGetEventTested_GetEventTested_EvtInfo_DmTestCom
          OpEventGetEventTested_GetEventTested_Event_DmTestCom: RteEventRef=OpEventGetEventTested_GetEventTested_Event_DmTestCom
          OpEventGetEventTested_GetEventTested_EvtInfo_FrsmEClusterSyncLoss: RteEventRef=OpEventGetEventTested_GetEventTested_EvtInfo_FrsmEClusterSyncLoss
          OpEventGetEventTested_GetEventTested_Event_FrsmEClusterSyncLoss: RteEventRef=OpEventGetEventTested_GetEventTested_Event_FrsmEClusterSyncLoss
          OpEventGetEventTested_GetEventTested_EvtInfo_FrtrcvEFrBuserrorTrcv0: RteEventRef=OpEventGetEventTested_GetEventTested_EvtInfo_FrtrcvEFrBuserrorTrcv0
          OpEventGetEventTested_GetEventTested_Event_FrtrcvEFrBuserrorTrcv0: RteEventRef=OpEventGetEventTested_GetEventTested_Event_FrtrcvEFrBuserrorTrcv0
          OpEventGetEventTested_GetEventTested_EvtInfo_GlobalOvervoltageExt: RteEventRef=OpEventGetEventTested_GetEventTested_EvtInfo_GlobalOvervoltageExt
          OpEventGetEventTested_GetEventTested_Event_GlobalOvervoltageExt: RteEventRef=OpEventGetEventTested_GetEventTested_Event_GlobalOvervoltageExt
          OpEventGetEventTested_GetEventTested_EvtInfo_GlobalOvervoltageInt: RteEventRef=OpEventGetEventTested_GetEventTested_EvtInfo_GlobalOvervoltageInt
          OpEventGetEventTested_GetEventTested_Event_GlobalOvervoltageInt: RteEventRef=OpEventGetEventTested_GetEventTested_Event_GlobalOvervoltageInt
          OpEventGetEventTested_GetEventTested_EvtInfo_GlobalUndervoltageExt: RteEventRef=OpEventGetEventTested_GetEventTested_EvtInfo_GlobalUndervoltageExt
          OpEventGetEventTested_GetEventTested_Event_GlobalUndervoltageExt: RteEventRef=OpEventGetEventTested_GetEventTested_Event_GlobalUndervoltageExt
          OpEventGetEventTested_GetEventTested_EvtInfo_GlobalUndervoltageInt: RteEventRef=OpEventGetEventTested_GetEventTested_EvtInfo_GlobalUndervoltageInt
          OpEventGetEventTested_GetEventTested_Event_GlobalUndervoltageInt: RteEventRef=OpEventGetEventTested_GetEventTested_Event_GlobalUndervoltageInt
          OpEventGetEventTested_GetEventTested_EvtInfo_LocalOvervoltage: RteEventRef=OpEventGetEventTested_GetEventTested_EvtInfo_LocalOvervoltage
          OpEventGetEventTested_GetEventTested_Event_LocalOvervoltage: RteEventRef=OpEventGetEventTested_GetEventTested_Event_LocalOvervoltage
          OpEventGetEventTested_GetEventTested_EvtInfo_LocalUndervoltage: RteEventRef=OpEventGetEventTested_GetEventTested_EvtInfo_LocalUndervoltage
          OpEventGetEventTested_GetEventTested_Event_LocalUndervoltage: RteEventRef=OpEventGetEventTested_GetEventTested_Event_LocalUndervoltage
          OpEventGetEventTested_GetEventTested_EvtInfo_VsmEventOpmode: RteEventRef=OpEventGetEventTested_GetEventTested_EvtInfo_VsmEventOpmode
          OpEventGetEventTested_GetEventTested_Event_VsmEventOpmode: RteEventRef=OpEventGetEventTested_GetEventTested_Event_VsmEventOpmode
          OpEventGetEventTested_GetEventTested_GeneralEventInfo: RteEventRef=OpEventGetEventTested_GetEventTested_GeneralEventInfo
          OpEventGetDTCOfEvent_GetDTCOfEvent_EvtInfo_MCU_E_CLM_SELFDIAG_FAILURE: RteEventRef=OpEventGetDTCOfEvent_GetDTCOfEvent_EvtInfo_MCU_E_CLM_SELFDIAG_FAILURE
          OpEventGetDTCOfEvent_GetDTCOfEvent_EvtInfo_MCU_E_CLOCK_FAILURE: RteEventRef=OpEventGetDTCOfEvent_GetDTCOfEvent_EvtInfo_MCU_E_CLOCK_FAILURE
          OpEventGetDTCOfEvent_GetDTCOfEvent_EvtInfo_MCU_E_CVM_SELFDIAG_FAILURE: RteEventRef=OpEventGetDTCOfEvent_GetDTCOfEvent_EvtInfo_MCU_E_CVM_SELFDIAG_FAILURE
          OpEventGetDTCOfEvent_GetDTCOfEvent_EvtInfo_MCU_E_ECM_SELFDIAG_FAILURE: RteEventRef=OpEventGetDTCOfEvent_GetDTCOfEvent_EvtInfo_MCU_E_ECM_SELFDIAG_FAILURE
          OpEventGetDTCOfEvent_GetDTCOfEvent_EvtInfo_MCU_E_LOCKSTEP_SELFDIAG_FAILURE: RteEventRef=OpEventGetDTCOfEvent_GetDTCOfEvent_EvtInfo_MCU_E_LOCKSTEP_SELFDIAG_FAILURE
          OpEventGetDTCOfEvent_GetDTCOfEvent_EvtInfo_MCU_E_WRITE_TIMEOUT_FAILURE: RteEventRef=OpEventGetDTCOfEvent_GetDTCOfEvent_EvtInfo_MCU_E_WRITE_TIMEOUT_FAILURE
          OpEventGetDTCOfEvent_GetDTCOfEvent_EvtInfo_MCU_E_REG_WRITE_VERIFY: RteEventRef=OpEventGetDTCOfEvent_GetDTCOfEvent_EvtInfo_MCU_E_REG_WRITE_VERIFY
          OpEventGetDTCOfEvent_GetDTCOfEvent_EvtInfo_MCU_E_INT_INCONSISTENT: RteEventRef=OpEventGetDTCOfEvent_GetDTCOfEvent_EvtInfo_MCU_E_INT_INCONSISTENT
          OpEventGetDTCOfEvent_GetDTCOfEvent_EvtInfo_MCU_E_RESETCONTROLLER_STARTUP_FAILURE: RteEventRef=OpEventGetDTCOfEvent_GetDTCOfEvent_EvtInfo_MCU_E_RESETCONTROLLER_STARTUP_FAILURE
          OpEventGetDTCOfEvent_GetDTCOfEvent_EvtInfo_DIO_E_REG_WRITE_VERIFY: RteEventRef=OpEventGetDTCOfEvent_GetDTCOfEvent_EvtInfo_DIO_E_REG_WRITE_VERIFY
          OpEventGetDTCOfEvent_GetDTCOfEvent_EvtInfo_FLS_E_COMPARE_FAILED: RteEventRef=OpEventGetDTCOfEvent_GetDTCOfEvent_EvtInfo_FLS_E_COMPARE_FAILED
          OpEventGetDTCOfEvent_GetDTCOfEvent_EvtInfo_FLS_E_ERASE_FAILED: RteEventRef=OpEventGetDTCOfEvent_GetDTCOfEvent_EvtInfo_FLS_E_ERASE_FAILED
          OpEventGetDTCOfEvent_GetDTCOfEvent_EvtInfo_FLS_E_READ_FAILED: RteEventRef=OpEventGetDTCOfEvent_GetDTCOfEvent_EvtInfo_FLS_E_READ_FAILED
          OpEventGetDTCOfEvent_GetDTCOfEvent_EvtInfo_FLS_E_INT_INCONSISTENT: RteEventRef=OpEventGetDTCOfEvent_GetDTCOfEvent_EvtInfo_FLS_E_INT_INCONSISTENT
          OpEventGetDTCOfEvent_GetDTCOfEvent_EvtInfo_FLS_E_REG_WRITE_VERIFY: RteEventRef=OpEventGetDTCOfEvent_GetDTCOfEvent_EvtInfo_FLS_E_REG_WRITE_VERIFY
          OpEventGetDTCOfEvent_GetDTCOfEvent_EvtInfo_FLS_E_READ_FAILED_DED: RteEventRef=OpEventGetDTCOfEvent_GetDTCOfEvent_EvtInfo_FLS_E_READ_FAILED_DED
          OpEventGetDTCOfEvent_GetDTCOfEvent_EvtInfo_FLS_E_HW_FAILURE: RteEventRef=OpEventGetDTCOfEvent_GetDTCOfEvent_EvtInfo_FLS_E_HW_FAILURE
          OpEventGetDTCOfEvent_GetDTCOfEvent_EvtInfo_FLS_E_ECC_FAILED: RteEventRef=OpEventGetDTCOfEvent_GetDTCOfEvent_EvtInfo_FLS_E_ECC_FAILED
          OpEventGetDTCOfEvent_GetDTCOfEvent_EvtInfo_FLS_E_UNEXPECTED_FLASH_ID: RteEventRef=OpEventGetDTCOfEvent_GetDTCOfEvent_EvtInfo_FLS_E_UNEXPECTED_FLASH_ID
          OpEventGetDTCOfEvent_GetDTCOfEvent_EvtInfo_FLS_E_WRITE_FAILED: RteEventRef=OpEventGetDTCOfEvent_GetDTCOfEvent_EvtInfo_FLS_E_WRITE_FAILED
          OpEventGetDTCOfEvent_GetDTCOfEvent_EvtInfo_SPI_E_DATA_TX_TIMEOUT_FAILURE: RteEventRef=OpEventGetDTCOfEvent_GetDTCOfEvent_EvtInfo_SPI_E_DATA_TX_TIMEOUT_FAILURE
          OpEventGetDTCOfEvent_GetDTCOfEvent_EvtInfo_SPI_E_ECC_SELFTEST_FAILURE: RteEventRef=OpEventGetDTCOfEvent_GetDTCOfEvent_EvtInfo_SPI_E_ECC_SELFTEST_FAILURE
          OpEventGetDTCOfEvent_GetDTCOfEvent_EvtInfo_SPI_E_HARDWARE_ERROR: RteEventRef=OpEventGetDTCOfEvent_GetDTCOfEvent_EvtInfo_SPI_E_HARDWARE_ERROR
          OpEventGetDTCOfEvent_GetDTCOfEvent_EvtInfo_SPI_E_INT_INCONSISTENT: RteEventRef=OpEventGetDTCOfEvent_GetDTCOfEvent_EvtInfo_SPI_E_INT_INCONSISTENT
          OpEventGetDTCOfEvent_GetDTCOfEvent_EvtInfo_SPI_E_LOOPBACK_SELFTEST_FAILURE: RteEventRef=OpEventGetDTCOfEvent_GetDTCOfEvent_EvtInfo_SPI_E_LOOPBACK_SELFTEST_FAILURE
          OpEventGetDTCOfEvent_GetDTCOfEvent_EvtInfo_SPI_E_REG_WRITE_VERIFY: RteEventRef=OpEventGetDTCOfEvent_GetDTCOfEvent_EvtInfo_SPI_E_REG_WRITE_VERIFY
          OpEventGetDTCOfEvent_GetDTCOfEvent_EvtInfo_WDGM_E_IMPROPER_CALLER: RteEventRef=OpEventGetDTCOfEvent_GetDTCOfEvent_EvtInfo_WDGM_E_IMPROPER_CALLER
          OpEventGetDTCOfEvent_GetDTCOfEvent_EvtInfo_WDGM_E_MONITORING: RteEventRef=OpEventGetDTCOfEvent_GetDTCOfEvent_EvtInfo_WDGM_E_MONITORING
          OpEventGetDTCOfEvent_GetDTCOfEvent_EvtInfo_WDGM_E_SET_MODE: RteEventRef=OpEventGetDTCOfEvent_GetDTCOfEvent_EvtInfo_WDGM_E_SET_MODE
          OpEventGetDTCOfEvent_GetDTCOfEvent_EvtInfo_WDG_E_DISABLE_REJECTED: RteEventRef=OpEventGetDTCOfEvent_GetDTCOfEvent_EvtInfo_WDG_E_DISABLE_REJECTED
          OpEventGetDTCOfEvent_GetDTCOfEvent_EvtInfo_WDG_E_INT_INCONSISTENT: RteEventRef=OpEventGetDTCOfEvent_GetDTCOfEvent_EvtInfo_WDG_E_INT_INCONSISTENT
          OpEventGetDTCOfEvent_GetDTCOfEvent_EvtInfo_WDG_E_MODE_FAILED: RteEventRef=OpEventGetDTCOfEvent_GetDTCOfEvent_EvtInfo_WDG_E_MODE_FAILED
          OpEventGetDTCOfEvent_GetDTCOfEvent_EvtInfo_WDG_E_REG_WRITE_VERIFY: RteEventRef=OpEventGetDTCOfEvent_GetDTCOfEvent_EvtInfo_WDG_E_REG_WRITE_VERIFY
          OpEventGetDTCOfEvent_GetDTCOfEvent_EvtInfo_PORT_E_WRITE_TIMEOUT_FAILURE: RteEventRef=OpEventGetDTCOfEvent_GetDTCOfEvent_EvtInfo_PORT_E_WRITE_TIMEOUT_FAILURE
          OpEventGetDTCOfEvent_GetDTCOfEvent_EvtInfo_PORT_E_REG_WRITE_VERIFY: RteEventRef=OpEventGetDTCOfEvent_GetDTCOfEvent_EvtInfo_PORT_E_REG_WRITE_VERIFY
          OpEventGetDTCOfEvent_GetDTCOfEvent_EvtInfo_CodingEventNotCoded: RteEventRef=OpEventGetDTCOfEvent_GetDTCOfEvent_EvtInfo_CodingEventNotCoded
          OpEventGetDTCOfEvent_GetDTCOfEvent_Event_CodingEventNotCoded: RteEventRef=OpEventGetDTCOfEvent_GetDTCOfEvent_Event_CodingEventNotCoded
          OpEventGetDTCOfEvent_GetDTCOfEvent_EvtInfo_CodingEventUnqualifiedData: RteEventRef=OpEventGetDTCOfEvent_GetDTCOfEvent_EvtInfo_CodingEventUnqualifiedData
          OpEventGetDTCOfEvent_GetDTCOfEvent_Event_CodingEventUnqualifiedData: RteEventRef=OpEventGetDTCOfEvent_GetDTCOfEvent_Event_CodingEventUnqualifiedData
          OpEventGetDTCOfEvent_GetDTCOfEvent_EvtInfo_CodingEventWrongVehicle: RteEventRef=OpEventGetDTCOfEvent_GetDTCOfEvent_EvtInfo_CodingEventWrongVehicle
          OpEventGetDTCOfEvent_GetDTCOfEvent_Event_CodingEventWrongVehicle: RteEventRef=OpEventGetDTCOfEvent_GetDTCOfEvent_Event_CodingEventWrongVehicle
          OpEventGetDTCOfEvent_GetDTCOfEvent_EvtInfo_DmTestAppl: RteEventRef=OpEventGetDTCOfEvent_GetDTCOfEvent_EvtInfo_DmTestAppl
          OpEventGetDTCOfEvent_GetDTCOfEvent_Event_DmTestAppl: RteEventRef=OpEventGetDTCOfEvent_GetDTCOfEvent_Event_DmTestAppl
          OpEventGetDTCOfEvent_GetDTCOfEvent_EvtInfo_DmTestCom: RteEventRef=OpEventGetDTCOfEvent_GetDTCOfEvent_EvtInfo_DmTestCom
          OpEventGetDTCOfEvent_GetDTCOfEvent_Event_DmTestCom: RteEventRef=OpEventGetDTCOfEvent_GetDTCOfEvent_Event_DmTestCom
          OpEventGetDTCOfEvent_GetDTCOfEvent_EvtInfo_FrsmEClusterSyncLoss: RteEventRef=OpEventGetDTCOfEvent_GetDTCOfEvent_EvtInfo_FrsmEClusterSyncLoss
          OpEventGetDTCOfEvent_GetDTCOfEvent_Event_FrsmEClusterSyncLoss: RteEventRef=OpEventGetDTCOfEvent_GetDTCOfEvent_Event_FrsmEClusterSyncLoss
          OpEventGetDTCOfEvent_GetDTCOfEvent_EvtInfo_FrtrcvEFrBuserrorTrcv0: RteEventRef=OpEventGetDTCOfEvent_GetDTCOfEvent_EvtInfo_FrtrcvEFrBuserrorTrcv0
          OpEventGetDTCOfEvent_GetDTCOfEvent_Event_FrtrcvEFrBuserrorTrcv0: RteEventRef=OpEventGetDTCOfEvent_GetDTCOfEvent_Event_FrtrcvEFrBuserrorTrcv0
          OpEventGetDTCOfEvent_GetDTCOfEvent_EvtInfo_GlobalOvervoltageExt: RteEventRef=OpEventGetDTCOfEvent_GetDTCOfEvent_EvtInfo_GlobalOvervoltageExt
          OpEventGetDTCOfEvent_GetDTCOfEvent_Event_GlobalOvervoltageExt: RteEventRef=OpEventGetDTCOfEvent_GetDTCOfEvent_Event_GlobalOvervoltageExt
          OpEventGetDTCOfEvent_GetDTCOfEvent_EvtInfo_GlobalOvervoltageInt: RteEventRef=OpEventGetDTCOfEvent_GetDTCOfEvent_EvtInfo_GlobalOvervoltageInt
          OpEventGetDTCOfEvent_GetDTCOfEvent_Event_GlobalOvervoltageInt: RteEventRef=OpEventGetDTCOfEvent_GetDTCOfEvent_Event_GlobalOvervoltageInt
          OpEventGetDTCOfEvent_GetDTCOfEvent_EvtInfo_GlobalUndervoltageExt: RteEventRef=OpEventGetDTCOfEvent_GetDTCOfEvent_EvtInfo_GlobalUndervoltageExt
          OpEventGetDTCOfEvent_GetDTCOfEvent_Event_GlobalUndervoltageExt: RteEventRef=OpEventGetDTCOfEvent_GetDTCOfEvent_Event_GlobalUndervoltageExt
          OpEventGetDTCOfEvent_GetDTCOfEvent_EvtInfo_GlobalUndervoltageInt: RteEventRef=OpEventGetDTCOfEvent_GetDTCOfEvent_EvtInfo_GlobalUndervoltageInt
          OpEventGetDTCOfEvent_GetDTCOfEvent_Event_GlobalUndervoltageInt: RteEventRef=OpEventGetDTCOfEvent_GetDTCOfEvent_Event_GlobalUndervoltageInt
          OpEventGetDTCOfEvent_GetDTCOfEvent_EvtInfo_LocalOvervoltage: RteEventRef=OpEventGetDTCOfEvent_GetDTCOfEvent_EvtInfo_LocalOvervoltage
          OpEventGetDTCOfEvent_GetDTCOfEvent_Event_LocalOvervoltage: RteEventRef=OpEventGetDTCOfEvent_GetDTCOfEvent_Event_LocalOvervoltage
          OpEventGetDTCOfEvent_GetDTCOfEvent_EvtInfo_LocalUndervoltage: RteEventRef=OpEventGetDTCOfEvent_GetDTCOfEvent_EvtInfo_LocalUndervoltage
          OpEventGetDTCOfEvent_GetDTCOfEvent_Event_LocalUndervoltage: RteEventRef=OpEventGetDTCOfEvent_GetDTCOfEvent_Event_LocalUndervoltage
          OpEventGetDTCOfEvent_GetDTCOfEvent_EvtInfo_VsmEventOpmode: RteEventRef=OpEventGetDTCOfEvent_GetDTCOfEvent_EvtInfo_VsmEventOpmode
          OpEventGetDTCOfEvent_GetDTCOfEvent_Event_VsmEventOpmode: RteEventRef=OpEventGetDTCOfEvent_GetDTCOfEvent_Event_VsmEventOpmode
          OpEventGetDTCOfEvent_GetDTCOfEvent_GeneralEventInfo: RteEventRef=OpEventGetDTCOfEvent_GetDTCOfEvent_GeneralEventInfo
          OpEventGetFaultDetectionCounter_GetFaultDetectionCounter_EvtInfo_MCU_E_CLM_SELFDIAG_FAILURE: RteEventRef=OpEventGetFaultDetectionCounter_GetFaultDetectionCounter_EvtInfo_MCU_E_CLM_SELFDIAG_FAILURE
          OpEventGetFaultDetectionCounter_GetFaultDetectionCounter_EvtInfo_MCU_E_CLOCK_FAILURE: RteEventRef=OpEventGetFaultDetectionCounter_GetFaultDetectionCounter_EvtInfo_MCU_E_CLOCK_FAILURE
          OpEventGetFaultDetectionCounter_GetFaultDetectionCounter_EvtInfo_MCU_E_CVM_SELFDIAG_FAILURE: RteEventRef=OpEventGetFaultDetectionCounter_GetFaultDetectionCounter_EvtInfo_MCU_E_CVM_SELFDIAG_FAILURE
          OpEventGetFaultDetectionCounter_GetFaultDetectionCounter_EvtInfo_MCU_E_ECM_SELFDIAG_FAILURE: RteEventRef=OpEventGetFaultDetectionCounter_GetFaultDetectionCounter_EvtInfo_MCU_E_ECM_SELFDIAG_FAILURE
          OpEventGetFaultDetectionCounter_GetFaultDetectionCounter_EvtInfo_MCU_E_LOCKSTEP_SELFDIAG_FAILURE: RteEventRef=OpEventGetFaultDetectionCounter_GetFaultDetectionCounter_EvtInfo_MCU_E_LOCKSTEP_SELFDIAG_FAILURE
          OpEventGetFaultDetectionCounter_GetFaultDetectionCounter_EvtInfo_MCU_E_WRITE_TIMEOUT_FAILURE: RteEventRef=OpEventGetFaultDetectionCounter_GetFaultDetectionCounter_EvtInfo_MCU_E_WRITE_TIMEOUT_FAILURE
          OpEventGetFaultDetectionCounter_GetFaultDetectionCounter_EvtInfo_MCU_E_REG_WRITE_VERIFY: RteEventRef=OpEventGetFaultDetectionCounter_GetFaultDetectionCounter_EvtInfo_MCU_E_REG_WRITE_VERIFY
          OpEventGetFaultDetectionCounter_GetFaultDetectionCounter_EvtInfo_MCU_E_INT_INCONSISTENT: RteEventRef=OpEventGetFaultDetectionCounter_GetFaultDetectionCounter_EvtInfo_MCU_E_INT_INCONSISTENT
          OpEventGetFaultDetectionCounter_GetFaultDetectionCounter_EvtInfo_MCU_E_RESETCONTROLLER_STARTUP_FAILURE: RteEventRef=OpEventGetFaultDetectionCounter_GetFaultDetectionCounter_EvtInfo_MCU_E_RESETCONTROLLER_STARTUP_FAILURE
          OpEventGetFaultDetectionCounter_GetFaultDetectionCounter_EvtInfo_DIO_E_REG_WRITE_VERIFY: RteEventRef=OpEventGetFaultDetectionCounter_GetFaultDetectionCounter_EvtInfo_DIO_E_REG_WRITE_VERIFY
          OpEventGetFaultDetectionCounter_GetFaultDetectionCounter_EvtInfo_FLS_E_COMPARE_FAILED: RteEventRef=OpEventGetFaultDetectionCounter_GetFaultDetectionCounter_EvtInfo_FLS_E_COMPARE_FAILED
          OpEventGetFaultDetectionCounter_GetFaultDetectionCounter_EvtInfo_FLS_E_ERASE_FAILED: RteEventRef=OpEventGetFaultDetectionCounter_GetFaultDetectionCounter_EvtInfo_FLS_E_ERASE_FAILED
          OpEventGetFaultDetectionCounter_GetFaultDetectionCounter_EvtInfo_FLS_E_READ_FAILED: RteEventRef=OpEventGetFaultDetectionCounter_GetFaultDetectionCounter_EvtInfo_FLS_E_READ_FAILED
          OpEventGetFaultDetectionCounter_GetFaultDetectionCounter_EvtInfo_FLS_E_INT_INCONSISTENT: RteEventRef=OpEventGetFaultDetectionCounter_GetFaultDetectionCounter_EvtInfo_FLS_E_INT_INCONSISTENT
          OpEventGetFaultDetectionCounter_GetFaultDetectionCounter_EvtInfo_FLS_E_REG_WRITE_VERIFY: RteEventRef=OpEventGetFaultDetectionCounter_GetFaultDetectionCounter_EvtInfo_FLS_E_REG_WRITE_VERIFY
          OpEventGetFaultDetectionCounter_GetFaultDetectionCounter_EvtInfo_FLS_E_READ_FAILED_DED: RteEventRef=OpEventGetFaultDetectionCounter_GetFaultDetectionCounter_EvtInfo_FLS_E_READ_FAILED_DED
          OpEventGetFaultDetectionCounter_GetFaultDetectionCounter_EvtInfo_FLS_E_HW_FAILURE: RteEventRef=OpEventGetFaultDetectionCounter_GetFaultDetectionCounter_EvtInfo_FLS_E_HW_FAILURE
          OpEventGetFaultDetectionCounter_GetFaultDetectionCounter_EvtInfo_FLS_E_ECC_FAILED: RteEventRef=OpEventGetFaultDetectionCounter_GetFaultDetectionCounter_EvtInfo_FLS_E_ECC_FAILED
          OpEventGetFaultDetectionCounter_GetFaultDetectionCounter_EvtInfo_FLS_E_UNEXPECTED_FLASH_ID: RteEventRef=OpEventGetFaultDetectionCounter_GetFaultDetectionCounter_EvtInfo_FLS_E_UNEXPECTED_FLASH_ID
          OpEventGetFaultDetectionCounter_GetFaultDetectionCounter_EvtInfo_FLS_E_WRITE_FAILED: RteEventRef=OpEventGetFaultDetectionCounter_GetFaultDetectionCounter_EvtInfo_FLS_E_WRITE_FAILED
          OpEventGetFaultDetectionCounter_GetFaultDetectionCounter_EvtInfo_SPI_E_DATA_TX_TIMEOUT_FAILURE: RteEventRef=OpEventGetFaultDetectionCounter_GetFaultDetectionCounter_EvtInfo_SPI_E_DATA_TX_TIMEOUT_FAILURE
          OpEventGetFaultDetectionCounter_GetFaultDetectionCounter_EvtInfo_SPI_E_ECC_SELFTEST_FAILURE: RteEventRef=OpEventGetFaultDetectionCounter_GetFaultDetectionCounter_EvtInfo_SPI_E_ECC_SELFTEST_FAILURE
          OpEventGetFaultDetectionCounter_GetFaultDetectionCounter_EvtInfo_SPI_E_HARDWARE_ERROR: RteEventRef=OpEventGetFaultDetectionCounter_GetFaultDetectionCounter_EvtInfo_SPI_E_HARDWARE_ERROR
          OpEventGetFaultDetectionCounter_GetFaultDetectionCounter_EvtInfo_SPI_E_INT_INCONSISTENT: RteEventRef=OpEventGetFaultDetectionCounter_GetFaultDetectionCounter_EvtInfo_SPI_E_INT_INCONSISTENT
          OpEventGetFaultDetectionCounter_GetFaultDetectionCounter_EvtInfo_SPI_E_LOOPBACK_SELFTEST_FAILURE: RteEventRef=OpEventGetFaultDetectionCounter_GetFaultDetectionCounter_EvtInfo_SPI_E_LOOPBACK_SELFTEST_FAILURE
          OpEventGetFaultDetectionCounter_GetFaultDetectionCounter_EvtInfo_SPI_E_REG_WRITE_VERIFY: RteEventRef=OpEventGetFaultDetectionCounter_GetFaultDetectionCounter_EvtInfo_SPI_E_REG_WRITE_VERIFY
          OpEventGetFaultDetectionCounter_GetFaultDetectionCounter_EvtInfo_WDGM_E_IMPROPER_CALLER: RteEventRef=OpEventGetFaultDetectionCounter_GetFaultDetectionCounter_EvtInfo_WDGM_E_IMPROPER_CALLER
          OpEventGetFaultDetectionCounter_GetFaultDetectionCounter_EvtInfo_WDGM_E_MONITORING: RteEventRef=OpEventGetFaultDetectionCounter_GetFaultDetectionCounter_EvtInfo_WDGM_E_MONITORING
          OpEventGetFaultDetectionCounter_GetFaultDetectionCounter_EvtInfo_WDGM_E_SET_MODE: RteEventRef=OpEventGetFaultDetectionCounter_GetFaultDetectionCounter_EvtInfo_WDGM_E_SET_MODE
          OpEventGetFaultDetectionCounter_GetFaultDetectionCounter_EvtInfo_WDG_E_DISABLE_REJECTED: RteEventRef=OpEventGetFaultDetectionCounter_GetFaultDetectionCounter_EvtInfo_WDG_E_DISABLE_REJECTED
          OpEventGetFaultDetectionCounter_GetFaultDetectionCounter_EvtInfo_WDG_E_INT_INCONSISTENT: RteEventRef=OpEventGetFaultDetectionCounter_GetFaultDetectionCounter_EvtInfo_WDG_E_INT_INCONSISTENT
          OpEventGetFaultDetectionCounter_GetFaultDetectionCounter_EvtInfo_WDG_E_MODE_FAILED: RteEventRef=OpEventGetFaultDetectionCounter_GetFaultDetectionCounter_EvtInfo_WDG_E_MODE_FAILED
          OpEventGetFaultDetectionCounter_GetFaultDetectionCounter_EvtInfo_WDG_E_REG_WRITE_VERIFY: RteEventRef=OpEventGetFaultDetectionCounter_GetFaultDetectionCounter_EvtInfo_WDG_E_REG_WRITE_VERIFY
          OpEventGetFaultDetectionCounter_GetFaultDetectionCounter_EvtInfo_PORT_E_WRITE_TIMEOUT_FAILURE: RteEventRef=OpEventGetFaultDetectionCounter_GetFaultDetectionCounter_EvtInfo_PORT_E_WRITE_TIMEOUT_FAILURE
          OpEventGetFaultDetectionCounter_GetFaultDetectionCounter_EvtInfo_PORT_E_REG_WRITE_VERIFY: RteEventRef=OpEventGetFaultDetectionCounter_GetFaultDetectionCounter_EvtInfo_PORT_E_REG_WRITE_VERIFY
          OpEventGetFaultDetectionCounter_GetFaultDetectionCounter_EvtInfo_CodingEventNotCoded: RteEventRef=OpEventGetFaultDetectionCounter_GetFaultDetectionCounter_EvtInfo_CodingEventNotCoded
          OpEventGetFaultDetectionCounter_GetFaultDetectionCounter_Event_CodingEventNotCoded: RteEventRef=OpEventGetFaultDetectionCounter_GetFaultDetectionCounter_Event_CodingEventNotCoded
          OpEventGetFaultDetectionCounter_GetFaultDetectionCounter_EvtInfo_CodingEventUnqualifiedData: RteEventRef=OpEventGetFaultDetectionCounter_GetFaultDetectionCounter_EvtInfo_CodingEventUnqualifiedData
          OpEventGetFaultDetectionCounter_GetFaultDetectionCounter_Event_CodingEventUnqualifiedData: RteEventRef=OpEventGetFaultDetectionCounter_GetFaultDetectionCounter_Event_CodingEventUnqualifiedData
          OpEventGetFaultDetectionCounter_GetFaultDetectionCounter_EvtInfo_CodingEventWrongVehicle: RteEventRef=OpEventGetFaultDetectionCounter_GetFaultDetectionCounter_EvtInfo_CodingEventWrongVehicle
          OpEventGetFaultDetectionCounter_GetFaultDetectionCounter_Event_CodingEventWrongVehicle: RteEventRef=OpEventGetFaultDetectionCounter_GetFaultDetectionCounter_Event_CodingEventWrongVehicle
          OpEventGetFaultDetectionCounter_GetFaultDetectionCounter_EvtInfo_DmTestAppl: RteEventRef=OpEventGetFaultDetectionCounter_GetFaultDetectionCounter_EvtInfo_DmTestAppl
          OpEventGetFaultDetectionCounter_GetFaultDetectionCounter_Event_DmTestAppl: RteEventRef=OpEventGetFaultDetectionCounter_GetFaultDetectionCounter_Event_DmTestAppl
          OpEventGetFaultDetectionCounter_GetFaultDetectionCounter_EvtInfo_DmTestCom: RteEventRef=OpEventGetFaultDetectionCounter_GetFaultDetectionCounter_EvtInfo_DmTestCom
          OpEventGetFaultDetectionCounter_GetFaultDetectionCounter_Event_DmTestCom: RteEventRef=OpEventGetFaultDetectionCounter_GetFaultDetectionCounter_Event_DmTestCom
          OpEventGetFaultDetectionCounter_GetFaultDetectionCounter_EvtInfo_FrsmEClusterSyncLoss: RteEventRef=OpEventGetFaultDetectionCounter_GetFaultDetectionCounter_EvtInfo_FrsmEClusterSyncLoss
          OpEventGetFaultDetectionCounter_GetFaultDetectionCounter_Event_FrsmEClusterSyncLoss: RteEventRef=OpEventGetFaultDetectionCounter_GetFaultDetectionCounter_Event_FrsmEClusterSyncLoss
          OpEventGetFaultDetectionCounter_GetFaultDetectionCounter_EvtInfo_FrtrcvEFrBuserrorTrcv0: RteEventRef=OpEventGetFaultDetectionCounter_GetFaultDetectionCounter_EvtInfo_FrtrcvEFrBuserrorTrcv0
          OpEventGetFaultDetectionCounter_GetFaultDetectionCounter_Event_FrtrcvEFrBuserrorTrcv0: RteEventRef=OpEventGetFaultDetectionCounter_GetFaultDetectionCounter_Event_FrtrcvEFrBuserrorTrcv0
          OpEventGetFaultDetectionCounter_GetFaultDetectionCounter_EvtInfo_GlobalOvervoltageExt: RteEventRef=OpEventGetFaultDetectionCounter_GetFaultDetectionCounter_EvtInfo_GlobalOvervoltageExt
          OpEventGetFaultDetectionCounter_GetFaultDetectionCounter_Event_GlobalOvervoltageExt: RteEventRef=OpEventGetFaultDetectionCounter_GetFaultDetectionCounter_Event_GlobalOvervoltageExt
          OpEventGetFaultDetectionCounter_GetFaultDetectionCounter_EvtInfo_GlobalOvervoltageInt: RteEventRef=OpEventGetFaultDetectionCounter_GetFaultDetectionCounter_EvtInfo_GlobalOvervoltageInt
          OpEventGetFaultDetectionCounter_GetFaultDetectionCounter_Event_GlobalOvervoltageInt: RteEventRef=OpEventGetFaultDetectionCounter_GetFaultDetectionCounter_Event_GlobalOvervoltageInt
          OpEventGetFaultDetectionCounter_GetFaultDetectionCounter_EvtInfo_GlobalUndervoltageExt: RteEventRef=OpEventGetFaultDetectionCounter_GetFaultDetectionCounter_EvtInfo_GlobalUndervoltageExt
          OpEventGetFaultDetectionCounter_GetFaultDetectionCounter_Event_GlobalUndervoltageExt: RteEventRef=OpEventGetFaultDetectionCounter_GetFaultDetectionCounter_Event_GlobalUndervoltageExt
          OpEventGetFaultDetectionCounter_GetFaultDetectionCounter_EvtInfo_GlobalUndervoltageInt: RteEventRef=OpEventGetFaultDetectionCounter_GetFaultDetectionCounter_EvtInfo_GlobalUndervoltageInt
          OpEventGetFaultDetectionCounter_GetFaultDetectionCounter_Event_GlobalUndervoltageInt: RteEventRef=OpEventGetFaultDetectionCounter_GetFaultDetectionCounter_Event_GlobalUndervoltageInt
          OpEventGetFaultDetectionCounter_GetFaultDetectionCounter_EvtInfo_LocalOvervoltage: RteEventRef=OpEventGetFaultDetectionCounter_GetFaultDetectionCounter_EvtInfo_LocalOvervoltage
          OpEventGetFaultDetectionCounter_GetFaultDetectionCounter_Event_LocalOvervoltage: RteEventRef=OpEventGetFaultDetectionCounter_GetFaultDetectionCounter_Event_LocalOvervoltage
          OpEventGetFaultDetectionCounter_GetFaultDetectionCounter_EvtInfo_LocalUndervoltage: RteEventRef=OpEventGetFaultDetectionCounter_GetFaultDetectionCounter_EvtInfo_LocalUndervoltage
          OpEventGetFaultDetectionCounter_GetFaultDetectionCounter_Event_LocalUndervoltage: RteEventRef=OpEventGetFaultDetectionCounter_GetFaultDetectionCounter_Event_LocalUndervoltage
          OpEventGetFaultDetectionCounter_GetFaultDetectionCounter_EvtInfo_VsmEventOpmode: RteEventRef=OpEventGetFaultDetectionCounter_GetFaultDetectionCounter_EvtInfo_VsmEventOpmode
          OpEventGetFaultDetectionCounter_GetFaultDetectionCounter_Event_VsmEventOpmode: RteEventRef=OpEventGetFaultDetectionCounter_GetFaultDetectionCounter_Event_VsmEventOpmode
          OpEventGetFaultDetectionCounter_GetFaultDetectionCounter_GeneralEventInfo: RteEventRef=OpEventGetFaultDetectionCounter_GetFaultDetectionCounter_GeneralEventInfo
          OpEventGetEventFreezeFrameDataEx_GetEventFreezeFrameDataEx_EvtInfo_MCU_E_CLM_SELFDIAG_FAILURE: RteEventRef=OpEventGetEventFreezeFrameDataEx_GetEventFreezeFrameDataEx_EvtInfo_MCU_E_CLM_SELFDIAG_FAILURE
          OpEventGetEventFreezeFrameDataEx_GetEventFreezeFrameDataEx_EvtInfo_MCU_E_CLOCK_FAILURE: RteEventRef=OpEventGetEventFreezeFrameDataEx_GetEventFreezeFrameDataEx_EvtInfo_MCU_E_CLOCK_FAILURE
          OpEventGetEventFreezeFrameDataEx_GetEventFreezeFrameDataEx_EvtInfo_MCU_E_CVM_SELFDIAG_FAILURE: RteEventRef=OpEventGetEventFreezeFrameDataEx_GetEventFreezeFrameDataEx_EvtInfo_MCU_E_CVM_SELFDIAG_FAILURE
          OpEventGetEventFreezeFrameDataEx_GetEventFreezeFrameDataEx_EvtInfo_MCU_E_ECM_SELFDIAG_FAILURE: RteEventRef=OpEventGetEventFreezeFrameDataEx_GetEventFreezeFrameDataEx_EvtInfo_MCU_E_ECM_SELFDIAG_FAILURE
          OpEventGetEventFreezeFrameDataEx_GetEventFreezeFrameDataEx_EvtInfo_MCU_E_LOCKSTEP_SELFDIAG_FAILURE: RteEventRef=OpEventGetEventFreezeFrameDataEx_GetEventFreezeFrameDataEx_EvtInfo_MCU_E_LOCKSTEP_SELFDIAG_FAILURE
          OpEventGetEventFreezeFrameDataEx_GetEventFreezeFrameDataEx_EvtInfo_MCU_E_WRITE_TIMEOUT_FAILURE: RteEventRef=OpEventGetEventFreezeFrameDataEx_GetEventFreezeFrameDataEx_EvtInfo_MCU_E_WRITE_TIMEOUT_FAILURE
          OpEventGetEventFreezeFrameDataEx_GetEventFreezeFrameDataEx_EvtInfo_MCU_E_REG_WRITE_VERIFY: RteEventRef=OpEventGetEventFreezeFrameDataEx_GetEventFreezeFrameDataEx_EvtInfo_MCU_E_REG_WRITE_VERIFY
          OpEventGetEventFreezeFrameDataEx_GetEventFreezeFrameDataEx_EvtInfo_MCU_E_INT_INCONSISTENT: RteEventRef=OpEventGetEventFreezeFrameDataEx_GetEventFreezeFrameDataEx_EvtInfo_MCU_E_INT_INCONSISTENT
          OpEventGetEventFreezeFrameDataEx_GetEventFreezeFrameDataEx_EvtInfo_MCU_E_RESETCONTROLLER_STARTUP_FAILURE: RteEventRef=OpEventGetEventFreezeFrameDataEx_GetEventFreezeFrameDataEx_EvtInfo_MCU_E_RESETCONTROLLER_STARTUP_FAILURE
          OpEventGetEventFreezeFrameDataEx_GetEventFreezeFrameDataEx_EvtInfo_DIO_E_REG_WRITE_VERIFY: RteEventRef=OpEventGetEventFreezeFrameDataEx_GetEventFreezeFrameDataEx_EvtInfo_DIO_E_REG_WRITE_VERIFY
          OpEventGetEventFreezeFrameDataEx_GetEventFreezeFrameDataEx_EvtInfo_FLS_E_COMPARE_FAILED: RteEventRef=OpEventGetEventFreezeFrameDataEx_GetEventFreezeFrameDataEx_EvtInfo_FLS_E_COMPARE_FAILED
          OpEventGetEventFreezeFrameDataEx_GetEventFreezeFrameDataEx_EvtInfo_FLS_E_ERASE_FAILED: RteEventRef=OpEventGetEventFreezeFrameDataEx_GetEventFreezeFrameDataEx_EvtInfo_FLS_E_ERASE_FAILED
          OpEventGetEventFreezeFrameDataEx_GetEventFreezeFrameDataEx_EvtInfo_FLS_E_READ_FAILED: RteEventRef=OpEventGetEventFreezeFrameDataEx_GetEventFreezeFrameDataEx_EvtInfo_FLS_E_READ_FAILED
          OpEventGetEventFreezeFrameDataEx_GetEventFreezeFrameDataEx_EvtInfo_FLS_E_INT_INCONSISTENT: RteEventRef=OpEventGetEventFreezeFrameDataEx_GetEventFreezeFrameDataEx_EvtInfo_FLS_E_INT_INCONSISTENT
          OpEventGetEventFreezeFrameDataEx_GetEventFreezeFrameDataEx_EvtInfo_FLS_E_REG_WRITE_VERIFY: RteEventRef=OpEventGetEventFreezeFrameDataEx_GetEventFreezeFrameDataEx_EvtInfo_FLS_E_REG_WRITE_VERIFY
          OpEventGetEventFreezeFrameDataEx_GetEventFreezeFrameDataEx_EvtInfo_FLS_E_READ_FAILED_DED: RteEventRef=OpEventGetEventFreezeFrameDataEx_GetEventFreezeFrameDataEx_EvtInfo_FLS_E_READ_FAILED_DED
          OpEventGetEventFreezeFrameDataEx_GetEventFreezeFrameDataEx_EvtInfo_FLS_E_HW_FAILURE: RteEventRef=OpEventGetEventFreezeFrameDataEx_GetEventFreezeFrameDataEx_EvtInfo_FLS_E_HW_FAILURE
          OpEventGetEventFreezeFrameDataEx_GetEventFreezeFrameDataEx_EvtInfo_FLS_E_ECC_FAILED: RteEventRef=OpEventGetEventFreezeFrameDataEx_GetEventFreezeFrameDataEx_EvtInfo_FLS_E_ECC_FAILED
          OpEventGetEventFreezeFrameDataEx_GetEventFreezeFrameDataEx_EvtInfo_FLS_E_UNEXPECTED_FLASH_ID: RteEventRef=OpEventGetEventFreezeFrameDataEx_GetEventFreezeFrameDataEx_EvtInfo_FLS_E_UNEXPECTED_FLASH_ID
          OpEventGetEventFreezeFrameDataEx_GetEventFreezeFrameDataEx_EvtInfo_FLS_E_WRITE_FAILED: RteEventRef=OpEventGetEventFreezeFrameDataEx_GetEventFreezeFrameDataEx_EvtInfo_FLS_E_WRITE_FAILED
          OpEventGetEventFreezeFrameDataEx_GetEventFreezeFrameDataEx_EvtInfo_SPI_E_DATA_TX_TIMEOUT_FAILURE: RteEventRef=OpEventGetEventFreezeFrameDataEx_GetEventFreezeFrameDataEx_EvtInfo_SPI_E_DATA_TX_TIMEOUT_FAILURE
          OpEventGetEventFreezeFrameDataEx_GetEventFreezeFrameDataEx_EvtInfo_SPI_E_ECC_SELFTEST_FAILURE: RteEventRef=OpEventGetEventFreezeFrameDataEx_GetEventFreezeFrameDataEx_EvtInfo_SPI_E_ECC_SELFTEST_FAILURE
          OpEventGetEventFreezeFrameDataEx_GetEventFreezeFrameDataEx_EvtInfo_SPI_E_HARDWARE_ERROR: RteEventRef=OpEventGetEventFreezeFrameDataEx_GetEventFreezeFrameDataEx_EvtInfo_SPI_E_HARDWARE_ERROR
          OpEventGetEventFreezeFrameDataEx_GetEventFreezeFrameDataEx_EvtInfo_SPI_E_INT_INCONSISTENT: RteEventRef=OpEventGetEventFreezeFrameDataEx_GetEventFreezeFrameDataEx_EvtInfo_SPI_E_INT_INCONSISTENT
          OpEventGetEventFreezeFrameDataEx_GetEventFreezeFrameDataEx_EvtInfo_SPI_E_LOOPBACK_SELFTEST_FAILURE: RteEventRef=OpEventGetEventFreezeFrameDataEx_GetEventFreezeFrameDataEx_EvtInfo_SPI_E_LOOPBACK_SELFTEST_FAILURE
          OpEventGetEventFreezeFrameDataEx_GetEventFreezeFrameDataEx_EvtInfo_SPI_E_REG_WRITE_VERIFY: RteEventRef=OpEventGetEventFreezeFrameDataEx_GetEventFreezeFrameDataEx_EvtInfo_SPI_E_REG_WRITE_VERIFY
          OpEventGetEventFreezeFrameDataEx_GetEventFreezeFrameDataEx_EvtInfo_WDGM_E_IMPROPER_CALLER: RteEventRef=OpEventGetEventFreezeFrameDataEx_GetEventFreezeFrameDataEx_EvtInfo_WDGM_E_IMPROPER_CALLER
          OpEventGetEventFreezeFrameDataEx_GetEventFreezeFrameDataEx_EvtInfo_WDGM_E_MONITORING: RteEventRef=OpEventGetEventFreezeFrameDataEx_GetEventFreezeFrameDataEx_EvtInfo_WDGM_E_MONITORING
          OpEventGetEventFreezeFrameDataEx_GetEventFreezeFrameDataEx_EvtInfo_WDGM_E_SET_MODE: RteEventRef=OpEventGetEventFreezeFrameDataEx_GetEventFreezeFrameDataEx_EvtInfo_WDGM_E_SET_MODE
          OpEventGetEventFreezeFrameDataEx_GetEventFreezeFrameDataEx_EvtInfo_WDG_E_DISABLE_REJECTED: RteEventRef=OpEventGetEventFreezeFrameDataEx_GetEventFreezeFrameDataEx_EvtInfo_WDG_E_DISABLE_REJECTED
          OpEventGetEventFreezeFrameDataEx_GetEventFreezeFrameDataEx_EvtInfo_WDG_E_INT_INCONSISTENT: RteEventRef=OpEventGetEventFreezeFrameDataEx_GetEventFreezeFrameDataEx_EvtInfo_WDG_E_INT_INCONSISTENT
          OpEventGetEventFreezeFrameDataEx_GetEventFreezeFrameDataEx_EvtInfo_WDG_E_MODE_FAILED: RteEventRef=OpEventGetEventFreezeFrameDataEx_GetEventFreezeFrameDataEx_EvtInfo_WDG_E_MODE_FAILED
          OpEventGetEventFreezeFrameDataEx_GetEventFreezeFrameDataEx_EvtInfo_WDG_E_REG_WRITE_VERIFY: RteEventRef=OpEventGetEventFreezeFrameDataEx_GetEventFreezeFrameDataEx_EvtInfo_WDG_E_REG_WRITE_VERIFY
          OpEventGetEventFreezeFrameDataEx_GetEventFreezeFrameDataEx_EvtInfo_PORT_E_WRITE_TIMEOUT_FAILURE: RteEventRef=OpEventGetEventFreezeFrameDataEx_GetEventFreezeFrameDataEx_EvtInfo_PORT_E_WRITE_TIMEOUT_FAILURE
          OpEventGetEventFreezeFrameDataEx_GetEventFreezeFrameDataEx_EvtInfo_PORT_E_REG_WRITE_VERIFY: RteEventRef=OpEventGetEventFreezeFrameDataEx_GetEventFreezeFrameDataEx_EvtInfo_PORT_E_REG_WRITE_VERIFY
          OpEventGetEventFreezeFrameDataEx_GetEventFreezeFrameDataEx_EvtInfo_CodingEventNotCoded: RteEventRef=OpEventGetEventFreezeFrameDataEx_GetEventFreezeFrameDataEx_EvtInfo_CodingEventNotCoded
          OpEventGetEventFreezeFrameDataEx_GetEventFreezeFrameDataEx_Event_CodingEventNotCoded: RteEventRef=OpEventGetEventFreezeFrameDataEx_GetEventFreezeFrameDataEx_Event_CodingEventNotCoded
          OpEventGetEventFreezeFrameDataEx_GetEventFreezeFrameDataEx_EvtInfo_CodingEventUnqualifiedData: RteEventRef=OpEventGetEventFreezeFrameDataEx_GetEventFreezeFrameDataEx_EvtInfo_CodingEventUnqualifiedData
          OpEventGetEventFreezeFrameDataEx_GetEventFreezeFrameDataEx_Event_CodingEventUnqualifiedData: RteEventRef=OpEventGetEventFreezeFrameDataEx_GetEventFreezeFrameDataEx_Event_CodingEventUnqualifiedData
          OpEventGetEventFreezeFrameDataEx_GetEventFreezeFrameDataEx_EvtInfo_CodingEventWrongVehicle: RteEventRef=OpEventGetEventFreezeFrameDataEx_GetEventFreezeFrameDataEx_EvtInfo_CodingEventWrongVehicle
          OpEventGetEventFreezeFrameDataEx_GetEventFreezeFrameDataEx_Event_CodingEventWrongVehicle: RteEventRef=OpEventGetEventFreezeFrameDataEx_GetEventFreezeFrameDataEx_Event_CodingEventWrongVehicle
          OpEventGetEventFreezeFrameDataEx_GetEventFreezeFrameDataEx_EvtInfo_DmTestAppl: RteEventRef=OpEventGetEventFreezeFrameDataEx_GetEventFreezeFrameDataEx_EvtInfo_DmTestAppl
          OpEventGetEventFreezeFrameDataEx_GetEventFreezeFrameDataEx_Event_DmTestAppl: RteEventRef=OpEventGetEventFreezeFrameDataEx_GetEventFreezeFrameDataEx_Event_DmTestAppl
          OpEventGetEventFreezeFrameDataEx_GetEventFreezeFrameDataEx_EvtInfo_DmTestCom: RteEventRef=OpEventGetEventFreezeFrameDataEx_GetEventFreezeFrameDataEx_EvtInfo_DmTestCom
          OpEventGetEventFreezeFrameDataEx_GetEventFreezeFrameDataEx_Event_DmTestCom: RteEventRef=OpEventGetEventFreezeFrameDataEx_GetEventFreezeFrameDataEx_Event_DmTestCom
          OpEventGetEventFreezeFrameDataEx_GetEventFreezeFrameDataEx_EvtInfo_FrsmEClusterSyncLoss: RteEventRef=OpEventGetEventFreezeFrameDataEx_GetEventFreezeFrameDataEx_EvtInfo_FrsmEClusterSyncLoss
          OpEventGetEventFreezeFrameDataEx_GetEventFreezeFrameDataEx_Event_FrsmEClusterSyncLoss: RteEventRef=OpEventGetEventFreezeFrameDataEx_GetEventFreezeFrameDataEx_Event_FrsmEClusterSyncLoss
          OpEventGetEventFreezeFrameDataEx_GetEventFreezeFrameDataEx_EvtInfo_FrtrcvEFrBuserrorTrcv0: RteEventRef=OpEventGetEventFreezeFrameDataEx_GetEventFreezeFrameDataEx_EvtInfo_FrtrcvEFrBuserrorTrcv0
          OpEventGetEventFreezeFrameDataEx_GetEventFreezeFrameDataEx_Event_FrtrcvEFrBuserrorTrcv0: RteEventRef=OpEventGetEventFreezeFrameDataEx_GetEventFreezeFrameDataEx_Event_FrtrcvEFrBuserrorTrcv0
          OpEventGetEventFreezeFrameDataEx_GetEventFreezeFrameDataEx_EvtInfo_GlobalOvervoltageExt: RteEventRef=OpEventGetEventFreezeFrameDataEx_GetEventFreezeFrameDataEx_EvtInfo_GlobalOvervoltageExt
          OpEventGetEventFreezeFrameDataEx_GetEventFreezeFrameDataEx_Event_GlobalOvervoltageExt: RteEventRef=OpEventGetEventFreezeFrameDataEx_GetEventFreezeFrameDataEx_Event_GlobalOvervoltageExt
          OpEventGetEventFreezeFrameDataEx_GetEventFreezeFrameDataEx_EvtInfo_GlobalOvervoltageInt: RteEventRef=OpEventGetEventFreezeFrameDataEx_GetEventFreezeFrameDataEx_EvtInfo_GlobalOvervoltageInt
          OpEventGetEventFreezeFrameDataEx_GetEventFreezeFrameDataEx_Event_GlobalOvervoltageInt: RteEventRef=OpEventGetEventFreezeFrameDataEx_GetEventFreezeFrameDataEx_Event_GlobalOvervoltageInt
          OpEventGetEventFreezeFrameDataEx_GetEventFreezeFrameDataEx_EvtInfo_GlobalUndervoltageExt: RteEventRef=OpEventGetEventFreezeFrameDataEx_GetEventFreezeFrameDataEx_EvtInfo_GlobalUndervoltageExt
          OpEventGetEventFreezeFrameDataEx_GetEventFreezeFrameDataEx_Event_GlobalUndervoltageExt: RteEventRef=OpEventGetEventFreezeFrameDataEx_GetEventFreezeFrameDataEx_Event_GlobalUndervoltageExt
          OpEventGetEventFreezeFrameDataEx_GetEventFreezeFrameDataEx_EvtInfo_GlobalUndervoltageInt: RteEventRef=OpEventGetEventFreezeFrameDataEx_GetEventFreezeFrameDataEx_EvtInfo_GlobalUndervoltageInt
          OpEventGetEventFreezeFrameDataEx_GetEventFreezeFrameDataEx_Event_GlobalUndervoltageInt: RteEventRef=OpEventGetEventFreezeFrameDataEx_GetEventFreezeFrameDataEx_Event_GlobalUndervoltageInt
          OpEventGetEventFreezeFrameDataEx_GetEventFreezeFrameDataEx_EvtInfo_LocalOvervoltage: RteEventRef=OpEventGetEventFreezeFrameDataEx_GetEventFreezeFrameDataEx_EvtInfo_LocalOvervoltage
          OpEventGetEventFreezeFrameDataEx_GetEventFreezeFrameDataEx_Event_LocalOvervoltage: RteEventRef=OpEventGetEventFreezeFrameDataEx_GetEventFreezeFrameDataEx_Event_LocalOvervoltage
          OpEventGetEventFreezeFrameDataEx_GetEventFreezeFrameDataEx_EvtInfo_LocalUndervoltage: RteEventRef=OpEventGetEventFreezeFrameDataEx_GetEventFreezeFrameDataEx_EvtInfo_LocalUndervoltage
          OpEventGetEventFreezeFrameDataEx_GetEventFreezeFrameDataEx_Event_LocalUndervoltage: RteEventRef=OpEventGetEventFreezeFrameDataEx_GetEventFreezeFrameDataEx_Event_LocalUndervoltage
          OpEventGetEventFreezeFrameDataEx_GetEventFreezeFrameDataEx_EvtInfo_VsmEventOpmode: RteEventRef=OpEventGetEventFreezeFrameDataEx_GetEventFreezeFrameDataEx_EvtInfo_VsmEventOpmode
          OpEventGetEventFreezeFrameDataEx_GetEventFreezeFrameDataEx_Event_VsmEventOpmode: RteEventRef=OpEventGetEventFreezeFrameDataEx_GetEventFreezeFrameDataEx_Event_VsmEventOpmode
          OpEventGetEventFreezeFrameDataEx_GetEventFreezeFrameDataEx_GeneralEventInfo: RteEventRef=OpEventGetEventFreezeFrameDataEx_GetEventFreezeFrameDataEx_GeneralEventInfo
          OpEventGetEventExtendedDataRecordEx_GetEventExtendedDataRecordEx_EvtInfo_MCU_E_CLM_SELFDIAG_FAILURE: RteEventRef=OpEventGetEventExtendedDataRecordEx_GetEventExtendedDataRecordEx_EvtInfo_MCU_E_CLM_SELFDIAG_FAILURE
          OpEventGetEventExtendedDataRecordEx_GetEventExtendedDataRecordEx_EvtInfo_MCU_E_CLOCK_FAILURE: RteEventRef=OpEventGetEventExtendedDataRecordEx_GetEventExtendedDataRecordEx_EvtInfo_MCU_E_CLOCK_FAILURE
          OpEventGetEventExtendedDataRecordEx_GetEventExtendedDataRecordEx_EvtInfo_MCU_E_CVM_SELFDIAG_FAILURE: RteEventRef=OpEventGetEventExtendedDataRecordEx_GetEventExtendedDataRecordEx_EvtInfo_MCU_E_CVM_SELFDIAG_FAILURE
          OpEventGetEventExtendedDataRecordEx_GetEventExtendedDataRecordEx_EvtInfo_MCU_E_ECM_SELFDIAG_FAILURE: RteEventRef=OpEventGetEventExtendedDataRecordEx_GetEventExtendedDataRecordEx_EvtInfo_MCU_E_ECM_SELFDIAG_FAILURE
          OpEventGetEventExtendedDataRecordEx_GetEventExtendedDataRecordEx_EvtInfo_MCU_E_LOCKSTEP_SELFDIAG_FAILURE: RteEventRef=OpEventGetEventExtendedDataRecordEx_GetEventExtendedDataRecordEx_EvtInfo_MCU_E_LOCKSTEP_SELFDIAG_FAILURE
          OpEventGetEventExtendedDataRecordEx_GetEventExtendedDataRecordEx_EvtInfo_MCU_E_WRITE_TIMEOUT_FAILURE: RteEventRef=OpEventGetEventExtendedDataRecordEx_GetEventExtendedDataRecordEx_EvtInfo_MCU_E_WRITE_TIMEOUT_FAILURE
          OpEventGetEventExtendedDataRecordEx_GetEventExtendedDataRecordEx_EvtInfo_MCU_E_REG_WRITE_VERIFY: RteEventRef=OpEventGetEventExtendedDataRecordEx_GetEventExtendedDataRecordEx_EvtInfo_MCU_E_REG_WRITE_VERIFY
          OpEventGetEventExtendedDataRecordEx_GetEventExtendedDataRecordEx_EvtInfo_MCU_E_INT_INCONSISTENT: RteEventRef=OpEventGetEventExtendedDataRecordEx_GetEventExtendedDataRecordEx_EvtInfo_MCU_E_INT_INCONSISTENT
          OpEventGetEventExtendedDataRecordEx_GetEventExtendedDataRecordEx_EvtInfo_MCU_E_RESETCONTROLLER_STARTUP_FAILURE: RteEventRef=OpEventGetEventExtendedDataRecordEx_GetEventExtendedDataRecordEx_EvtInfo_MCU_E_RESETCONTROLLER_STARTUP_FAILURE
          OpEventGetEventExtendedDataRecordEx_GetEventExtendedDataRecordEx_EvtInfo_DIO_E_REG_WRITE_VERIFY: RteEventRef=OpEventGetEventExtendedDataRecordEx_GetEventExtendedDataRecordEx_EvtInfo_DIO_E_REG_WRITE_VERIFY
          OpEventGetEventExtendedDataRecordEx_GetEventExtendedDataRecordEx_EvtInfo_FLS_E_COMPARE_FAILED: RteEventRef=OpEventGetEventExtendedDataRecordEx_GetEventExtendedDataRecordEx_EvtInfo_FLS_E_COMPARE_FAILED
          OpEventGetEventExtendedDataRecordEx_GetEventExtendedDataRecordEx_EvtInfo_FLS_E_ERASE_FAILED: RteEventRef=OpEventGetEventExtendedDataRecordEx_GetEventExtendedDataRecordEx_EvtInfo_FLS_E_ERASE_FAILED
          OpEventGetEventExtendedDataRecordEx_GetEventExtendedDataRecordEx_EvtInfo_FLS_E_READ_FAILED: RteEventRef=OpEventGetEventExtendedDataRecordEx_GetEventExtendedDataRecordEx_EvtInfo_FLS_E_READ_FAILED
          OpEventGetEventExtendedDataRecordEx_GetEventExtendedDataRecordEx_EvtInfo_FLS_E_INT_INCONSISTENT: RteEventRef=OpEventGetEventExtendedDataRecordEx_GetEventExtendedDataRecordEx_EvtInfo_FLS_E_INT_INCONSISTENT
          OpEventGetEventExtendedDataRecordEx_GetEventExtendedDataRecordEx_EvtInfo_FLS_E_REG_WRITE_VERIFY: RteEventRef=OpEventGetEventExtendedDataRecordEx_GetEventExtendedDataRecordEx_EvtInfo_FLS_E_REG_WRITE_VERIFY
          OpEventGetEventExtendedDataRecordEx_GetEventExtendedDataRecordEx_EvtInfo_FLS_E_READ_FAILED_DED: RteEventRef=OpEventGetEventExtendedDataRecordEx_GetEventExtendedDataRecordEx_EvtInfo_FLS_E_READ_FAILED_DED
          OpEventGetEventExtendedDataRecordEx_GetEventExtendedDataRecordEx_EvtInfo_FLS_E_HW_FAILURE: RteEventRef=OpEventGetEventExtendedDataRecordEx_GetEventExtendedDataRecordEx_EvtInfo_FLS_E_HW_FAILURE
          OpEventGetEventExtendedDataRecordEx_GetEventExtendedDataRecordEx_EvtInfo_FLS_E_ECC_FAILED: RteEventRef=OpEventGetEventExtendedDataRecordEx_GetEventExtendedDataRecordEx_EvtInfo_FLS_E_ECC_FAILED
          OpEventGetEventExtendedDataRecordEx_GetEventExtendedDataRecordEx_EvtInfo_FLS_E_UNEXPECTED_FLASH_ID: RteEventRef=OpEventGetEventExtendedDataRecordEx_GetEventExtendedDataRecordEx_EvtInfo_FLS_E_UNEXPECTED_FLASH_ID
          OpEventGetEventExtendedDataRecordEx_GetEventExtendedDataRecordEx_EvtInfo_FLS_E_WRITE_FAILED: RteEventRef=OpEventGetEventExtendedDataRecordEx_GetEventExtendedDataRecordEx_EvtInfo_FLS_E_WRITE_FAILED
          OpEventGetEventExtendedDataRecordEx_GetEventExtendedDataRecordEx_EvtInfo_SPI_E_DATA_TX_TIMEOUT_FAILURE: RteEventRef=OpEventGetEventExtendedDataRecordEx_GetEventExtendedDataRecordEx_EvtInfo_SPI_E_DATA_TX_TIMEOUT_FAILURE
          OpEventGetEventExtendedDataRecordEx_GetEventExtendedDataRecordEx_EvtInfo_SPI_E_ECC_SELFTEST_FAILURE: RteEventRef=OpEventGetEventExtendedDataRecordEx_GetEventExtendedDataRecordEx_EvtInfo_SPI_E_ECC_SELFTEST_FAILURE
          OpEventGetEventExtendedDataRecordEx_GetEventExtendedDataRecordEx_EvtInfo_SPI_E_HARDWARE_ERROR: RteEventRef=OpEventGetEventExtendedDataRecordEx_GetEventExtendedDataRecordEx_EvtInfo_SPI_E_HARDWARE_ERROR
          OpEventGetEventExtendedDataRecordEx_GetEventExtendedDataRecordEx_EvtInfo_SPI_E_INT_INCONSISTENT: RteEventRef=OpEventGetEventExtendedDataRecordEx_GetEventExtendedDataRecordEx_EvtInfo_SPI_E_INT_INCONSISTENT
          OpEventGetEventExtendedDataRecordEx_GetEventExtendedDataRecordEx_EvtInfo_SPI_E_LOOPBACK_SELFTEST_FAILURE: RteEventRef=OpEventGetEventExtendedDataRecordEx_GetEventExtendedDataRecordEx_EvtInfo_SPI_E_LOOPBACK_SELFTEST_FAILURE
          OpEventGetEventExtendedDataRecordEx_GetEventExtendedDataRecordEx_EvtInfo_SPI_E_REG_WRITE_VERIFY: RteEventRef=OpEventGetEventExtendedDataRecordEx_GetEventExtendedDataRecordEx_EvtInfo_SPI_E_REG_WRITE_VERIFY
          OpEventGetEventExtendedDataRecordEx_GetEventExtendedDataRecordEx_EvtInfo_WDGM_E_IMPROPER_CALLER: RteEventRef=OpEventGetEventExtendedDataRecordEx_GetEventExtendedDataRecordEx_EvtInfo_WDGM_E_IMPROPER_CALLER
          OpEventGetEventExtendedDataRecordEx_GetEventExtendedDataRecordEx_EvtInfo_WDGM_E_MONITORING: RteEventRef=OpEventGetEventExtendedDataRecordEx_GetEventExtendedDataRecordEx_EvtInfo_WDGM_E_MONITORING
          OpEventGetEventExtendedDataRecordEx_GetEventExtendedDataRecordEx_EvtInfo_WDGM_E_SET_MODE: RteEventRef=OpEventGetEventExtendedDataRecordEx_GetEventExtendedDataRecordEx_EvtInfo_WDGM_E_SET_MODE
          OpEventGetEventExtendedDataRecordEx_GetEventExtendedDataRecordEx_EvtInfo_WDG_E_DISABLE_REJECTED: RteEventRef=OpEventGetEventExtendedDataRecordEx_GetEventExtendedDataRecordEx_EvtInfo_WDG_E_DISABLE_REJECTED
          OpEventGetEventExtendedDataRecordEx_GetEventExtendedDataRecordEx_EvtInfo_WDG_E_INT_INCONSISTENT: RteEventRef=OpEventGetEventExtendedDataRecordEx_GetEventExtendedDataRecordEx_EvtInfo_WDG_E_INT_INCONSISTENT
          OpEventGetEventExtendedDataRecordEx_GetEventExtendedDataRecordEx_EvtInfo_WDG_E_MODE_FAILED: RteEventRef=OpEventGetEventExtendedDataRecordEx_GetEventExtendedDataRecordEx_EvtInfo_WDG_E_MODE_FAILED
          OpEventGetEventExtendedDataRecordEx_GetEventExtendedDataRecordEx_EvtInfo_WDG_E_REG_WRITE_VERIFY: RteEventRef=OpEventGetEventExtendedDataRecordEx_GetEventExtendedDataRecordEx_EvtInfo_WDG_E_REG_WRITE_VERIFY
          OpEventGetEventExtendedDataRecordEx_GetEventExtendedDataRecordEx_EvtInfo_PORT_E_WRITE_TIMEOUT_FAILURE: RteEventRef=OpEventGetEventExtendedDataRecordEx_GetEventExtendedDataRecordEx_EvtInfo_PORT_E_WRITE_TIMEOUT_FAILURE
          OpEventGetEventExtendedDataRecordEx_GetEventExtendedDataRecordEx_EvtInfo_PORT_E_REG_WRITE_VERIFY: RteEventRef=OpEventGetEventExtendedDataRecordEx_GetEventExtendedDataRecordEx_EvtInfo_PORT_E_REG_WRITE_VERIFY
          OpEventGetEventExtendedDataRecordEx_GetEventExtendedDataRecordEx_EvtInfo_CodingEventNotCoded: RteEventRef=OpEventGetEventExtendedDataRecordEx_GetEventExtendedDataRecordEx_EvtInfo_CodingEventNotCoded
          OpEventGetEventExtendedDataRecordEx_GetEventExtendedDataRecordEx_Event_CodingEventNotCoded: RteEventRef=OpEventGetEventExtendedDataRecordEx_GetEventExtendedDataRecordEx_Event_CodingEventNotCoded
          OpEventGetEventExtendedDataRecordEx_GetEventExtendedDataRecordEx_EvtInfo_CodingEventUnqualifiedData: RteEventRef=OpEventGetEventExtendedDataRecordEx_GetEventExtendedDataRecordEx_EvtInfo_CodingEventUnqualifiedData
          OpEventGetEventExtendedDataRecordEx_GetEventExtendedDataRecordEx_Event_CodingEventUnqualifiedData: RteEventRef=OpEventGetEventExtendedDataRecordEx_GetEventExtendedDataRecordEx_Event_CodingEventUnqualifiedData
          OpEventGetEventExtendedDataRecordEx_GetEventExtendedDataRecordEx_EvtInfo_CodingEventWrongVehicle: RteEventRef=OpEventGetEventExtendedDataRecordEx_GetEventExtendedDataRecordEx_EvtInfo_CodingEventWrongVehicle
          OpEventGetEventExtendedDataRecordEx_GetEventExtendedDataRecordEx_Event_CodingEventWrongVehicle: RteEventRef=OpEventGetEventExtendedDataRecordEx_GetEventExtendedDataRecordEx_Event_CodingEventWrongVehicle
          OpEventGetEventExtendedDataRecordEx_GetEventExtendedDataRecordEx_EvtInfo_DmTestAppl: RteEventRef=OpEventGetEventExtendedDataRecordEx_GetEventExtendedDataRecordEx_EvtInfo_DmTestAppl
          OpEventGetEventExtendedDataRecordEx_GetEventExtendedDataRecordEx_Event_DmTestAppl: RteEventRef=OpEventGetEventExtendedDataRecordEx_GetEventExtendedDataRecordEx_Event_DmTestAppl
          OpEventGetEventExtendedDataRecordEx_GetEventExtendedDataRecordEx_EvtInfo_DmTestCom: RteEventRef=OpEventGetEventExtendedDataRecordEx_GetEventExtendedDataRecordEx_EvtInfo_DmTestCom
          OpEventGetEventExtendedDataRecordEx_GetEventExtendedDataRecordEx_Event_DmTestCom: RteEventRef=OpEventGetEventExtendedDataRecordEx_GetEventExtendedDataRecordEx_Event_DmTestCom
          OpEventGetEventExtendedDataRecordEx_GetEventExtendedDataRecordEx_EvtInfo_FrsmEClusterSyncLoss: RteEventRef=OpEventGetEventExtendedDataRecordEx_GetEventExtendedDataRecordEx_EvtInfo_FrsmEClusterSyncLoss
          OpEventGetEventExtendedDataRecordEx_GetEventExtendedDataRecordEx_Event_FrsmEClusterSyncLoss: RteEventRef=OpEventGetEventExtendedDataRecordEx_GetEventExtendedDataRecordEx_Event_FrsmEClusterSyncLoss
          OpEventGetEventExtendedDataRecordEx_GetEventExtendedDataRecordEx_EvtInfo_FrtrcvEFrBuserrorTrcv0: RteEventRef=OpEventGetEventExtendedDataRecordEx_GetEventExtendedDataRecordEx_EvtInfo_FrtrcvEFrBuserrorTrcv0
          OpEventGetEventExtendedDataRecordEx_GetEventExtendedDataRecordEx_Event_FrtrcvEFrBuserrorTrcv0: RteEventRef=OpEventGetEventExtendedDataRecordEx_GetEventExtendedDataRecordEx_Event_FrtrcvEFrBuserrorTrcv0
          OpEventGetEventExtendedDataRecordEx_GetEventExtendedDataRecordEx_EvtInfo_GlobalOvervoltageExt: RteEventRef=OpEventGetEventExtendedDataRecordEx_GetEventExtendedDataRecordEx_EvtInfo_GlobalOvervoltageExt
          OpEventGetEventExtendedDataRecordEx_GetEventExtendedDataRecordEx_Event_GlobalOvervoltageExt: RteEventRef=OpEventGetEventExtendedDataRecordEx_GetEventExtendedDataRecordEx_Event_GlobalOvervoltageExt
          OpEventGetEventExtendedDataRecordEx_GetEventExtendedDataRecordEx_EvtInfo_GlobalOvervoltageInt: RteEventRef=OpEventGetEventExtendedDataRecordEx_GetEventExtendedDataRecordEx_EvtInfo_GlobalOvervoltageInt
          OpEventGetEventExtendedDataRecordEx_GetEventExtendedDataRecordEx_Event_GlobalOvervoltageInt: RteEventRef=OpEventGetEventExtendedDataRecordEx_GetEventExtendedDataRecordEx_Event_GlobalOvervoltageInt
          OpEventGetEventExtendedDataRecordEx_GetEventExtendedDataRecordEx_EvtInfo_GlobalUndervoltageExt: RteEventRef=OpEventGetEventExtendedDataRecordEx_GetEventExtendedDataRecordEx_EvtInfo_GlobalUndervoltageExt
          OpEventGetEventExtendedDataRecordEx_GetEventExtendedDataRecordEx_Event_GlobalUndervoltageExt: RteEventRef=OpEventGetEventExtendedDataRecordEx_GetEventExtendedDataRecordEx_Event_GlobalUndervoltageExt
          OpEventGetEventExtendedDataRecordEx_GetEventExtendedDataRecordEx_EvtInfo_GlobalUndervoltageInt: RteEventRef=OpEventGetEventExtendedDataRecordEx_GetEventExtendedDataRecordEx_EvtInfo_GlobalUndervoltageInt
          OpEventGetEventExtendedDataRecordEx_GetEventExtendedDataRecordEx_Event_GlobalUndervoltageInt: RteEventRef=OpEventGetEventExtendedDataRecordEx_GetEventExtendedDataRecordEx_Event_GlobalUndervoltageInt
          OpEventGetEventExtendedDataRecordEx_GetEventExtendedDataRecordEx_EvtInfo_LocalOvervoltage: RteEventRef=OpEventGetEventExtendedDataRecordEx_GetEventExtendedDataRecordEx_EvtInfo_LocalOvervoltage
          OpEventGetEventExtendedDataRecordEx_GetEventExtendedDataRecordEx_Event_LocalOvervoltage: RteEventRef=OpEventGetEventExtendedDataRecordEx_GetEventExtendedDataRecordEx_Event_LocalOvervoltage
          OpEventGetEventExtendedDataRecordEx_GetEventExtendedDataRecordEx_EvtInfo_LocalUndervoltage: RteEventRef=OpEventGetEventExtendedDataRecordEx_GetEventExtendedDataRecordEx_EvtInfo_LocalUndervoltage
          OpEventGetEventExtendedDataRecordEx_GetEventExtendedDataRecordEx_Event_LocalUndervoltage: RteEventRef=OpEventGetEventExtendedDataRecordEx_GetEventExtendedDataRecordEx_Event_LocalUndervoltage
          OpEventGetEventExtendedDataRecordEx_GetEventExtendedDataRecordEx_EvtInfo_VsmEventOpmode: RteEventRef=OpEventGetEventExtendedDataRecordEx_GetEventExtendedDataRecordEx_EvtInfo_VsmEventOpmode
          OpEventGetEventExtendedDataRecordEx_GetEventExtendedDataRecordEx_Event_VsmEventOpmode: RteEventRef=OpEventGetEventExtendedDataRecordEx_GetEventExtendedDataRecordEx_Event_VsmEventOpmode
          OpEventGetEventExtendedDataRecordEx_GetEventExtendedDataRecordEx_GeneralEventInfo: RteEventRef=OpEventGetEventExtendedDataRecordEx_GetEventExtendedDataRecordEx_GeneralEventInfo
          OpEventGetEventEnableCondition_GetEventEnableCondition_EvtInfo_MCU_E_CLM_SELFDIAG_FAILURE: RteEventRef=OpEventGetEventEnableCondition_GetEventEnableCondition_EvtInfo_MCU_E_CLM_SELFDIAG_FAILURE
          OpEventGetEventEnableCondition_GetEventEnableCondition_EvtInfo_MCU_E_CLOCK_FAILURE: RteEventRef=OpEventGetEventEnableCondition_GetEventEnableCondition_EvtInfo_MCU_E_CLOCK_FAILURE
          OpEventGetEventEnableCondition_GetEventEnableCondition_EvtInfo_MCU_E_CVM_SELFDIAG_FAILURE: RteEventRef=OpEventGetEventEnableCondition_GetEventEnableCondition_EvtInfo_MCU_E_CVM_SELFDIAG_FAILURE
          OpEventGetEventEnableCondition_GetEventEnableCondition_EvtInfo_MCU_E_ECM_SELFDIAG_FAILURE: RteEventRef=OpEventGetEventEnableCondition_GetEventEnableCondition_EvtInfo_MCU_E_ECM_SELFDIAG_FAILURE
          OpEventGetEventEnableCondition_GetEventEnableCondition_EvtInfo_MCU_E_LOCKSTEP_SELFDIAG_FAILURE: RteEventRef=OpEventGetEventEnableCondition_GetEventEnableCondition_EvtInfo_MCU_E_LOCKSTEP_SELFDIAG_FAILURE
          OpEventGetEventEnableCondition_GetEventEnableCondition_EvtInfo_MCU_E_WRITE_TIMEOUT_FAILURE: RteEventRef=OpEventGetEventEnableCondition_GetEventEnableCondition_EvtInfo_MCU_E_WRITE_TIMEOUT_FAILURE
          OpEventGetEventEnableCondition_GetEventEnableCondition_EvtInfo_MCU_E_REG_WRITE_VERIFY: RteEventRef=OpEventGetEventEnableCondition_GetEventEnableCondition_EvtInfo_MCU_E_REG_WRITE_VERIFY
          OpEventGetEventEnableCondition_GetEventEnableCondition_EvtInfo_MCU_E_INT_INCONSISTENT: RteEventRef=OpEventGetEventEnableCondition_GetEventEnableCondition_EvtInfo_MCU_E_INT_INCONSISTENT
          OpEventGetEventEnableCondition_GetEventEnableCondition_EvtInfo_MCU_E_RESETCONTROLLER_STARTUP_FAILURE: RteEventRef=OpEventGetEventEnableCondition_GetEventEnableCondition_EvtInfo_MCU_E_RESETCONTROLLER_STARTUP_FAILURE
          OpEventGetEventEnableCondition_GetEventEnableCondition_EvtInfo_DIO_E_REG_WRITE_VERIFY: RteEventRef=OpEventGetEventEnableCondition_GetEventEnableCondition_EvtInfo_DIO_E_REG_WRITE_VERIFY
          OpEventGetEventEnableCondition_GetEventEnableCondition_EvtInfo_FLS_E_COMPARE_FAILED: RteEventRef=OpEventGetEventEnableCondition_GetEventEnableCondition_EvtInfo_FLS_E_COMPARE_FAILED
          OpEventGetEventEnableCondition_GetEventEnableCondition_EvtInfo_FLS_E_ERASE_FAILED: RteEventRef=OpEventGetEventEnableCondition_GetEventEnableCondition_EvtInfo_FLS_E_ERASE_FAILED
          OpEventGetEventEnableCondition_GetEventEnableCondition_EvtInfo_FLS_E_READ_FAILED: RteEventRef=OpEventGetEventEnableCondition_GetEventEnableCondition_EvtInfo_FLS_E_READ_FAILED
          OpEventGetEventEnableCondition_GetEventEnableCondition_EvtInfo_FLS_E_INT_INCONSISTENT: RteEventRef=OpEventGetEventEnableCondition_GetEventEnableCondition_EvtInfo_FLS_E_INT_INCONSISTENT
          OpEventGetEventEnableCondition_GetEventEnableCondition_EvtInfo_FLS_E_REG_WRITE_VERIFY: RteEventRef=OpEventGetEventEnableCondition_GetEventEnableCondition_EvtInfo_FLS_E_REG_WRITE_VERIFY
          OpEventGetEventEnableCondition_GetEventEnableCondition_EvtInfo_FLS_E_READ_FAILED_DED: RteEventRef=OpEventGetEventEnableCondition_GetEventEnableCondition_EvtInfo_FLS_E_READ_FAILED_DED
          OpEventGetEventEnableCondition_GetEventEnableCondition_EvtInfo_FLS_E_HW_FAILURE: RteEventRef=OpEventGetEventEnableCondition_GetEventEnableCondition_EvtInfo_FLS_E_HW_FAILURE
          OpEventGetEventEnableCondition_GetEventEnableCondition_EvtInfo_FLS_E_ECC_FAILED: RteEventRef=OpEventGetEventEnableCondition_GetEventEnableCondition_EvtInfo_FLS_E_ECC_FAILED
          OpEventGetEventEnableCondition_GetEventEnableCondition_EvtInfo_FLS_E_UNEXPECTED_FLASH_ID: RteEventRef=OpEventGetEventEnableCondition_GetEventEnableCondition_EvtInfo_FLS_E_UNEXPECTED_FLASH_ID
          OpEventGetEventEnableCondition_GetEventEnableCondition_EvtInfo_FLS_E_WRITE_FAILED: RteEventRef=OpEventGetEventEnableCondition_GetEventEnableCondition_EvtInfo_FLS_E_WRITE_FAILED
          OpEventGetEventEnableCondition_GetEventEnableCondition_EvtInfo_SPI_E_DATA_TX_TIMEOUT_FAILURE: RteEventRef=OpEventGetEventEnableCondition_GetEventEnableCondition_EvtInfo_SPI_E_DATA_TX_TIMEOUT_FAILURE
          OpEventGetEventEnableCondition_GetEventEnableCondition_EvtInfo_SPI_E_ECC_SELFTEST_FAILURE: RteEventRef=OpEventGetEventEnableCondition_GetEventEnableCondition_EvtInfo_SPI_E_ECC_SELFTEST_FAILURE
          OpEventGetEventEnableCondition_GetEventEnableCondition_EvtInfo_SPI_E_HARDWARE_ERROR: RteEventRef=OpEventGetEventEnableCondition_GetEventEnableCondition_EvtInfo_SPI_E_HARDWARE_ERROR
          OpEventGetEventEnableCondition_GetEventEnableCondition_EvtInfo_SPI_E_INT_INCONSISTENT: RteEventRef=OpEventGetEventEnableCondition_GetEventEnableCondition_EvtInfo_SPI_E_INT_INCONSISTENT
          OpEventGetEventEnableCondition_GetEventEnableCondition_EvtInfo_SPI_E_LOOPBACK_SELFTEST_FAILURE: RteEventRef=OpEventGetEventEnableCondition_GetEventEnableCondition_EvtInfo_SPI_E_LOOPBACK_SELFTEST_FAILURE
          OpEventGetEventEnableCondition_GetEventEnableCondition_EvtInfo_SPI_E_REG_WRITE_VERIFY: RteEventRef=OpEventGetEventEnableCondition_GetEventEnableCondition_EvtInfo_SPI_E_REG_WRITE_VERIFY
          OpEventGetEventEnableCondition_GetEventEnableCondition_EvtInfo_WDGM_E_IMPROPER_CALLER: RteEventRef=OpEventGetEventEnableCondition_GetEventEnableCondition_EvtInfo_WDGM_E_IMPROPER_CALLER
          OpEventGetEventEnableCondition_GetEventEnableCondition_EvtInfo_WDGM_E_MONITORING: RteEventRef=OpEventGetEventEnableCondition_GetEventEnableCondition_EvtInfo_WDGM_E_MONITORING
          OpEventGetEventEnableCondition_GetEventEnableCondition_EvtInfo_WDGM_E_SET_MODE: RteEventRef=OpEventGetEventEnableCondition_GetEventEnableCondition_EvtInfo_WDGM_E_SET_MODE
          OpEventGetEventEnableCondition_GetEventEnableCondition_EvtInfo_WDG_E_DISABLE_REJECTED: RteEventRef=OpEventGetEventEnableCondition_GetEventEnableCondition_EvtInfo_WDG_E_DISABLE_REJECTED
          OpEventGetEventEnableCondition_GetEventEnableCondition_EvtInfo_WDG_E_INT_INCONSISTENT: RteEventRef=OpEventGetEventEnableCondition_GetEventEnableCondition_EvtInfo_WDG_E_INT_INCONSISTENT
          OpEventGetEventEnableCondition_GetEventEnableCondition_EvtInfo_WDG_E_MODE_FAILED: RteEventRef=OpEventGetEventEnableCondition_GetEventEnableCondition_EvtInfo_WDG_E_MODE_FAILED
          OpEventGetEventEnableCondition_GetEventEnableCondition_EvtInfo_WDG_E_REG_WRITE_VERIFY: RteEventRef=OpEventGetEventEnableCondition_GetEventEnableCondition_EvtInfo_WDG_E_REG_WRITE_VERIFY
          OpEventGetEventEnableCondition_GetEventEnableCondition_EvtInfo_PORT_E_WRITE_TIMEOUT_FAILURE: RteEventRef=OpEventGetEventEnableCondition_GetEventEnableCondition_EvtInfo_PORT_E_WRITE_TIMEOUT_FAILURE
          OpEventGetEventEnableCondition_GetEventEnableCondition_EvtInfo_PORT_E_REG_WRITE_VERIFY: RteEventRef=OpEventGetEventEnableCondition_GetEventEnableCondition_EvtInfo_PORT_E_REG_WRITE_VERIFY
          OpEventGetEventEnableCondition_GetEventEnableCondition_EvtInfo_CodingEventNotCoded: RteEventRef=OpEventGetEventEnableCondition_GetEventEnableCondition_EvtInfo_CodingEventNotCoded
          OpEventGetEventEnableCondition_GetEventEnableCondition_EvtInfo_CodingEventUnqualifiedData: RteEventRef=OpEventGetEventEnableCondition_GetEventEnableCondition_EvtInfo_CodingEventUnqualifiedData
          OpEventGetEventEnableCondition_GetEventEnableCondition_EvtInfo_CodingEventWrongVehicle: RteEventRef=OpEventGetEventEnableCondition_GetEventEnableCondition_EvtInfo_CodingEventWrongVehicle
          OpEventGetEventEnableCondition_GetEventEnableCondition_EvtInfo_DmTestAppl: RteEventRef=OpEventGetEventEnableCondition_GetEventEnableCondition_EvtInfo_DmTestAppl
          OpEventGetEventEnableCondition_GetEventEnableCondition_EvtInfo_DmTestCom: RteEventRef=OpEventGetEventEnableCondition_GetEventEnableCondition_EvtInfo_DmTestCom
          OpEventGetEventEnableCondition_GetEventEnableCondition_EvtInfo_FrsmEClusterSyncLoss: RteEventRef=OpEventGetEventEnableCondition_GetEventEnableCondition_EvtInfo_FrsmEClusterSyncLoss
          OpEventGetEventEnableCondition_GetEventEnableCondition_EvtInfo_FrtrcvEFrBuserrorTrcv0: RteEventRef=OpEventGetEventEnableCondition_GetEventEnableCondition_EvtInfo_FrtrcvEFrBuserrorTrcv0
          OpEventGetEventEnableCondition_GetEventEnableCondition_EvtInfo_GlobalOvervoltageExt: RteEventRef=OpEventGetEventEnableCondition_GetEventEnableCondition_EvtInfo_GlobalOvervoltageExt
          OpEventGetEventEnableCondition_GetEventEnableCondition_EvtInfo_GlobalOvervoltageInt: RteEventRef=OpEventGetEventEnableCondition_GetEventEnableCondition_EvtInfo_GlobalOvervoltageInt
          OpEventGetEventEnableCondition_GetEventEnableCondition_EvtInfo_GlobalUndervoltageExt: RteEventRef=OpEventGetEventEnableCondition_GetEventEnableCondition_EvtInfo_GlobalUndervoltageExt
          OpEventGetEventEnableCondition_GetEventEnableCondition_EvtInfo_GlobalUndervoltageInt: RteEventRef=OpEventGetEventEnableCondition_GetEventEnableCondition_EvtInfo_GlobalUndervoltageInt
          OpEventGetEventEnableCondition_GetEventEnableCondition_EvtInfo_LocalOvervoltage: RteEventRef=OpEventGetEventEnableCondition_GetEventEnableCondition_EvtInfo_LocalOvervoltage
          OpEventGetEventEnableCondition_GetEventEnableCondition_EvtInfo_LocalUndervoltage: RteEventRef=OpEventGetEventEnableCondition_GetEventEnableCondition_EvtInfo_LocalUndervoltage
          OpEventGetEventEnableCondition_GetEventEnableCondition_EvtInfo_VsmEventOpmode: RteEventRef=OpEventGetEventEnableCondition_GetEventEnableCondition_EvtInfo_VsmEventOpmode
          OpEventGetEventEnableCondition_GetEventEnableCondition_GeneralEventInfo: RteEventRef=OpEventGetEventEnableCondition_GetEventEnableCondition_GeneralEventInfo
          OpEventGetDebouncingOfEvent_GetDebouncingOfEvent_EvtInfo_MCU_E_CLM_SELFDIAG_FAILURE: RteEventRef=OpEventGetDebouncingOfEvent_GetDebouncingOfEvent_EvtInfo_MCU_E_CLM_SELFDIAG_FAILURE
          OpEventGetDebouncingOfEvent_GetDebouncingOfEvent_EvtInfo_MCU_E_CLOCK_FAILURE: RteEventRef=OpEventGetDebouncingOfEvent_GetDebouncingOfEvent_EvtInfo_MCU_E_CLOCK_FAILURE
          OpEventGetDebouncingOfEvent_GetDebouncingOfEvent_EvtInfo_MCU_E_CVM_SELFDIAG_FAILURE: RteEventRef=OpEventGetDebouncingOfEvent_GetDebouncingOfEvent_EvtInfo_MCU_E_CVM_SELFDIAG_FAILURE
          OpEventGetDebouncingOfEvent_GetDebouncingOfEvent_EvtInfo_MCU_E_ECM_SELFDIAG_FAILURE: RteEventRef=OpEventGetDebouncingOfEvent_GetDebouncingOfEvent_EvtInfo_MCU_E_ECM_SELFDIAG_FAILURE
          OpEventGetDebouncingOfEvent_GetDebouncingOfEvent_EvtInfo_MCU_E_LOCKSTEP_SELFDIAG_FAILURE: RteEventRef=OpEventGetDebouncingOfEvent_GetDebouncingOfEvent_EvtInfo_MCU_E_LOCKSTEP_SELFDIAG_FAILURE
          OpEventGetDebouncingOfEvent_GetDebouncingOfEvent_EvtInfo_MCU_E_WRITE_TIMEOUT_FAILURE: RteEventRef=OpEventGetDebouncingOfEvent_GetDebouncingOfEvent_EvtInfo_MCU_E_WRITE_TIMEOUT_FAILURE
          OpEventGetDebouncingOfEvent_GetDebouncingOfEvent_EvtInfo_MCU_E_REG_WRITE_VERIFY: RteEventRef=OpEventGetDebouncingOfEvent_GetDebouncingOfEvent_EvtInfo_MCU_E_REG_WRITE_VERIFY
          OpEventGetDebouncingOfEvent_GetDebouncingOfEvent_EvtInfo_MCU_E_INT_INCONSISTENT: RteEventRef=OpEventGetDebouncingOfEvent_GetDebouncingOfEvent_EvtInfo_MCU_E_INT_INCONSISTENT
          OpEventGetDebouncingOfEvent_GetDebouncingOfEvent_EvtInfo_MCU_E_RESETCONTROLLER_STARTUP_FAILURE: RteEventRef=OpEventGetDebouncingOfEvent_GetDebouncingOfEvent_EvtInfo_MCU_E_RESETCONTROLLER_STARTUP_FAILURE
          OpEventGetDebouncingOfEvent_GetDebouncingOfEvent_EvtInfo_DIO_E_REG_WRITE_VERIFY: RteEventRef=OpEventGetDebouncingOfEvent_GetDebouncingOfEvent_EvtInfo_DIO_E_REG_WRITE_VERIFY
          OpEventGetDebouncingOfEvent_GetDebouncingOfEvent_EvtInfo_FLS_E_COMPARE_FAILED: RteEventRef=OpEventGetDebouncingOfEvent_GetDebouncingOfEvent_EvtInfo_FLS_E_COMPARE_FAILED
          OpEventGetDebouncingOfEvent_GetDebouncingOfEvent_EvtInfo_FLS_E_ERASE_FAILED: RteEventRef=OpEventGetDebouncingOfEvent_GetDebouncingOfEvent_EvtInfo_FLS_E_ERASE_FAILED
          OpEventGetDebouncingOfEvent_GetDebouncingOfEvent_EvtInfo_FLS_E_READ_FAILED: RteEventRef=OpEventGetDebouncingOfEvent_GetDebouncingOfEvent_EvtInfo_FLS_E_READ_FAILED
          OpEventGetDebouncingOfEvent_GetDebouncingOfEvent_EvtInfo_FLS_E_INT_INCONSISTENT: RteEventRef=OpEventGetDebouncingOfEvent_GetDebouncingOfEvent_EvtInfo_FLS_E_INT_INCONSISTENT
          OpEventGetDebouncingOfEvent_GetDebouncingOfEvent_EvtInfo_FLS_E_REG_WRITE_VERIFY: RteEventRef=OpEventGetDebouncingOfEvent_GetDebouncingOfEvent_EvtInfo_FLS_E_REG_WRITE_VERIFY
          OpEventGetDebouncingOfEvent_GetDebouncingOfEvent_EvtInfo_FLS_E_READ_FAILED_DED: RteEventRef=OpEventGetDebouncingOfEvent_GetDebouncingOfEvent_EvtInfo_FLS_E_READ_FAILED_DED
          OpEventGetDebouncingOfEvent_GetDebouncingOfEvent_EvtInfo_FLS_E_HW_FAILURE: RteEventRef=OpEventGetDebouncingOfEvent_GetDebouncingOfEvent_EvtInfo_FLS_E_HW_FAILURE
          OpEventGetDebouncingOfEvent_GetDebouncingOfEvent_EvtInfo_FLS_E_ECC_FAILED: RteEventRef=OpEventGetDebouncingOfEvent_GetDebouncingOfEvent_EvtInfo_FLS_E_ECC_FAILED
          OpEventGetDebouncingOfEvent_GetDebouncingOfEvent_EvtInfo_FLS_E_UNEXPECTED_FLASH_ID: RteEventRef=OpEventGetDebouncingOfEvent_GetDebouncingOfEvent_EvtInfo_FLS_E_UNEXPECTED_FLASH_ID
          OpEventGetDebouncingOfEvent_GetDebouncingOfEvent_EvtInfo_FLS_E_WRITE_FAILED: RteEventRef=OpEventGetDebouncingOfEvent_GetDebouncingOfEvent_EvtInfo_FLS_E_WRITE_FAILED
          OpEventGetDebouncingOfEvent_GetDebouncingOfEvent_EvtInfo_SPI_E_DATA_TX_TIMEOUT_FAILURE: RteEventRef=OpEventGetDebouncingOfEvent_GetDebouncingOfEvent_EvtInfo_SPI_E_DATA_TX_TIMEOUT_FAILURE
          OpEventGetDebouncingOfEvent_GetDebouncingOfEvent_EvtInfo_SPI_E_ECC_SELFTEST_FAILURE: RteEventRef=OpEventGetDebouncingOfEvent_GetDebouncingOfEvent_EvtInfo_SPI_E_ECC_SELFTEST_FAILURE
          OpEventGetDebouncingOfEvent_GetDebouncingOfEvent_EvtInfo_SPI_E_HARDWARE_ERROR: RteEventRef=OpEventGetDebouncingOfEvent_GetDebouncingOfEvent_EvtInfo_SPI_E_HARDWARE_ERROR
          OpEventGetDebouncingOfEvent_GetDebouncingOfEvent_EvtInfo_SPI_E_INT_INCONSISTENT: RteEventRef=OpEventGetDebouncingOfEvent_GetDebouncingOfEvent_EvtInfo_SPI_E_INT_INCONSISTENT
          OpEventGetDebouncingOfEvent_GetDebouncingOfEvent_EvtInfo_SPI_E_LOOPBACK_SELFTEST_FAILURE: RteEventRef=OpEventGetDebouncingOfEvent_GetDebouncingOfEvent_EvtInfo_SPI_E_LOOPBACK_SELFTEST_FAILURE
          OpEventGetDebouncingOfEvent_GetDebouncingOfEvent_EvtInfo_SPI_E_REG_WRITE_VERIFY: RteEventRef=OpEventGetDebouncingOfEvent_GetDebouncingOfEvent_EvtInfo_SPI_E_REG_WRITE_VERIFY
          OpEventGetDebouncingOfEvent_GetDebouncingOfEvent_EvtInfo_WDGM_E_IMPROPER_CALLER: RteEventRef=OpEventGetDebouncingOfEvent_GetDebouncingOfEvent_EvtInfo_WDGM_E_IMPROPER_CALLER
          OpEventGetDebouncingOfEvent_GetDebouncingOfEvent_EvtInfo_WDGM_E_MONITORING: RteEventRef=OpEventGetDebouncingOfEvent_GetDebouncingOfEvent_EvtInfo_WDGM_E_MONITORING
          OpEventGetDebouncingOfEvent_GetDebouncingOfEvent_EvtInfo_WDGM_E_SET_MODE: RteEventRef=OpEventGetDebouncingOfEvent_GetDebouncingOfEvent_EvtInfo_WDGM_E_SET_MODE
          OpEventGetDebouncingOfEvent_GetDebouncingOfEvent_EvtInfo_WDG_E_DISABLE_REJECTED: RteEventRef=OpEventGetDebouncingOfEvent_GetDebouncingOfEvent_EvtInfo_WDG_E_DISABLE_REJECTED
          OpEventGetDebouncingOfEvent_GetDebouncingOfEvent_EvtInfo_WDG_E_INT_INCONSISTENT: RteEventRef=OpEventGetDebouncingOfEvent_GetDebouncingOfEvent_EvtInfo_WDG_E_INT_INCONSISTENT
          OpEventGetDebouncingOfEvent_GetDebouncingOfEvent_EvtInfo_WDG_E_MODE_FAILED: RteEventRef=OpEventGetDebouncingOfEvent_GetDebouncingOfEvent_EvtInfo_WDG_E_MODE_FAILED
          OpEventGetDebouncingOfEvent_GetDebouncingOfEvent_EvtInfo_WDG_E_REG_WRITE_VERIFY: RteEventRef=OpEventGetDebouncingOfEvent_GetDebouncingOfEvent_EvtInfo_WDG_E_REG_WRITE_VERIFY
          OpEventGetDebouncingOfEvent_GetDebouncingOfEvent_EvtInfo_PORT_E_WRITE_TIMEOUT_FAILURE: RteEventRef=OpEventGetDebouncingOfEvent_GetDebouncingOfEvent_EvtInfo_PORT_E_WRITE_TIMEOUT_FAILURE
          OpEventGetDebouncingOfEvent_GetDebouncingOfEvent_EvtInfo_PORT_E_REG_WRITE_VERIFY: RteEventRef=OpEventGetDebouncingOfEvent_GetDebouncingOfEvent_EvtInfo_PORT_E_REG_WRITE_VERIFY
          OpEventGetDebouncingOfEvent_GetDebouncingOfEvent_EvtInfo_CodingEventNotCoded: RteEventRef=OpEventGetDebouncingOfEvent_GetDebouncingOfEvent_EvtInfo_CodingEventNotCoded
          OpEventGetDebouncingOfEvent_GetDebouncingOfEvent_EvtInfo_CodingEventUnqualifiedData: RteEventRef=OpEventGetDebouncingOfEvent_GetDebouncingOfEvent_EvtInfo_CodingEventUnqualifiedData
          OpEventGetDebouncingOfEvent_GetDebouncingOfEvent_EvtInfo_CodingEventWrongVehicle: RteEventRef=OpEventGetDebouncingOfEvent_GetDebouncingOfEvent_EvtInfo_CodingEventWrongVehicle
          OpEventGetDebouncingOfEvent_GetDebouncingOfEvent_EvtInfo_DmTestAppl: RteEventRef=OpEventGetDebouncingOfEvent_GetDebouncingOfEvent_EvtInfo_DmTestAppl
          OpEventGetDebouncingOfEvent_GetDebouncingOfEvent_EvtInfo_DmTestCom: RteEventRef=OpEventGetDebouncingOfEvent_GetDebouncingOfEvent_EvtInfo_DmTestCom
          OpEventGetDebouncingOfEvent_GetDebouncingOfEvent_EvtInfo_FrsmEClusterSyncLoss: RteEventRef=OpEventGetDebouncingOfEvent_GetDebouncingOfEvent_EvtInfo_FrsmEClusterSyncLoss
          OpEventGetDebouncingOfEvent_GetDebouncingOfEvent_EvtInfo_FrtrcvEFrBuserrorTrcv0: RteEventRef=OpEventGetDebouncingOfEvent_GetDebouncingOfEvent_EvtInfo_FrtrcvEFrBuserrorTrcv0
          OpEventGetDebouncingOfEvent_GetDebouncingOfEvent_EvtInfo_GlobalOvervoltageExt: RteEventRef=OpEventGetDebouncingOfEvent_GetDebouncingOfEvent_EvtInfo_GlobalOvervoltageExt
          OpEventGetDebouncingOfEvent_GetDebouncingOfEvent_EvtInfo_GlobalOvervoltageInt: RteEventRef=OpEventGetDebouncingOfEvent_GetDebouncingOfEvent_EvtInfo_GlobalOvervoltageInt
          OpEventGetDebouncingOfEvent_GetDebouncingOfEvent_EvtInfo_GlobalUndervoltageExt: RteEventRef=OpEventGetDebouncingOfEvent_GetDebouncingOfEvent_EvtInfo_GlobalUndervoltageExt
          OpEventGetDebouncingOfEvent_GetDebouncingOfEvent_EvtInfo_GlobalUndervoltageInt: RteEventRef=OpEventGetDebouncingOfEvent_GetDebouncingOfEvent_EvtInfo_GlobalUndervoltageInt
          OpEventGetDebouncingOfEvent_GetDebouncingOfEvent_EvtInfo_LocalOvervoltage: RteEventRef=OpEventGetDebouncingOfEvent_GetDebouncingOfEvent_EvtInfo_LocalOvervoltage
          OpEventGetDebouncingOfEvent_GetDebouncingOfEvent_EvtInfo_LocalUndervoltage: RteEventRef=OpEventGetDebouncingOfEvent_GetDebouncingOfEvent_EvtInfo_LocalUndervoltage
          OpEventGetDebouncingOfEvent_GetDebouncingOfEvent_EvtInfo_VsmEventOpmode: RteEventRef=OpEventGetDebouncingOfEvent_GetDebouncingOfEvent_EvtInfo_VsmEventOpmode
          OpEventGetDebouncingOfEvent_GetDebouncingOfEvent_GeneralEventInfo: RteEventRef=OpEventGetDebouncingOfEvent_GetDebouncingOfEvent_GeneralEventInfo
          OpEventGetMonitorStatus_GetMonitorStatus_EvtInfo_MCU_E_CLM_SELFDIAG_FAILURE: RteEventRef=OpEventGetMonitorStatus_GetMonitorStatus_EvtInfo_MCU_E_CLM_SELFDIAG_FAILURE
          OpEventGetMonitorStatus_GetMonitorStatus_EvtInfo_MCU_E_CLOCK_FAILURE: RteEventRef=OpEventGetMonitorStatus_GetMonitorStatus_EvtInfo_MCU_E_CLOCK_FAILURE
          OpEventGetMonitorStatus_GetMonitorStatus_EvtInfo_MCU_E_CVM_SELFDIAG_FAILURE: RteEventRef=OpEventGetMonitorStatus_GetMonitorStatus_EvtInfo_MCU_E_CVM_SELFDIAG_FAILURE
          OpEventGetMonitorStatus_GetMonitorStatus_EvtInfo_MCU_E_ECM_SELFDIAG_FAILURE: RteEventRef=OpEventGetMonitorStatus_GetMonitorStatus_EvtInfo_MCU_E_ECM_SELFDIAG_FAILURE
          OpEventGetMonitorStatus_GetMonitorStatus_EvtInfo_MCU_E_LOCKSTEP_SELFDIAG_FAILURE: RteEventRef=OpEventGetMonitorStatus_GetMonitorStatus_EvtInfo_MCU_E_LOCKSTEP_SELFDIAG_FAILURE
          OpEventGetMonitorStatus_GetMonitorStatus_EvtInfo_MCU_E_WRITE_TIMEOUT_FAILURE: RteEventRef=OpEventGetMonitorStatus_GetMonitorStatus_EvtInfo_MCU_E_WRITE_TIMEOUT_FAILURE
          OpEventGetMonitorStatus_GetMonitorStatus_EvtInfo_MCU_E_REG_WRITE_VERIFY: RteEventRef=OpEventGetMonitorStatus_GetMonitorStatus_EvtInfo_MCU_E_REG_WRITE_VERIFY
          OpEventGetMonitorStatus_GetMonitorStatus_EvtInfo_MCU_E_INT_INCONSISTENT: RteEventRef=OpEventGetMonitorStatus_GetMonitorStatus_EvtInfo_MCU_E_INT_INCONSISTENT
          OpEventGetMonitorStatus_GetMonitorStatus_EvtInfo_MCU_E_RESETCONTROLLER_STARTUP_FAILURE: RteEventRef=OpEventGetMonitorStatus_GetMonitorStatus_EvtInfo_MCU_E_RESETCONTROLLER_STARTUP_FAILURE
          OpEventGetMonitorStatus_GetMonitorStatus_EvtInfo_DIO_E_REG_WRITE_VERIFY: RteEventRef=OpEventGetMonitorStatus_GetMonitorStatus_EvtInfo_DIO_E_REG_WRITE_VERIFY
          OpEventGetMonitorStatus_GetMonitorStatus_EvtInfo_FLS_E_COMPARE_FAILED: RteEventRef=OpEventGetMonitorStatus_GetMonitorStatus_EvtInfo_FLS_E_COMPARE_FAILED
          OpEventGetMonitorStatus_GetMonitorStatus_EvtInfo_FLS_E_ERASE_FAILED: RteEventRef=OpEventGetMonitorStatus_GetMonitorStatus_EvtInfo_FLS_E_ERASE_FAILED
          OpEventGetMonitorStatus_GetMonitorStatus_EvtInfo_FLS_E_READ_FAILED: RteEventRef=OpEventGetMonitorStatus_GetMonitorStatus_EvtInfo_FLS_E_READ_FAILED
          OpEventGetMonitorStatus_GetMonitorStatus_EvtInfo_FLS_E_INT_INCONSISTENT: RteEventRef=OpEventGetMonitorStatus_GetMonitorStatus_EvtInfo_FLS_E_INT_INCONSISTENT
          OpEventGetMonitorStatus_GetMonitorStatus_EvtInfo_FLS_E_REG_WRITE_VERIFY: RteEventRef=OpEventGetMonitorStatus_GetMonitorStatus_EvtInfo_FLS_E_REG_WRITE_VERIFY
          OpEventGetMonitorStatus_GetMonitorStatus_EvtInfo_FLS_E_READ_FAILED_DED: RteEventRef=OpEventGetMonitorStatus_GetMonitorStatus_EvtInfo_FLS_E_READ_FAILED_DED
          OpEventGetMonitorStatus_GetMonitorStatus_EvtInfo_FLS_E_HW_FAILURE: RteEventRef=OpEventGetMonitorStatus_GetMonitorStatus_EvtInfo_FLS_E_HW_FAILURE
          OpEventGetMonitorStatus_GetMonitorStatus_EvtInfo_FLS_E_ECC_FAILED: RteEventRef=OpEventGetMonitorStatus_GetMonitorStatus_EvtInfo_FLS_E_ECC_FAILED
          OpEventGetMonitorStatus_GetMonitorStatus_EvtInfo_FLS_E_UNEXPECTED_FLASH_ID: RteEventRef=OpEventGetMonitorStatus_GetMonitorStatus_EvtInfo_FLS_E_UNEXPECTED_FLASH_ID
          OpEventGetMonitorStatus_GetMonitorStatus_EvtInfo_FLS_E_WRITE_FAILED: RteEventRef=OpEventGetMonitorStatus_GetMonitorStatus_EvtInfo_FLS_E_WRITE_FAILED
          OpEventGetMonitorStatus_GetMonitorStatus_EvtInfo_SPI_E_DATA_TX_TIMEOUT_FAILURE: RteEventRef=OpEventGetMonitorStatus_GetMonitorStatus_EvtInfo_SPI_E_DATA_TX_TIMEOUT_FAILURE
          OpEventGetMonitorStatus_GetMonitorStatus_EvtInfo_SPI_E_ECC_SELFTEST_FAILURE: RteEventRef=OpEventGetMonitorStatus_GetMonitorStatus_EvtInfo_SPI_E_ECC_SELFTEST_FAILURE
          OpEventGetMonitorStatus_GetMonitorStatus_EvtInfo_SPI_E_HARDWARE_ERROR: RteEventRef=OpEventGetMonitorStatus_GetMonitorStatus_EvtInfo_SPI_E_HARDWARE_ERROR
          OpEventGetMonitorStatus_GetMonitorStatus_EvtInfo_SPI_E_INT_INCONSISTENT: RteEventRef=OpEventGetMonitorStatus_GetMonitorStatus_EvtInfo_SPI_E_INT_INCONSISTENT
          OpEventGetMonitorStatus_GetMonitorStatus_EvtInfo_SPI_E_LOOPBACK_SELFTEST_FAILURE: RteEventRef=OpEventGetMonitorStatus_GetMonitorStatus_EvtInfo_SPI_E_LOOPBACK_SELFTEST_FAILURE
          OpEventGetMonitorStatus_GetMonitorStatus_EvtInfo_SPI_E_REG_WRITE_VERIFY: RteEventRef=OpEventGetMonitorStatus_GetMonitorStatus_EvtInfo_SPI_E_REG_WRITE_VERIFY
          OpEventGetMonitorStatus_GetMonitorStatus_EvtInfo_WDGM_E_IMPROPER_CALLER: RteEventRef=OpEventGetMonitorStatus_GetMonitorStatus_EvtInfo_WDGM_E_IMPROPER_CALLER
          OpEventGetMonitorStatus_GetMonitorStatus_EvtInfo_WDGM_E_MONITORING: RteEventRef=OpEventGetMonitorStatus_GetMonitorStatus_EvtInfo_WDGM_E_MONITORING
          OpEventGetMonitorStatus_GetMonitorStatus_EvtInfo_WDGM_E_SET_MODE: RteEventRef=OpEventGetMonitorStatus_GetMonitorStatus_EvtInfo_WDGM_E_SET_MODE
          OpEventGetMonitorStatus_GetMonitorStatus_EvtInfo_WDG_E_DISABLE_REJECTED: RteEventRef=OpEventGetMonitorStatus_GetMonitorStatus_EvtInfo_WDG_E_DISABLE_REJECTED
          OpEventGetMonitorStatus_GetMonitorStatus_EvtInfo_WDG_E_INT_INCONSISTENT: RteEventRef=OpEventGetMonitorStatus_GetMonitorStatus_EvtInfo_WDG_E_INT_INCONSISTENT
          OpEventGetMonitorStatus_GetMonitorStatus_EvtInfo_WDG_E_MODE_FAILED: RteEventRef=OpEventGetMonitorStatus_GetMonitorStatus_EvtInfo_WDG_E_MODE_FAILED
          OpEventGetMonitorStatus_GetMonitorStatus_EvtInfo_WDG_E_REG_WRITE_VERIFY: RteEventRef=OpEventGetMonitorStatus_GetMonitorStatus_EvtInfo_WDG_E_REG_WRITE_VERIFY
          OpEventGetMonitorStatus_GetMonitorStatus_EvtInfo_PORT_E_WRITE_TIMEOUT_FAILURE: RteEventRef=OpEventGetMonitorStatus_GetMonitorStatus_EvtInfo_PORT_E_WRITE_TIMEOUT_FAILURE
          OpEventGetMonitorStatus_GetMonitorStatus_EvtInfo_PORT_E_REG_WRITE_VERIFY: RteEventRef=OpEventGetMonitorStatus_GetMonitorStatus_EvtInfo_PORT_E_REG_WRITE_VERIFY
          OpEventGetMonitorStatus_GetMonitorStatus_EvtInfo_CodingEventNotCoded: RteEventRef=OpEventGetMonitorStatus_GetMonitorStatus_EvtInfo_CodingEventNotCoded
          OpEventGetMonitorStatus_GetMonitorStatus_EvtInfo_CodingEventUnqualifiedData: RteEventRef=OpEventGetMonitorStatus_GetMonitorStatus_EvtInfo_CodingEventUnqualifiedData
          OpEventGetMonitorStatus_GetMonitorStatus_EvtInfo_CodingEventWrongVehicle: RteEventRef=OpEventGetMonitorStatus_GetMonitorStatus_EvtInfo_CodingEventWrongVehicle
          OpEventGetMonitorStatus_GetMonitorStatus_EvtInfo_DmTestAppl: RteEventRef=OpEventGetMonitorStatus_GetMonitorStatus_EvtInfo_DmTestAppl
          OpEventGetMonitorStatus_GetMonitorStatus_EvtInfo_DmTestCom: RteEventRef=OpEventGetMonitorStatus_GetMonitorStatus_EvtInfo_DmTestCom
          OpEventGetMonitorStatus_GetMonitorStatus_EvtInfo_FrsmEClusterSyncLoss: RteEventRef=OpEventGetMonitorStatus_GetMonitorStatus_EvtInfo_FrsmEClusterSyncLoss
          OpEventGetMonitorStatus_GetMonitorStatus_EvtInfo_FrtrcvEFrBuserrorTrcv0: RteEventRef=OpEventGetMonitorStatus_GetMonitorStatus_EvtInfo_FrtrcvEFrBuserrorTrcv0
          OpEventGetMonitorStatus_GetMonitorStatus_EvtInfo_GlobalOvervoltageExt: RteEventRef=OpEventGetMonitorStatus_GetMonitorStatus_EvtInfo_GlobalOvervoltageExt
          OpEventGetMonitorStatus_GetMonitorStatus_EvtInfo_GlobalOvervoltageInt: RteEventRef=OpEventGetMonitorStatus_GetMonitorStatus_EvtInfo_GlobalOvervoltageInt
          OpEventGetMonitorStatus_GetMonitorStatus_EvtInfo_GlobalUndervoltageExt: RteEventRef=OpEventGetMonitorStatus_GetMonitorStatus_EvtInfo_GlobalUndervoltageExt
          OpEventGetMonitorStatus_GetMonitorStatus_EvtInfo_GlobalUndervoltageInt: RteEventRef=OpEventGetMonitorStatus_GetMonitorStatus_EvtInfo_GlobalUndervoltageInt
          OpEventGetMonitorStatus_GetMonitorStatus_EvtInfo_LocalOvervoltage: RteEventRef=OpEventGetMonitorStatus_GetMonitorStatus_EvtInfo_LocalOvervoltage
          OpEventGetMonitorStatus_GetMonitorStatus_EvtInfo_LocalUndervoltage: RteEventRef=OpEventGetMonitorStatus_GetMonitorStatus_EvtInfo_LocalUndervoltage
          OpEventGetMonitorStatus_GetMonitorStatus_EvtInfo_VsmEventOpmode: RteEventRef=OpEventGetMonitorStatus_GetMonitorStatus_EvtInfo_VsmEventOpmode
          OpEventGetMonitorStatus_GetMonitorStatus_GeneralEventInfo: RteEventRef=OpEventGetMonitorStatus_GetMonitorStatus_GeneralEventInfo
          OpEventSetEventStatus_SetEventStatus_Event_CodingEventNotCoded: RteEventRef=OpEventSetEventStatus_SetEventStatus_Event_CodingEventNotCoded
          OpEventSetEventStatus_SetEventStatus_Event_CodingEventUnqualifiedData: RteEventRef=OpEventSetEventStatus_SetEventStatus_Event_CodingEventUnqualifiedData
          OpEventSetEventStatus_SetEventStatus_Event_CodingEventWrongVehicle: RteEventRef=OpEventSetEventStatus_SetEventStatus_Event_CodingEventWrongVehicle
          OpEventSetEventStatus_SetEventStatus_Event_DmTestAppl: RteEventRef=OpEventSetEventStatus_SetEventStatus_Event_DmTestAppl
          OpEventSetEventStatus_SetEventStatus_Event_DmTestCom: RteEventRef=OpEventSetEventStatus_SetEventStatus_Event_DmTestCom
          OpEventSetEventStatus_SetEventStatus_Event_FrsmEClusterSyncLoss: RteEventRef=OpEventSetEventStatus_SetEventStatus_Event_FrsmEClusterSyncLoss
          OpEventSetEventStatus_SetEventStatus_Event_FrtrcvEFrBuserrorTrcv0: RteEventRef=OpEventSetEventStatus_SetEventStatus_Event_FrtrcvEFrBuserrorTrcv0
          OpEventSetEventStatus_SetEventStatus_Event_GlobalOvervoltageExt: RteEventRef=OpEventSetEventStatus_SetEventStatus_Event_GlobalOvervoltageExt
          OpEventSetEventStatus_SetEventStatus_Event_GlobalOvervoltageInt: RteEventRef=OpEventSetEventStatus_SetEventStatus_Event_GlobalOvervoltageInt
          OpEventSetEventStatus_SetEventStatus_Event_GlobalUndervoltageExt: RteEventRef=OpEventSetEventStatus_SetEventStatus_Event_GlobalUndervoltageExt
          OpEventSetEventStatus_SetEventStatus_Event_GlobalUndervoltageInt: RteEventRef=OpEventSetEventStatus_SetEventStatus_Event_GlobalUndervoltageInt
          OpEventSetEventStatus_SetEventStatus_Event_LocalOvervoltage: RteEventRef=OpEventSetEventStatus_SetEventStatus_Event_LocalOvervoltage
          OpEventSetEventStatus_SetEventStatus_Event_LocalUndervoltage: RteEventRef=OpEventSetEventStatus_SetEventStatus_Event_LocalUndervoltage
          OpEventSetEventStatus_SetEventStatus_Event_VsmEventOpmode: RteEventRef=OpEventSetEventStatus_SetEventStatus_Event_VsmEventOpmode
          OpEventResetEventStatus_ResetEventStatus_Event_CodingEventNotCoded: RteEventRef=OpEventResetEventStatus_ResetEventStatus_Event_CodingEventNotCoded
          OpEventResetEventStatus_ResetEventStatus_Event_CodingEventUnqualifiedData: RteEventRef=OpEventResetEventStatus_ResetEventStatus_Event_CodingEventUnqualifiedData
          OpEventResetEventStatus_ResetEventStatus_Event_CodingEventWrongVehicle: RteEventRef=OpEventResetEventStatus_ResetEventStatus_Event_CodingEventWrongVehicle
          OpEventResetEventStatus_ResetEventStatus_Event_DmTestAppl: RteEventRef=OpEventResetEventStatus_ResetEventStatus_Event_DmTestAppl
          OpEventResetEventStatus_ResetEventStatus_Event_DmTestCom: RteEventRef=OpEventResetEventStatus_ResetEventStatus_Event_DmTestCom
          OpEventResetEventStatus_ResetEventStatus_Event_FrsmEClusterSyncLoss: RteEventRef=OpEventResetEventStatus_ResetEventStatus_Event_FrsmEClusterSyncLoss
          OpEventResetEventStatus_ResetEventStatus_Event_FrtrcvEFrBuserrorTrcv0: RteEventRef=OpEventResetEventStatus_ResetEventStatus_Event_FrtrcvEFrBuserrorTrcv0
          OpEventResetEventStatus_ResetEventStatus_Event_GlobalOvervoltageExt: RteEventRef=OpEventResetEventStatus_ResetEventStatus_Event_GlobalOvervoltageExt
          OpEventResetEventStatus_ResetEventStatus_Event_GlobalOvervoltageInt: RteEventRef=OpEventResetEventStatus_ResetEventStatus_Event_GlobalOvervoltageInt
          OpEventResetEventStatus_ResetEventStatus_Event_GlobalUndervoltageExt: RteEventRef=OpEventResetEventStatus_ResetEventStatus_Event_GlobalUndervoltageExt
          OpEventResetEventStatus_ResetEventStatus_Event_GlobalUndervoltageInt: RteEventRef=OpEventResetEventStatus_ResetEventStatus_Event_GlobalUndervoltageInt
          OpEventResetEventStatus_ResetEventStatus_Event_LocalOvervoltage: RteEventRef=OpEventResetEventStatus_ResetEventStatus_Event_LocalOvervoltage
          OpEventResetEventStatus_ResetEventStatus_Event_LocalUndervoltage: RteEventRef=OpEventResetEventStatus_ResetEventStatus_Event_LocalUndervoltage
          OpEventResetEventStatus_ResetEventStatus_Event_VsmEventOpmode: RteEventRef=OpEventResetEventStatus_ResetEventStatus_Event_VsmEventOpmode
          OpEventResetEventDebounceStatus_ResetEventDebounceStatus_Event_CodingEventNotCoded: RteEventRef=OpEventResetEventDebounceStatus_ResetEventDebounceStatus_Event_CodingEventNotCoded
          OpEventResetEventDebounceStatus_ResetEventDebounceStatus_Event_CodingEventUnqualifiedData: RteEventRef=OpEventResetEventDebounceStatus_ResetEventDebounceStatus_Event_CodingEventUnqualifiedData
          OpEventResetEventDebounceStatus_ResetEventDebounceStatus_Event_CodingEventWrongVehicle: RteEventRef=OpEventResetEventDebounceStatus_ResetEventDebounceStatus_Event_CodingEventWrongVehicle
          OpEventResetEventDebounceStatus_ResetEventDebounceStatus_Event_DmTestAppl: RteEventRef=OpEventResetEventDebounceStatus_ResetEventDebounceStatus_Event_DmTestAppl
          OpEventResetEventDebounceStatus_ResetEventDebounceStatus_Event_DmTestCom: RteEventRef=OpEventResetEventDebounceStatus_ResetEventDebounceStatus_Event_DmTestCom
          OpEventResetEventDebounceStatus_ResetEventDebounceStatus_Event_FrsmEClusterSyncLoss: RteEventRef=OpEventResetEventDebounceStatus_ResetEventDebounceStatus_Event_FrsmEClusterSyncLoss
          OpEventResetEventDebounceStatus_ResetEventDebounceStatus_Event_FrtrcvEFrBuserrorTrcv0: RteEventRef=OpEventResetEventDebounceStatus_ResetEventDebounceStatus_Event_FrtrcvEFrBuserrorTrcv0
          OpEventResetEventDebounceStatus_ResetEventDebounceStatus_Event_GlobalOvervoltageExt: RteEventRef=OpEventResetEventDebounceStatus_ResetEventDebounceStatus_Event_GlobalOvervoltageExt
          OpEventResetEventDebounceStatus_ResetEventDebounceStatus_Event_GlobalOvervoltageInt: RteEventRef=OpEventResetEventDebounceStatus_ResetEventDebounceStatus_Event_GlobalOvervoltageInt
          OpEventResetEventDebounceStatus_ResetEventDebounceStatus_Event_GlobalUndervoltageExt: RteEventRef=OpEventResetEventDebounceStatus_ResetEventDebounceStatus_Event_GlobalUndervoltageExt
          OpEventResetEventDebounceStatus_ResetEventDebounceStatus_Event_GlobalUndervoltageInt: RteEventRef=OpEventResetEventDebounceStatus_ResetEventDebounceStatus_Event_GlobalUndervoltageInt
          OpEventResetEventDebounceStatus_ResetEventDebounceStatus_Event_LocalOvervoltage: RteEventRef=OpEventResetEventDebounceStatus_ResetEventDebounceStatus_Event_LocalOvervoltage
          OpEventResetEventDebounceStatus_ResetEventDebounceStatus_Event_LocalUndervoltage: RteEventRef=OpEventResetEventDebounceStatus_ResetEventDebounceStatus_Event_LocalUndervoltage
          OpEventResetEventDebounceStatus_ResetEventDebounceStatus_Event_VsmEventOpmode: RteEventRef=OpEventResetEventDebounceStatus_ResetEventDebounceStatus_Event_VsmEventOpmode
          OpEventGetDTCOfEvent_GetDTCOfEvent_EvtInfo_SecondaryEve_31F300: RteEventRef=OpEventGetDTCOfEvent_GetDTCOfEvent_EvtInfo_SecondaryEve_31F300
          OpEventGetEventTested_GetEventTested_Event_PriEve4822E4_SecEve31F100: RteEventRef=OpEventGetEventTested_GetEventTested_Event_PriEve4822E4_SecEve31F100
          OpEventResetEventStatus_ResetEventStatus_Event_PriEve4822F5_SecEve31F300: RteEventRef=OpEventResetEventStatus_ResetEventStatus_Event_PriEve4822F5_SecEve31F300
          OpEventGetMonitorStatus_GetMonitorStatus_EvtInfo_SecondaryEve_30F300: RteEventRef=OpEventGetMonitorStatus_GetMonitorStatus_EvtInfo_SecondaryEve_30F300
          OpEventGetDebouncingOfEvent_GetDebouncingOfEvent_EvtInfo_SecondaryEve_31F300: RteEventRef=OpEventGetDebouncingOfEvent_GetDebouncingOfEvent_EvtInfo_SecondaryEve_31F300
          OpEventResetEventStatus_ResetEventStatus_Event_PriEve4822E4_SecEve21F100: RteEventRef=OpEventResetEventStatus_ResetEventStatus_Event_PriEve4822E4_SecEve21F100
          OpEventGetMonitorStatus_GetMonitorStatus_EvtInfo_PriEve4822F5_SecEve21F300: RteEventRef=OpEventGetMonitorStatus_GetMonitorStatus_EvtInfo_PriEve4822F5_SecEve21F300
          OpEventGetEventTested_GetEventTested_Event_SecondaryEve_30F300: RteEventRef=OpEventGetEventTested_GetEventTested_Event_SecondaryEve_30F300
          OpEventGetEventFreezeFrameDataEx_GetEventFreezeFrameDataEx_EvtInfo_SecondaryEve_31F100: RteEventRef=OpEventGetEventFreezeFrameDataEx_GetEventFreezeFrameDataEx_EvtInfo_SecondaryEve_31F100
          OpEventGetEventExtendedDataRecordEx_GetEventExtendedDataRecordEx_EvtInfo_SecondaryEve_31F100: RteEventRef=OpEventGetEventExtendedDataRecordEx_GetEventExtendedDataRecordEx_EvtInfo_SecondaryEve_31F100
          OpEventGetEventEnableCondition_GetEventEnableCondition_EvtInfo_PriEve4822E4_SecEve21F100: RteEventRef=OpEventGetEventEnableCondition_GetEventEnableCondition_EvtInfo_PriEve4822E4_SecEve21F100
          OpEventGetFaultDetectionCounter_GetFaultDetectionCounter_EvtInfo_SecondaryEve_30F300: RteEventRef=OpEventGetFaultDetectionCounter_GetFaultDetectionCounter_EvtInfo_SecondaryEve_30F300
          OpEventGetEventFailed_GetEventFailed_Event_SecondaryEve_31F300: RteEventRef=OpEventGetEventFailed_GetEventFailed_Event_SecondaryEve_31F300
          OpEventGetDTCOfEvent_GetDTCOfEvent_EvtInfo_SecondaryEve_21F300: RteEventRef=OpEventGetDTCOfEvent_GetDTCOfEvent_EvtInfo_SecondaryEve_21F300
          OpEventGetEventExtendedDataRecordEx_GetEventExtendedDataRecordEx_Event_SecondaryEve_31F100: RteEventRef=OpEventGetEventExtendedDataRecordEx_GetEventExtendedDataRecordEx_Event_SecondaryEve_31F100
          OpEventResetEventDebounceStatus_ResetEventDebounceStatus_Event_PriEve4822E4_SecEve21F100: RteEventRef=OpEventResetEventDebounceStatus_ResetEventDebounceStatus_Event_PriEve4822E4_SecEve21F100
          OpEventSetEventStatus_SetEventStatus_Event_PriEve4822E4_SecEve21F100: RteEventRef=OpEventSetEventStatus_SetEventStatus_Event_PriEve4822E4_SecEve21F100
          OpEventGetEventStatus_GetEventStatus_EvtInfo_PriEve4822E4_SecEve31F100: RteEventRef=OpEventGetEventStatus_GetEventStatus_EvtInfo_PriEve4822E4_SecEve31F100
          OpEventGetEventTested_GetEventTested_Event_PriEve4822E4_SecEve21F100: RteEventRef=OpEventGetEventTested_GetEventTested_Event_PriEve4822E4_SecEve21F100
          OpEventGetEventFailed_GetEventFailed_EvtInfo_SecondaryEve_30F300: RteEventRef=OpEventGetEventFailed_GetEventFailed_EvtInfo_SecondaryEve_30F300
          OpEventGetEventEnableCondition_GetEventEnableCondition_EvtInfo_SecondaryEve_21F100: RteEventRef=OpEventGetEventEnableCondition_GetEventEnableCondition_EvtInfo_SecondaryEve_21F100
          OpEventGetFaultDetectionCounter_GetFaultDetectionCounter_EvtInfo_SecondaryEve_21F100: RteEventRef=OpEventGetFaultDetectionCounter_GetFaultDetectionCounter_EvtInfo_SecondaryEve_21F100
          OpEventGetDTCOfEvent_GetDTCOfEvent_Event_SecondaryEve_20F300: RteEventRef=OpEventGetDTCOfEvent_GetDTCOfEvent_Event_SecondaryEve_20F300
          OpEventGetEventFreezeFrameDataEx_GetEventFreezeFrameDataEx_Event_PriEve4822F5_SecEve31F300: RteEventRef=OpEventGetEventFreezeFrameDataEx_GetEventFreezeFrameDataEx_Event_PriEve4822F5_SecEve31F300
          OpEventGetDebouncingOfEvent_GetDebouncingOfEvent_EvtInfo_SecondaryEve_30F300: RteEventRef=OpEventGetDebouncingOfEvent_GetDebouncingOfEvent_EvtInfo_SecondaryEve_30F300
          OpEventGetEventTested_GetEventTested_Event_PriEve4822F5_SecEve31F300: RteEventRef=OpEventGetEventTested_GetEventTested_Event_PriEve4822F5_SecEve31F300
          OpEventGetFaultDetectionCounter_GetFaultDetectionCounter_EvtInfo_PriEve4822F5_SecEve31F300: RteEventRef=OpEventGetFaultDetectionCounter_GetFaultDetectionCounter_EvtInfo_PriEve4822F5_SecEve31F300
          OpEventGetEventTested_GetEventTested_EvtInfo_PriEve4822F5_SecEve21F300: RteEventRef=OpEventGetEventTested_GetEventTested_EvtInfo_PriEve4822F5_SecEve21F300
          OpEventGetDTCOfEvent_GetDTCOfEvent_Event_SecondaryEve_21F100: RteEventRef=OpEventGetDTCOfEvent_GetDTCOfEvent_Event_SecondaryEve_21F100
          OpEventGetEventFreezeFrameDataEx_GetEventFreezeFrameDataEx_EvtInfo_PriEve4822E4_SecEve21F100: RteEventRef=OpEventGetEventFreezeFrameDataEx_GetEventFreezeFrameDataEx_EvtInfo_PriEve4822E4_SecEve21F100
          OpEventGetEventFailed_GetEventFailed_Event_PriEve4822E4_SecEve31F100: RteEventRef=OpEventGetEventFailed_GetEventFailed_Event_PriEve4822E4_SecEve31F100
          OpEventSetEventStatus_SetEventStatus_Event_SecondaryEve_31F300: RteEventRef=OpEventSetEventStatus_SetEventStatus_Event_SecondaryEve_31F300
          OpEventGetEventFreezeFrameDataEx_GetEventFreezeFrameDataEx_EvtInfo_PriEve4822F5_SecEve31F300: RteEventRef=OpEventGetEventFreezeFrameDataEx_GetEventFreezeFrameDataEx_EvtInfo_PriEve4822F5_SecEve31F300
          OpEventGetEventStatus_GetEventStatus_Event_SecondaryEve_21F300: RteEventRef=OpEventGetEventStatus_GetEventStatus_Event_SecondaryEve_21F300
          OpEventGetEventEnableCondition_GetEventEnableCondition_EvtInfo_SecondaryEve_21F300: RteEventRef=OpEventGetEventEnableCondition_GetEventEnableCondition_EvtInfo_SecondaryEve_21F300
          OpEventGetEventTested_GetEventTested_Event_SecondaryEve_21F300: RteEventRef=OpEventGetEventTested_GetEventTested_Event_SecondaryEve_21F300
          OpEventGetEventExtendedDataRecordEx_GetEventExtendedDataRecordEx_Event_PriEve4822E4_SecEve31F100: RteEventRef=OpEventGetEventExtendedDataRecordEx_GetEventExtendedDataRecordEx_Event_PriEve4822E4_SecEve31F100
          OpEventGetEventFreezeFrameDataEx_GetEventFreezeFrameDataEx_Event_SecondaryEve_20F300: RteEventRef=OpEventGetEventFreezeFrameDataEx_GetEventFreezeFrameDataEx_Event_SecondaryEve_20F300
          OpEventGetDTCOfEvent_GetDTCOfEvent_Event_PriEve4822E4_SecEve31F100: RteEventRef=OpEventGetDTCOfEvent_GetDTCOfEvent_Event_PriEve4822E4_SecEve31F100
          OpEventGetEventUdsStatus_GetEventUdsStatus_Event_PriEve4822E4_SecEve31F100: RteEventRef=OpEventGetEventUdsStatus_GetEventUdsStatus_Event_PriEve4822E4_SecEve31F100
          OpEventGetEventExtendedDataRecordEx_GetEventExtendedDataRecordEx_EvtInfo_SecondaryEve_31F300: RteEventRef=OpEventGetEventExtendedDataRecordEx_GetEventExtendedDataRecordEx_EvtInfo_SecondaryEve_31F300
          OpEventGetEventFailed_GetEventFailed_Event_SecondaryEve_21F100: RteEventRef=OpEventGetEventFailed_GetEventFailed_Event_SecondaryEve_21F100
          OpEventGetDTCOfEvent_GetDTCOfEvent_EvtInfo_PriEve4822E4_SecEve31F100: RteEventRef=OpEventGetDTCOfEvent_GetDTCOfEvent_EvtInfo_PriEve4822E4_SecEve31F100
          OpEventResetEventStatus_ResetEventStatus_Event_SecondaryEve_31F100: RteEventRef=OpEventResetEventStatus_ResetEventStatus_Event_SecondaryEve_31F100
          OpEventGetEventFailed_GetEventFailed_Event_PriEve4822F5_SecEve31F300: RteEventRef=OpEventGetEventFailed_GetEventFailed_Event_PriEve4822F5_SecEve31F300
          OpEventGetEventExtendedDataRecordEx_GetEventExtendedDataRecordEx_EvtInfo_PriEve4822F5_SecEve31F300: RteEventRef=OpEventGetEventExtendedDataRecordEx_GetEventExtendedDataRecordEx_EvtInfo_PriEve4822F5_SecEve31F300
          OpEventGetEventEnableCondition_GetEventEnableCondition_EvtInfo_PriEve4822F5_SecEve31F300: RteEventRef=OpEventGetEventEnableCondition_GetEventEnableCondition_EvtInfo_PriEve4822F5_SecEve31F300
          OpEventGetEventUdsStatus_GetEventUdsStatus_EvtInfo_SecondaryEve_20F300: RteEventRef=OpEventGetEventUdsStatus_GetEventUdsStatus_EvtInfo_SecondaryEve_20F300
          OpEventGetEventUdsStatus_GetEventUdsStatus_EvtInfo_SecondaryEve_30F300: RteEventRef=OpEventGetEventUdsStatus_GetEventUdsStatus_EvtInfo_SecondaryEve_30F300
          OpEventGetEventFailed_GetEventFailed_EvtInfo_SecondaryEve_21F100: RteEventRef=OpEventGetEventFailed_GetEventFailed_EvtInfo_SecondaryEve_21F100
          OpEventGetEventFreezeFrameDataEx_GetEventFreezeFrameDataEx_Event_SecondaryEve_21F300: RteEventRef=OpEventGetEventFreezeFrameDataEx_GetEventFreezeFrameDataEx_Event_SecondaryEve_21F300
          OpEventGetDTCOfEvent_GetDTCOfEvent_Event_SecondaryEve_31F300: RteEventRef=OpEventGetDTCOfEvent_GetDTCOfEvent_Event_SecondaryEve_31F300
          OpEventGetEventStatus_GetEventStatus_EvtInfo_SecondaryEve_21F100: RteEventRef=OpEventGetEventStatus_GetEventStatus_EvtInfo_SecondaryEve_21F100
          OpEventResetEventDebounceStatus_ResetEventDebounceStatus_Event_PriEve4822F5_SecEve31F300: RteEventRef=OpEventResetEventDebounceStatus_ResetEventDebounceStatus_Event_PriEve4822F5_SecEve31F300
          OpEventGetEventTested_GetEventTested_EvtInfo_PriEve4822F5_SecEve31F300: RteEventRef=OpEventGetEventTested_GetEventTested_EvtInfo_PriEve4822F5_SecEve31F300
          OpEventGetFaultDetectionCounter_GetFaultDetectionCounter_Event_PriEve4822E4_SecEve21F100: RteEventRef=OpEventGetFaultDetectionCounter_GetFaultDetectionCounter_Event_PriEve4822E4_SecEve21F100
          OpEventGetEventUdsStatus_GetEventUdsStatus_EvtInfo_SecondaryEve_21F300: RteEventRef=OpEventGetEventUdsStatus_GetEventUdsStatus_EvtInfo_SecondaryEve_21F300
          OpEventGetEventTested_GetEventTested_EvtInfo_PriEve4822E4_SecEve21F100: RteEventRef=OpEventGetEventTested_GetEventTested_EvtInfo_PriEve4822E4_SecEve21F100
          OpEventGetFaultDetectionCounter_GetFaultDetectionCounter_Event_SecondaryEve_30F300: RteEventRef=OpEventGetFaultDetectionCounter_GetFaultDetectionCounter_Event_SecondaryEve_30F300
          OpEventSetEventStatus_SetEventStatus_Event_SecondaryEve_21F300: RteEventRef=OpEventSetEventStatus_SetEventStatus_Event_SecondaryEve_21F300
          OpEventGetEventExtendedDataRecordEx_GetEventExtendedDataRecordEx_Event_SecondaryEve_30F300: RteEventRef=OpEventGetEventExtendedDataRecordEx_GetEventExtendedDataRecordEx_Event_SecondaryEve_30F300
          OpEventGetEventFreezeFrameDataEx_GetEventFreezeFrameDataEx_EvtInfo_PriEve4822F5_SecEve21F300: RteEventRef=OpEventGetEventFreezeFrameDataEx_GetEventFreezeFrameDataEx_EvtInfo_PriEve4822F5_SecEve21F300
          OpEventGetFaultDetectionCounter_GetFaultDetectionCounter_EvtInfo_PriEve4822E4_SecEve21F100: RteEventRef=OpEventGetFaultDetectionCounter_GetFaultDetectionCounter_EvtInfo_PriEve4822E4_SecEve21F100
          OpEventResetEventStatus_ResetEventStatus_Event_SecondaryEve_30F300: RteEventRef=OpEventResetEventStatus_ResetEventStatus_Event_SecondaryEve_30F300
          OpEventGetMonitorStatus_GetMonitorStatus_EvtInfo_PriEve4822E4_SecEve31F100: RteEventRef=OpEventGetMonitorStatus_GetMonitorStatus_EvtInfo_PriEve4822E4_SecEve31F100
          OpEventGetDTCOfEvent_GetDTCOfEvent_EvtInfo_SecondaryEve_30F300: RteEventRef=OpEventGetDTCOfEvent_GetDTCOfEvent_EvtInfo_SecondaryEve_30F300
          OpEventGetEventFailed_GetEventFailed_EvtInfo_PriEve4822E4_SecEve21F100: RteEventRef=OpEventGetEventFailed_GetEventFailed_EvtInfo_PriEve4822E4_SecEve21F100
          OpEventGetEventStatus_GetEventStatus_Event_PriEve4822E4_SecEve21F100: RteEventRef=OpEventGetEventStatus_GetEventStatus_Event_PriEve4822E4_SecEve21F100
          OpEventResetEventDebounceStatus_ResetEventDebounceStatus_Event_SecondaryEve_21F300: RteEventRef=OpEventResetEventDebounceStatus_ResetEventDebounceStatus_Event_SecondaryEve_21F300
          OpEventGetEventTested_GetEventTested_Event_SecondaryEve_20F300: RteEventRef=OpEventGetEventTested_GetEventTested_Event_SecondaryEve_20F300
          OpEventGetDebouncingOfEvent_GetDebouncingOfEvent_EvtInfo_SecondaryEve_31F100: RteEventRef=OpEventGetDebouncingOfEvent_GetDebouncingOfEvent_EvtInfo_SecondaryEve_31F100
          OpEventGetEventFreezeFrameDataEx_GetEventFreezeFrameDataEx_Event_SecondaryEve_30F300: RteEventRef=OpEventGetEventFreezeFrameDataEx_GetEventFreezeFrameDataEx_Event_SecondaryEve_30F300
          OpEventGetFaultDetectionCounter_GetFaultDetectionCounter_EvtInfo_SecondaryEve_20F300: RteEventRef=OpEventGetFaultDetectionCounter_GetFaultDetectionCounter_EvtInfo_SecondaryEve_20F300
          OpEventGetEventTested_GetEventTested_EvtInfo_SecondaryEve_31F100: RteEventRef=OpEventGetEventTested_GetEventTested_EvtInfo_SecondaryEve_31F100
          OpEventGetFaultDetectionCounter_GetFaultDetectionCounter_Event_SecondaryEve_21F100: RteEventRef=OpEventGetFaultDetectionCounter_GetFaultDetectionCounter_Event_SecondaryEve_21F100
          OpEventGetMonitorStatus_GetMonitorStatus_EvtInfo_PriEve4822E4_SecEve21F100: RteEventRef=OpEventGetMonitorStatus_GetMonitorStatus_EvtInfo_PriEve4822E4_SecEve21F100
          OpEventGetEventFailed_GetEventFailed_Event_PriEve4822E4_SecEve21F100: RteEventRef=OpEventGetEventFailed_GetEventFailed_Event_PriEve4822E4_SecEve21F100
          OpEventGetFaultDetectionCounter_GetFaultDetectionCounter_EvtInfo_SecondaryEve_21F300: RteEventRef=OpEventGetFaultDetectionCounter_GetFaultDetectionCounter_EvtInfo_SecondaryEve_21F300
          OpEventGetDTCOfEvent_GetDTCOfEvent_Event_SecondaryEve_21F300: RteEventRef=OpEventGetDTCOfEvent_GetDTCOfEvent_Event_SecondaryEve_21F300
          OpEventGetEventTested_GetEventTested_Event_SecondaryEve_31F100: RteEventRef=OpEventGetEventTested_GetEventTested_Event_SecondaryEve_31F100
          OpEventGetEventExtendedDataRecordEx_GetEventExtendedDataRecordEx_EvtInfo_SecondaryEve_20F300: RteEventRef=OpEventGetEventExtendedDataRecordEx_GetEventExtendedDataRecordEx_EvtInfo_SecondaryEve_20F300
          OpEventGetEventExtendedDataRecordEx_GetEventExtendedDataRecordEx_Event_PriEve4822F5_SecEve21F300: RteEventRef=OpEventGetEventExtendedDataRecordEx_GetEventExtendedDataRecordEx_Event_PriEve4822F5_SecEve21F300
          OpEventGetDTCOfEvent_GetDTCOfEvent_Event_PriEve4822E4_SecEve21F100: RteEventRef=OpEventGetDTCOfEvent_GetDTCOfEvent_Event_PriEve4822E4_SecEve21F100
          OpEventGetMonitorStatus_GetMonitorStatus_EvtInfo_SecondaryEve_21F100: RteEventRef=OpEventGetMonitorStatus_GetMonitorStatus_EvtInfo_SecondaryEve_21F100
          OpEventGetMonitorStatus_GetMonitorStatus_EvtInfo_SecondaryEve_31F300: RteEventRef=OpEventGetMonitorStatus_GetMonitorStatus_EvtInfo_SecondaryEve_31F300
          OpEventSetEventStatus_SetEventStatus_Event_SecondaryEve_20F300: RteEventRef=OpEventSetEventStatus_SetEventStatus_Event_SecondaryEve_20F300
          OpEventGetEventExtendedDataRecordEx_GetEventExtendedDataRecordEx_EvtInfo_SecondaryEve_21F300: RteEventRef=OpEventGetEventExtendedDataRecordEx_GetEventExtendedDataRecordEx_EvtInfo_SecondaryEve_21F300
          OpEventGetEventFreezeFrameDataEx_GetEventFreezeFrameDataEx_EvtInfo_SecondaryEve_21F300: RteEventRef=OpEventGetEventFreezeFrameDataEx_GetEventFreezeFrameDataEx_EvtInfo_SecondaryEve_21F300
          OpEventGetEventTested_GetEventTested_EvtInfo_SecondaryEve_21F300: RteEventRef=OpEventGetEventTested_GetEventTested_EvtInfo_SecondaryEve_21F300
          OpEventGetDTCOfEvent_GetDTCOfEvent_Event_PriEve4822F5_SecEve21F300: RteEventRef=OpEventGetDTCOfEvent_GetDTCOfEvent_Event_PriEve4822F5_SecEve21F300
          OpEventGetDTCOfEvent_GetDTCOfEvent_Event_SecondaryEve_31F100: RteEventRef=OpEventGetDTCOfEvent_GetDTCOfEvent_Event_SecondaryEve_31F100
          OpEventGetEventUdsStatus_GetEventUdsStatus_EvtInfo_PriEve4822E4_SecEve31F100: RteEventRef=OpEventGetEventUdsStatus_GetEventUdsStatus_EvtInfo_PriEve4822E4_SecEve31F100
          OpEventGetEventFailed_GetEventFailed_Event_SecondaryEve_21F300: RteEventRef=OpEventGetEventFailed_GetEventFailed_Event_SecondaryEve_21F300
          OpEventGetDebouncingOfEvent_GetDebouncingOfEvent_EvtInfo_PriEve4822F5_SecEve21F300: RteEventRef=OpEventGetDebouncingOfEvent_GetDebouncingOfEvent_EvtInfo_PriEve4822F5_SecEve21F300
          OpEventGetEventEnableCondition_GetEventEnableCondition_EvtInfo_SecondaryEve_20F300: RteEventRef=OpEventGetEventEnableCondition_GetEventEnableCondition_EvtInfo_SecondaryEve_20F300
          OpEventGetEventStatus_GetEventStatus_Event_SecondaryEve_21F100: RteEventRef=OpEventGetEventStatus_GetEventStatus_Event_SecondaryEve_21F100
          OpEventGetEventUdsStatus_GetEventUdsStatus_Event_SecondaryEve_20F300: RteEventRef=OpEventGetEventUdsStatus_GetEventUdsStatus_Event_SecondaryEve_20F300
          OpEventSetEventStatus_SetEventStatus_Event_PriEve4822F5_SecEve21F300: RteEventRef=OpEventSetEventStatus_SetEventStatus_Event_PriEve4822F5_SecEve21F300
          OpEventGetFaultDetectionCounter_GetFaultDetectionCounter_Event_PriEve4822F5_SecEve31F300: RteEventRef=OpEventGetFaultDetectionCounter_GetFaultDetectionCounter_Event_PriEve4822F5_SecEve31F300
          OpEventGetEventFreezeFrameDataEx_GetEventFreezeFrameDataEx_EvtInfo_SecondaryEve_21F100: RteEventRef=OpEventGetEventFreezeFrameDataEx_GetEventFreezeFrameDataEx_EvtInfo_SecondaryEve_21F100
          OpEventGetDebouncingOfEvent_GetDebouncingOfEvent_EvtInfo_SecondaryEve_20F300: RteEventRef=OpEventGetDebouncingOfEvent_GetDebouncingOfEvent_EvtInfo_SecondaryEve_20F300
          OpEventGetDTCOfEvent_GetDTCOfEvent_EvtInfo_PriEve4822E4_SecEve21F100: RteEventRef=OpEventGetDTCOfEvent_GetDTCOfEvent_EvtInfo_PriEve4822E4_SecEve21F100
          OpEventGetEventFailed_GetEventFailed_EvtInfo_SecondaryEve_31F300: RteEventRef=OpEventGetEventFailed_GetEventFailed_EvtInfo_SecondaryEve_31F300
          OpEventGetFaultDetectionCounter_GetFaultDetectionCounter_Event_SecondaryEve_31F300: RteEventRef=OpEventGetFaultDetectionCounter_GetFaultDetectionCounter_Event_SecondaryEve_31F300
          OpEventGetEventUdsStatus_GetEventUdsStatus_Event_PriEve4822E4_SecEve21F100: RteEventRef=OpEventGetEventUdsStatus_GetEventUdsStatus_Event_PriEve4822E4_SecEve21F100
          OpEventGetDTCOfEvent_GetDTCOfEvent_Event_PriEve4822F5_SecEve31F300: RteEventRef=OpEventGetDTCOfEvent_GetDTCOfEvent_Event_PriEve4822F5_SecEve31F300
          OpEventGetEventEnableCondition_GetEventEnableCondition_EvtInfo_PriEve4822E4_SecEve31F100: RteEventRef=OpEventGetEventEnableCondition_GetEventEnableCondition_EvtInfo_PriEve4822E4_SecEve31F100
          OpEventResetEventStatus_ResetEventStatus_Event_PriEve4822F5_SecEve21F300: RteEventRef=OpEventResetEventStatus_ResetEventStatus_Event_PriEve4822F5_SecEve21F300
          OpEventGetEventStatus_GetEventStatus_EvtInfo_SecondaryEve_20F300: RteEventRef=OpEventGetEventStatus_GetEventStatus_EvtInfo_SecondaryEve_20F300
          OpEventGetEventFreezeFrameDataEx_GetEventFreezeFrameDataEx_Event_PriEve4822F5_SecEve21F300: RteEventRef=OpEventGetEventFreezeFrameDataEx_GetEventFreezeFrameDataEx_Event_PriEve4822F5_SecEve21F300
          OpEventResetEventDebounceStatus_ResetEventDebounceStatus_Event_SecondaryEve_21F100: RteEventRef=OpEventResetEventDebounceStatus_ResetEventDebounceStatus_Event_SecondaryEve_21F100
          OpEventSetEventStatus_SetEventStatus_Event_PriEve4822F5_SecEve31F300: RteEventRef=OpEventSetEventStatus_SetEventStatus_Event_PriEve4822F5_SecEve31F300
          OpEventGetMonitorStatus_GetMonitorStatus_EvtInfo_SecondaryEve_31F100: RteEventRef=OpEventGetMonitorStatus_GetMonitorStatus_EvtInfo_SecondaryEve_31F100
          OpEventGetEventFailed_GetEventFailed_EvtInfo_SecondaryEve_31F100: RteEventRef=OpEventGetEventFailed_GetEventFailed_EvtInfo_SecondaryEve_31F100
          OpEventGetDTCOfEvent_GetDTCOfEvent_Event_SecondaryEve_30F300: RteEventRef=OpEventGetDTCOfEvent_GetDTCOfEvent_Event_SecondaryEve_30F300
          OpEventSetEventStatus_SetEventStatus_Event_SecondaryEve_21F100: RteEventRef=OpEventSetEventStatus_SetEventStatus_Event_SecondaryEve_21F100
          OpEventGetEventUdsStatus_GetEventUdsStatus_Event_PriEve4822F5_SecEve21F300: RteEventRef=OpEventGetEventUdsStatus_GetEventUdsStatus_Event_PriEve4822F5_SecEve21F300
          OpEventGetFaultDetectionCounter_GetFaultDetectionCounter_Event_SecondaryEve_31F100: RteEventRef=OpEventGetFaultDetectionCounter_GetFaultDetectionCounter_Event_SecondaryEve_31F100
          OpEventGetEventStatus_GetEventStatus_EvtInfo_PriEve4822F5_SecEve21F300: RteEventRef=OpEventGetEventStatus_GetEventStatus_EvtInfo_PriEve4822F5_SecEve21F300
          OpEventGetEventStatus_GetEventStatus_EvtInfo_SecondaryEve_30F300: RteEventRef=OpEventGetEventStatus_GetEventStatus_EvtInfo_SecondaryEve_30F300
          OpEventGetEventUdsStatus_GetEventUdsStatus_EvtInfo_SecondaryEve_31F100: RteEventRef=OpEventGetEventUdsStatus_GetEventUdsStatus_EvtInfo_SecondaryEve_31F100
          OpEventGetDTCOfEvent_GetDTCOfEvent_EvtInfo_PriEve4822F5_SecEve31F300: RteEventRef=OpEventGetDTCOfEvent_GetDTCOfEvent_EvtInfo_PriEve4822F5_SecEve31F300
          OpEventGetEventStatus_GetEventStatus_Event_SecondaryEve_31F300: RteEventRef=OpEventGetEventStatus_GetEventStatus_Event_SecondaryEve_31F300
          OpEventGetMonitorStatus_GetMonitorStatus_EvtInfo_SecondaryEve_21F300: RteEventRef=OpEventGetMonitorStatus_GetMonitorStatus_EvtInfo_SecondaryEve_21F300
          OpEventResetEventDebounceStatus_ResetEventDebounceStatus_Event_PriEve4822E4_SecEve31F100: RteEventRef=OpEventResetEventDebounceStatus_ResetEventDebounceStatus_Event_PriEve4822E4_SecEve31F100
          OpEventGetEventStatus_GetEventStatus_Event_SecondaryEve_31F100: RteEventRef=OpEventGetEventStatus_GetEventStatus_Event_SecondaryEve_31F100
          OpEventGetEventEnableCondition_GetEventEnableCondition_EvtInfo_SecondaryEve_30F300: RteEventRef=OpEventGetEventEnableCondition_GetEventEnableCondition_EvtInfo_SecondaryEve_30F300
          OpEventGetEventEnableCondition_GetEventEnableCondition_EvtInfo_PriEve4822F5_SecEve21F300: RteEventRef=OpEventGetEventEnableCondition_GetEventEnableCondition_EvtInfo_PriEve4822F5_SecEve21F300
          OpEventGetDTCOfEvent_GetDTCOfEvent_EvtInfo_SecondaryEve_21F100: RteEventRef=OpEventGetDTCOfEvent_GetDTCOfEvent_EvtInfo_SecondaryEve_21F100
          OpEventGetEventStatus_GetEventStatus_EvtInfo_SecondaryEve_21F300: RteEventRef=OpEventGetEventStatus_GetEventStatus_EvtInfo_SecondaryEve_21F300
          OpEventSetEventStatus_SetEventStatus_Event_SecondaryEve_31F100: RteEventRef=OpEventSetEventStatus_SetEventStatus_Event_SecondaryEve_31F100
          OpEventGetEventUdsStatus_GetEventUdsStatus_EvtInfo_PriEve4822F5_SecEve21F300: RteEventRef=OpEventGetEventUdsStatus_GetEventUdsStatus_EvtInfo_PriEve4822F5_SecEve21F300
          OpEventGetEventFreezeFrameDataEx_GetEventFreezeFrameDataEx_EvtInfo_SecondaryEve_30F300: RteEventRef=OpEventGetEventFreezeFrameDataEx_GetEventFreezeFrameDataEx_EvtInfo_SecondaryEve_30F300
          OpEventGetDTCOfEvent_GetDTCOfEvent_EvtInfo_PriEve4822F5_SecEve21F300: RteEventRef=OpEventGetDTCOfEvent_GetDTCOfEvent_EvtInfo_PriEve4822F5_SecEve21F300
          OpEventGetEventFailed_GetEventFailed_EvtInfo_PriEve4822F5_SecEve21F300: RteEventRef=OpEventGetEventFailed_GetEventFailed_EvtInfo_PriEve4822F5_SecEve21F300
          OpEventGetEventStatus_GetEventStatus_EvtInfo_PriEve4822F5_SecEve31F300: RteEventRef=OpEventGetEventStatus_GetEventStatus_EvtInfo_PriEve4822F5_SecEve31F300
          OpEventGetEventFailed_GetEventFailed_EvtInfo_SecondaryEve_20F300: RteEventRef=OpEventGetEventFailed_GetEventFailed_EvtInfo_SecondaryEve_20F300
          OpEventGetEventFreezeFrameDataEx_GetEventFreezeFrameDataEx_Event_SecondaryEve_31F100: RteEventRef=OpEventGetEventFreezeFrameDataEx_GetEventFreezeFrameDataEx_Event_SecondaryEve_31F100
          OpEventGetEventTested_GetEventTested_Event_SecondaryEve_31F300: RteEventRef=OpEventGetEventTested_GetEventTested_Event_SecondaryEve_31F300
          OpEventGetEventUdsStatus_GetEventUdsStatus_EvtInfo_SecondaryEve_21F100: RteEventRef=OpEventGetEventUdsStatus_GetEventUdsStatus_EvtInfo_SecondaryEve_21F100
          OpEventGetEventEnableCondition_GetEventEnableCondition_EvtInfo_SecondaryEve_31F100: RteEventRef=OpEventGetEventEnableCondition_GetEventEnableCondition_EvtInfo_SecondaryEve_31F100
          OpEventGetEventTested_GetEventTested_EvtInfo_SecondaryEve_20F300: RteEventRef=OpEventGetEventTested_GetEventTested_EvtInfo_SecondaryEve_20F300
          OpEventResetEventStatus_ResetEventStatus_Event_PriEve4822E4_SecEve31F100: RteEventRef=OpEventResetEventStatus_ResetEventStatus_Event_PriEve4822E4_SecEve31F100
          OpEventGetFaultDetectionCounter_GetFaultDetectionCounter_EvtInfo_SecondaryEve_31F300: RteEventRef=OpEventGetFaultDetectionCounter_GetFaultDetectionCounter_EvtInfo_SecondaryEve_31F300
          OpEventGetEventExtendedDataRecordEx_GetEventExtendedDataRecordEx_EvtInfo_PriEve4822E4_SecEve21F100: RteEventRef=OpEventGetEventExtendedDataRecordEx_GetEventExtendedDataRecordEx_EvtInfo_PriEve4822E4_SecEve21F100
          OpEventGetEventFreezeFrameDataEx_GetEventFreezeFrameDataEx_Event_SecondaryEve_31F300: RteEventRef=OpEventGetEventFreezeFrameDataEx_GetEventFreezeFrameDataEx_Event_SecondaryEve_31F300
          OpEventResetEventDebounceStatus_ResetEventDebounceStatus_Event_PriEve4822F5_SecEve21F300: RteEventRef=OpEventResetEventDebounceStatus_ResetEventDebounceStatus_Event_PriEve4822F5_SecEve21F300
          OpEventGetEventStatus_GetEventStatus_Event_SecondaryEve_30F300: RteEventRef=OpEventGetEventStatus_GetEventStatus_Event_SecondaryEve_30F300
          OpEventResetEventStatus_ResetEventStatus_Event_SecondaryEve_21F100: RteEventRef=OpEventResetEventStatus_ResetEventStatus_Event_SecondaryEve_21F100
          OpEventGetEventTested_GetEventTested_Event_PriEve4822F5_SecEve21F300: RteEventRef=OpEventGetEventTested_GetEventTested_Event_PriEve4822F5_SecEve21F300
          OpEventGetEventExtendedDataRecordEx_GetEventExtendedDataRecordEx_EvtInfo_PriEve4822F5_SecEve21F300: RteEventRef=OpEventGetEventExtendedDataRecordEx_GetEventExtendedDataRecordEx_EvtInfo_PriEve4822F5_SecEve21F300
          OpEventGetEventExtendedDataRecordEx_GetEventExtendedDataRecordEx_EvtInfo_SecondaryEve_21F100: RteEventRef=OpEventGetEventExtendedDataRecordEx_GetEventExtendedDataRecordEx_EvtInfo_SecondaryEve_21F100
          OpEventGetEventFreezeFrameDataEx_GetEventFreezeFrameDataEx_Event_PriEve4822E4_SecEve31F100: RteEventRef=OpEventGetEventFreezeFrameDataEx_GetEventFreezeFrameDataEx_Event_PriEve4822E4_SecEve31F100
          OpEventGetEventFailed_GetEventFailed_Event_SecondaryEve_30F300: RteEventRef=OpEventGetEventFailed_GetEventFailed_Event_SecondaryEve_30F300
          OpEventSetEventStatus_SetEventStatus_Event_SecondaryEve_30F300: RteEventRef=OpEventSetEventStatus_SetEventStatus_Event_SecondaryEve_30F300
          OpEventGetEventStatus_GetEventStatus_Event_PriEve4822F5_SecEve21F300: RteEventRef=OpEventGetEventStatus_GetEventStatus_Event_PriEve4822F5_SecEve21F300
          OpEventGetEventEnableCondition_GetEventEnableCondition_EvtInfo_SecondaryEve_31F300: RteEventRef=OpEventGetEventEnableCondition_GetEventEnableCondition_EvtInfo_SecondaryEve_31F300
          OpEventGetEventFailed_GetEventFailed_EvtInfo_SecondaryEve_21F300: RteEventRef=OpEventGetEventFailed_GetEventFailed_EvtInfo_SecondaryEve_21F300
          OpEventGetEventFailed_GetEventFailed_Event_PriEve4822F5_SecEve21F300: RteEventRef=OpEventGetEventFailed_GetEventFailed_Event_PriEve4822F5_SecEve21F300
          OpEventGetFaultDetectionCounter_GetFaultDetectionCounter_Event_SecondaryEve_21F300: RteEventRef=OpEventGetFaultDetectionCounter_GetFaultDetectionCounter_Event_SecondaryEve_21F300
          OpEventGetEventExtendedDataRecordEx_GetEventExtendedDataRecordEx_Event_PriEve4822E4_SecEve21F100: RteEventRef=OpEventGetEventExtendedDataRecordEx_GetEventExtendedDataRecordEx_Event_PriEve4822E4_SecEve21F100
          OpEventGetEventStatus_GetEventStatus_EvtInfo_SecondaryEve_31F100: RteEventRef=OpEventGetEventStatus_GetEventStatus_EvtInfo_SecondaryEve_31F100
          OpEventGetEventUdsStatus_GetEventUdsStatus_Event_SecondaryEve_30F300: RteEventRef=OpEventGetEventUdsStatus_GetEventUdsStatus_Event_SecondaryEve_30F300
          OpEventGetFaultDetectionCounter_GetFaultDetectionCounter_Event_SecondaryEve_20F300: RteEventRef=OpEventGetFaultDetectionCounter_GetFaultDetectionCounter_Event_SecondaryEve_20F300
          OpEventGetFaultDetectionCounter_GetFaultDetectionCounter_Event_PriEve4822F5_SecEve21F300: RteEventRef=OpEventGetFaultDetectionCounter_GetFaultDetectionCounter_Event_PriEve4822F5_SecEve21F300
          OpEventGetEventFreezeFrameDataEx_GetEventFreezeFrameDataEx_Event_SecondaryEve_21F100: RteEventRef=OpEventGetEventFreezeFrameDataEx_GetEventFreezeFrameDataEx_Event_SecondaryEve_21F100
          OpEventGetEventFreezeFrameDataEx_GetEventFreezeFrameDataEx_EvtInfo_SecondaryEve_31F300: RteEventRef=OpEventGetEventFreezeFrameDataEx_GetEventFreezeFrameDataEx_EvtInfo_SecondaryEve_31F300
          OpEventGetDebouncingOfEvent_GetDebouncingOfEvent_EvtInfo_SecondaryEve_21F100: RteEventRef=OpEventGetDebouncingOfEvent_GetDebouncingOfEvent_EvtInfo_SecondaryEve_21F100
          OpEventGetEventUdsStatus_GetEventUdsStatus_Event_SecondaryEve_21F100: RteEventRef=OpEventGetEventUdsStatus_GetEventUdsStatus_Event_SecondaryEve_21F100
          OpEventGetEventUdsStatus_GetEventUdsStatus_Event_SecondaryEve_31F300: RteEventRef=OpEventGetEventUdsStatus_GetEventUdsStatus_Event_SecondaryEve_31F300
          OpEventGetEventUdsStatus_GetEventUdsStatus_Event_SecondaryEve_31F100: RteEventRef=OpEventGetEventUdsStatus_GetEventUdsStatus_Event_SecondaryEve_31F100
          OpEventGetEventExtendedDataRecordEx_GetEventExtendedDataRecordEx_Event_PriEve4822F5_SecEve31F300: RteEventRef=OpEventGetEventExtendedDataRecordEx_GetEventExtendedDataRecordEx_Event_PriEve4822F5_SecEve31F300
          OpEventGetEventUdsStatus_GetEventUdsStatus_EvtInfo_PriEve4822E4_SecEve21F100: RteEventRef=OpEventGetEventUdsStatus_GetEventUdsStatus_EvtInfo_PriEve4822E4_SecEve21F100
          OpEventGetEventTested_GetEventTested_EvtInfo_SecondaryEve_30F300: RteEventRef=OpEventGetEventTested_GetEventTested_EvtInfo_SecondaryEve_30F300
          OpEventGetFaultDetectionCounter_GetFaultDetectionCounter_EvtInfo_SecondaryEve_31F100: RteEventRef=OpEventGetFaultDetectionCounter_GetFaultDetectionCounter_EvtInfo_SecondaryEve_31F100
          OpEventResetEventDebounceStatus_ResetEventDebounceStatus_Event_SecondaryEve_31F300: RteEventRef=OpEventResetEventDebounceStatus_ResetEventDebounceStatus_Event_SecondaryEve_31F300
          OpEventGetEventFreezeFrameDataEx_GetEventFreezeFrameDataEx_EvtInfo_PriEve4822E4_SecEve31F100: RteEventRef=OpEventGetEventFreezeFrameDataEx_GetEventFreezeFrameDataEx_EvtInfo_PriEve4822E4_SecEve31F100
          OpEventResetEventDebounceStatus_ResetEventDebounceStatus_Event_SecondaryEve_20F300: RteEventRef=OpEventResetEventDebounceStatus_ResetEventDebounceStatus_Event_SecondaryEve_20F300
          OpEventResetEventStatus_ResetEventStatus_Event_SecondaryEve_20F300: RteEventRef=OpEventResetEventStatus_ResetEventStatus_Event_SecondaryEve_20F300
          OpEventGetEventStatus_GetEventStatus_Event_PriEve4822F5_SecEve31F300: RteEventRef=OpEventGetEventStatus_GetEventStatus_Event_PriEve4822F5_SecEve31F300
          OpEventGetDTCOfEvent_GetDTCOfEvent_EvtInfo_SecondaryEve_31F100: RteEventRef=OpEventGetDTCOfEvent_GetDTCOfEvent_EvtInfo_SecondaryEve_31F100
          OpEventGetEventFailed_GetEventFailed_Event_SecondaryEve_20F300: RteEventRef=OpEventGetEventFailed_GetEventFailed_Event_SecondaryEve_20F300
          OpEventGetFaultDetectionCounter_GetFaultDetectionCounter_EvtInfo_PriEve4822E4_SecEve31F100: RteEventRef=OpEventGetFaultDetectionCounter_GetFaultDetectionCounter_EvtInfo_PriEve4822E4_SecEve31F100
          OpEventResetEventStatus_ResetEventStatus_Event_SecondaryEve_31F300: RteEventRef=OpEventResetEventStatus_ResetEventStatus_Event_SecondaryEve_31F300
          OpEventGetMonitorStatus_GetMonitorStatus_EvtInfo_SecondaryEve_20F300: RteEventRef=OpEventGetMonitorStatus_GetMonitorStatus_EvtInfo_SecondaryEve_20F300
          OpEventGetEventStatus_GetEventStatus_Event_SecondaryEve_20F300: RteEventRef=OpEventGetEventStatus_GetEventStatus_Event_SecondaryEve_20F300
          OpEventGetEventStatus_GetEventStatus_EvtInfo_PriEve4822E4_SecEve21F100: RteEventRef=OpEventGetEventStatus_GetEventStatus_EvtInfo_PriEve4822E4_SecEve21F100
          OpEventGetFaultDetectionCounter_GetFaultDetectionCounter_Event_PriEve4822E4_SecEve31F100: RteEventRef=OpEventGetFaultDetectionCounter_GetFaultDetectionCounter_Event_PriEve4822E4_SecEve31F100
          OpEventGetEventFailed_GetEventFailed_Event_SecondaryEve_31F100: RteEventRef=OpEventGetEventFailed_GetEventFailed_Event_SecondaryEve_31F100
          OpEventGetEventFreezeFrameDataEx_GetEventFreezeFrameDataEx_Event_PriEve4822E4_SecEve21F100: RteEventRef=OpEventGetEventFreezeFrameDataEx_GetEventFreezeFrameDataEx_Event_PriEve4822E4_SecEve21F100
          OpEventGetEventStatus_GetEventStatus_EvtInfo_SecondaryEve_31F300: RteEventRef=OpEventGetEventStatus_GetEventStatus_EvtInfo_SecondaryEve_31F300
          OpEventResetEventStatus_ResetEventStatus_Event_SecondaryEve_21F300: RteEventRef=OpEventResetEventStatus_ResetEventStatus_Event_SecondaryEve_21F300
          OpEventGetEventStatus_GetEventStatus_Event_PriEve4822E4_SecEve31F100: RteEventRef=OpEventGetEventStatus_GetEventStatus_Event_PriEve4822E4_SecEve31F100
          OpEventGetEventUdsStatus_GetEventUdsStatus_EvtInfo_SecondaryEve_31F300: RteEventRef=OpEventGetEventUdsStatus_GetEventUdsStatus_EvtInfo_SecondaryEve_31F300
          OpEventGetEventExtendedDataRecordEx_GetEventExtendedDataRecordEx_EvtInfo_SecondaryEve_30F300: RteEventRef=OpEventGetEventExtendedDataRecordEx_GetEventExtendedDataRecordEx_EvtInfo_SecondaryEve_30F300
          OpEventGetDebouncingOfEvent_GetDebouncingOfEvent_EvtInfo_PriEve4822E4_SecEve31F100: RteEventRef=OpEventGetDebouncingOfEvent_GetDebouncingOfEvent_EvtInfo_PriEve4822E4_SecEve31F100
          OpEventGetEventExtendedDataRecordEx_GetEventExtendedDataRecordEx_EvtInfo_PriEve4822E4_SecEve31F100: RteEventRef=OpEventGetEventExtendedDataRecordEx_GetEventExtendedDataRecordEx_EvtInfo_PriEve4822E4_SecEve31F100
          OpEventGetDebouncingOfEvent_GetDebouncingOfEvent_EvtInfo_PriEve4822F5_SecEve31F300: RteEventRef=OpEventGetDebouncingOfEvent_GetDebouncingOfEvent_EvtInfo_PriEve4822F5_SecEve31F300
          OpEventGetEventUdsStatus_GetEventUdsStatus_Event_SecondaryEve_21F300: RteEventRef=OpEventGetEventUdsStatus_GetEventUdsStatus_Event_SecondaryEve_21F300
          OpEventSetEventStatus_SetEventStatus_Event_PriEve4822E4_SecEve31F100: RteEventRef=OpEventSetEventStatus_SetEventStatus_Event_PriEve4822E4_SecEve31F100
          OpEventGetDTCOfEvent_GetDTCOfEvent_EvtInfo_SecondaryEve_20F300: RteEventRef=OpEventGetDTCOfEvent_GetDTCOfEvent_EvtInfo_SecondaryEve_20F300
          OpEventGetEventUdsStatus_GetEventUdsStatus_Event_PriEve4822F5_SecEve31F300: RteEventRef=OpEventGetEventUdsStatus_GetEventUdsStatus_Event_PriEve4822F5_SecEve31F300
          OpEventGetEventTested_GetEventTested_EvtInfo_SecondaryEve_21F100: RteEventRef=OpEventGetEventTested_GetEventTested_EvtInfo_SecondaryEve_21F100
          OpEventGetEventFreezeFrameDataEx_GetEventFreezeFrameDataEx_EvtInfo_SecondaryEve_20F300: RteEventRef=OpEventGetEventFreezeFrameDataEx_GetEventFreezeFrameDataEx_EvtInfo_SecondaryEve_20F300
          OpEventGetEventFailed_GetEventFailed_EvtInfo_PriEve4822E4_SecEve31F100: RteEventRef=OpEventGetEventFailed_GetEventFailed_EvtInfo_PriEve4822E4_SecEve31F100
          OpEventGetMonitorStatus_GetMonitorStatus_EvtInfo_PriEve4822F5_SecEve31F300: RteEventRef=OpEventGetMonitorStatus_GetMonitorStatus_EvtInfo_PriEve4822F5_SecEve31F300
          OpEventGetEventFailed_GetEventFailed_EvtInfo_PriEve4822F5_SecEve31F300: RteEventRef=OpEventGetEventFailed_GetEventFailed_EvtInfo_PriEve4822F5_SecEve31F300
          OpEventGetEventExtendedDataRecordEx_GetEventExtendedDataRecordEx_Event_SecondaryEve_21F100: RteEventRef=OpEventGetEventExtendedDataRecordEx_GetEventExtendedDataRecordEx_Event_SecondaryEve_21F100
          OpEventGetEventExtendedDataRecordEx_GetEventExtendedDataRecordEx_Event_SecondaryEve_20F300: RteEventRef=OpEventGetEventExtendedDataRecordEx_GetEventExtendedDataRecordEx_Event_SecondaryEve_20F300
          OpEventGetEventExtendedDataRecordEx_GetEventExtendedDataRecordEx_Event_SecondaryEve_21F300: RteEventRef=OpEventGetEventExtendedDataRecordEx_GetEventExtendedDataRecordEx_Event_SecondaryEve_21F300
          OpEventGetEventTested_GetEventTested_EvtInfo_SecondaryEve_31F300: RteEventRef=OpEventGetEventTested_GetEventTested_EvtInfo_SecondaryEve_31F300
          OpEventResetEventDebounceStatus_ResetEventDebounceStatus_Event_SecondaryEve_30F300: RteEventRef=OpEventResetEventDebounceStatus_ResetEventDebounceStatus_Event_SecondaryEve_30F300
          OpEventGetEventTested_GetEventTested_EvtInfo_PriEve4822E4_SecEve31F100: RteEventRef=OpEventGetEventTested_GetEventTested_EvtInfo_PriEve4822E4_SecEve31F100
          OpEventGetDebouncingOfEvent_GetDebouncingOfEvent_EvtInfo_SecondaryEve_21F300: RteEventRef=OpEventGetDebouncingOfEvent_GetDebouncingOfEvent_EvtInfo_SecondaryEve_21F300
          OpEventGetEventUdsStatus_GetEventUdsStatus_EvtInfo_PriEve4822F5_SecEve31F300: RteEventRef=OpEventGetEventUdsStatus_GetEventUdsStatus_EvtInfo_PriEve4822F5_SecEve31F300
          OpEventResetEventDebounceStatus_ResetEventDebounceStatus_Event_SecondaryEve_31F100: RteEventRef=OpEventResetEventDebounceStatus_ResetEventDebounceStatus_Event_SecondaryEve_31F100
          OpEventGetDebouncingOfEvent_GetDebouncingOfEvent_EvtInfo_PriEve4822E4_SecEve21F100: RteEventRef=OpEventGetDebouncingOfEvent_GetDebouncingOfEvent_EvtInfo_PriEve4822E4_SecEve21F100
          OpEventGetFaultDetectionCounter_GetFaultDetectionCounter_EvtInfo_PriEve4822F5_SecEve21F300: RteEventRef=OpEventGetFaultDetectionCounter_GetFaultDetectionCounter_EvtInfo_PriEve4822F5_SecEve21F300
          OpEventGetEventTested_GetEventTested_Event_SecondaryEve_21F100: RteEventRef=OpEventGetEventTested_GetEventTested_Event_SecondaryEve_21F100
          OpEventGetEventExtendedDataRecordEx_GetEventExtendedDataRecordEx_Event_SecondaryEve_31F300: RteEventRef=OpEventGetEventExtendedDataRecordEx_GetEventExtendedDataRecordEx_Event_SecondaryEve_31F300
      CmnMfgSrvIf_EcuSwComposition: RteSoftwareComponentInstanceRef=CmnMfgSrvIf
        CmnMfgSrvIf_InitEvent (RteEventToTaskMapping): RteImmediateRestart=false, RtePositionInTask=109, RteEventRef=CmnMfgSrvIf_InitEvent, RteMappedToTaskRef=Task_Init_Appl10
    CmnMfgSrvIf (RteSwComponentType): RteComponentTypeRef=CmnMfgSrvIf, RteImplementationRef=CmnMfgSrvIf_Implementation
      ComponentTypeCalibration (RteComponentTypeCalibration): RteCalibrationSupportEnabled=true
    DemWrapper_EcuSwComposition (RteSwComponentInstance): RteSoftwareComponentInstanceRef=DemWrapper
      6 x RteEventToTaskMapping, all with RteImmediateRestart=false:
        OIT_DemWrapper_ApplicationDTCInfoPort_GetDTCOfEvent_DemWrapper_ApplicationDTCInfoPort_GetDTCOfEvent: RteEventRef=OIT_DemWrapper_ApplicationDTCInfoPort_GetDTCOfEvent_DemWrapper_ApplicationDTCInfoPort_GetDTCOfEvent
        OIT_DemWrapper_CddIf_ClearDTC_DemWrapper_CddIf_ClearDTC: RteEventRef=OIT_DemWrapper_CddIf_ClearDTC_DemWrapper_CddIf_ClearDTC
        OIT_DemWrapper_Darh_GeneralDiagnosticInfo_GetDTCOfEvent_DemWrapper_Darh_GeneralDiagnosticInfo_GetDTCOfEvent: RteEventRef=OIT_DemWrapper_Darh_GeneralDiagnosticInfo_GetDTCOfEvent_DemWrapper_Darh_GeneralDiagnosticInfo_GetDTCOfEvent
        OIT_DemWrapper_Darh_GeneralDiagnosticInfo_GetEventFreezeFrameData_DemWrapper_Darh_GeneralDiagnosticInfo_GetEventFreezeFrameData: RteEventRef=OIT_DemWrapper_Darh_GeneralDiagnosticInfo_GetEventFreezeFrameData_DemWrapper_Darh_GeneralDiagnosticInfo_GetEventFreezeFrameData
        DemWrapper_InitEvent: RtePositionInTask=110, RteEventRef=DemWrapper_InitEvent, RteMappedToTaskRef=Task_Init_Appl10
        OIT_DemWrapper_NetworkDTCInfoPort_GetDTCOfEvent_DemWrapper_NetworkDTCInfoPort_GetDTCOfEvent: RteEventRef=OIT_DemWrapper_NetworkDTCInfoPort_GetDTCOfEvent_DemWrapper_NetworkDTCInfoPort_GetDTCOfEvent
    DemWrapper (RteSwComponentType): RteComponentTypeRef=DemWrapper, RteImplementationRef=DemWrapper_Implementation
      ComponentTypeCalibration (RteComponentTypeCalibration): RteCalibrationSupportEnabled=true
    ProgMfgSrv_EcuSwComposition (RteSwComponentInstance): RteSoftwareComponentInstanceRef=ProgMfgSrv
      PartNrPer1_InitEvent (RteEventToTaskMapping): RteImmediateRestart=false, RtePositionInTask=80, RteEventRef=PartNrPer1_InitEvent, RteMappedToTaskRef=Task_Init_Appl10
