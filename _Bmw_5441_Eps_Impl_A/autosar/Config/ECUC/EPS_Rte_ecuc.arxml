[part 2 of 4: package /ActiveEcuC]
AUTOSAR XML (schema 4-3-0)
package /ActiveEcuC  (continued)
  module config Rte: implementation-config-variant=VARIANT-PRE-COMPILE, module-description=Rte_Impl  (continued)
    10 x RteSwComponentType:
      McuErrInj: RteComponentTypeRef=McuErrInj, RteImplementationRef=McuErrInj_Implementation
        ComponentTypeCalibration (RteComponentTypeCalibration): RteCalibrationSupportEnabled=true
      DiagcMgr: RteComponentTypeRef=DiagcMgr, RteImplementationRef=DiagcMgr_Implementation
        ComponentTypeCalibration (RteComponentTypeCalibration): RteCalibrationSupportEnabled=true
      DiagcMgrProxyAppl10: RteComponentTypeRef=DiagcMgrProxyAppl10, RteImplementationRef=DiagcMgrProxyAppl10_Implementation
        ComponentTypeCalibration (RteComponentTypeCalibration): RteCalibrationSupportEnabled=true
      DiagcMgrStub: RteComponentTypeRef=DiagcMgrStub, RteImplementationRef=DiagcMgrStub_Implementation
        ComponentTypeCalibration (RteComponentTypeCalibration): RteCalibrationSupportEnabled=true
      CDD_NxtrTi: RteComponentTypeRef=CDD_NxtrTi, RteImplementationRef=CDD_NxtrTi_Implementation
        ComponentTypeCalibration (RteComponentTypeCalibration): RteCalibrationSupportEnabled=true
      CDD_ExcpnHndlg: RteComponentTypeRef=CDD_ExcpnHndlg, RteImplementationRef=CDD_ExcpnHndlg_Implementation
        ComponentTypeCalibration (RteComponentTypeCalibration): RteCalibrationSupportEnabled=true
      SysStMod: RteComponentTypeRef=SysStMod, RteImplementationRef=SysStMod_Implementation
        ComponentTypeCalibration (RteComponentTypeCalibration): RteCalibrationSupportEnabled=true
      CDD_NvMProxy: RteComponentTypeRef=CDD_NvMProxy, RteImplementationRef=CDD_NvMProxy_Implementation
        ComponentTypeCalibration (RteComponentTypeCalibration): RteCalibrationSupportEnabled=true
      McalErrHndlg: RteComponentTypeRef=McalErrHndlg, RteImplementationRef=McalErrHndlg_Implementation
        ComponentTypeCalibration (RteComponentTypeCalibration): RteCalibrationSupportEnabled=true
      NxtrMath: RteComponentTypeRef=NxtrMath, RteImplementationRef=NxtrMath_Implementation
        ComponentTypeCalibration (RteComponentTypeCalibration): RteCalibrationSupportEnabled=true
    Port (RteBswModuleInstance): RteBswImplementationRef=Port_Impl, RteBswModuleConfigurationRef=Port
      7 x RteBswExclusiveAreaImpl, all with RteExclusiveAreaImplMechanism=ALL_INTERRUPT_BLOCKING, RteExclusiveAreaOptimization=false:
        PORT_SET_PIN_MODE_PROTECTION: RteBswExclusiveAreaRef=PORT_SET_PIN_MODE_PROTECTION
        PORT_SET_PIN_DIR_PROTECTION: RteBswExclusiveAreaRef=PORT_SET_PIN_DIR_PROTECTION
        PORT_SET_TO_DIO_ALT_PROTECTION: RteBswExclusiveAreaRef=PORT_SET_TO_DIO_ALT_PROTECTION
        PORT_INIT_CONFIG_PROTECTION: RteBswExclusiveAreaRef=PORT_INIT_CONFIG_PROTECTION
        PORT_REFRESHPORT_INTERNAL_PROTECTION: RteBswExclusiveAreaRef=PORT_REFRESHPORT_INTERNAL_PROTECTION
        PORT_SET_PIN_DEFAULT_MODE_PROTECTION: RteBswExclusiveAreaRef=PORT_SET_PIN_DEFAULT_MODE_PROTECTION
        PORT_SET_PIN_DEFAULT_DIR_PROTECTION: RteBswExclusiveAreaRef=PORT_SET_PIN_DEFAULT_DIR_PROTECTION
    IoHwAb (RteBswModuleInstance): RteBswImplementationRef=IoHwAb_Impl, RteBswModuleConfigurationRef=IoHwAb
      IOHWAB_EXCLUSIVE_AREA_0 (RteBswExclusiveAreaImpl): RteExclusiveAreaImplMechanism=OS_INTERRUPT_BLOCKING, RteExclusiveAreaOptimization=false, RteBswExclusiveAreaRef=IOHWAB_EXCLUSIVE_AREA_0
    CDD_EcmOutpAndDiagc_EcuSwComposition (RteSwComponentInstance): RteSoftwareComponentInstanceRef=CDD_EcmOutpAndDiagc
      OIT_CtrlErrOut_Oper_CtrlErrOut_Oper (RteEventToTaskMapping): RteImmediateRestart=false, RteEventRef=OIT_CtrlErrOut_Oper_CtrlErrOut_Oper
      EcmOutpAndDiagcInit2_InitEvent (RteEventToTaskMapping): RteImmediateRestart=false, RtePositionInTask=10, RteEventRef=EcmOutpAndDiagcInit2_InitEvent, RteMappedToTaskRef=Task_Init_Appl10
    CDD_GuardCfgAndDiagc_EcuSwComposition (RteSwComponentInstance): RteSoftwareComponentInstanceRef=CDD_GuardCfgAndDiagc
      CDD_GuardCfgAndDiagc_InitEvent (RteEventToTaskMapping): RteImmediateRestart=false, RtePositionInTask=11, RteEventRef=CDD_GuardCfgAndDiagc_InitEvent, RteMappedToTaskRef=Task_Init_Appl10
    CDD_EcmOutpAndDiagc (RteSwComponentType): RteComponentTypeRef=CDD_EcmOutpAndDiagc, RteImplementationRef=CDD_EcmOutpAndDiagc_Implementation
      ComponentTypeCalibration (RteComponentTypeCalibration): RteCalibrationSupportEnabled=true
    CDD_GuardCfgAndDiagc (RteSwComponentType): RteComponentTypeRef=CDD_GuardCfgAndDiagc, RteImplementationRef=CDD_GuardCfgAndDiagc_Implementation
      ComponentTypeCalibration (RteComponentTypeCalibration): RteCalibrationSupportEnabled=true
    FltInj_EcuSwComposition (RteSwComponentInstance): RteSoftwareComponentInstanceRef=FltInj
      5 x RteEventToTaskMapping, all with RteImmediateRestart=false:
        OIT_FltInj_f32_Oper_FltInj_f32_Oper: RteEventRef=OIT_FltInj_f32_Oper_FltInj_f32_Oper
        OIT_FltInj_logl_Oper_FltInj_logl_Oper: RteEventRef=OIT_FltInj_logl_Oper_FltInj_logl_Oper
        OIT_FltInj_u08_Oper_FltInj_u08_Oper: RteEventRef=OIT_FltInj_u08_Oper_FltInj_u08_Oper
        OIT_FltInj_u0p16_Oper_FltInj_u0p16_Oper: RteEventRef=OIT_FltInj_u0p16_Oper_FltInj_u0p16_Oper
        TMT_FltInjPer1: RtePositionInTask=6, RteEventRef=TMT_FltInjPer1, RteMappedToTaskRef=Task_2msA_Appl10, RteUsedOsAlarmRef=Rte_Al_TE_Task_2msA_Appl10_0_2ms
    CDD_SyncCrc_EcuSwComposition (RteSwComponentInstance): RteSoftwareComponentInstanceRef=CDD_SyncCrc
      SyncCrcExclusiveArea (RteExclusiveAreaImplementation): RteExclusiveAreaImplMechanism=OS_INTERRUPT_BLOCKING, RteExclusiveAreaOptimization=false, RteExclusiveAreaRef=SyncCrcExclusiveArea
      9 x RteEventToTaskMapping, all with RteImmediateRestart=false:
        OIT_Calc16BitCrc_u08_Oper_Calc16BitCrc_u08_Oper: RteEventRef=OIT_Calc16BitCrc_u08_Oper_Calc16BitCrc_u08_Oper
        OIT_Calc16BitCrc_u16_Oper_Calc16BitCrc_u16_Oper: RteEventRef=OIT_Calc16BitCrc_u16_Oper_Calc16BitCrc_u16_Oper
        OIT_Calc32BitCrc_u08_Oper_Calc32BitCrc_u08_Oper: RteEventRef=OIT_Calc32BitCrc_u08_Oper_Calc32BitCrc_u08_Oper
        OIT_Calc32BitCrc_u16_Oper_Calc32BitCrc_u16_Oper: RteEventRef=OIT_Calc32BitCrc_u16_Oper_Calc32BitCrc_u16_Oper
        OIT_Calc32BitCrc_u32_Oper_Calc32BitCrc_u32_Oper: RteEventRef=OIT_Calc32BitCrc_u32_Oper_Calc32BitCrc_u32_Oper
        OIT_Calc8BitCrc_Oper_Calc8BitCrc_Oper: RteEventRef=OIT_Calc8BitCrc_Oper_Calc8BitCrc_Oper
        OIT_Calc8BitCrc0X2F_Oper_Calc8BitCrc0X2F_Oper: RteEventRef=OIT_Calc8BitCrc0X2F_Oper_Calc8BitCrc0X2F_Oper
        OIT_ResvCrcHwUnit_Oper_ResvCrcHwUnit_Oper: RteEventRef=OIT_ResvCrcHwUnit_Oper_ResvCrcHwUnit_Oper
        SyncCrcInit1_InitEvent: RtePositionInTask=57, RteEventRef=SyncCrcInit1_InitEvent, RteMappedToTaskRef=Task_Init_Appl10
    FltInj (RteSwComponentType): RteComponentTypeRef=FltInj, RteImplementationRef=FltInj_Implementation
      ComponentTypeCalibration (RteComponentTypeCalibration): RteCalibrationSupportEnabled=true
    CDD_SyncCrc (RteSwComponentType): RteComponentTypeRef=CDD_SyncCrc, RteImplementationRef=CDD_SyncCrc_Implementation
      ComponentTypeCalibration (RteComponentTypeCalibration): RteCalibrationSupportEnabled=true
    8 x RteSwComponentInstance:
      CDD_Tauj0CfgAndUse_EcuSwComposition: RteSoftwareComponentInstanceRef=CDD_Tauj0CfgAndUse
        Tauj0CfgAndUse_InitEvent (RteEventToTaskMapping): RteImmediateRestart=false, RtePositionInTask=28, RteEventRef=Tauj0CfgAndUse_InitEvent, RteMappedToTaskRef=Task_Init_Appl10
        TMT_Tauj0CfgAndUsePer1 (RteEventToTaskMapping):
          RteImmediateRestart = false
          RtePositionInTask = 2
          RteEventRef = TMT_Tauj0CfgAndUsePer1
          RteMappedToTaskRef = Task_2msA_Appl10
          RteUsedOsAlarmRef = Rte_Al_TE_Task_2msA_Appl10_0_2ms
      CDD_Adc0CfgAndUse_EcuSwComposition: RteSoftwareComponentInstanceRef=CDD_Adc0CfgAndUse
        CDD_Adc0CfgAndUse_InitEvent (RteEventToTaskMapping): RteImmediateRestart=false, RtePositionInTask=21, RteEventRef=CDD_Adc0CfgAndUse_InitEvent, RteMappedToTaskRef=Task_Init_Appl10
      CDD_AdcDiagc_EcuSwComposition: RteSoftwareComponentInstanceRef=CDD_AdcDiagc
        CDD_AdcDiagc_InitEvent (RteEventToTaskMapping): RteImmediateRestart=false, RtePositionInTask=62, RteEventRef=CDD_AdcDiagc_InitEvent, RteMappedToTaskRef=Task_Init_Appl10
        TMT_AdcDiagcPer1 (RteEventToTaskMapping):
          RteImmediateRestart = false
          RtePositionInTask = 11
          RteEventRef = TMT_AdcDiagcPer1
          RteMappedToTaskRef = Task_2msA_Appl10
          RteUsedOsAlarmRef = Rte_Al_TE_Task_2msA_Appl10_0_2ms
      CDD_MotAg1Meas_EcuSwComposition: RteSoftwareComponentInstanceRef=CDD_MotAg1Meas
        NvmBlock_CDD_MotAg1Meas_NvmMotAg1CoeffTbl (RteNvRamAllocation):
          RteNvmRamBlockLocationSymbol = Rte_CDD_MotAg1Meas_MotAg1CoeffTbl
          RteNvmBlockRef = Rte_NvmBlock_CDD_MotAg1Meas_MotAg1CoeffTbl
          RteSwNvRamMappingRef = NvmMotAg1CoeffTbl
        4 x RteEventToTaskMapping, all with RteImmediateRestart=false:
          OIT_MotAg1CoeffTblRead_Oper_MotAg1CoeffTblRead_Oper: RteEventRef=OIT_MotAg1CoeffTblRead_Oper_MotAg1CoeffTblRead_Oper
          OIT_MotAg1CoeffTblWr_Oper_MotAg1CoeffTblWr_Oper: RteEventRef=OIT_MotAg1CoeffTblWr_Oper_MotAg1CoeffTblWr_Oper
          CDD_MotAg1Meas_InitEvent: RtePositionInTask=30, RteEventRef=CDD_MotAg1Meas_InitEvent, RteMappedToTaskRef=Task_Init_Appl10
          TMT_MotAg1MeasPer2: RtePositionInTask=21, RteEventRef=TMT_MotAg1MeasPer2, RteMappedToTaskRef=Task_2msA_Appl10, RteUsedOsAlarmRef=Rte_Al_TE_Task_2msA_Appl10_0_2ms
      CDD_TSG31CfgAndUse_EcuSwComposition: RteSoftwareComponentInstanceRef=CDD_TSG31CfgAndUse
        CDD_TSG31CfgAndUse_InitEvent (RteEventToTaskMapping): RteImmediateRestart=false, RtePositionInTask=34, RteEventRef=CDD_TSG31CfgAndUse_InitEvent, RteMappedToTaskRef=Task_Init_Appl10
        TMT_TSG31CfgAndUsePer2 (RteEventToTaskMapping):
          RteImmediateRestart = false
          RtePositionInTask = 32
          RteEventRef = TMT_TSG31CfgAndUsePer2
          RteMappedToTaskRef = Task_2msB_Appl10
          RteUsedOsAlarmRef = Rte_Al_TE_Task_2msB_Appl10_0_2ms
      CDD_Adc1CfgAndUse_EcuSwComposition: RteSoftwareComponentInstanceRef=CDD_Adc1CfgAndUse
        4 x RteEventToTaskMapping, all with RteImmediateRestart=false:
          OIT_Adc1CfgAndUseAdc1EnaCnvn_Oper_Adc1CfgAndUseAdc1EnaCnvn_Oper: RteEventRef=OIT_Adc1CfgAndUseAdc1EnaCnvn_Oper_Adc1CfgAndUseAdc1EnaCnvn_Oper
          CDD_Adc1CfgAndUse_InitEvent: RtePositionInTask=22, RteEventRef=CDD_Adc1CfgAndUse_InitEvent, RteMappedToTaskRef=Task_Init_Appl10
          TMT_Adc1CfgAndUsePer1: RtePositionInTask=9, RteEventRef=TMT_Adc1CfgAndUsePer1, RteMappedToTaskRef=Task_2msA_Appl10, RteUsedOsAlarmRef=Rte_Al_TE_Task_2msA_Appl10_0_2ms
          TMT_Adc1CfgAndUsePer2: RtePositionInTask=17, RteEventRef=TMT_Adc1CfgAndUsePer2, RteMappedToTaskRef=Task_2msA_Appl10, RteUsedOsAlarmRef=Rte_Al_TE_Task_2msA_Appl10_0_2ms
      CDD_MotAg0Meas_EcuSwComposition: RteSoftwareComponentInstanceRef=CDD_MotAg0Meas
        NvmBlock_CDD_MotAg0Meas_NvmMotAg0CoeffTbl (RteNvRamAllocation):
          RteNvmRamBlockLocationSymbol = Rte_CDD_MotAg0Meas_MotAg0CoeffTbl
          RteNvmBlockRef = Rte_NvmBlock_CDD_MotAg0Meas_MotAg0CoeffTbl
          RteSwNvRamMappingRef = NvmMotAg0CoeffTbl
        5 x RteEventToTaskMapping, all with RteImmediateRestart=false:
          OIT_MotAg0CoeffTblRead_Oper_MotAg0CoeffTblRead_Oper: RteEventRef=OIT_MotAg0CoeffTblRead_Oper_MotAg0CoeffTblRead_Oper
          OIT_MotAg0CoeffTblWr_Oper_MotAg0CoeffTblWr_Oper: RteEventRef=OIT_MotAg0CoeffTblWr_Oper_MotAg0CoeffTblWr_Oper
          CDD_MotAg0Meas_InitEvent: RtePositionInTask=29, RteEventRef=CDD_MotAg0Meas_InitEvent, RteMappedToTaskRef=Task_Init_Appl10
          TMT_MotAg0MeasPer2: RtePositionInTask=20, RteEventRef=TMT_MotAg0MeasPer2, RteMappedToTaskRef=Task_2msA_Appl10, RteUsedOsAlarmRef=Rte_Al_TE_Task_2msA_Appl10_0_2ms
          TMT_MotAg0MeasPer3: RtePositionInTask=1, RteEventRef=TMT_MotAg0MeasPer3, RteMappedToTaskRef=Task_100ms_Appl10, RteUsedOsAlarmRef=Rte_Al_TE_Task_100ms_Appl10_0_100ms, RteUsedOsEventRef=Rte_Ev_Cyclic_Task_100ms_Appl10_0_100ms
      CDD_DmaCfgAndUse_EcuSwComposition: RteSoftwareComponentInstanceRef=CDD_DmaCfgAndUse
        5 x RteEventToTaskMapping, all with RteImmediateRestart=false:
          CDD_DmaCfgAndUse_InitEvent: RtePositionInTask=33, RteEventRef=CDD_DmaCfgAndUse_InitEvent, RteMappedToTaskRef=Task_Init_Appl10
          TMT_DmaCfgAndUsePer1: RtePositionInTask=1, RteEventRef=TMT_DmaCfgAndUsePer1, RteMappedToTaskRef=Task_2msA_Appl10, RteUsedOsAlarmRef=Rte_Al_TE_Task_2msA_Appl10_0_2ms
          OIT_DmaEna2MilliSecToMotCtrlTrf_Oper_DmaEna2MilliSecToMotCtrlTrf_Oper: RteEventRef=OIT_DmaEna2MilliSecToMotCtrlTrf_Oper_DmaEna2MilliSecToMotCtrlTrf_Oper
          OIT_DmaWaitForMotCtrlTo2MilliSecTrf_Oper_DmaWaitForMotCtrlTo2MilliSecTrf_Oper: RteEventRef=OIT_DmaWaitForMotCtrlTo2MilliSecTrf_Oper_DmaWaitForMotCtrlTo2MilliSecTrf_Oper
          OIT_MotAg0SnsrCfgDmaStrt_Oper_MotAg0SnsrCfgDmaStrt_Oper: RteEventRef=OIT_MotAg0SnsrCfgDmaStrt_Oper_MotAg0SnsrCfgDmaStrt_Oper
    8 x RteSwComponentType:
      CDD_DmaCfgAndUse: RteComponentTypeRef=CDD_DmaCfgAndUse, RteImplementationRef=CDD_DmaCfgAndUse_Implementation
        ComponentTypeCalibration (RteComponentTypeCalibration): RteCalibrationSupportEnabled=true
      CDD_AdcDiagc: RteComponentTypeRef=CDD_AdcDiagc, RteImplementationRef=CDD_AdcDiagc_Implementation
        ComponentTypeCalibration (RteComponentTypeCalibration): RteCalibrationSupportEnabled=true
      CDD_MotAg1Meas: RteComponentTypeRef=CDD_MotAg1Meas, RteImplementationRef=CDD_MotAg1Meas_Implementation
        ComponentTypeCalibration (RteComponentTypeCalibration): RteCalibrationSupportEnabled=true
      CDD_MotAg0Meas: RteComponentTypeRef=CDD_MotAg0Meas, RteImplementationRef=CDD_MotAg0Meas_Implementation
        ComponentTypeCalibration (RteComponentTypeCalibration): RteCalibrationSupportEnabled=true
      CDD_TSG31CfgAndUse: RteComponentTypeRef=CDD_TSG31CfgAndUse, RteImplementationRef=CDD_TSG31CfgAndUse_Implementation
        ComponentTypeCalibration (RteComponentTypeCalibration): RteCalibrationSupportEnabled=true
      CDD_Tauj0CfgAndUse: RteComponentTypeRef=CDD_Tauj0CfgAndUse, RteImplementationRef=CDD_Tauj0CfgAndUse_Implementation
        ComponentTypeCalibration (RteComponentTypeCalibration): RteCalibrationSupportEnabled=true
      CDD_Adc1CfgAndUse: RteComponentTypeRef=CDD_Adc1CfgAndUse, RteImplementationRef=CDD_Adc1CfgAndUse_Implementation
        ComponentTypeCalibration (RteComponentTypeCalibration): RteCalibrationSupportEnabled=true
      CDD_Adc0CfgAndUse: RteComponentTypeRef=CDD_Adc0CfgAndUse, RteImplementationRef=CDD_Adc0CfgAndUse_Implementation
        ComponentTypeCalibration (RteComponentTypeCalibration): RteCalibrationSupportEnabled=true
    CDD_MotCtrlMgr_EcuSwComposition (RteSwComponentInstance): RteSoftwareComponentInstanceRef=CDD_MotCtrlMgr
      TMT_MotCtrlMgrPer1 (RteEventToTaskMapping):
        RteImmediateRestart = false
        RtePositionInTask = 8
        RteEventRef = TMT_MotCtrlMgrPer1
        RteMappedToTaskRef = Task_2msA_Appl10
        RteUsedOsAlarmRef = Rte_Al_TE_Task_2msA_Appl10_0_2ms
      TMT_MotCtrlMgrPer2 (RteEventToTaskMapping):
        RteImmediateRestart = false
        RtePositionInTask = 35
        RteEventRef = TMT_MotCtrlMgrPer2
        RteMappedToTaskRef = Task_2msB_Appl10
        RteUsedOsAlarmRef = Rte_Al_TE_Task_2msB_Appl10_0_2ms
    CDD_MotCtrlMgr (RteSwComponentType): RteComponentTypeRef=CDD_MotCtrlMgr, RteImplementationRef=CDD_MotCtrlMgr_Implementation
      ComponentTypeCalibration (RteComponentTypeCalibration): RteCalibrationSupportEnabled=true
    IoHwAb_EcuSwComposition (RteSwComponentInstance): RteSoftwareComponentInstanceRef=IoHwAb
      41 x RteEventToTaskMapping, all with RteImmediateRestart=false:
        OpEventIoHwAb_SetFctPeriphPhaALowrCmd_Oper_Oper_SetFctPeriphPhaALowrCmd: RteEventRef=OpEventIoHwAb_SetFctPeriphPhaALowrCmd_Oper_Oper_SetFctPeriphPhaALowrCmd
        OpEventIoHwAb_SetGpioPhaBUpprCmd_Oper_Oper_SetGpioPhaBUpprCmd: RteEventRef=OpEventIoHwAb_SetGpioPhaBUpprCmd_Oper_Oper_SetGpioPhaBUpprCmd
        OpEventIoHwAb_SetGpioGateDrv0Rst_Oper_Oper_SetGpioGateDrv0Rst: RteEventRef=OpEventIoHwAb_SetGpioGateDrv0Rst_Oper_Oper_SetGpioGateDrv0Rst
        OpEventIoHwAb_SetFctPeriphPhaAUpprCmd_Oper_Oper_SetFctPeriphPhaAUpprCmd: RteEventRef=OpEventIoHwAb_SetFctPeriphPhaAUpprCmd_Oper_Oper_SetFctPeriphPhaAUpprCmd
        OpEventIoHwAb_SetGpioPhaBLowrCmd_Oper_Oper_SetGpioPhaBLowrCmd: RteEventRef=OpEventIoHwAb_SetGpioPhaBLowrCmd_Oper_Oper_SetGpioPhaBLowrCmd
        OpEventIoHwAb_GetGpioMcuEna_Oper_Oper_GetGpioMcuEna: RteEventRef=OpEventIoHwAb_GetGpioMcuEna_Oper_Oper_GetGpioMcuEna
        OpEventIoHwAb_SetGpioTmplMonrWdg_Oper_Oper_SetGpioTmplMonrWdg: RteEventRef=OpEventIoHwAb_SetGpioTmplMonrWdg_Oper_Oper_SetGpioTmplMonrWdg
        OpEventIoHwAb_SetFctGpioPhaALowrCmd_Oper_Oper_SetFctGpioPhaALowrCmd: RteEventRef=OpEventIoHwAb_SetFctGpioPhaALowrCmd_Oper_Oper_SetFctGpioPhaALowrCmd
        OpEventIoHwAb_GetGpioGateDrv0Diagc_Oper_Oper_GetGpioGateDrv0Diagc: RteEventRef=OpEventIoHwAb_GetGpioGateDrv0Diagc_Oper_Oper_GetGpioGateDrv0Diagc
        OpEventIoHwAb_SetFctPeriphPhaCUpprCmd_Oper_Oper_SetFctPeriphPhaCUpprCmd: RteEventRef=OpEventIoHwAb_SetFctPeriphPhaCUpprCmd_Oper_Oper_SetFctPeriphPhaCUpprCmd
        OpEventIoHwAb_SetFctGpioPhaBLowrCmd_Oper_Oper_SetFctGpioPhaBLowrCmd: RteEventRef=OpEventIoHwAb_SetFctGpioPhaBLowrCmd_Oper_Oper_SetFctGpioPhaBLowrCmd
        OpEventIoHwAb_SetGpioSysFlt2A_Oper_Oper_SetGpioSysFlt2A: RteEventRef=OpEventIoHwAb_SetGpioSysFlt2A_Oper_Oper_SetGpioSysFlt2A
        OpEventIoHwAb_SetGpioPwrTurnOffCtrl_Oper_Oper_SetGpioPwrTurnOffCtrl: RteEventRef=OpEventIoHwAb_SetGpioPwrTurnOffCtrl_Oper_Oper_SetGpioPwrTurnOffCtrl
        OpEventIoHwAb_SetFctGpioPhaBUpprCmd_Oper_Oper_SetFctGpioPhaBUpprCmd: RteEventRef=OpEventIoHwAb_SetFctGpioPhaBUpprCmd_Oper_Oper_SetFctGpioPhaBUpprCmd
        OpEventIoHwAb_SetFctPeriphPhaCLowrCmd_Oper_Oper_SetFctPeriphPhaCLowrCmd: RteEventRef=OpEventIoHwAb_SetFctPeriphPhaCLowrCmd_Oper_Oper_SetFctPeriphPhaCLowrCmd
        OpEventIoHwAb_SetGpioPhaCUpprCmd_Oper_Oper_SetGpioPhaCUpprCmd: RteEventRef=OpEventIoHwAb_SetGpioPhaCUpprCmd_Oper_Oper_SetGpioPhaCUpprCmd
        OpEventIoHwAb_SetFctGpioPhaCUpprCmd_Oper_Oper_SetFctGpioPhaCUpprCmd: RteEventRef=OpEventIoHwAb_SetFctGpioPhaCUpprCmd_Oper_Oper_SetFctGpioPhaCUpprCmd
        Timer_IoHwAb_Per1: RtePositionInTask=12, RteEventRef=Timer_IoHwAb_Per1, RteMappedToTaskRef=Task_100ms_Appl10, RteUsedOsEventRef=Rte_Ev_Cyclic_Task_100ms_Appl10_0_100ms, RteUsedOsAlarmRef=Rte_Al_TE_Task_100ms_Appl10_0_100ms
        OpEventIoHwAb_SetFctGpioPhaAUpprCmd_Oper_Oper_SetFctGpioPhaAUpprCmd: RteEventRef=OpEventIoHwAb_SetFctGpioPhaAUpprCmd_Oper_Oper_SetFctGpioPhaAUpprCmd
        OpEventIoHwAb_SetGpioPhaALowrCmd_Oper_Oper_SetGpioPhaALowrCmd: RteEventRef=OpEventIoHwAb_SetGpioPhaALowrCmd_Oper_Oper_SetGpioPhaALowrCmd
        OpEventIoHwAb_SetFctPeriphPhaBUpprCmd_Oper_Oper_SetFctPeriphPhaBUpprCmd: RteEventRef=OpEventIoHwAb_SetFctPeriphPhaBUpprCmd_Oper_Oper_SetFctPeriphPhaBUpprCmd
        OpEventIoHwAb_SetFctPeriphPhaBLowrCmd_Oper_Oper_SetFctPeriphPhaBLowrCmd: RteEventRef=OpEventIoHwAb_SetFctPeriphPhaBLowrCmd_Oper_Oper_SetFctPeriphPhaBLowrCmd
        OpEventIoHwAb_SetGpioPhaAUpprCmd_Oper_Oper_SetGpioPhaAUpprCmd: RteEventRef=OpEventIoHwAb_SetGpioPhaAUpprCmd_Oper_Oper_SetGpioPhaAUpprCmd
        OpEventIoHwAb_GetGpioPwrOutpEnaFb_Oper_Oper_GetGpioPwrOutpEnaFb: RteEventRef=OpEventIoHwAb_GetGpioPwrOutpEnaFb_Oper_Oper_GetGpioPwrOutpEnaFb
        OpEventIoHwAb_SetGpioPhaCLowrCmd_Oper_Oper_SetGpioPhaCLowrCmd: RteEventRef=OpEventIoHwAb_SetGpioPhaCLowrCmd_Oper_Oper_SetGpioPhaCLowrCmd
        OpEventIoHwAb_SetFctGpioPhaCLowrCmd_Oper_Oper_SetFctGpioPhaCLowrCmd: RteEventRef=OpEventIoHwAb_SetFctGpioPhaCLowrCmd_Oper_Oper_SetFctGpioPhaCLowrCmd
        OpEventIoHwAb_SetGpioPhaDiscnctA_Oper_Oper_SetGpioPhaDiscnctA: RteEventRef=OpEventIoHwAb_SetGpioPhaDiscnctA_Oper_Oper_SetGpioPhaDiscnctA
        OpEventIoHwAb_SetGpioPhaDiscnctB_Oper_Oper_SetGpioPhaDiscnctB: RteEventRef=OpEventIoHwAb_SetGpioPhaDiscnctB_Oper_Oper_SetGpioPhaDiscnctB
        OpEventIoHwAb_SetGpioPhaDiscnctC_Oper_Oper_SetGpioPhaDiscnctC: RteEventRef=OpEventIoHwAb_SetGpioPhaDiscnctC_Oper_Oper_SetGpioPhaDiscnctC
        OpEventIoHwAb_SetGpioMotAg0Mosi_Oper_Oper_SetGpioMotAg0Mosi: RteEventRef=OpEventIoHwAb_SetGpioMotAg0Mosi_Oper_Oper_SetGpioMotAg0Mosi
        OpEventIoHwAb_SetFctGpioMotAg0Mosi_Oper_Oper_SetFctGpioMotAg0Mosi: RteEventRef=OpEventIoHwAb_SetFctGpioMotAg0Mosi_Oper_Oper_SetFctGpioMotAg0Mosi
        OpEventIoHwAb_SetGpioMotAg0Cs_Oper_Oper_SetGpioMotAg0Cs: RteEventRef=OpEventIoHwAb_SetGpioMotAg0Cs_Oper_Oper_SetGpioMotAg0Cs
        OpEventIoHwAb_SetGpioMotAg0Clk_Oper_Oper_SetGpioMotAg0Clk: RteEventRef=OpEventIoHwAb_SetGpioMotAg0Clk_Oper_Oper_SetGpioMotAg0Clk
        OpEventIoHwAb_SetFctGpioMotAg0Clk_Oper_Oper_SetFctGpioMotAg0Clk: RteEventRef=OpEventIoHwAb_SetFctGpioMotAg0Clk_Oper_Oper_SetFctGpioMotAg0Clk
        OpEventIoHwAb_SetFctGpioMotAg0Cs_Oper_Oper_SetFctGpioMotAg0Cs: RteEventRef=OpEventIoHwAb_SetFctGpioMotAg0Cs_Oper_Oper_SetFctGpioMotAg0Cs
        OpEventIoHwAb_SetFctGpioMotAg1Clk_Oper_Oper_SetFctGpioMotAg1Clk: RteEventRef=OpEventIoHwAb_SetFctGpioMotAg1Clk_Oper_Oper_SetFctGpioMotAg1Clk
        OpEventIoHwAb_SetGpioMotAg1Mosi_Oper_Oper_SetGpioMotAg1Mosi: RteEventRef=OpEventIoHwAb_SetGpioMotAg1Mosi_Oper_Oper_SetGpioMotAg1Mosi
        OpEventIoHwAb_SetFctGpioMotAg1Mosi_Oper_Oper_SetFctGpioMotAg1Mosi: RteEventRef=OpEventIoHwAb_SetFctGpioMotAg1Mosi_Oper_Oper_SetFctGpioMotAg1Mosi
        OpEventIoHwAb_SetGpioMotAg1Cs_Oper_Oper_SetGpioMotAg1Cs: RteEventRef=OpEventIoHwAb_SetGpioMotAg1Cs_Oper_Oper_SetGpioMotAg1Cs
        OpEventIoHwAb_SetFctGpioMotAg1Cs_Oper_Oper_SetFctGpioMotAg1Cs: RteEventRef=OpEventIoHwAb_SetFctGpioMotAg1Cs_Oper_Oper_SetFctGpioMotAg1Cs
        OpEventIoHwAb_SetGpioMotAg1Clk_Oper_Oper_SetGpioMotAg1Clk: RteEventRef=OpEventIoHwAb_SetGpioMotAg1Clk_Oper_Oper_SetGpioMotAg1Clk
    CDD_CurrMeas_EcuSwComposition (RteSwComponentInstance): RteSoftwareComponentInstanceRef=CDD_CurrMeas
      NvmBlock_CDD_CurrMeas_NvmCurrMeasEolGainCalSetABC (RteNvRamAllocation):
        RteNvmRamBlockLocationSymbol = Rte_CDD_CurrMeas_CurrMeasEolGainCalSetABC
        RteNvmRomBlockLocationSymbol = Rte_CurrMeasEolGainCalSetABCDft
        RteNvmBlockRef = Rte_NvmBlock_CDD_CurrMeas_CurrMeasEolGainCalSetABC
        RteSwNvRamMappingRef = NvmCurrMeasEolGainCalSetABC
      NvmBlock_CDD_CurrMeas_NvmCurrMeasEolOffsCalSetABC (RteNvRamAllocation):
        RteNvmRamBlockLocationSymbol = Rte_CDD_CurrMeas_CurrMeasEolOffsCalSetABC
        RteNvmRomBlockLocationSymbol = Rte_CurrMeasEolOffsCalSetABCDft
        RteNvmBlockRef = Rte_NvmBlock_CDD_CurrMeas_CurrMeasEolOffsCalSetABC
        RteSwNvRamMappingRef = NvmCurrMeasEolOffsCalSetABC
      11 x RteEventToTaskMapping, all with RteImmediateRestart=false:
        OIT_CurrMeasEolGainReq_Oper_CurrMeasEolGainReq_Oper: RteEventRef=OIT_CurrMeasEolGainReq_Oper_CurrMeasEolGainReq_Oper
        OIT_CurrMeasEolGainStsReq_Oper_CurrMeasEolGainStsReq_Oper: RteEventRef=OIT_CurrMeasEolGainStsReq_Oper_CurrMeasEolGainStsReq_Oper
        OIT_CurrMeasEolOffsReq_Oper_CurrMeasEolOffsReq_Oper: RteEventRef=OIT_CurrMeasEolOffsReq_Oper_CurrMeasEolOffsReq_Oper
        OIT_CurrMeasEolOffsStsReq_Oper_CurrMeasEolOffsStsReq_Oper: RteEventRef=OIT_CurrMeasEolOffsStsReq_Oper_CurrMeasEolOffsStsReq_Oper
        OIT_CurrMeasGainReadReqSngIvtr_Oper_CurrMeasGainReadReqSngIvtr_Oper: RteEventRef=OIT_CurrMeasGainReadReqSngIvtr_Oper_CurrMeasGainReadReqSngIvtr_Oper
        OIT_CurrMeasGainWrReqSngIvtr_Oper_CurrMeasGainWrReqSngIvtr_Oper: RteEventRef=OIT_CurrMeasGainWrReqSngIvtr_Oper_CurrMeasGainWrReqSngIvtr_Oper
        CDD_CurrMeas_InitEvent: RtePositionInTask=16, RteEventRef=CDD_CurrMeas_InitEvent, RteMappedToTaskRef=Task_Init_Appl10
        OIT_CurrMeasOffsReadReqSngIvtr_Oper_CurrMeasOffsReadReqSngIvtr_Oper: RteEventRef=OIT_CurrMeasOffsReadReqSngIvtr_Oper_CurrMeasOffsReadReqSngIvtr_Oper
        OIT_CurrMeasOffsWrReqSngIvtr_Oper_CurrMeasOffsWrReqSngIvtr_Oper: RteEventRef=OIT_CurrMeasOffsWrReqSngIvtr_Oper_CurrMeasOffsWrReqSngIvtr_Oper
        TMT_CurrMeasPer1: RtePositionInTask=23, RteEventRef=TMT_CurrMeasPer1, RteMappedToTaskRef=Task_2msB_Appl10, RteUsedOsAlarmRef=Rte_Al_TE_Task_2msB_Appl10_0_2ms
        TMT_CurrMeasPer3: RtePositionInTask=24, RteEventRef=TMT_CurrMeasPer3, RteMappedToTaskRef=Task_2msB_Appl10, RteUsedOsAlarmRef=Rte_Al_TE_Task_2msB_Appl10_0_2ms
    CDD_CurrMeas (RteSwComponentType): RteComponentTypeRef=CDD_CurrMeas, RteImplementationRef=CDD_CurrMeas_Implementation
      ComponentTypeCalibration (RteComponentTypeCalibration): RteCalibrationSupportEnabled=true
    MotAgCorrln_EcuSwComposition (RteSwComponentInstance): RteSoftwareComponentInstanceRef=MotAgCorrln
      MotAgCorrln_InitEvent (RteEventToTaskMapping): RteImmediateRestart=false, RtePositionInTask=58, RteEventRef=MotAgCorrln_InitEvent, RteMappedToTaskRef=Task_Init_Appl10
      TMT_MotAgCorrlnPer1 (RteEventToTaskMapping):
        RteImmediateRestart = false
        RtePositionInTask = 22
        RteEventRef = TMT_MotAgCorrlnPer1
        RteMappedToTaskRef = Task_2msA_Appl10
        RteUsedOsAlarmRef = Rte_Al_TE_Task_2msA_Appl10_0_2ms
    MotAgCorrln (RteSwComponentType): RteComponentTypeRef=MotAgCorrln, RteImplementationRef=MotAgCorrln_Implementation
      ComponentTypeCalibration (RteComponentTypeCalibration): RteCalibrationSupportEnabled=true
    CDD_Bmw5441McuCfg_EcuSwComposition (RteSwComponentInstance): RteSoftwareComponentInstanceRef=CDD_Bmw5441McuCfg
      5 x RteEventToTaskMapping, all with RteImmediateRestart=false:
        Bmw5441McuCfgInit1_InitEvent: RtePositionInTask=23, RteEventRef=Bmw5441McuCfgInit1_InitEvent, RteMappedToTaskRef=Task_Init_Appl10
        Bmw5441McuCfgInit2_InitEvent: RtePositionInTask=24, RteEventRef=Bmw5441McuCfgInit2_InitEvent, RteMappedToTaskRef=Task_Init_Appl10
        Bmw5441McuCfgInit3_InitEvent: RtePositionInTask=25, RteEventRef=Bmw5441McuCfgInit3_InitEvent, RteMappedToTaskRef=Task_Init_Appl10
        TMT_Bmw5441McuCfgPer2: RtePositionInTask=10, RteEventRef=TMT_Bmw5441McuCfgPer2, RteMappedToTaskRef=Task_2msA_Appl10, RteUsedOsAlarmRef=Rte_Al_TE_Task_2msA_Appl10_0_2ms
        TMT_Bmw5441McuCfgPer3: RtePositionInTask=12, RteEventRef=TMT_Bmw5441McuCfgPer3, RteMappedToTaskRef=Task_2msA_Appl10, RteUsedOsAlarmRef=Rte_Al_TE_Task_2msA_Appl10_0_2ms
    CDD_Bmw5441McuCfg (RteSwComponentType): RteComponentTypeRef=CDD_Bmw5441McuCfg, RteImplementationRef=CDD_Bmw5441McuCfg_Implementation
      ComponentTypeCalibration (RteComponentTypeCalibration): RteCalibrationSupportEnabled=true
    3 x RteSwComponentInstance:
      BattVltgCorrln_EcuSwComposition: RteSoftwareComponentInstanceRef=BattVltgCorrln
        BattVltgCorrln_InitEvent (RteEventToTaskMapping): RteImmediateRestart=false, RtePositionInTask=27, RteEventRef=BattVltgCorrln_InitEvent, RteMappedToTaskRef=Task_Init_Appl10
        TMT_BattVltgCorrlnPer1 (RteEventToTaskMapping):
          RteImmediateRestart = false
          RtePositionInTask = 17
          RteEventRef = TMT_BattVltgCorrlnPer1
          RteMappedToTaskRef = Task_2msB_Appl10
          RteUsedOsAlarmRef = Rte_Al_TE_Task_2msB_Appl10_0_2ms
      BattVltg_EcuSwComposition: RteSoftwareComponentInstanceRef=BattVltg
        TMT_BattVltgPer1 (RteEventToTaskMapping):
          RteImmediateRestart = false
          RtePositionInTask = 18
          RteEventRef = TMT_BattVltgPer1
          RteMappedToTaskRef = Task_2msB_Appl10
          RteUsedOsAlarmRef = Rte_Al_TE_Task_2msB_Appl10_0_2ms
        BattVltgInit1_InitEvent (RteEventToTaskMapping): RteImmediateRestart=false, RtePositionInTask=26, RteEventRef=BattVltgInit1_InitEvent, RteMappedToTaskRef=Task_Init_Appl10
      EcuTMeas_EcuSwComposition: RteSoftwareComponentInstanceRef=EcuTMeas
        EcuTMeas_InitEvent (RteEventToTaskMapping): RteImmediateRestart=false, RtePositionInTask=3, RteEventRef=EcuTMeas_InitEvent, RteMappedToTaskRef=Task_Init_Appl9
        TMT_EcuTMeasPer1 (RteEventToTaskMapping):
          RteImmediateRestart = false
          RtePositionInTask = 1
          RteEventRef = TMT_EcuTMeasPer1
          RteMappedToTaskRef = Task_100ms_Appl9
          RteUsedOsAlarmRef = Rte_Al_TE_Task_100ms_Appl9_0_100ms
    3 x RteSwComponentType:
      BattVltgCorrln: RteComponentTypeRef=BattVltgCorrln, RteImplementationRef=BattVltgCorrln_Implementation
        ComponentTypeCalibration (RteComponentTypeCalibration): RteCalibrationSupportEnabled=true
      EcuTMeas: RteComponentTypeRef=EcuTMeas, RteImplementationRef=EcuTMeas_Implementation
        ComponentTypeCalibration (RteComponentTypeCalibration): RteCalibrationSupportEnabled=true
      BattVltg: RteComponentTypeRef=BattVltg, RteImplementationRef=BattVltg_Implementation
        ComponentTypeCalibration (RteComponentTypeCalibration): RteCalibrationSupportEnabled=true
    CDD_RamMem_EcuSwComposition (RteSwComponentInstance): RteSoftwareComponentInstanceRef=CDD_RamMem
      CDD_RamMem_InitEvent (RteEventToTaskMapping): RteImmediateRestart=false, RtePositionInTask=9, RteEventRef=CDD_RamMem_InitEvent, RteMappedToTaskRef=Task_Init_Appl10
      TMT_RamMemPer1 (RteEventToTaskMapping):
        RteImmediateRestart = false
        RtePositionInTask = 33
        RteEventRef = TMT_RamMemPer1
        RteMappedToTaskRef = Task_2msB_Appl10
        RteUsedOsAlarmRef = Rte_Al_TE_Task_2msB_Appl10_0_2ms
    CDD_FlsMem_EcuSwComposition (RteSwComponentInstance): RteSoftwareComponentInstanceRef=CDD_FlsMem
      FlsMemInit1_InitEvent (RteEventToTaskMapping): RteImmediateRestart=false, RtePositionInTask=12, RteEventRef=FlsMemInit1_InitEvent, RteMappedToTaskRef=Task_Init_Appl10
      TMT_FlsMemPer2 (RteEventToTaskMapping):
        RteImmediateRestart = false
        RtePositionInTask = 13
        RteEventRef = TMT_FlsMemPer2
        RteMappedToTaskRef = Task_100ms_Appl10
        RteUsedOsAlarmRef = Rte_Al_TE_Task_100ms_Appl10_0_100ms
        RteUsedOsEventRef = Rte_Ev_Cyclic_Task_100ms_Appl10_0_100ms
    CDD_FlsMem (RteSwComponentType): RteComponentTypeRef=CDD_FlsMem, RteImplementationRef=CDD_FlsMem_Implementation
      ComponentTypeCalibration (RteComponentTypeCalibration): RteCalibrationSupportEnabled=true
    CDD_RamMem (RteSwComponentType): RteComponentTypeRef=CDD_RamMem, RteImplementationRef=CDD_RamMem_Implementation
      ComponentTypeCalibration (RteComponentTypeCalibration): RteCalibrationSupportEnabled=true
    CDD_ChkPtAppl10_EcuSwComposition (RteSwComponentInstance): RteSoftwareComponentInstanceRef=CDD_ChkPtAppl10
      10 x RteEventToTaskMapping, all with RteImmediateRestart=false:
        TMT_ChkPt_100msAppl10End: RtePositionInTask=29, RteEventRef=TMT_ChkPt_100msAppl10End, RteMappedToTaskRef=Task_100ms_Appl10, RteUsedOsAlarmRef=Rte_Al_TE_Task_100ms_Appl10_0_100ms, RteUsedOsEventRef=Rte_Ev_Cyclic_Task_100ms_Appl10_0_100ms
        TMT_ChkPt_100msAppl10Strt: RtePositionInTask=0, RteEventRef=TMT_ChkPt_100msAppl10Strt, RteMappedToTaskRef=Task_100ms_Appl10, RteUsedOsAlarmRef=Rte_Al_TE_Task_100ms_Appl10_0_100ms, RteUsedOsEventRef=Rte_Ev_Cyclic_Task_100ms_Appl10_0_100ms
        TMT_ChkPt_10msAppl10End: RtePositionInTask=53, RteEventRef=TMT_ChkPt_10msAppl10End, RteMappedToTaskRef=Task_10ms_Appl10, RteUsedOsAlarmRef=Rte_Al_TE_Task_10ms_Appl10_0_10ms, RteUsedOsEventRef=Rte_Ev_Cyclic_Task_10ms_Appl10_0_10ms
        TMT_ChkPt_10msAppl10Strt: RtePositionInTask=0, RteEventRef=TMT_ChkPt_10msAppl10Strt, RteMappedToTaskRef=Task_10ms_Appl10, RteUsedOsAlarmRef=Rte_Al_TE_Task_10ms_Appl10_0_10ms, RteUsedOsEventRef=Rte_Ev_Cyclic_Task_10ms_Appl10_0_10ms
        TMT_ChkPt_4msAppl10End: RtePositionInTask=5, RteEventRef=TMT_ChkPt_4msAppl10End, RteMappedToTaskRef=Task_4ms_Appl10, RteUsedOsAlarmRef=Rte_Al_TE_Task_4ms_Appl10_0_4ms
        TMT_ChkPt_4msAppl10Strt: RtePositionInTask=0, RteEventRef=TMT_ChkPt_4msAppl10Strt, RteMappedToTaskRef=Task_4ms_Appl10, RteUsedOsAlarmRef=Rte_Al_TE_Task_4ms_Appl10_0_4ms
        TMT_ChkPt_2msAAppl10Strt: RtePositionInTask=0, RteEventRef=TMT_ChkPt_2msAAppl10Strt, RteMappedToTaskRef=Task_2msA_Appl10, RteUsedOsAlarmRef=Rte_Al_TE_Task_2msA_Appl10_0_2ms
        TMT_ChkPt_2msBAppl10End: RtePositionInTask=37, RteEventRef=TMT_ChkPt_2msBAppl10End, RteMappedToTaskRef=Task_2msB_Appl10, RteUsedOsAlarmRef=Rte_Al_TE_Task_2msB_Appl10_0_2ms
        TMT_ChkPt_2msBAppl10Strt: RtePositionInTask=0, RteEventRef=TMT_ChkPt_2msBAppl10Strt, RteMappedToTaskRef=Task_2msB_Appl10, RteUsedOsAlarmRef=Rte_Al_TE_Task_2msB_Appl10_0_2ms
        TMT_ChkPt_2msAAppl10End: RtePositionInTask=32, RteEventRef=TMT_ChkPt_2msAAppl10End, RteMappedToTaskRef=Task_2msA_Appl10, RteUsedOsAlarmRef=Rte_Al_TE_Task_2msA_Appl10_0_2ms
    CDD_ChkPtAppl10 (RteSwComponentType): RteComponentTypeRef=CDD_ChkPtAppl10, RteImplementationRef=CDD_ChkPtAppl10_Implementation
      ComponentTypeCalibration (RteComponentTypeCalibration): RteCalibrationSupportEnabled=true
    9 x RteBswModuleInstance:
      ChkPt: RteBswImplementationRef=ChkPt_Impl, RteBswModuleConfigurationRef=ChkPt
        ChkPt_10msBswAppl10StrtTimingEvent0 (RteBswEventToTaskMapping):
          RteBswImmediateRestart = false
          RteBswPositionInTask = 0
          RteBswEventRef = ChkPt_10msBswAppl10StrtTimingEvent0
          RteBswMappedToTaskRef = Task_10msBsw_Appl10
          RteBswUsedOsAlarmRef = Rte_Al_TE2_Task_10msBsw_Appl10_0_10ms
        ChkPt_10msBswAppl10EndTimingEvent0 (RteBswEventToTaskMapping):
          RteBswImmediateRestart = false
          RteBswPositionInTask = 11
          RteBswEventRef = ChkPt_10msBswAppl10EndTimingEvent0
          RteBswMappedToTaskRef = Task_10msBsw_Appl10
          RteBswUsedOsAlarmRef = Rte_Al_TE2_Task_10msBsw_Appl10_0_10ms
      Com: RteBswImplementationRef=Com_Impl, RteBswModuleConfigurationRef=Com
        Com_MainFunctionTxTimingEvent0 (RteBswEventToTaskMapping):
          RteBswImmediateRestart = false
          RteBswPositionInTask = 8
          RteBswEventRef = Com_MainFunctionTxTimingEvent0
          RteBswMappedToTaskRef = Task_ComBsw_Appl10
          RteBswUsedOsEventRef = Rte_Ev_Cyclic2_Task_ComBsw_Appl10_0_5ms
          RteBswUsedOsAlarmRef = Rte_Al_TE2_Task_ComBsw_Appl10_0_5ms
        Com_MainFunctionRxTimingEvent0 (RteBswEventToTaskMapping):
          RteBswImmediateRestart = false
          RteBswPositionInTask = 12
          RteBswEventRef = Com_MainFunctionRxTimingEvent0
          RteBswMappedToTaskRef = Task_ComBsw_Appl10
          RteBswUsedOsEventRef = Rte_Ev_Cyclic2_Task_ComBsw_Appl10_0_5ms
          RteBswUsedOsAlarmRef = Rte_Al_TE2_Task_ComBsw_Appl10_0_5ms
        3 x RteBswExclusiveAreaImpl, all with RteExclusiveAreaImplMechanism=OS_INTERRUPT_BLOCKING, RteExclusiveAreaOptimization=false:
          COM_EXCLUSIVE_AREA_TX: RteBswExclusiveAreaRef=COM_EXCLUSIVE_AREA_TX
          COM_EXCLUSIVE_AREA_RX: RteBswExclusiveAreaRef=COM_EXCLUSIVE_AREA_RX
          COM_EXCLUSIVE_AREA_BOTH: RteBswExclusiveAreaRef=COM_EXCLUSIVE_AREA_BOTH
      FrSM: RteBswImplementationRef=FrSM_Impl, RteBswModuleConfigurationRef=FrSM
        4 x RteBswExclusiveAreaImpl, all with RteExclusiveAreaImplMechanism=OS_INTERRUPT_BLOCKING, RteExclusiveAreaOptimization=false:
          FRSM_EXCLUSIVE_AREA_{0..3}: RteBswExclusiveAreaRef=FRSM_EXCLUSIVE_AREA_{0..3}
        FrSM_MainFunction_0TimingEvent0 (RteBswEventToTaskMapping):
          RteBswImmediateRestart = false
          RteBswPositionInTask = 1
          RteBswEventRef = FrSM_MainFunction_0TimingEvent0
          RteBswMappedToTaskRef = Task_5msBsw_Appl10
          RteBswUsedOsAlarmRef = Rte_Al_TE2_Task_5msBsw_Appl10_0_5ms
          RteBswUsedOsEventRef = Rte_Ev_Cyclic2_Task_5msBsw_Appl10_0_5ms
      FrTp: RteBswImplementationRef=FrTp_Impl, RteBswModuleConfigurationRef=FrTp
        FrTp_MainFunctionTimingEvent0 (RteBswEventToTaskMapping):
          RteBswImmediateRestart = false
          RteBswPositionInTask = 10
          RteBswEventRef = FrTp_MainFunctionTimingEvent0
          RteBswMappedToTaskRef = Task_ComBsw_Appl10
          RteBswUsedOsEventRef = Rte_Ev_Cyclic2_Task_ComBsw_Appl10_0_5ms
          RteBswUsedOsAlarmRef = Rte_Al_TE2_Task_ComBsw_Appl10_0_5ms
        3 x RteBswExclusiveAreaImpl, all with RteExclusiveAreaImplMechanism=OS_INTERRUPT_BLOCKING, RteExclusiveAreaOptimization=false:
          FRTP_EXCLUSIVE_AREA_{0..2}: RteBswExclusiveAreaRef=FRTP_EXCLUSIVE_AREA_{0..2}
      FrTrcv: RteBswImplementationRef=FrTrcv_Impl, RteBswModuleConfigurationRef=FrTrcv
        FrTrcv_30_Tja1082_MainFunctionTimingEvent0 (RteBswEventToTaskMapping):
          RteBswImmediateRestart = false
          RteBswPositionInTask = 2
          RteBswEventRef = FrTrcv_30_Tja1082_MainFunctionTimingEvent0
          RteBswMappedToTaskRef = Task_5msBsw_Appl10
          RteBswUsedOsAlarmRef = Rte_Al_TE2_Task_5msBsw_Appl10_0_5ms
          RteBswUsedOsEventRef = Rte_Ev_Cyclic2_Task_5msBsw_Appl10_0_5ms
        FRTRCV_30_TJA1082_EXCLUSIVE_AREA_0 (RteBswExclusiveAreaImpl):
          RteExclusiveAreaImplMechanism = OS_INTERRUPT_BLOCKING
          RteExclusiveAreaOptimization = false
          RteBswExclusiveAreaRef = FRTRCV_30_TJA1082_EXCLUSIVE_AREA_0
      IpduM: RteBswImplementationRef=IpduM_Impl, RteBswModuleConfigurationRef=IpduM
        IpduM_MainFunctionRxTimingEvent0 (RteBswEventToTaskMapping):
          RteBswImmediateRestart = false
          RteBswPositionInTask = 11
          RteBswEventRef = IpduM_MainFunctionRxTimingEvent0
          RteBswMappedToTaskRef = Task_ComBsw_Appl10
          RteBswUsedOsEventRef = Rte_Ev_Cyclic2_Task_ComBsw_Appl10_0_5ms
          RteBswUsedOsAlarmRef = Rte_Al_TE2_Task_ComBsw_Appl10_0_5ms
        IpduM_MainFunctionTxTimingEvent0 (RteBswEventToTaskMapping):
          RteBswImmediateRestart = false
          RteBswPositionInTask = 9
          RteBswEventRef = IpduM_MainFunctionTxTimingEvent0
          RteBswMappedToTaskRef = Task_ComBsw_Appl10
          RteBswUsedOsEventRef = Rte_Ev_Cyclic2_Task_ComBsw_Appl10_0_5ms
          RteBswUsedOsAlarmRef = Rte_Al_TE2_Task_ComBsw_Appl10_0_5ms
        IPDUM_EXCLUSIVE_AREA_0 (RteBswExclusiveAreaImpl): RteExclusiveAreaImplMechanism=OS_INTERRUPT_BLOCKING, RteExclusiveAreaOptimization=false, RteBswExclusiveAreaRef=IPDUM_EXCLUSIVE_AREA_0
      PduR: RteBswImplementationRef=PduR_Impl, RteBswModuleConfigurationRef=PduR
        PDUR_EXCLUSIVE_AREA_0 (RteBswExclusiveAreaImpl): RteExclusiveAreaImplMechanism=OS_INTERRUPT_BLOCKING, RteExclusiveAreaOptimization=false, RteBswExclusiveAreaRef=PDUR_EXCLUSIVE_AREA_0
      Xcp: RteBswImplementationRef=Xcp_Impl, RteBswModuleConfigurationRef=Xcp
        Xcp_MainFunctionTimingEvent0 (RteBswEventToTaskMapping):
          RteBswImmediateRestart = false
          RteBswPositionInTask = 5
          RteBswEventRef = Xcp_MainFunctionTimingEvent0
          RteBswMappedToTaskRef = Task_5msBsw_Appl10
          RteBswUsedOsAlarmRef = Rte_Al_TE2_Task_5msBsw_Appl10_0_5ms
          RteBswUsedOsEventRef = Rte_Ev_Cyclic2_Task_5msBsw_Appl10_0_5ms
        8 x RteBswExclusiveAreaImpl, all with RteExclusiveAreaImplMechanism=NONE, RteExclusiveAreaOptimization=false:
          XCP_EXCLUSIVE_AREA_{0..2}: RteBswExclusiveAreaRef=XCP_EXCLUSIVE_AREA_{0..2}
          CANXCP_EXCLUSIVE_AREA_0: RteBswExclusiveAreaRef=CANXCP_EXCLUSIVE_AREA_0
          FRXCP_EXCLUSIVE_AREA_{0..2}: RteBswExclusiveAreaRef=FRXCP_EXCLUSIVE_AREA_{0..2}
          TCPIPXCP_EXCLUSIVE_AREA_0: RteBswExclusiveAreaRef=TCPIPXCP_EXCLUSIVE_AREA_0
        FrXcp_MainFunctionRxTimingEvent0 (RteBswEventToTaskMapping):
          RteBswImmediateRestart = false
          RteBswPositionInTask = 4
          RteBswEventRef = FrXcp_MainFunctionRxTimingEvent0
          RteBswMappedToTaskRef = Task_5msBsw_Appl10
          RteBswUsedOsAlarmRef = Rte_Al_TE2_Task_5msBsw_Appl10_0_5ms
          RteBswUsedOsEventRef = Rte_Ev_Cyclic2_Task_5msBsw_Appl10_0_5ms
        FrXcp_MainFunctionTxTimingEvent0 (RteBswEventToTaskMapping):
          RteBswImmediateRestart = false
          RteBswPositionInTask = 6
          RteBswEventRef = FrXcp_MainFunctionTxTimingEvent0
          RteBswMappedToTaskRef = Task_5msBsw_Appl10
          RteBswUsedOsAlarmRef = Rte_Al_TE2_Task_5msBsw_Appl10_0_5ms
          RteBswUsedOsEventRef = Rte_Ev_Cyclic2_Task_5msBsw_Appl10_0_5ms
      Fr: RteBswImplementationRef=Fr_Impl, RteBswModuleConfigurationRef=Fr
        FR_EXCLUSIVE_AREA_0 (RteBswExclusiveAreaImpl): RteExclusiveAreaImplMechanism=OS_INTERRUPT_BLOCKING, RteExclusiveAreaOptimization=false, RteBswExclusiveAreaRef=FR_EXCLUSIVE_AREA_0
        FR_EXCLUSIVE_AREA_1 (RteBswExclusiveAreaImpl): RteExclusiveAreaImplMechanism=OS_INTERRUPT_BLOCKING, RteExclusiveAreaOptimization=false, RteBswExclusiveAreaRef=FR_EXCLUSIVE_AREA_1
    ComM_EcuSwComposition (RteSwComponentInstance): RteSoftwareComponentInstanceRef=ComM
      13 x RteEventToTaskMapping, all with RteImmediateRestart=false:
        Timer_ComM_MainFunction_0: RtePositionInTask=0, RteEventRef=Timer_ComM_MainFunction_0, RteMappedToTaskRef=Task_5msBsw_Appl10, RteUsedOsAlarmRef=Rte_Al_TE2_Task_5msBsw_Appl10_0_5ms, RteUsedOsEventRef=Rte_Ev_Cyclic2_Task_5msBsw_Appl10_0_5ms
        OpEventLimitECUToNoComMode_LimitECUToNoComMode_modeLimitation: RteEventRef=OpEventLimitECUToNoComMode_LimitECUToNoComMode_modeLimitation
        OpEventReadInhibitCounter_ReadInhibitCounter_modeLimitation: RteEventRef=OpEventReadInhibitCounter_ReadInhibitCounter_modeLimitation
        OpEventResetInhibitCounter_ResetInhibitCounter_modeLimitation: RteEventRef=OpEventResetInhibitCounter_ResetInhibitCounter_modeLimitation
        OpEventSetECUGroupClassification_SetECUGroupClassification_modeLimitation: RteEventRef=OpEventSetECUGroupClassification_SetECUGroupClassification_modeLimitation
        OpEventGetInhibitionStatus_GetInhibitionStatus_CL_A_FlexRay_372befd6: RteEventRef=OpEventGetInhibitionStatus_GetInhibitionStatus_CL_A_FlexRay_372befd6
        OpEventGetCurrentComMode_GetCurrentComMode_UR_USR_A_FlexRay_372befd6: RteEventRef=OpEventGetCurrentComMode_GetCurrentComMode_UR_USR_A_FlexRay_372befd6
        OpEventGetRequestedComMode_GetRequestedComMode_UR_USR_A_FlexRay_372befd6: RteEventRef=OpEventGetRequestedComMode_GetRequestedComMode_UR_USR_A_FlexRay_372befd6
        OpEventGetMaxComMode_GetMaxComMode_UR_USR_A_FlexRay_372befd6: RteEventRef=OpEventGetMaxComMode_GetMaxComMode_UR_USR_A_FlexRay_372befd6
        OpEventPreventWakeUp_PreventWakeUp_CW_A_FlexRay_372befd6: RteEventRef=OpEventPreventWakeUp_PreventWakeUp_CW_A_FlexRay_372befd6
        OpEventLimitChannelToNoComMode_LimitChannelToNoComMode_CL_A_FlexRay_372befd6: RteEventRef=OpEventLimitChannelToNoComMode_LimitChannelToNoComMode_CL_A_FlexRay_372befd6
        OpEventRequestComMode_RequestComMode_UR_USR_A_FlexRay_372befd6: RteEventRef=OpEventRequestComMode_RequestComMode_UR_USR_A_FlexRay_372befd6
        OpEventGetInhibitionStatus_GetInhibitionStatus_CW_A_FlexRay_372befd6: RteEventRef=OpEventGetInhibitionStatus_GetInhibitionStatus_CW_A_FlexRay_372befd6
    FrIf (RteBswModuleInstance): RteBswImplementationRef=FrIf_Impl, RteBswModuleConfigurationRef=FrIf
      FrIf_MainFunction_0TimingEvent0 (RteBswEventToTaskMapping):
        RteBswImmediateRestart = false
        RteBswPositionInTask = 3
        RteBswEventRef = FrIf_MainFunction_0TimingEvent0
        RteBswMappedToTaskRef = Task_5msBsw_Appl10
        RteBswUsedOsAlarmRef = Rte_Al_TE2_Task_5msBsw_Appl10_0_5ms
        RteBswUsedOsEventRef = Rte_Ev_Cyclic2_Task_5msBsw_Appl10_0_5ms
      3 x RteBswExclusiveAreaImpl, all with RteExclusiveAreaImplMechanism=OS_INTERRUPT_BLOCKING, RteExclusiveAreaOptimization=false:
        FRIF_EXCLUSIVE_AREA_{0..2}: RteBswExclusiveAreaRef=FRIF_EXCLUSIVE_AREA_{0..2}
    Dcm_EcuSwComposition (RteSwComponentInstance): RteSoftwareComponentInstanceRef=Dcm
      8 x RteEventToTaskMapping, all with RteImmediateRestart=false:
        OpEventGetActiveProtocol_GetActiveProtocol_DCMServices: RteEventRef=OpEventGetActiveProtocol_GetActiveProtocol_DCMServices
        OpEventGetSesCtrlType_GetSesCtrlType_DCMServices: RteEventRef=OpEventGetSesCtrlType_GetSesCtrlType_DCMServices
        OpEventResetToDefaultSession_ResetToDefaultSession_DCMServices: RteEventRef=OpEventResetToDefaultSession_ResetToDefaultSession_DCMServices
        OpEventSetActiveDiagnostic_SetActiveDiagnostic_DCMServices: RteEventRef=OpEventSetActiveDiagnostic_SetActiveDiagnostic_DCMServices
        OpEventGetRequestKind_GetRequestKind_DCMServices: RteEventRef=OpEventGetRequestKind_GetRequestKind_DCMServices
        OpEventTriggerOnEvent_TriggerOnEvent_DCM_Roe_DcmDspRoeEvent: RteEventRef=OpEventTriggerOnEvent_TriggerOnEvent_DCM_Roe_DcmDspRoeEvent
        OpEventGetSecurityLevel_GetSecurityLevel_DCMServices: RteEventRef=OpEventGetSecurityLevel_GetSecurityLevel_DCMServices
        Timer_Dcm_MainFunction: RtePositionInTask=7, RteEventRef=Timer_Dcm_MainFunction, RteMappedToTaskRef=Task_5msBsw_Appl10, RteUsedOsAlarmRef=Rte_Al_TE2_Task_5msBsw_Appl10_0_5ms, RteUsedOsEventRef=Rte_Ev_Cyclic2_Task_5msBsw_Appl10_0_5ms
    Vin_EcuSwComposition (RteSwComponentInstance): RteSoftwareComponentInstanceRef=Vin
      VinState (RteExclusiveAreaImplementation):
        RteExclusiveAreaImplMechanism = OS_RESOURCE
        RteExclusiveAreaOptimization = false
        RteExclusiveAreaRef = VinState
        RteExclusiveAreaOsResourceRef = Rte_Res_Vin_VinState
      7 x RteEventToTaskMapping, all with RteImmediateRestart=false:
        LifeCycleRequest: RtePositionInTask=18, RteEventRef=LifeCycleRequest, RteMappedToTaskRef=Task_100ms_Appl10, RteUsedOsEventRef=Rte_Ev_Run_Vin_Vin_LifeCycleModeRequest
        Main: RtePositionInTask=17, RteEventRef=Main, RteMappedToTaskRef=Task_100ms_Appl10, RteUsedOsEventRef=Rte_Ev_Cyclic_Task_100ms_Appl10_0_100ms, RteUsedOsAlarmRef=Rte_Al_TE_Task_100ms_Appl10_0_100ms
        dre_ComVin: RtePositionInTask=22, RteEventRef=dre_ComVin, RteMappedToTaskRef=Task_100ms_Appl10, RteUsedOsEventRef=Rte_Ev_Run_Vin_Vin_ReceiveFromCom
        msae_VinChangeIndicator: RtePositionInTask=21, RteEventRef=msae_VinChangeIndicator, RteMappedToTaskRef=Task_100ms_Appl10, RteUsedOsEventRef=Rte_Ev_Run_Vin_Vin_OnVinChangeIndicatorAck
        mse_ComOff: RtePositionInTask=19, RteEventRef=mse_ComOff, RteMappedToTaskRef=Task_100ms_Appl10, RteUsedOsEventRef=Rte_Ev_Run_Vin_Vin_OnComOff
        mse_ComOn: RtePositionInTask=20, RteEventRef=mse_ComOn, RteMappedToTaskRef=Task_100ms_Appl10, RteUsedOsEventRef=Rte_Ev_Run_Vin_Vin_OnComOn
        oie_NvMNotifyJobFinished_Vin_JobFinished: RteEventRef=oie_NvMNotifyJobFinished_Vin_JobFinished
    StdDiag (RteSwComponentType): RteComponentTypeRef=StdDiag, RteImplementationRef=Impl_StdDiag
      ComponentTypeCalibration (RteComponentTypeCalibration): RteCalibrationSupportEnabled=true
    Vin (RteSwComponentType): RteComponentTypeRef=Vin, RteImplementationRef=Vin_Impl
      ComponentTypeCalibration (RteComponentTypeCalibration): RteCalibrationSupportEnabled=true
    Dcm (RteBswModuleInstance): RteBswImplementationRef=Dcm_Impl, RteBswModuleConfigurationRef=Dcm
      DCM_EXCLUSIVE_AREA_0 (RteBswExclusiveAreaImpl): RteExclusiveAreaImplMechanism=OS_INTERRUPT_BLOCKING, RteExclusiveAreaOptimization=false, RteBswExclusiveAreaRef=DCM_EXCLUSIVE_AREA_0
      Dcm_MainFunctionTimingEvent0 (RteBswEventToTaskMapping):
        RteBswImmediateRestart = false
        RteBswPositionInTask = 7
        RteBswEventRef = Dcm_MainFunctionTimingEvent0
        RteBswMappedToTaskRef = Task_5msBsw_Appl10
        RteBswUsedOsAlarmRef = Rte_Al_TE2_Task_5msBsw_Appl10_0_5ms
        RteBswUsedOsEventRef = Rte_Ev_Cyclic2_Task_5msBsw_Appl10_0_5ms
    Dem (RteBswModuleInstance): RteBswImplementationRef=Dem_Impl, RteBswModuleConfigurationRef=Dem
      3 x RteBswExclusiveAreaImpl, all with RteExclusiveAreaImplMechanism=OS_INTERRUPT_BLOCKING, RteExclusiveAreaOptimization=false:
        DEM_EXCLUSIVE_AREA_{0..2}: RteBswExclusiveAreaRef=DEM_EXCLUSIVE_AREA_{0..2}
      Dem_MasterMainFunctionTimingEvent0 (RteBswEventToTaskMapping):
        RteBswImmediateRestart = false
        RteBswPositionInTask = 1
        RteBswEventRef = Dem_MasterMainFunctionTimingEvent0
        RteBswMappedToTaskRef = Task_10msBsw_Appl10
        RteBswUsedOsAlarmRef = Rte_Al_TE2_Task_10msBsw_Appl10_0_10ms
      Dem_SatelliteMainFunctionTimingEvent0 (RteBswEventToTaskMapping):
        RteBswImmediateRestart = false
        RteBswPositionInTask = 2
        RteBswEventRef = Dem_SatelliteMainFunctionTimingEvent0
        RteBswMappedToTaskRef = Task_10msBsw_Appl10
        RteBswUsedOsAlarmRef = Rte_Al_TE2_Task_10msBsw_Appl10_0_10ms
      DEM_EXCLUSIVE_AREA_3 (RteBswExclusiveAreaImpl): RteExclusiveAreaImplMechanism=OS_INTERRUPT_BLOCKING, RteExclusiveAreaOptimization=false, RteBswExclusiveAreaRef=DEM_EXCLUSIVE_AREA_3
    CmnMfgSrv_EcuSwComposition (RteSwComponentInstance): RteSoftwareComponentInstanceRef=CmnMfgSrv
      12 x RteNvRamAllocation:
        NvmBlock_CmnMfgSrv_NvmCcaHwPartNr: RteNvmRamBlockLocationSymbol=Rte_CmnMfgSrv_CcaHwPartNr, RteNvmBlockRef=Rte_NvmBlock_CmnMfgSrv_CcaHwPartNr, RteSwNvRamMappingRef=NvmCcaHwPartNr
        NvmBlock_CmnMfgSrv_NvmCcaSerlNr: RteNvmRamBlockLocationSymbol=Rte_CmnMfgSrv_CcaSerlNr, RteNvmBlockRef=Rte_NvmBlock_CmnMfgSrv_CcaSerlNr, RteSwNvRamMappingRef=NvmCcaSerlNr
        NvmBlock_CmnMfgSrv_NvmDiRestore: RteNvmRamBlockLocationSymbol=Rte_CmnMfgSrv_DiRestore, RteNvmBlockRef=Rte_NvmBlock_CmnMfgSrv_DiRestore, RteSwNvRamMappingRef=NvmDiRestore
        NvmBlock_CmnMfgSrv_NvmEpsSysSerlNr: RteNvmRamBlockLocationSymbol=Rte_CmnMfgSrv_EpsSysSerlNr, RteNvmBlockRef=Rte_NvmBlock_CmnMfgSrv_EpsSysSerlNr, RteSwNvRamMappingRef=NvmEpsSysSerlNr
        NvmBlock_CmnMfgSrv_NvmIgnCntr: RteNvmRamBlockLocationSymbol=Rte_CmnMfgSrv_IgnCntr, RteNvmRomBlockLocationSymbol=Rte_NvmIgnCntr_DefaultValue, RteNvmBlockRef=Rte_NvmBlock_CmnMfgSrv_IgnCntr, RteSwNvRamMappingRef=NvmIgnCntr
        NvmBlock_CmnMfgSrv_NvmMfgEnaCntr: RteNvmRamBlockLocationSymbol=Rte_CmnMfgSrv_NxtrMfgEnaCntr, RteNvmRomBlockLocationSymbol=Rte_NvmMfgEnaCntr_DefaultValue, RteNvmBlockRef=Rte_NvmBlock_CmnMfgSrv_NxtrMfgEnaCntr, RteSwNvRamMappingRef=NvmMfgEnaCntr
        NvmBlock_CmnMfgSrv_NvmMfgTmpBuf{0..4}: RteNvmRamBlockLocationSymbol=Rte_CmnMfgSrv_MfgTmpBuf{0..4}, RteNvmBlockRef=Rte_NvmBlock_CmnMfgSrv_MfgTmpBuf{0..4}, RteSwNvRamMappingRef=NvmMfgTmpBuf{0..4}
        NvmBlock_CmnMfgSrv_NvmSeedKey: RteNvmRamBlockLocationSymbol=Rte_CmnMfgSrv_SeedKey, RteNvmRomBlockLocationSymbol=Rte_SeedKeyDft, RteNvmBlockRef=Rte_NvmBlock_CmnMfgSrv_SeedKey, RteSwNvRamMappingRef=NvmSeedKey
      4 x RteEventToTaskMapping, all with RteImmediateRestart=false:
        OIT_CmnMfgSrvCmnMfgSrvMaiHndl_Oper_CmnMfgSrvCmnMfgSrvMaiHndl_Oper: RteEventRef=OIT_CmnMfgSrvCmnMfgSrvMaiHndl_Oper_CmnMfgSrvCmnMfgSrvMaiHndl_Oper
        CmnMfgSrv_InitEvent: RtePositionInTask=79, RteEventRef=CmnMfgSrv_InitEvent, RteMappedToTaskRef=Task_Init_Appl10
        TMT_CmnMfgSrvPer1: RtePositionInTask=9, RteEventRef=TMT_CmnMfgSrvPer1, RteMappedToTaskRef=Task_10ms_Appl10, RteUsedOsEventRef=Rte_Ev_Cyclic_Task_10ms_Appl10_0_10ms, RteUsedOsAlarmRef=Rte_Al_TE_Task_10ms_Appl10_0_10ms
        OIT_SwCalStsCallBack_Oper_SwCalStsCallBack_Oper: RteEventRef=OIT_SwCalStsCallBack_Oper_SwCalStsCallBack_Oper
    CmnMfgSrv (RteSwComponentType): RteComponentTypeRef=CmnMfgSrv, RteImplementationRef=CmnMfgSrv_Implementation
      ComponentTypeCalibration (RteComponentTypeCalibration): RteCalibrationSupportEnabled=true
    NxtrSwIds_EcuSwComposition (RteSwComponentInstance): RteSoftwareComponentInstanceRef=NxtrSwIds
      6 x RteEventToTaskMapping, all with RteImmediateRestart=false:
        CmnMfgSrv_InitEvent: RtePositionInTask=81, RteEventRef=CmnMfgSrv_InitEvent, RteMappedToTaskRef=Task_Init_Appl10
        OIT_NxtrSwIdsPsrInfoRd_Oper_NxtrSwIdsPsrInfoRd_Oper: RteEventRef=OIT_NxtrSwIdsPsrInfoRd_Oper_NxtrSwIdsPsrInfoRd_Oper
        OIT_NxtrSwIdsSwBuildDateTiRd_Oper_NxtrSwIdsSwBuildDateTiRd_Oper: RteEventRef=OIT_NxtrSwIdsSwBuildDateTiRd_Oper_NxtrSwIdsSwBuildDateTiRd_Oper
        OIT_NxtSwIdsSwRelInfoRd_Oper_NxtSwIdsSwRelInfoRd_Oper: RteEventRef=OIT_NxtSwIdsSwRelInfoRd_Oper_NxtSwIdsSwRelInfoRd_Oper
        OIT_NxtrSwIdsSwRelNrRd_Oper_NxtrSwIdsSwRelNrRd_Oper: RteEventRef=OIT_NxtrSwIdsSwRelNrRd_Oper_NxtrSwIdsSwRelNrRd_Oper
        OIT_NxtrSwIdsSwRelVerRd_Oper_NxtrSwIdsSwRelVerRd_Oper: RteEventRef=OIT_NxtrSwIdsSwRelVerRd_Oper_NxtrSwIdsSwRelVerRd_Oper
    NxtrSwIds (RteSwComponentType): RteComponentTypeRef=NxtrSwIds, RteImplementationRef=NxtrSwIds_Implementation
      ComponentTypeCalibration (RteComponentTypeCalibration): RteCalibrationSupportEnabled=true
    9 x RteSwComponentInstance:
      PolarityCfg_EcuSwComposition: RteSoftwareComponentInstanceRef=PolarityCfg
        NvmBlock_PolarityCfg_NvmPolarityCfgSaved (RteNvRamAllocation):
          RteNvmRamBlockLocationSymbol = Rte_PolarityCfg_PolarityCfgSaved
          RteNvmRomBlockLocationSymbol = Rte_PolarityCfgSavedDft
          RteNvmBlockRef = Rte_NvmBlock_PolarityCfg_PolarityCfgSaved
          RteSwNvRamMappingRef = NvmPolarityCfgSaved
        3 x RteEventToTaskMapping, all with RteImmediateRestart=false:
          PolarityCfgInit1_InitEvent: RtePositionInTask=15, RteEventRef=PolarityCfgInit1_InitEvent, RteMappedToTaskRef=Task_Init_Appl10
          OIT_PolarityCfgRead_Oper_PolarityCfgRead_Oper: RteEventRef=OIT_PolarityCfgRead_Oper_PolarityCfgRead_Oper
          OIT_PolarityCfgWr_Oper_PolarityCfgWr_Oper: RteEventRef=OIT_PolarityCfgWr_Oper_PolarityCfgWr_Oper
      GateDrv0Ctrl_EcuSwComposition: RteSoftwareComponentInstanceRef=GateDrv0Ctrl
        3 x RteEventToTaskMapping, all with RteImmediateRestart=false:
          GateDrvCtrl_InitEvent: RtePositionInTask=68, RteEventRef=GateDrvCtrl_InitEvent, RteMappedToTaskRef=Task_Init_Appl10
          TMT_GateDrvCtrlPer1: RtePositionInTask=3, RteEventRef=TMT_GateDrvCtrlPer1, RteMappedToTaskRef=Task_2msA_Appl10, RteUsedOsAlarmRef=Rte_Al_TE_Task_2msA_Appl10_0_2ms
          TMT_GateDrv0CtrlPer2: RtePositionInTask=14, RteEventRef=TMT_GateDrv0CtrlPer2, RteMappedToTaskRef=Task_2msB_Appl10, RteUsedOsAlarmRef=Rte_Al_TE_Task_2msB_Appl10_0_2ms
      CDD_SinVltgGenn_EcuSwComposition: RteSoftwareComponentInstanceRef=CDD_SinVltgGenn
        SinVltgGenn_InitEvent (RteEventToTaskMapping): RteImmediateRestart=false, RtePositionInTask=20, RteEventRef=SinVltgGenn_InitEvent, RteMappedToTaskRef=Task_Init_Appl10
      PwrSply_EcuSwComposition: RteSoftwareComponentInstanceRef=PwrSply
        PwrSply_InitEvent (RteEventToTaskMapping): RteImmediateRestart=false, RtePositionInTask=82, RteEventRef=PwrSply_InitEvent, RteMappedToTaskRef=Task_Init_Appl10
        TMT_PwrSplyPer1 (RteEventToTaskMapping):
          RteImmediateRestart = false
          RtePositionInTask = 3
          RteEventRef = TMT_PwrSplyPer1
          RteMappedToTaskRef = Task_4ms_Appl10
          RteUsedOsAlarmRef = Rte_Al_TE_Task_4ms_Appl10_0_4ms
      ShtdwnMech_EcuSwComposition: RteSoftwareComponentInstanceRef=ShtdwnMech
        ShtdwnMech_InitEvent (RteEventToTaskMapping): RteImmediateRestart=false, RtePositionInTask=71, RteEventRef=ShtdwnMech_InitEvent, RteMappedToTaskRef=Task_Init_Appl10
        TMT_ShtdwnMechPer1 (RteEventToTaskMapping):
          RteImmediateRestart = false
          RtePositionInTask = 34
          RteEventRef = TMT_ShtdwnMechPer1
          RteMappedToTaskRef = Task_2msB_Appl10
          RteUsedOsAlarmRef = Rte_Al_TE_Task_2msB_Appl10_0_2ms
      PwrUpSeq_EcuSwComposition: RteSoftwareComponentInstanceRef=PwrUpSeq
        3 x RteEventToTaskMapping, all with RteImmediateRestart=false:
          OIT_PwrTurnOffCtrl_Oper_PwrTurnOffCtrl_Oper: RteEventRef=OIT_PwrTurnOffCtrl_Oper_PwrTurnOffCtrl_Oper
          PwrUpSeqInit1_InitEvent: RtePositionInTask=59, RteEventRef=PwrUpSeqInit1_InitEvent, RteMappedToTaskRef=Task_Init_Appl10
          TMT_PwrUpSeqPer1: RtePositionInTask=29, RteEventRef=TMT_PwrUpSeqPer1, RteMappedToTaskRef=Task_2msB_Appl10, RteUsedOsAlarmRef=Rte_Al_TE_Task_2msB_Appl10_0_2ms
      CDD_MotAgCmp_EcuSwComposition: RteSoftwareComponentInstanceRef=CDD_MotAgCmp
        NvmBlock_CDD_MotAgCmp_NvmMotAgCmpMotAgBackEmf (RteNvRamAllocation):
          RteNvmRamBlockLocationSymbol = Rte_CDD_MotAgCmp_MotAgCmpMotAgBackEmf
          RteNvmRomBlockLocationSymbol = Rte_MotAgCmpMotAgBackEmfDft
          RteNvmBlockRef = Rte_NvmBlock_CDD_MotAgCmp_MotAgCmpMotAgBackEmf
          RteSwNvRamMappingRef = NvmMotAgCmpMotAgBackEmf
        4 x RteEventToTaskMapping, all with RteImmediateRestart=false:
          OIT_MotAgCmpBackEmfRead_Oper_MotAgCmpBackEmfRead_Oper: RteEventRef=OIT_MotAgCmpBackEmfRead_Oper_MotAgCmpBackEmfRead_Oper
          OIT_MotAgCmpBackEmfWr_Oper_MotAgCmpBackEmfWr_Oper: RteEventRef=OIT_MotAgCmpBackEmfWr_Oper_MotAgCmpBackEmfWr_Oper
          CDD_MotAgCmp_InitEvent: RtePositionInTask=69, RteEventRef=CDD_MotAgCmp_InitEvent, RteMappedToTaskRef=Task_Init_Appl10
          TMT_MotAgCmpPer2: RtePositionInTask=23, RteEventRef=TMT_MotAgCmpPer2, RteMappedToTaskRef=Task_2msA_Appl10, RteUsedOsAlarmRef=Rte_Al_TE_Task_2msA_Appl10_0_2ms
      PwrDiscnct_EcuSwComposition: RteSoftwareComponentInstanceRef=PwrDiscnct
        PwrDiscnct_InitEvent (RteEventToTaskMapping): RteImmediateRestart=false, RtePositionInTask=70, RteEventRef=PwrDiscnct_InitEvent, RteMappedToTaskRef=Task_Init_Appl10
        TMT_PwrDiscnctPer1 (RteEventToTaskMapping):
          RteImmediateRestart = false
          RtePositionInTask = 19
          RteEventRef = TMT_PwrDiscnctPer1
          RteMappedToTaskRef = Task_2msA_Appl10
          RteUsedOsAlarmRef = Rte_Al_TE_Task_2msA_Appl10_0_2ms
      TmplMonr_EcuSwComposition: RteSoftwareComponentInstanceRef=TmplMonr
        4 x RteEventToTaskMapping, all with RteImmediateRestart=false:
          TmplMonr_InitEvent: RtePositionInTask=5, RteEventRef=TmplMonr_InitEvent, RteMappedToTaskRef=Task_Init_Appl10
          TMT_TmplMonrPer1: RtePositionInTask=0, RteEventRef=TMT_TmplMonrPer1, RteMappedToTaskRef=Task_2msTmplMonr_Appl10, RteUsedOsAlarmRef=Rte_Al_TE_Task_2msTmplMonr_Appl10_0_2ms
          TMT_TmplMonrPer2: RtePositionInTask=31, RteEventRef=TMT_TmplMonrPer2, RteMappedToTaskRef=Task_2msB_Appl10, RteUsedOsAlarmRef=Rte_Al_TE_Task_2msB_Appl10_0_2ms
          TMT_TmplMonrPer2_1: RtePositionInTask=1, RteEventRef=TMT_TmplMonrPer2_1, RteMappedToTaskRef=Task_2msTmplMonr_Appl10, RteUsedOsAlarmRef=Rte_Al_TE_Task_2msTmplMonr_Appl10_0_2ms
    9 x RteSwComponentType:
      PolarityCfg: RteComponentTypeRef=PolarityCfg, RteImplementationRef=PolarityCfg_Implementation
        ComponentTypeCalibration (RteComponentTypeCalibration): RteCalibrationSupportEnabled=true
      PwrUpSeq: RteComponentTypeRef=PwrUpSeq, RteImplementationRef=PwrUpSeq_Implementation
        ComponentTypeCalibration (RteComponentTypeCalibration): RteCalibrationSupportEnabled=true
      PwrDiscnct: RteComponentTypeRef=PwrDiscnct, RteImplementationRef=PwrDiscnct_Implementation
        ComponentTypeCalibration (RteComponentTypeCalibration): RteCalibrationSupportEnabled=true
      PwrSply: RteComponentTypeRef=PwrSply, RteImplementationRef=PwrSply_Implementation
        ComponentTypeCalibration (RteComponentTypeCalibration): RteCalibrationSupportEnabled=true
      CDD_MotAgCmp: RteComponentTypeRef=CDD_MotAgCmp, RteImplementationRef=CDD_MotAgCmp_Implementation
        ComponentTypeCalibration (RteComponentTypeCalibration): RteCalibrationSupportEnabled=true
      GateDrv0Ctrl: RteComponentTypeRef=GateDrv0Ctrl, RteImplementationRef=GateDrv0Ctrl_Implementation
        ComponentTypeCalibration (RteComponentTypeCalibration): RteCalibrationSupportEnabled=true
      ShtdwnMech: RteComponentTypeRef=ShtdwnMech, RteImplementationRef=ShtdwnMech_Implementation
        ComponentTypeCalibration (RteComponentTypeCalibration): RteCalibrationSupportEnabled=true
      CDD_SinVltgGenn: RteComponentTypeRef=CDD_SinVltgGenn, RteImplementationRef=CDD_SinVltgGenn_Implementation
        ComponentTypeCalibration (RteComponentTypeCalibration): RteCalibrationSupportEnabled=true
      TmplMonr: RteComponentTypeRef=TmplMonr, RteImplementationRef=TmplMonr_Implementation
        ComponentTypeCalibration (RteComponentTypeCalibration): RteCalibrationSupportEnabled=true
    4 x RteSwComponentInstance:
      HwTqCorrln_EcuSwComposition: RteSoftwareComponentInstanceRef=HwTqCorrln
        NvmBlock_HwTqCorrln_NvmHwTqChACmnModCmpLpFilSt (RteNvRamAllocation):
          RteNvmRamBlockLocationSymbol = Rte_HwTqCorrln_HwTqChACmnModCmpLpFilSt
          RteNvmRomBlockLocationSymbol = Rte_HwTqChACmnModCmpLpFilStDft
          RteNvmBlockRef = Rte_NvmBlock_HwTqCorrln_HwTqChACmnModCmpLpFilSt
          RteSwNvRamMappingRef = NvmHwTqChACmnModCmpLpFilSt
        4 x RteEventToTaskMapping, all with RteImmediateRestart=false:
          HwTqCorrln_InitEvent: RtePositionInTask=19, RteEventRef=HwTqCorrln_InitEvent, RteMappedToTaskRef=Task_Init_Appl10
          TMT_HwTqCorrlnPer1: RtePositionInTask=15, RteEventRef=TMT_HwTqCorrlnPer1, RteMappedToTaskRef=Task_2msA_Appl10, RteUsedOsAlarmRef=Rte_Al_TE_Task_2msA_Appl10_0_2ms
          TMT_HwTqCorrlnPer2: RtePositionInTask=1, RteEventRef=TMT_HwTqCorrlnPer2, RteMappedToTaskRef=Task_4ms_Appl10, RteUsedOsAlarmRef=Rte_Al_TE_Task_4ms_Appl10_0_4ms
          TMT_HwTqCorrlnPer3: RtePositionInTask=7, RteEventRef=TMT_HwTqCorrlnPer3, RteMappedToTaskRef=Task_100ms_Appl10, RteUsedOsEventRef=Rte_Ev_Cyclic_Task_100ms_Appl10_0_100ms, RteUsedOsAlarmRef=Rte_Al_TE_Task_100ms_Appl10_0_100ms
      CDD_HwTq5Meas_EcuSwComposition: RteSoftwareComponentInstanceRef=CDD_HwTq5Meas
        NvmBlock_CDD_HwTq5Meas_NvmHwTq5Offs (RteNvRamAllocation):
          RteNvmRamBlockLocationSymbol = Rte_CDD_HwTq5Meas_HwTq5Offs
          RteNvmBlockRef = Rte_NvmBlock_CDD_HwTq5Meas_HwTq5Offs_MirrorBlock
          RteSwNvRamMappingRef = NvmHwTq5Offs
        NvmBlock_CDD_HwTq5Meas_NvmHwTq5Sca (RteNvRamAllocation):
          RteNvmRamBlockLocationSymbol = Rte_CDD_HwTq5Meas_HwTq5Sca
          RteNvmBlockRef = Rte_NvmBlock_CDD_HwTq5Meas_HwTq5Sca_MirrorBlock
          RteSwNvRamMappingRef = NvmHwTq5Sca
        13 x RteEventToTaskMapping, all with RteImmediateRestart=false:
          OIT_HwTq5AutTrim_Oper_HwTq5AutTrim_Oper: RteEventRef=OIT_HwTq5AutTrim_Oper_HwTq5AutTrim_Oper
          OIT_HwTq5ClrSnsrSca_Oper_HwTq5ClrSnsrSca_Oper: RteEventRef=OIT_HwTq5ClrSnsrSca_Oper_HwTq5ClrSnsrSca_Oper
          OIT_HwTq5ClrTrim_Oper_HwTq5ClrTrim_Oper: RteEventRef=OIT_HwTq5ClrTrim_Oper_HwTq5ClrTrim_Oper
          HwTq5Meas_InitEvent: RtePositionInTask=36, RteEventRef=HwTq5Meas_InitEvent, RteMappedToTaskRef=Task_Init_Appl10
          TMT_HwTq5MeasPer2: RtePositionInTask=14, RteEventRef=TMT_HwTq5MeasPer2, RteMappedToTaskRef=Task_2msA_Appl10, RteUsedOsAlarmRef=Rte_Al_TE_Task_2msA_Appl10_0_2ms
          TMT_HwTq5MeasPer3: RtePositionInTask=5, RteEventRef=TMT_HwTq5MeasPer3, RteMappedToTaskRef=Task_100ms_Appl10, RteUsedOsEventRef=Rte_Ev_Cyclic_Task_100ms_Appl10_0_100ms, RteUsedOsAlarmRef=Rte_Al_TE_Task_100ms_Appl10_0_100ms
          TMT_HwTq5MeasPer4: RtePositionInTask=6, RteEventRef=TMT_HwTq5MeasPer4, RteMappedToTaskRef=Task_100ms_Appl10, RteUsedOsEventRef=Rte_Ev_Cyclic_Task_100ms_Appl10_0_100ms, RteUsedOsAlarmRef=Rte_Al_TE_Task_100ms_Appl10_0_100ms
          OIT_HwTq5ReadSnsrSca_Oper_HwTq5ReadSnsrSca_Oper: RteEventRef=OIT_HwTq5ReadSnsrSca_Oper_HwTq5ReadSnsrSca_Oper
          OIT_HwTq5ReadTrim_Oper_HwTq5ReadTrim_Oper: RteEventRef=OIT_HwTq5ReadTrim_Oper_HwTq5ReadTrim_Oper
          OIT_HwTq5SnsrScaPrfmdSts_Oper_HwTq5SnsrScaPrfmdSts_Oper: RteEventRef=OIT_HwTq5SnsrScaPrfmdSts_Oper_HwTq5SnsrScaPrfmdSts_Oper
          OIT_HwTq5TrimPrfmdSts_Oper_HwTq5TrimPrfmdSts_Oper: RteEventRef=OIT_HwTq5TrimPrfmdSts_Oper_HwTq5TrimPrfmdSts_Oper
          OIT_HwTq5WrSnsrSca_Oper_HwTq5WrSnsrSca_Oper: RteEventRef=OIT_HwTq5WrSnsrSca_Oper_HwTq5WrSnsrSca_Oper
          OIT_HwTq5WrTrim_Oper_HwTq5WrTrim_Oper: RteEventRef=OIT_HwTq5WrTrim_Oper_HwTq5WrTrim_Oper
      CDD_HwTq4Meas_EcuSwComposition: RteSoftwareComponentInstanceRef=CDD_HwTq4Meas
        NvmBlock_CDD_HwTq4Meas_NvmHwTq4Offs (RteNvRamAllocation):
          RteNvmRamBlockLocationSymbol = Rte_CDD_HwTq4Meas_HwTq4Offs
          RteNvmBlockRef = Rte_NvmBlock_CDD_HwTq4Meas_HwTq4Offs_MirrorBlock
          RteSwNvRamMappingRef = NvmHwTq4Offs
        NvmBlock_CDD_HwTq4Meas_NvmHwTq4Sca (RteNvRamAllocation):
          RteNvmRamBlockLocationSymbol = Rte_CDD_HwTq4Meas_HwTq4Sca
          RteNvmBlockRef = Rte_NvmBlock_CDD_HwTq4Meas_HwTq4Sca_MirrorBlock
          RteSwNvRamMappingRef = NvmHwTq4Sca
        13 x RteEventToTaskMapping, all with RteImmediateRestart=false:
          OIT_HwTq4AutTrim_Oper_HwTq4AutTrim_Oper: RteEventRef=OIT_HwTq4AutTrim_Oper_HwTq4AutTrim_Oper
          OIT_HwTq4ClrSnsrSca_Oper_HwTq4ClrSnsrSca_Oper: RteEventRef=OIT_HwTq4ClrSnsrSca_Oper_HwTq4ClrSnsrSca_Oper
          OIT_HwTq4ClrTrim_Oper_HwTq4ClrTrim_Oper: RteEventRef=OIT_HwTq4ClrTrim_Oper_HwTq4ClrTrim_Oper
          HwTq4Meas_InitEvent: RtePositionInTask=35, RteEventRef=HwTq4Meas_InitEvent, RteMappedToTaskRef=Task_Init_Appl10
          TMT_HwTq4MeasPer2: RtePositionInTask=13, RteEventRef=TMT_HwTq4MeasPer2, RteMappedToTaskRef=Task_2msA_Appl10, RteUsedOsAlarmRef=Rte_Al_TE_Task_2msA_Appl10_0_2ms
          TMT_HwTq4MeasPer3: RtePositionInTask=3, RteEventRef=TMT_HwTq4MeasPer3, RteMappedToTaskRef=Task_100ms_Appl10, RteUsedOsEventRef=Rte_Ev_Cyclic_Task_100ms_Appl10_0_100ms, RteUsedOsAlarmRef=Rte_Al_TE_Task_100ms_Appl10_0_100ms
          TMT_HwTq4MeasPer4: RtePositionInTask=4, RteEventRef=TMT_HwTq4MeasPer4, RteMappedToTaskRef=Task_100ms_Appl10, RteUsedOsEventRef=Rte_Ev_Cyclic_Task_100ms_Appl10_0_100ms, RteUsedOsAlarmRef=Rte_Al_TE_Task_100ms_Appl10_0_100ms
          OIT_HwTq4ReadSnsrSca_Oper_HwTq4ReadSnsrSca_Oper: RteEventRef=OIT_HwTq4ReadSnsrSca_Oper_HwTq4ReadSnsrSca_Oper
          OIT_HwTq4ReadTrim_Oper_HwTq4ReadTrim_Oper: RteEventRef=OIT_HwTq4ReadTrim_Oper_HwTq4ReadTrim_Oper
          OIT_HwTq4SnsrScaPrfmdSts_Oper_HwTq4SnsrScaPrfmdSts_Oper: RteEventRef=OIT_HwTq4SnsrScaPrfmdSts_Oper_HwTq4SnsrScaPrfmdSts_Oper
          OIT_HwTq4TrimPrfmdSts_Oper_HwTq4TrimPrfmdSts_Oper: RteEventRef=OIT_HwTq4TrimPrfmdSts_Oper_HwTq4TrimPrfmdSts_Oper
          OIT_HwTq4WrSnsrSca_Oper_HwTq4WrSnsrSca_Oper: RteEventRef=OIT_HwTq4WrSnsrSca_Oper_HwTq4WrSnsrSca_Oper
          OIT_HwTq4WrTrim_Oper_HwTq4WrTrim_Oper: RteEventRef=OIT_HwTq4WrTrim_Oper_HwTq4WrTrim_Oper
      HwTqArbn_EcuSwComposition: RteSoftwareComponentInstanceRef=HwTqArbn
        HwTqArbn_InitEvent (RteEventToTaskMapping): RteImmediateRestart=false, RtePositionInTask=37, RteEventRef=HwTqArbn_InitEvent, RteMappedToTaskRef=Task_Init_Appl10
        TMT_HwTqArbnPer1 (RteEventToTaskMapping):
          RteImmediateRestart = false
          RtePositionInTask = 16
          RteEventRef = TMT_HwTqArbnPer1
          RteMappedToTaskRef = Task_2msA_Appl10
          RteUsedOsAlarmRef = Rte_Al_TE_Task_2msA_Appl10_0_2ms
    4 x RteSwComponentType:
      HwTqArbn: RteComponentTypeRef=HwTqArbn, RteImplementationRef=HwTqArbn_Implementation
        ComponentTypeCalibration (RteComponentTypeCalibration): RteCalibrationSupportEnabled=true
      CDD_HwTq5Meas: RteComponentTypeRef=CDD_HwTq5Meas, RteImplementationRef=CDD_HwTq5Meas_Implementation
        ComponentTypeCalibration (RteComponentTypeCalibration): RteCalibrationSupportEnabled=true
      CDD_HwTq4Meas: RteComponentTypeRef=CDD_HwTq4Meas, RteImplementationRef=CDD_HwTq4Meas_Implementation
        ComponentTypeCalibration (RteComponentTypeCalibration): RteCalibrationSupportEnabled=true
      HwTqCorrln: RteComponentTypeRef=HwTqCorrln, RteImplementationRef=HwTqCorrln_Implementation
        ComponentTypeCalibration (RteComponentTypeCalibration): RteCalibrationSupportEnabled=true
    12 x RteSwComponentInstance:
      MotCtrlPrmEstimn_EcuSwComposition: RteSoftwareComponentInstanceRef=MotCtrlPrmEstimn
        5 x RteEventToTaskMapping, all with RteImmediateRestart=false:
          OIT_GetMotPrmNomEol_Oper_GetMotPrmNomEol_Oper: RteEventRef=OIT_GetMotPrmNomEol_Oper_GetMotPrmNomEol_Oper
          MotCtrlPrmEstimn_InitEvent: RtePositionInTask=51, RteEventRef=MotCtrlPrmEstimn_InitEvent, RteMappedToTaskRef=Task_Init_Appl10
          TMT_MotCtrlPrmEstimnPer1: RtePositionInTask=27, RteEventRef=TMT_MotCtrlPrmEstimnPer1, RteMappedToTaskRef=Task_2msB_Appl10, RteUsedOsAlarmRef=Rte_Al_TE_Task_2msB_Appl10_0_2ms
          TMT_MotCtrlPrmEstimnPer2: RtePositionInTask=10, RteEventRef=TMT_MotCtrlPrmEstimnPer2, RteMappedToTaskRef=Task_100ms_Appl10, RteUsedOsEventRef=Rte_Ev_Cyclic_Task_100ms_Appl10_0_100ms, RteUsedOsAlarmRef=Rte_Al_TE_Task_100ms_Appl10_0_100ms
          OIT_SetMotPrmNomEol_Oper_SetMotPrmNomEol_Oper: RteEventRef=OIT_SetMotPrmNomEol_Oper_SetMotPrmNomEol_Oper
      MotCurrRegCfg_EcuSwComposition: RteSoftwareComponentInstanceRef=MotCurrRegCfg
        MotCurrRegCfg_InitEvent (RteEventToTaskMapping): RteImmediateRestart=false, RtePositionInTask=53, RteEventRef=MotCurrRegCfg_InitEvent, RteMappedToTaskRef=Task_Init_Appl10
        TMT_MotCurrRegCfgPer1 (RteEventToTaskMapping):
          RteImmediateRestart = false
          RtePositionInTask = 26
          RteEventRef = TMT_MotCurrRegCfgPer1
          RteMappedToTaskRef = Task_2msB_Appl10
          RteUsedOsAlarmRef = Rte_Al_TE_Task_2msB_Appl10_0_2ms
      MotQuadDetn_EcuSwComposition: RteSoftwareComponentInstanceRef=MotQuadDetn
        MotQuadDetn_InitEvent (RteEventToTaskMapping): RteImmediateRestart=false, RtePositionInTask=50, RteEventRef=MotQuadDetn_InitEvent, RteMappedToTaskRef=Task_Init_Appl10
        TMT_MotQuadDetnPer1 (RteEventToTaskMapping):
          RteImmediateRestart = false
          RtePositionInTask = 21
          RteEventRef = TMT_MotQuadDetnPer1
          RteMappedToTaskRef = Task_2msB_Appl10
          RteUsedOsAlarmRef = Rte_Al_TE_Task_2msB_Appl10_0_2ms
      ElecPwrCns_EcuSwComposition: RteSoftwareComponentInstanceRef=ElecPwrCns
        TMT_ElecPwrCnsPer1 (RteEventToTaskMapping):
          RteImmediateRestart = false
          RtePositionInTask = 1
          RteEventRef = TMT_ElecPwrCnsPer1
          RteMappedToTaskRef = Task_10ms_Appl8
          RteUsedOsAlarmRef = Rte_Al_TE_Task_10ms_Appl8_0_10ms
      PwrLimr_EcuSwComposition: RteSoftwareComponentInstanceRef=PwrLimr
        3 x RteEventToTaskMapping, all with RteImmediateRestart=false:
          PwrLimr_InitEvent: RtePositionInTask=48, RteEventRef=PwrLimr_InitEvent, RteMappedToTaskRef=Task_Init_Appl10
          TMT_PwrLimrPer1: RtePositionInTask=19, RteEventRef=TMT_PwrLimrPer1, RteMappedToTaskRef=Task_2msB_Appl10, RteUsedOsAlarmRef=Rte_Al_TE_Task_2msB_Appl10_0_2ms
          TMT_PwrLimrPer2: RtePositionInTask=3, RteEventRef=TMT_PwrLimrPer2, RteMappedToTaskRef=Task_10ms_Appl10, RteUsedOsEventRef=Rte_Ev_Cyclic_Task_10ms_Appl10_0_10ms, RteUsedOsAlarmRef=Rte_Al_TE_Task_10ms_Appl10_0_10ms
      TEstimn_EcuSwComposition: RteSoftwareComponentInstanceRef=TEstimn
        TEstimn_InitEvent (RteEventToTaskMapping): RteImmediateRestart=false, RtePositionInTask=4, RteEventRef=TEstimn_InitEvent, RteMappedToTaskRef=Task_Init_Appl9
        TMT_TEstimnPer1 (RteEventToTaskMapping):
          RteImmediateRestart = false
          RtePositionInTask = 2
          RteEventRef = TMT_TEstimnPer1
          RteMappedToTaskRef = Task_100ms_Appl9
          RteUsedOsAlarmRef = Rte_Al_TE_Task_100ms_Appl9_0_100ms
        NvmBlock_TEstimn_NvmTFilStVal (RteNvRamAllocation): RteNvmRamBlockLocationSymbol=Rte_TEstimn_TFilStVal, RteNvmBlockRef=Rte_NvmBlock_TEstimn_TFilStVal, RteSwNvRamMappingRef=NvmTFilStVal
      DutyCycThermProtn_EcuSwComposition: RteSoftwareComponentInstanceRef=DutyCycThermProtn
        NvmBlock_DutyCycThermProtn_NvmFilStVal (RteNvRamAllocation):
          RteNvmRamBlockLocationSymbol = Rte_DutyCycThermProtn_FilStVal
          RteNvmBlockRef = Rte_NvmBlock_DutyCycThermProtn_FilStVal
          RteSwNvRamMappingRef = NvmFilStVal
        DutyCycThermProtn_InitEvent (RteEventToTaskMapping): RteImmediateRestart=false, RtePositionInTask=3, RteEventRef=DutyCycThermProtn_InitEvent, RteMappedToTaskRef=Task_Init_Appl7
        TMT_DutyCycThermProtnPer1 (RteEventToTaskMapping):
          RteImmediateRestart = false
          RtePositionInTask = 2
          RteEventRef = TMT_DutyCycThermProtnPer1
          RteMappedToTaskRef = Task_100ms_Appl7
          RteUsedOsAlarmRef = Rte_Al_TE_Task_100ms_Appl7_0_100ms
      CDD_MotVel_EcuSwComposition: RteSoftwareComponentInstanceRef=CDD_MotVel
        CDD_MotVel_InitEvent (RteEventToTaskMapping): RteImmediateRestart=false, RtePositionInTask=67, RteEventRef=CDD_MotVel_InitEvent, RteMappedToTaskRef=Task_Init_Appl10
        TMT_MotVelPer2 (RteEventToTaskMapping):
          RteImmediateRestart = false
          RtePositionInTask = 24
          RteEventRef = TMT_MotVelPer2
          RteMappedToTaskRef = Task_2msA_Appl10
          RteUsedOsAlarmRef = Rte_Al_TE_Task_2msA_Appl10_0_2ms
      CDD_MotCurrRegVltgLimr_EcuSwComposition: RteSoftwareComponentInstanceRef=CDD_MotCurrRegVltgLimr
        MotCurrRegVltgLimrInit1_InitEvent (RteEventToTaskMapping): RteImmediateRestart=false, RtePositionInTask=54, RteEventRef=MotCurrRegVltgLimrInit1_InitEvent, RteMappedToTaskRef=Task_Init_Appl10
      MotCurrPeakEstimn_EcuSwComposition: RteSoftwareComponentInstanceRef=MotCurrPeakEstimn
        3 x RteEventToTaskMapping, all with RteImmediateRestart=false:
          MotCurrPeakEstimn_InitEvent: RtePositionInTask=55, RteEventRef=MotCurrPeakEstimn_InitEvent, RteMappedToTaskRef=Task_Init_Appl10
          TMT_MotCurrPeakEstimnPer1: RtePositionInTask=28, RteEventRef=TMT_MotCurrPeakEstimnPer1, RteMappedToTaskRef=Task_2msB_Appl10, RteUsedOsAlarmRef=Rte_Al_TE_Task_2msB_Appl10_0_2ms
          TMT_MotCurrPeakEstimnPer2: RtePositionInTask=8, RteEventRef=TMT_MotCurrPeakEstimnPer2, RteMappedToTaskRef=Task_100ms_Appl10, RteUsedOsEventRef=Rte_Ev_Cyclic_Task_100ms_Appl10_0_100ms, RteUsedOsAlarmRef=Rte_Al_TE_Task_100ms_Appl10_0_100ms
      MotRefMdl_EcuSwComposition: RteSoftwareComponentInstanceRef=MotRefMdl
        MotRefMdlInit1_InitEvent (RteEventToTaskMapping): RteImmediateRestart=false, RtePositionInTask=52, RteEventRef=MotRefMdlInit1_InitEvent, RteMappedToTaskRef=Task_Init_Appl10
        TMT_MotRefMdlPer1 (RteEventToTaskMapping):
          RteImmediateRestart = false
          RtePositionInTask = 22
          RteEventRef = TMT_MotRefMdlPer1
          RteMappedToTaskRef = Task_2msB_Appl10
          RteUsedOsAlarmRef = Rte_Al_TE_Task_2msB_Appl10_0_2ms
      HiLoadStallLimr_EcuSwComposition: RteSoftwareComponentInstanceRef=HiLoadStallLimr
        HiLoadStallLimr_InitEvent (RteEventToTaskMapping): RteImmediateRestart=false, RtePositionInTask=1, RteEventRef=HiLoadStallLimr_InitEvent, RteMappedToTaskRef=Task_Init_Appl7
        TMT_HiLoadStallLimrPer1 (RteEventToTaskMapping):
          RteImmediateRestart = false
          RtePositionInTask = 2
          RteEventRef = TMT_HiLoadStallLimrPer1
          RteMappedToTaskRef = Task_2ms_Appl7
          RteUsedOsAlarmRef = Rte_Al_TE_Task_2ms_Appl7_0_2ms
    12 x RteSwComponentType:
      MotCurrPeakEstimn: RteComponentTypeRef=MotCurrPeakEstimn, RteImplementationRef=MotCurrPeakEstimn_Implementation
        ComponentTypeCalibration (RteComponentTypeCalibration): RteCalibrationSupportEnabled=true
      ElecPwrCns: RteComponentTypeRef=ElecPwrCns, RteImplementationRef=ElecPwrCns_Implementation
        ComponentTypeCalibration (RteComponentTypeCalibration): RteCalibrationSupportEnabled=true
      MotRefMdl: RteComponentTypeRef=MotRefMdl, RteImplementationRef=MotRefMdl_Implementation
        ComponentTypeCalibration (RteComponentTypeCalibration): RteCalibrationSupportEnabled=true
      CDD_MotVel: RteComponentTypeRef=CDD_MotVel, RteImplementationRef=CDD_MotVel_Implementation
        ComponentTypeCalibration (RteComponentTypeCalibration): RteCalibrationSupportEnabled=true
      DutyCycThermProtn: RteComponentTypeRef=DutyCycThermProtn, RteImplementationRef=DutyCycThermProtn_Implementation
        ComponentTypeCalibration (RteComponentTypeCalibration): RteCalibrationSupportEnabled=true
      CDD_MotCurrRegVltgLimr: RteComponentTypeRef=CDD_MotCurrRegVltgLimr, RteImplementationRef=CDD_MotCurrRegVltgLimr_Implementation
        ComponentTypeCalibration (RteComponentTypeCalibration): RteCalibrationSupportEnabled=true
      HiLoadStallLimr: RteComponentTypeRef=HiLoadStallLimr, RteImplementationRef=HiLoadStallLimr_Implementation
        ComponentTypeCalibration (RteComponentTypeCalibration): RteCalibrationSupportEnabled=true
      MotQuadDetn: RteComponentTypeRef=MotQuadDetn, RteImplementationRef=MotQuadDetn_Implementation
        ComponentTypeCalibration (RteComponentTypeCalibration): RteCalibrationSupportEnabled=true
      PwrLimr: RteComponentTypeRef=PwrLimr, RteImplementationRef=PwrLimr_Implementation
        ComponentTypeCalibration (RteComponentTypeCalibration): RteCalibrationSupportEnabled=true
      MotCtrlPrmEstimn: RteComponentTypeRef=MotCtrlPrmEstimn, RteImplementationRef=MotCtrlPrmEstimn_Implementation
        ComponentTypeCalibration (RteComponentTypeCalibration): RteCalibrationSupportEnabled=true
      MotCurrRegCfg: RteComponentTypeRef=MotCurrRegCfg, RteImplementationRef=MotCurrRegCfg_Implementation
        ComponentTypeCalibration (RteComponentTypeCalibration): RteCalibrationSupportEnabled=true
      TEstimn: RteComponentTypeRef=TEstimn, RteImplementationRef=TEstimn_Implementation
        ComponentTypeCalibration (RteComponentTypeCalibration): RteCalibrationSupportEnabled=true
    ComM (RteBswModuleInstance): RteBswImplementationRef=ComM_Impl, RteBswModuleConfigurationRef=ComM
      COMM_EXCLUSIVE_AREA_0 (RteBswExclusiveAreaImpl): RteExclusiveAreaImplMechanism=OS_INTERRUPT_BLOCKING, RteExclusiveAreaOptimization=false, RteBswExclusiveAreaRef=COMM_EXCLUSIVE_AREA_0
      COMM_EXCLUSIVE_AREA_1 (RteBswExclusiveAreaImpl): RteExclusiveAreaImplMechanism=OS_INTERRUPT_BLOCKING, RteExclusiveAreaOptimization=false, RteBswExclusiveAreaRef=COMM_EXCLUSIVE_AREA_1
      ComM_MainFunction_0TimingEvent0 (RteBswEventToTaskMapping):
        RteBswImmediateRestart = false
        RteBswPositionInTask = 0
        RteBswEventRef = ComM_MainFunction_0TimingEvent0
        RteBswMappedToTaskRef = Task_5msBsw_Appl10
        RteBswUsedOsAlarmRef = Rte_Al_TE2_Task_5msBsw_Appl10_0_5ms
        RteBswUsedOsEventRef = Rte_Ev_Cyclic2_Task_5msBsw_Appl10_0_5ms
    IoHwAb_001 (RteSwComponentType): RteComponentTypeRef=IoHwAb, RteImplementationRef=IoHwAbImplementation
      ComponentTypeCalibration (RteComponentTypeCalibration): RteCalibrationSupportEnabled=true
    MotTqCmdSca_EcuSwComposition (RteSwComponentInstance): RteSoftwareComponentInstanceRef=MotTqCmdSca
      NvmBlock_MotTqCmdSca_NvmMotTqScaFac (RteNvRamAllocation):
        RteNvmRamBlockLocationSymbol = Rte_MotTqCmdSca_MotTqScaFac
        RteNvmBlockRef = Rte_NvmBlock_MotTqCmdSca_MotTqScaFac
        RteSwNvRamMappingRef = NvmMotTqScaFac
      4 x RteEventToTaskMapping, all with RteImmediateRestart=false:
        OIT_GetMotTqCmdSca_Oper_GetMotTqCmdSca_Oper: RteEventRef=OIT_GetMotTqCmdSca_Oper_GetMotTqCmdSca_Oper
        MotTqCmdSca_InitEvent: RtePositionInTask=64, RteEventRef=MotTqCmdSca_InitEvent, RteMappedToTaskRef=Task_Init_Appl10
        TMT_MotTqCmdScaPer1: RtePositionInTask=20, RteEventRef=TMT_MotTqCmdScaPer1, RteMappedToTaskRef=Task_2msB_Appl10, RteUsedOsAlarmRef=Rte_Al_TE_Task_2msB_Appl10_0_2ms
        OIT_SetMotTqCmdSca_Oper_SetMotTqCmdSca_Oper: RteEventRef=OIT_SetMotTqCmdSca_Oper_SetMotTqCmdSca_Oper
    MotTqCmdSca (RteSwComponentType): RteComponentTypeRef=MotTqCmdSca, RteImplementationRef=MotTqCmdSca_Implementation
      ComponentTypeCalibration (RteComponentTypeCalibration): RteCalibrationSupportEnabled=true
    MotTqTranlDampg_EcuSwComposition (RteSwComponentInstance): RteSoftwareComponentInstanceRef=MotTqTranlDampg
      MotTqTranlDampg_InitEvent (RteEventToTaskMapping): RteImmediateRestart=false, RtePositionInTask=49, RteEventRef=MotTqTranlDampg_InitEvent, RteMappedToTaskRef=Task_Init_Appl10
      TMT_MotTqTranlDampgPer1 (RteEventToTaskMapping):
        RteImmediateRestart = false
        RtePositionInTask = 16
        RteEventRef = TMT_MotTqTranlDampgPer1
        RteMappedToTaskRef = Task_2msB_Appl10
        RteUsedOsAlarmRef = Rte_Al_TE_Task_2msB_Appl10_0_2ms
    Swp_EcuSwComposition (RteSwComponentInstance): RteSoftwareComponentInstanceRef=Swp
      3 x RteEventToTaskMapping, all with RteImmediateRestart=false:
        Swp_InitEvent: RtePositionInTask=38, RteEventRef=Swp_InitEvent, RteMappedToTaskRef=Task_Init_Appl10
        TMT_SwpPer1: RtePositionInTask=28, RteEventRef=TMT_SwpPer1, RteMappedToTaskRef=Task_2msA_Appl10, RteUsedOsAlarmRef=Rte_Al_TE_Task_2msA_Appl10_0_2ms
        TMT_SwpPer2: RtePositionInTask=15, RteEventRef=TMT_SwpPer2, RteMappedToTaskRef=Task_2msB_Appl10, RteUsedOsAlarmRef=Rte_Al_TE_Task_2msB_Appl10_0_2ms
    MotTqTranlDampg (RteSwComponentType): RteComponentTypeRef=MotTqTranlDampg, RteImplementationRef=MotTqTranlDampg_Implementation
      ComponentTypeCalibration (RteComponentTypeCalibration): RteCalibrationSupportEnabled=true
    Swp (RteSwComponentType): RteComponentTypeRef=Swp, RteImplementationRef=Swp_Implementation
      ComponentTypeCalibration (RteComponentTypeCalibration): RteCalibrationSupportEnabled=true
    BacComIf_EcuSwComposition (RteSwComponentInstance): RteSoftwareComponentInstanceRef=BacComIf
      TMT_VinUpdate (RteEventToTaskMapping):
        RteImmediateRestart = false
        RtePositionInTask = 23
        RteEventRef = TMT_VinUpdate
        RteMappedToTaskRef = Task_100ms_Appl10
        RteUsedOsEventRef = Rte_Ev_Cyclic_Task_100ms_Appl10_0_100ms
        RteUsedOsAlarmRef = Rte_Al_TE_Task_100ms_Appl10_0_100ms
    BacComIf (RteSwComponentType): RteComponentTypeRef=BacComIf, RteImplementationRef=BacComIf_Implementation
      ComponentTypeCalibration (RteComponentTypeCalibration): RteCalibrationSupportEnabled=true
    3 x RteSwComponentInstance:
      CDD_ChkPtAppl7_EcuSwComposition: RteSoftwareComponentInstanceRef=CDD_ChkPtAppl7
        8 x RteEventToTaskMapping, all with RteImmediateRestart=false:
          TMT_ChkPt_100msAppl7End: RtePositionInTask=3, RteEventRef=TMT_ChkPt_100msAppl7End, RteMappedToTaskRef=Task_100ms_Appl7, RteUsedOsAlarmRef=Rte_Al_TE_Task_100ms_Appl7_0_100ms
          TMT_ChkPt_100msAppl7Strt: RtePositionInTask=0, RteEventRef=TMT_ChkPt_100msAppl7Strt, RteMappedToTaskRef=Task_100ms_Appl7, RteUsedOsAlarmRef=Rte_Al_TE_Task_100ms_Appl7_0_100ms
          TMT_ChkPt_10msAppl7End: RtePositionInTask=4, RteEventRef=TMT_ChkPt_10msAppl7End, RteMappedToTaskRef=Task_10ms_Appl7, RteUsedOsAlarmRef=Rte_Al_TE_Task_10ms_Appl7_0_10ms
          TMT_ChkPt_10msAppl7Strt: RtePositionInTask=0, RteEventRef=TMT_ChkPt_10msAppl7Strt, RteMappedToTaskRef=Task_10ms_Appl7, RteUsedOsAlarmRef=Rte_Al_TE_Task_10ms_Appl7_0_10ms
          TMT_ChkPt_2msAppl7End: RtePositionInTask=19, RteEventRef=TMT_ChkPt_2msAppl7End, RteMappedToTaskRef=Task_2ms_Appl7, RteUsedOsAlarmRef=Rte_Al_TE_Task_2ms_Appl7_0_2ms
          TMT_ChkPt_2msAppl7Strt: RtePositionInTask=0, RteEventRef=TMT_ChkPt_2msAppl7Strt, RteMappedToTaskRef=Task_2ms_Appl7, RteUsedOsAlarmRef=Rte_Al_TE_Task_2ms_Appl7_0_2ms
          TMT_ChkPt_4msAppl7End: RtePositionInTask=2, RteEventRef=TMT_ChkPt_4msAppl7End, RteMappedToTaskRef=Task_4ms_Appl7, RteUsedOsAlarmRef=Rte_Al_TE_Task_4ms_Appl7_0_4ms
          TMT_ChkPt_4msAppl7Strt: RtePositionInTask=0, RteEventRef=TMT_ChkPt_4msAppl7Strt, RteMappedToTaskRef=Task_4ms_Appl7, RteUsedOsAlarmRef=Rte_Al_TE_Task_4ms_Appl7_0_4ms
      CDD_ChkPtAppl9_EcuSwComposition: RteSoftwareComponentInstanceRef=CDD_ChkPtAppl9
        6 x RteEventToTaskMapping, all with RteImmediateRestart=false:
          TMT_ChkPt_100msAppl9End: RtePositionInTask=3, RteEventRef=TMT_ChkPt_100msAppl9End, RteMappedToTaskRef=Task_100ms_Appl9, RteUsedOsAlarmRef=Rte_Al_TE_Task_100ms_Appl9_0_100ms
          TMT_ChkPt_100msAppl9Strt: RtePositionInTask=0, RteEventRef=TMT_ChkPt_100msAppl9Strt, RteMappedToTaskRef=Task_100ms_Appl9, RteUsedOsAlarmRef=Rte_Al_TE_Task_100ms_Appl9_0_100ms
          TMT_ChkPt_10msAppl9End: RtePositionInTask=2, RteEventRef=TMT_ChkPt_10msAppl9End, RteMappedToTaskRef=Task_10ms_Appl9, RteUsedOsAlarmRef=Rte_Al_TE_Task_10ms_Appl9_0_10ms
          TMT_ChkPt_10msAppl9Strt: RtePositionInTask=0, RteEventRef=TMT_ChkPt_10msAppl9Strt, RteMappedToTaskRef=Task_10ms_Appl9, RteUsedOsAlarmRef=Rte_Al_TE_Task_10ms_Appl9_0_10ms
          TMT_ChkPt_2msAppl9End: RtePositionInTask=5, RteEventRef=TMT_ChkPt_2msAppl9End, RteMappedToTaskRef=Task_2ms_Appl9, RteUsedOsAlarmRef=Rte_Al_TE_Task_2ms_Appl9_0_2ms
          TMT_ChkPt_2msAppl9Strt: RtePositionInTask=0, RteEventRef=TMT_ChkPt_2msAppl9Strt, RteMappedToTaskRef=Task_2ms_Appl9, RteUsedOsAlarmRef=Rte_Al_TE_Task_2ms_Appl9_0_2ms
      CDD_ChkPtAppl8_EcuSwComposition: RteSoftwareComponentInstanceRef=CDD_ChkPtAppl8
        4 x RteEventToTaskMapping, all with RteImmediateRestart=false:
          TMT_ChkPt_10msAppl8End: RtePositionInTask=3, RteEventRef=TMT_ChkPt_10msAppl8End, RteMappedToTaskRef=Task_10ms_Appl8, RteUsedOsAlarmRef=Rte_Al_TE_Task_10ms_Appl8_0_10ms
          TMT_ChkPt_10msAppl8Strt: RtePositionInTask=0, RteEventRef=TMT_ChkPt_10msAppl8Strt, RteMappedToTaskRef=Task_10ms_Appl8, RteUsedOsAlarmRef=Rte_Al_TE_Task_10ms_Appl8_0_10ms
          TMT_ChkPt_2msAppl8End: RtePositionInTask=4, RteEventRef=TMT_ChkPt_2msAppl8End, RteMappedToTaskRef=Task_2ms_Appl8, RteUsedOsAlarmRef=Rte_Al_TE_Task_2ms_Appl8_0_2ms
          TMT_ChkPt_2msAppl8Strt: RtePositionInTask=0, RteEventRef=TMT_ChkPt_2msAppl8Strt, RteMappedToTaskRef=Task_2ms_Appl8, RteUsedOsAlarmRef=Rte_Al_TE_Task_2ms_Appl8_0_2ms
    3 x RteSwComponentType:
      CDD_ChkPtAppl7: RteComponentTypeRef=CDD_ChkPtAppl7, RteImplementationRef=CDD_ChkPtAppl7_Implementation
        ComponentTypeCalibration (RteComponentTypeCalibration): RteCalibrationSupportEnabled=true
      CDD_ChkPtAppl9: RteComponentTypeRef=CDD_ChkPtAppl9, RteImplementationRef=CDD_ChkPtAppl9_Implementation
        ComponentTypeCalibration (RteComponentTypeCalibration): RteCalibrationSupportEnabled=true
      CDD_ChkPtAppl8: RteComponentTypeRef=CDD_ChkPtAppl8, RteImplementationRef=CDD_ChkPtAppl8_Implementation
        ComponentTypeCalibration (RteComponentTypeCalibration): RteCalibrationSupportEnabled=true
    8 x RteSwComponentInstance:
      WdgM_Appl9_EcuSwComposition: RteSoftwareComponentInstanceRef=WdgM_Appl9
        9 x RteEventToTaskMapping, all with RteImmediateRestart=false:
          OpEventGetLocalStatus_GetLocalStatus_localStatus_SE_2ms_Appl9: RtePositionInTask=7, RteEventRef=OpEventGetLocalStatus_GetLocalStatus_localStatus_SE_2ms_Appl9, RteMappedToTaskRef=Task_Init_Appl9
          OpEventCheckpointReached_CheckpointReached_alive_SE_2ms_Appl9_ChkPt_2ms_Appl9_End: RteEventRef=OpEventCheckpointReached_CheckpointReached_alive_SE_2ms_Appl9_ChkPt_2ms_Appl9_End
          OpEventCheckpointReached_CheckpointReached_alive_SE_2ms_Appl9_ChkPt_2ms_Appl9_Strt: RteEventRef=OpEventCheckpointReached_CheckpointReached_alive_SE_2ms_Appl9_ChkPt_2ms_Appl9_Strt
          OpEventGetLocalStatus_GetLocalStatus_localStatus_SE_10ms_Appl9: RteEventRef=OpEventGetLocalStatus_GetLocalStatus_localStatus_SE_10ms_Appl9
          OpEventCheckpointReached_CheckpointReached_alive_SE_10ms_Appl9_ChkPt_10ms_Appl9_End: RteEventRef=OpEventCheckpointReached_CheckpointReached_alive_SE_10ms_Appl9_ChkPt_10ms_Appl9_End
          OpEventCheckpointReached_CheckpointReached_alive_SE_10ms_Appl9_ChkPt_10ms_Appl9_Strt: RteEventRef=OpEventCheckpointReached_CheckpointReached_alive_SE_10ms_Appl9_ChkPt_10ms_Appl9_Strt
          OpEventCheckpointReached_CheckpointReached_alive_SE_100ms_Appl9_ChkPt_100ms_Appl9_End: RteEventRef=OpEventCheckpointReached_CheckpointReached_alive_SE_100ms_Appl9_ChkPt_100ms_Appl9_End
          OpEventCheckpointReached_CheckpointReached_alive_SE_100ms_Appl9_ChkPt_100ms_Appl9_Strt: RteEventRef=OpEventCheckpointReached_CheckpointReached_alive_SE_100ms_Appl9_ChkPt_100ms_Appl9_Strt
          OpEventGetLocalStatus_GetLocalStatus_localStatus_SE_100ms_Appl9: RteEventRef=OpEventGetLocalStatus_GetLocalStatus_localStatus_SE_100ms_Appl9
      WdgM_Appl8_EcuSwComposition: RteSoftwareComponentInstanceRef=WdgM_Appl8
        6 x RteEventToTaskMapping, all with RteImmediateRestart=false:
          OpEventGetLocalStatus_GetLocalStatus_localStatus_SE_2ms_Appl8: RtePositionInTask=4, RteEventRef=OpEventGetLocalStatus_GetLocalStatus_localStatus_SE_2ms_Appl8, RteMappedToTaskRef=Task_Init_Appl8
          OpEventCheckpointReached_CheckpointReached_alive_SE_2ms_Appl8_ChkPt_2ms_Appl8_Strt: RteEventRef=OpEventCheckpointReached_CheckpointReached_alive_SE_2ms_Appl8_ChkPt_2ms_Appl8_Strt
          OpEventCheckpointReached_CheckpointReached_alive_SE_2ms_Appl8_ChkPt_2ms_Appl8_End: RteEventRef=OpEventCheckpointReached_CheckpointReached_alive_SE_2ms_Appl8_ChkPt_2ms_Appl8_End
          OpEventCheckpointReached_CheckpointReached_alive_SE_10ms_Appl8_ChkPt_10ms_Appl8_End: RteEventRef=OpEventCheckpointReached_CheckpointReached_alive_SE_10ms_Appl8_ChkPt_10ms_Appl8_End
          OpEventCheckpointReached_CheckpointReached_alive_SE_10ms_Appl8_ChkPt_10ms_Appl8_Strt: RteEventRef=OpEventCheckpointReached_CheckpointReached_alive_SE_10ms_Appl8_ChkPt_10ms_Appl8_Strt
          OpEventGetLocalStatus_GetLocalStatus_localStatus_SE_10ms_Appl8: RteEventRef=OpEventGetLocalStatus_GetLocalStatus_localStatus_SE_10ms_Appl8
      WdgM_Appl7_EcuSwComposition: RteSoftwareComponentInstanceRef=WdgM_Appl7
        12 x RteEventToTaskMapping, all with RteImmediateRestart=false:
          OpEventCheckpointReached_CheckpointReached_alive_SE_2ms_Appl7_ChkPt_2ms_Appl7_End: RteEventRef=OpEventCheckpointReached_CheckpointReached_alive_SE_2ms_Appl7_ChkPt_2ms_Appl7_End
          OpEventCheckpointReached_CheckpointReached_alive_SE_2ms_Appl7_ChkPt_2ms_Appl7_Strt: RteEventRef=OpEventCheckpointReached_CheckpointReached_alive_SE_2ms_Appl7_ChkPt_2ms_Appl7_Strt
          OpEventGetLocalStatus_GetLocalStatus_localStatus_SE_2ms_Appl7: RtePositionInTask=21, RteEventRef=OpEventGetLocalStatus_GetLocalStatus_localStatus_SE_2ms_Appl7, RteMappedToTaskRef=Task_Init_Appl7
          OpEventCheckpointReached_CheckpointReached_alive_SE_10ms_Appl7_ChkPt_10ms_Appl7_End: RteEventRef=OpEventCheckpointReached_CheckpointReached_alive_SE_10ms_Appl7_ChkPt_10ms_Appl7_End
          OpEventGetLocalStatus_GetLocalStatus_localStatus_SE_100ms_Appl7: RteEventRef=OpEventGetLocalStatus_GetLocalStatus_localStatus_SE_100ms_Appl7
          OpEventCheckpointReached_CheckpointReached_alive_SE_10ms_Appl7_ChkPt_10ms_Appl7_Strt: RteEventRef=OpEventCheckpointReached_CheckpointReached_alive_SE_10ms_Appl7_ChkPt_10ms_Appl7_Strt
          OpEventGetLocalStatus_GetLocalStatus_localStatus_SE_10ms_Appl7: RteEventRef=OpEventGetLocalStatus_GetLocalStatus_localStatus_SE_10ms_Appl7
          OpEventCheckpointReached_CheckpointReached_alive_SE_4ms_Appl7_ChkPt_4ms_Appl7_End: RteEventRef=OpEventCheckpointReached_CheckpointReached_alive_SE_4ms_Appl7_ChkPt_4ms_Appl7_End
          OpEventCheckpointReached_CheckpointReached_alive_SE_4ms_Appl7_ChkPt_4ms_Appl7_Strt: RteEventRef=OpEventCheckpointReached_CheckpointReached_alive_SE_4ms_Appl7_ChkPt_4ms_Appl7_Strt
          OpEventCheckpointReached_CheckpointReached_alive_SE_100ms_Appl7_ChkPt_100ms_Appl7_End: RteEventRef=OpEventCheckpointReached_CheckpointReached_alive_SE_100ms_Appl7_ChkPt_100ms_Appl7_End
          OpEventCheckpointReached_CheckpointReached_alive_SE_100ms_Appl7_ChkPt_100ms_Appl7_Strt: RteEventRef=OpEventCheckpointReached_CheckpointReached_alive_SE_100ms_Appl7_ChkPt_100ms_Appl7_Strt
          OpEventGetLocalStatus_GetLocalStatus_localStatus_SE_4ms_Appl7: RteEventRef=OpEventGetLocalStatus_GetLocalStatus_localStatus_SE_4ms_Appl7
      StOutpCtrl_EcuSwComposition: RteSoftwareComponentInstanceRef=StOutpCtrl
        StOutpCtrl_InitEvent (RteEventToTaskMapping): RteImmediateRestart=false, RtePositionInTask=47, RteEventRef=StOutpCtrl_InitEvent, RteMappedToTaskRef=Task_Init_Appl10
        TMT_StOutpCtrlPer1 (RteEventToTaskMapping):
          RteImmediateRestart = false
          RtePositionInTask = 3
          RteEventRef = TMT_StOutpCtrlPer1
          RteMappedToTaskRef = Task_2msB_Appl10
          RteUsedOsAlarmRef = Rte_Al_TE_Task_2msB_Appl10_0_2ms
      VehSpdLimr_EcuSwComposition: RteSoftwareComponentInstanceRef=VehSpdLimr
        TMT_VehSpdLimrPer1 (RteEventToTaskMapping):
          RteImmediateRestart = false
          RtePositionInTask = 17
          RteEventRef = TMT_VehSpdLimrPer1
          RteMappedToTaskRef = Task_2ms_Appl7
          RteUsedOsAlarmRef = Rte_Al_TE_Task_2ms_Appl7_0_2ms
      PosnTrakgServo_EcuSwComposition: RteSoftwareComponentInstanceRef=PosnTrakgServo
        PosnTrakgServo_InitEvent (RteEventToTaskMapping): RteImmediateRestart=false, RtePositionInTask=60, RteEventRef=PosnTrakgServo_InitEvent, RteMappedToTaskRef=Task_Init_Appl10
        TMT_PosnTrakgServoPer1 (RteEventToTaskMapping):
          RteImmediateRestart = false
          RtePositionInTask = 4
          RteEventRef = TMT_PosnTrakgServoPer1
          RteMappedToTaskRef = Task_2msB_Appl10
          RteUsedOsAlarmRef = Rte_Al_TE_Task_2msB_Appl10_0_2ms
      EotProtn_EcuSwComposition: RteSoftwareComponentInstanceRef=EotProtn
        EotProtn_InitEvent (RteEventToTaskMapping): RteImmediateRestart=false, RtePositionInTask=0, RteEventRef=EotProtn_InitEvent, RteMappedToTaskRef=Task_Init_Appl7
        TMT_EotProtnPer1 (RteEventToTaskMapping):
          RteImmediateRestart = false
          RtePositionInTask = 1
          RteEventRef = TMT_EotProtnPer1
          RteMappedToTaskRef = Task_2ms_Appl7
          RteUsedOsAlarmRef = Rte_Al_TE_Task_2ms_Appl7_0_2ms
      SysFricLrng_EcuSwComposition: RteSoftwareComponentInstanceRef=SysFricLrng
        NvmBlock_SysFricLrng_NvMFricLrngData (RteNvRamAllocation):
          RteNvmRamBlockLocationSymbol = Rte_SysFricLrng_FricLrngData
          RteNvmRomBlockLocationSymbol = Rte_FricLrngDataDft
          RteNvmBlockRef = Rte_NvmBlock_SysFricLrng_FricLrngData
          RteSwNvRamMappingRef = NvMFricLrngData
        NvmBlock_SysFricLrng_NvMFricNonLrngData (RteNvRamAllocation):
          RteNvmRamBlockLocationSymbol = Rte_SysFricLrng_FricNonLrngData
          RteNvmRomBlockLocationSymbol = Rte_FricNonLrngDataDft
          RteNvmBlockRef = Rte_NvmBlock_SysFricLrng_FricNonLrngData
          RteSwNvRamMappingRef = NvMFricNonLrngData
        10 x RteEventToTaskMapping, all with RteImmediateRestart=false:
          OIT_ClrFricLrngOperMod_Oper_ClrFricLrngOperMod_Oper: RteEventRef=OIT_ClrFricLrngOperMod_Oper_ClrFricLrngOperMod_Oper
          OIT_GetFricData_Oper_GetFricData_Oper: RteEventRef=OIT_GetFricData_Oper_GetFricData_Oper
          OIT_GetFricLrngData_Oper_GetFricLrngData_Oper: RteEventRef=OIT_GetFricLrngData_Oper_GetFricLrngData_Oper
          OIT_GetFricOffsOutpDi_Oper_GetFricOffsOutpDi_Oper: RteEventRef=OIT_GetFricOffsOutpDi_Oper_GetFricOffsOutpDi_Oper
          OIT_InitFricLrngTbl_Oper_InitFricLrngTbl_Oper: RteEventRef=OIT_InitFricLrngTbl_Oper_InitFricLrngTbl_Oper
          OIT_SetFricData_Oper_SetFricData_Oper: RteEventRef=OIT_SetFricData_Oper_SetFricData_Oper
          OIT_SetFricLrngData_Oper_SetFricLrngData_Oper: RteEventRef=OIT_SetFricLrngData_Oper_SetFricLrngData_Oper
          OIT_SetFricOffsOutpDi_Oper_SetFricOffsOutpDi_Oper: RteEventRef=OIT_SetFricOffsOutpDi_Oper_SetFricOffsOutpDi_Oper
          SysFricLrng_InitEvent: RtePositionInTask=4, RteEventRef=SysFricLrng_InitEvent, RteMappedToTaskRef=Task_Init_Appl10
          TMT_SysFricLrngPer1: RtePositionInTask=2, RteEventRef=TMT_SysFricLrngPer1, RteMappedToTaskRef=Task_10ms_Appl10, RteUsedOsEventRef=Rte_Ev_Cyclic_Task_10ms_Appl10_0_10ms, RteUsedOsAlarmRef=Rte_Al_TE_Task_10ms_Appl10_0_10ms
    8 x RteSwComponentType:
      EotProtn: RteComponentTypeRef=EotProtn, RteImplementationRef=EotProtn_Implementation
        ComponentTypeCalibration (RteComponentTypeCalibration): RteCalibrationSupportEnabled=true
      VehSpdLimr: RteComponentTypeRef=VehSpdLimr, RteImplementationRef=VehSpdLimr_Implementation
        ComponentTypeCalibration (RteComponentTypeCalibration): RteCalibrationSupportEnabled=true
      SysFricLrng: RteComponentTypeRef=SysFricLrng, RteImplementationRef=SysFricLrng_Implementation
        ComponentTypeCalibration (RteComponentTypeCalibration): RteCalibrationSupportEnabled=true
      PosnTrakgServo: RteComponentTypeRef=PosnTrakgServo, RteImplementationRef=PosnTrakgServo_Implementation
        ComponentTypeCalibration (RteComponentTypeCalibration): RteCalibrationSupportEnabled=true
      StOutpCtrl: RteComponentTypeRef=StOutpCtrl, RteImplementationRef=StOutpCtrl_Implementation
        ComponentTypeCalibration (RteComponentTypeCalibration): RteCalibrationSupportEnabled=true
      DiagcMgrProxyAppl9: RteComponentTypeRef=DiagcMgrProxyAppl9, RteImplementationRef=DiagcMgrProxyAppl9_Implementation
        ComponentTypeCalibration (RteComponentTypeCalibration): RteCalibrationSupportEnabled=true
      DiagcMgrProxyAppl8: RteComponentTypeRef=DiagcMgrProxyAppl8, RteImplementationRef=DiagcMgrProxyAppl8_Implementation
        ComponentTypeCalibration (RteComponentTypeCalibration): RteCalibrationSupportEnabled=true
      DiagcMgrProxyAppl7: RteComponentTypeRef=DiagcMgrProxyAppl7, RteImplementationRef=DiagcMgrProxyAppl7_Implementation
        ComponentTypeCalibration (RteComponentTypeCalibration): RteCalibrationSupportEnabled=true
    VehSigCdng_EcuSwComposition (RteSwComponentInstance): RteSoftwareComponentInstanceRef=VehSigCdng
      VehSigCdng_InitEvent (RteEventToTaskMapping): RteImmediateRestart=false, RtePositionInTask=5, RteEventRef=VehSigCdng_InitEvent, RteMappedToTaskRef=Task_Init_Appl9
      TMT_VehSigCdngPer1 (RteEventToTaskMapping):
        RteImmediateRestart = false
        RtePositionInTask = 3
        RteEventRef = TMT_VehSigCdngPer1
        RteMappedToTaskRef = Task_2ms_Appl9
        RteUsedOsAlarmRef = Rte_Al_TE_Task_2ms_Appl9_0_2ms
    VehSigCdng (RteSwComponentType): RteComponentTypeRef=VehSigCdng, RteImplementationRef=VehSigCdng_Implementation
      ComponentTypeCalibration (RteComponentTypeCalibration): RteCalibrationSupportEnabled=true
    3 x RteSwComponentInstance:
      LimrCdng_EcuSwComposition: RteSoftwareComponentInstanceRef=LimrCdng
        TMT_LimrCdngPer1 (RteEventToTaskMapping):
          RteImmediateRestart = false
          RtePositionInTask = 4
          RteEventRef = TMT_LimrCdngPer1
          RteMappedToTaskRef = Task_2ms_Appl9
          RteUsedOsAlarmRef = Rte_Al_TE_Task_2ms_Appl9_0_2ms
      TunSelnAuthy_EcuSwComposition: RteSoftwareComponentInstanceRef=TunSelnAuthy
        3 x RteEventToTaskMapping, all with RteImmediateRestart=false:
          OIT_RtCalChgReq_Oper_RtCalChgReq_Oper: RteEventRef=OIT_RtCalChgReq_Oper_RtCalChgReq_Oper
          TunSelnAuthy_InitEvent: RtePositionInTask=2, RteEventRef=TunSelnAuthy_InitEvent, RteMappedToTaskRef=Task_Init_Appl9
          OIT_XcpCalChgReq_Oper_XcpCalChgReq_Oper: RteEventRef=OIT_XcpCalChgReq_Oper_XcpCalChgReq_Oper
      CmplncErr_EcuSwComposition: RteSoftwareComponentInstanceRef=CmplncErr
        CmplncErrInit1_InitEvent (RteEventToTaskMapping): RteImmediateRestart=false, RtePositionInTask=61, RteEventRef=CmplncErrInit1_InitEvent, RteMappedToTaskRef=Task_Init_Appl10
        TMT_CmplncErrPer1 (RteEventToTaskMapping):
          RteImmediateRestart = false
          RtePositionInTask = 25
          RteEventRef = TMT_CmplncErrPer1
          RteMappedToTaskRef = Task_2msA_Appl10
          RteUsedOsAlarmRef = Rte_Al_TE_Task_2msA_Appl10_0_2ms
    3 x RteSwComponentType:
      CmplncErr: RteComponentTypeRef=CmplncErr, RteImplementationRef=CmplncErr_Implementation
        ComponentTypeCalibration (RteComponentTypeCalibration): RteCalibrationSupportEnabled=true
      TunSelnAuthy: RteComponentTypeRef=TunSelnAuthy, RteImplementationRef=TunSelnAuthy_Implementation
        ComponentTypeCalibration (RteComponentTypeCalibration): RteCalibrationSupportEnabled=true
      LimrCdng: RteComponentTypeRef=LimrCdng, RteImplementationRef=LimrCdng_Implementation
        ComponentTypeCalibration (RteComponentTypeCalibration): RteCalibrationSupportEnabled=true
    3 x RteSwComponentInstance:
      CurrMeasCorrln_EcuSwComposition: RteSoftwareComponentInstanceRef=CurrMeasCorrln
        CurrMeasCorrln_InitEvent (RteEventToTaskMapping): RteImmediateRestart=false, RtePositionInTask=17, RteEventRef=CurrMeasCorrln_InitEvent, RteMappedToTaskRef=Task_Init_Appl10
        TMT_CurrMeasCorrlnPer1 (RteEventToTaskMapping):
          RteImmediateRestart = false
          RtePositionInTask = 25
          RteEventRef = TMT_CurrMeasCorrlnPer1
          RteMappedToTaskRef = Task_2msB_Appl10
          RteUsedOsAlarmRef = Rte_Al_TE_Task_2msB_Appl10_0_2ms
      CDD_CurrMeasArbn_EcuSwComposition: RteSoftwareComponentInstanceRef=CDD_CurrMeasArbn
        CurrMeasCorrln_InitEvent (RteEventToTaskMapping): RteImmediateRestart=false, RtePositionInTask=18, RteEventRef=CurrMeasCorrln_InitEvent, RteMappedToTaskRef=Task_Init_Appl10
      TurnCntrCorrln_EcuSwComposition: RteSoftwareComponentInstanceRef=TurnCntrCorrln
        TurnCntrCorrln_InitEvent (RteEventToTaskMapping): RteImmediateRestart=false, RtePositionInTask=1, RteEventRef=TurnCntrCorrln_InitEvent, RteMappedToTaskRef=Task_Init_Appl8
        TMT_TurnCntrCorrlnPer1 (RteEventToTaskMapping):
          RteImmediateRestart = false
          RtePositionInTask = 2
          RteEventRef = TMT_TurnCntrCorrlnPer1
          RteMappedToTaskRef = Task_2ms_Appl8
          RteUsedOsAlarmRef = Rte_Al_TE_Task_2ms_Appl8_0_2ms
    3 x RteSwComponentType:
      TurnCntrCorrln: RteComponentTypeRef=TurnCntrCorrln, RteImplementationRef=TurnCntrCorrln_Implementation
        ComponentTypeCalibration (RteComponentTypeCalibration): RteCalibrationSupportEnabled=true
      CDD_CurrMeasArbn: RteComponentTypeRef=CDD_CurrMeasArbn, RteImplementationRef=CDD_CurrMeasArbn_Implementation
        ComponentTypeCalibration (RteComponentTypeCalibration): RteCalibrationSupportEnabled=true
      CurrMeasCorrln: RteComponentTypeRef=CurrMeasCorrln, RteImplementationRef=CurrMeasCorrln_Implementation
        ComponentTypeCalibration (RteComponentTypeCalibration): RteCalibrationSupportEnabled=true
    CDD_McuDiagc_EcuSwComposition (RteSwComponentInstance): RteSoftwareComponentInstanceRef=CDD_McuDiagc
      CDD_McuDiagc_InitEvent (RteEventToTaskMapping): RteImmediateRestart=false, RtePositionInTask=66, RteEventRef=CDD_McuDiagc_InitEvent, RteMappedToTaskRef=Task_Init_Appl10
      TMT_McuDiagcPer2 (RteEventToTaskMapping):
        RteImmediateRestart = false
        RtePositionInTask = 18
        RteEventRef = TMT_McuDiagcPer2
        RteMappedToTaskRef = Task_2msA_Appl10
        RteUsedOsAlarmRef = Rte_Al_TE_Task_2msA_Appl10_0_2ms
    MotVelCtrl_EcuSwComposition (RteSwComponentInstance): RteSoftwareComponentInstanceRef=MotVelCtrl
      6 x RteEventToTaskMapping, all with RteImmediateRestart=false:
        OIT_GetCtrlPrm_Oper_GetCtrlPrm_Oper: RteEventRef=OIT_GetCtrlPrm_Oper_GetCtrlPrm_Oper
        MotVelCtrlInit1_InitEvent: RtePositionInTask=63, RteEventRef=MotVelCtrlInit1_InitEvent, RteMappedToTaskRef=Task_Init_Appl10
        TMT_MotVelCtrlPer1: RtePositionInTask=27, RteEventRef=TMT_MotVelCtrlPer1, RteMappedToTaskRef=Task_2msA_Appl10, RteUsedOsAlarmRef=Rte_Al_TE_Task_2msA_Appl10_0_2ms
        OIT_SetCtrlPrm_Oper_SetCtrlPrm_Oper: RteEventRef=OIT_SetCtrlPrm_Oper_SetCtrlPrm_Oper
        OIT_StopCtrl_Oper_StopCtrl_Oper: RteEventRef=OIT_StopCtrl_Oper_StopCtrl_Oper
        OIT_StrtCtrl_Oper_StrtCtrl_Oper: RteEventRef=OIT_StrtCtrl_Oper_StrtCtrl_Oper
    MotVelCtrl (RteSwComponentType): RteComponentTypeRef=MotVelCtrl, RteImplementationRef=MotVelCtrl_Implementation
      ComponentTypeCalibration (RteComponentTypeCalibration): RteCalibrationSupportEnabled=true
    CDD_McuDiagc (RteSwComponentType): RteComponentTypeRef=CDD_McuDiagc, RteImplementationRef=CDD_McuDiagc_Implementation
      ComponentTypeCalibration (RteComponentTypeCalibration): RteCalibrationSupportEnabled=true
    3 x RteSwComponentInstance:
      CDD_VrfyCritReg_EcuSwComposition: RteSoftwareComponentInstanceRef=CDD_VrfyCritReg
        NvmBlock_CDD_VrfyCritReg_MCalWrVrfyRegFltInfoStorg (RteNvRamAllocation):
          RteNvmRamBlockLocationSymbol = Rte_CDD_VrfyCritReg_MCalReadVrfyCritRegFltNvmInfo
          RteNvmBlockRef = Rte_NvmBlock_CDD_VrfyCritReg_MCalReadVrfyCritRegFltInfo
          RteSwNvRamMappingRef = MCalWrVrfyRegFltInfoStorg
        4 x RteEventToTaskMapping, all with RteImmediateRestart=false:
          OIT_MCalReadVrfyFailFltInfo_Oper_MCalReadVrfyFailFltInfo_Oper: RteEventRef=OIT_MCalReadVrfyFailFltInfo_Oper_MCalReadVrfyFailFltInfo_Oper
          VrfyCritRegInit1_InitEvent: RtePositionInTask=75, RteEventRef=VrfyCritRegInit1_InitEvent, RteMappedToTaskRef=Task_Init_Appl10
          TMT_VrfyCritRegPer1: RtePositionInTask=4, RteEventRef=TMT_VrfyCritRegPer1, RteMappedToTaskRef=Task_10ms_Appl10, RteUsedOsEventRef=Rte_Ev_Cyclic_Task_10ms_Appl10_0_10ms, RteUsedOsAlarmRef=Rte_Al_TE_Task_10ms_Appl10_0_10ms
          TMT_0_VrfyCritRegPer2: RtePositionInTask=11, RteEventRef=TMT_0_VrfyCritRegPer2, RteMappedToTaskRef=Task_100ms_Appl10, RteUsedOsEventRef=Rte_Ev_Cyclic_Task_100ms_Appl10_0_100ms, RteUsedOsAlarmRef=Rte_Al_TE_Task_100ms_Appl10_0_100ms
      CDD_McuCoreCfgAndDiagc_EcuSwComposition: RteSoftwareComponentInstanceRef=CDD_McuCoreCfgAndDiagc
        McuCoreCfgAndDiagcInit3_InitEvent (RteEventToTaskMapping): RteImmediateRestart=false, RtePositionInTask=14, RteEventRef=McuCoreCfgAndDiagcInit3_InitEvent, RteMappedToTaskRef=Task_Init_Appl10
      CDD_CoreVltgMonr_EcuSwComposition: RteSoftwareComponentInstanceRef=CDD_CoreVltgMonr
        CoreVltgMonr_InitEvent (RteEventToTaskMapping): RteImmediateRestart=false, RtePositionInTask=72, RteEventRef=CoreVltgMonr_InitEvent, RteMappedToTaskRef=Task_Init_Appl10
    3 x RteSwComponentType:
      CDD_McuCoreCfgAndDiagc: RteComponentTypeRef=CDD_McuCoreCfgAndDiagc, RteImplementationRef=CDD_McuCoreCfgAndDiagc_Implementation
        ComponentTypeCalibration (RteComponentTypeCalibration): RteCalibrationSupportEnabled=true
      CDD_VrfyCritReg: RteComponentTypeRef=CDD_VrfyCritReg, RteImplementationRef=CDD_VrfyCritReg_Implementation
        ComponentTypeCalibration (RteComponentTypeCalibration): RteCalibrationSupportEnabled=true
      CDD_CoreVltgMonr: RteComponentTypeRef=CDD_CoreVltgMonr, RteImplementationRef=CDD_CoreVltgMonr_Implementation
        ComponentTypeCalibration (RteComponentTypeCalibration): RteCalibrationSupportEnabled=true
    CDD_DataAndAdrPar_EcuSwComposition (RteSwComponentInstance): RteSoftwareComponentInstanceRef=CDD_DataAndAdrPar
      CDD_DataAndAdrPar_InitEvent (RteEventToTaskMapping): RteImmediateRestart=false, RtePositionInTask=74, RteEventRef=CDD_DataAndAdrPar_InitEvent, RteMappedToTaskRef=Task_Init_Appl10
    CDD_DataAndAdrPar (RteSwComponentType): RteComponentTypeRef=CDD_DataAndAdrPar, RteImplementationRef=CDD_DataAndAdrPar_Implementation
      ComponentTypeCalibration (RteComponentTypeCalibration): RteCalibrationSupportEnabled=true
    3 x RteSwComponentInstance:
      BmwMsgSlot107Bas0Repn1BusFrChA_EcuSwComposition: RteSoftwareComponentInstanceRef=BmwMsgSlot107Bas0Repn1BusFrChA
        3 x RteEventToTaskMapping, all with RteImmediateRestart=false:
          BmwMsgSlot107Bas0Repn1BusFrChAInit1_InitEvent: RtePositionInTask=86, RteEventRef=BmwMsgSlot107Bas0Repn1BusFrChAInit1_InitEvent, RteMappedToTaskRef=Task_Init_Appl10
          DRET_OFFS_QUAD_EPS_Missing_Oper_sigGroup_OFFS_QUAD_EPS_sigGroup_OFFS_QUAD_EPS: RtePositionInTask=19, RteEventRef=DRET_OFFS_QUAD_EPS_Missing_Oper_sigGroup_OFFS_QUAD_EPS_sigGroup_OFFS_QUAD_EPS, RteMappedToTaskRef=Task_10ms_Appl10, RteUsedOsEventRef=Rte_Ev_Run_BmwMsgSlot107Bas0Repn1BusFrChA_OFFS_QUAD_EPS_Missing_Oper
          DRT_OFFS_QUAD_EPS_Received_Oper_sigGroup_OFFS_QUAD_EPS_sigGroup_OFFS_QUAD_EPS: RtePositionInTask=22, RteEventRef=DRT_OFFS_QUAD_EPS_Received_Oper_sigGroup_OFFS_QUAD_EPS_sigGroup_OFFS_QUAD_EPS, RteMappedToTaskRef=Task_10ms_Appl10, RteUsedOsEventRef=Rte_Ev_Run_BmwMsgSlot107Bas0Repn1BusFrChA_OFFS_QUAD_EPS_Received_Oper
      BmwMsgSlot121Bas1Repn2BusFrChA_EcuSwComposition: RteSoftwareComponentInstanceRef=BmwMsgSlot121Bas1Repn2BusFrChA
        3 x RteEventToTaskMapping, all with RteImmediateRestart=false:
          BmwMsgSlot121Bas1Repn2BusFrChAInit1_InitEvent: RtePositionInTask=87, RteEventRef=BmwMsgSlot121Bas1Repn2BusFrChAInit1_InitEvent, RteMappedToTaskRef=Task_Init_Appl10
          DRET_CON_VEH_Missing_Oper_sigGroup_CON_VEH_sigGroup_CON_VEH: RtePositionInTask=25, RteEventRef=DRET_CON_VEH_Missing_Oper_sigGroup_CON_VEH_sigGroup_CON_VEH, RteMappedToTaskRef=Task_100ms_Appl10, RteUsedOsEventRef=Rte_Ev_Run_BmwMsgSlot121Bas1Repn2BusFrChA_CON_VEH_Missing_Oper
          DRT_CON_VEH_Received_Oper_sigGroup_CON_VEH_sigGroup_CON_VEH: RtePositionInTask=26, RteEventRef=DRT_CON_VEH_Received_Oper_sigGroup_CON_VEH_sigGroup_CON_VEH, RteMappedToTaskRef=Task_100ms_Appl10, RteUsedOsEventRef=Rte_Ev_Run_BmwMsgSlot121Bas1Repn2BusFrChA_CON_VEH_Received_Oper
      BmwMsgSlot55Bas3Repn4BusFrChA_EcuSwComposition: RteSoftwareComponentInstanceRef=BmwMsgSlot55Bas3Repn4BusFrChA
        3 x RteEventToTaskMapping, all with RteImmediateRestart=false:
          BmwMsgSlot55Bas3Repn4BusFrChA_InitEvent: RtePositionInTask=85, RteEventRef=BmwMsgSlot55Bas3Repn4BusFrChA_InitEvent, RteMappedToTaskRef=Task_Init_Appl10
          DRET_V_VEH_Missing_Oper_sigGroup_V_VEH_sigGroup_V_VEH: RtePositionInTask=28, RteEventRef=DRET_V_VEH_Missing_Oper_sigGroup_V_VEH_sigGroup_V_VEH, RteMappedToTaskRef=Task_100ms_Appl10, RteUsedOsEventRef=Rte_Ev_Run_BmwMsgSlot55Bas3Repn4BusFrChA_V_VEH_Missing_Oper
          DRT_V_VEH_Received_Oper_sigGroup_V_VEH_sigGroup_V_VEH: RtePositionInTask=27, RteEventRef=DRT_V_VEH_Received_Oper_sigGroup_V_VEH_sigGroup_V_VEH, RteMappedToTaskRef=Task_100ms_Appl10, RteUsedOsEventRef=Rte_Ev_Run_BmwMsgSlot55Bas3Repn4BusFrChA_V_VEH_Received_Oper
    3 x RteSwComponentType:
      BmwMsgSlot55Bas3Repn4BusFrChA: RteComponentTypeRef=BmwMsgSlot55Bas3Repn4BusFrChA, RteImplementationRef=BmwMsgSlot55Bas3Repn4BusFrChA_Implementation
        ComponentTypeCalibration (RteComponentTypeCalibration): RteCalibrationSupportEnabled=true
      BmwMsgSlot107Bas0Repn1BusFrChA: RteComponentTypeRef=BmwMsgSlot107Bas0Repn1BusFrChA, RteImplementationRef=BmwMsgSlot107Bas0Repn1BusFrChA_Implementation
        ComponentTypeCalibration (RteComponentTypeCalibration): RteCalibrationSupportEnabled=true
      BmwMsgSlot121Bas1Repn2BusFrChA: RteComponentTypeRef=BmwMsgSlot121Bas1Repn2BusFrChA, RteImplementationRef=BmwMsgSlot121Bas1Repn2BusFrChA_Implementation
        ComponentTypeCalibration (RteComponentTypeCalibration): RteCalibrationSupportEnabled=true
    4 x RteSwComponentInstance:
      DiagcMgrProxyAppl7_EcuSwComposition: RteSoftwareComponentInstanceRef=DiagcMgrProxyAppl7
        DiagcMgrProxyAppl7 (RteExclusiveAreaImplementation): RteExclusiveAreaImplMechanism=OS_INTERRUPT_BLOCKING, RteExclusiveAreaOptimization=false, RteExclusiveAreaRef=DiagcMgrProxyAppl7
        10 x RteEventToTaskMapping, all with RteImmediateRestart=false:
          DiagcMgrProxyAppl7_InitEvent: RtePositionInTask=18, RteEventRef=DiagcMgrProxyAppl7_InitEvent, RteMappedToTaskRef=Task_Init_Appl7
          TMT_DiagcMgrProxyAppl7Per1: RtePositionInTask=3, RteEventRef=TMT_DiagcMgrProxyAppl7Per1, RteMappedToTaskRef=Task_10ms_Appl7, RteUsedOsAlarmRef=Rte_Al_TE_Task_10ms_Appl7_0_10ms
          OIT_GetDiagcDataAppl7_Oper_GetDiagcDataAppl7_Oper: RteEventRef=OIT_GetDiagcDataAppl7_Oper_GetDiagcDataAppl7_Oper
          OIT_GetNtcActv7_Oper_GetNtcActv7_Oper: RteEventRef=OIT_GetNtcActv7_Oper_GetNtcActv7_Oper
          OIT_GetNtcDebCntrAppl7_Oper_GetNtcDebCntrAppl7_Oper: RteEventRef=OIT_GetNtcDebCntrAppl7_Oper_GetNtcDebCntrAppl7_Oper
          OIT_GetNtcInfoAppl7_Oper_GetNtcInfoAppl7_Oper: RteEventRef=OIT_GetNtcInfoAppl7_Oper_GetNtcInfoAppl7_Oper
          OIT_GetNtcQlfrSts7_Oper_GetNtcQlfrSts7_Oper: RteEventRef=OIT_GetNtcQlfrSts7_Oper_GetNtcQlfrSts7_Oper
          OIT_GetNtcSts7_Oper_GetNtcSts7_Oper: RteEventRef=OIT_GetNtcSts7_Oper_GetNtcSts7_Oper
          OIT_SetNtcSts7_Oper_SetNtcSts7_Oper: RteEventRef=OIT_SetNtcSts7_Oper_SetNtcSts7_Oper
          OIT_SetNtcStsAndSnpshtData7_Oper_SetNtcStsAndSnpshtData7_Oper: RteEventRef=OIT_SetNtcStsAndSnpshtData7_Oper_SetNtcStsAndSnpshtData7_Oper
      LrnPinionCentr_EcuSwComposition: RteSoftwareComponentInstanceRef=LrnPinionCentr
        3 x RteEventToTaskMapping, all with RteImmediateRestart=false:
          LrnPinionCentr_InitEvent: RtePositionInTask=17, RteEventRef=LrnPinionCentr_InitEvent, RteMappedToTaskRef=Task_Init_Appl7
          TMT_LrnPinionCentrPer1: RtePositionInTask=16, RteEventRef=TMT_LrnPinionCentrPer1, RteMappedToTaskRef=Task_2ms_Appl7, RteUsedOsAlarmRef=Rte_Al_TE_Task_2ms_Appl7_0_2ms
          OIT_SetInpPrm_Oper_SetInpPrm_Oper: RteEventRef=OIT_SetInpPrm_Oper_SetInpPrm_Oper
      LrndRackCentr_EcuSwComposition: RteSoftwareComponentInstanceRef=LrndRackCentr
        NvmBlock_LrndRackCentr_NvmLrndRackCentrNvm (RteNvRamAllocation):
          RteNvmRamBlockLocationSymbol = Rte_LrndRackCentr_LrndRackCentr
          RteNvmBlockRef = Rte_NvmBlock_LrndRackCentr_LrndRackCentr
          RteSwNvRamMappingRef = NvmLrndRackCentrNvm
        4 x RteEventToTaskMapping, all with RteImmediateRestart=false:
          LrndRackCentr_InitEvent: RtePositionInTask=103, RteEventRef=LrndRackCentr_InitEvent, RteMappedToTaskRef=Task_Init_Appl10
          TMT_LrndRackCentrPer1: RtePositionInTask=4, RteEventRef=TMT_LrndRackCentrPer1, RteMappedToTaskRef=Task_4ms_Appl10, RteUsedOsAlarmRef=Rte_Al_TE_Task_4ms_Appl10_0_4ms
          OIT_RstRackCentrMotAg_Oper_RstRackCentrMotAg_Oper: RteEventRef=OIT_RstRackCentrMotAg_Oper_RstRackCentrMotAg_Oper
          OIT_RstRackCentrMotRev_Oper_RstRackCentrMotRev_Oper: RteEventRef=OIT_RstRackCentrMotRev_Oper_RstRackCentrMotRev_Oper
      BmwHwAgArbnAndEotPosn_EcuSwComposition: RteSoftwareComponentInstanceRef=BmwHwAgArbnAndEotPosn
        NvmBlock_BmwHwAgArbnAndEotPosn_NvmBmwVehCentrOffs (RteNvRamAllocation):
          RteNvmRamBlockLocationSymbol = Rte_BmwHwAgArbnAndEotPosn_BmwVehCentrOffs
          RteSwNvRamMappingRef = NvmBmwVehCentrOffs
          RteNvmBlockRef = Rte_NvmBlock_BmwHwAgArbnAndEotPosn_BmwVehCentrOffs
        5 x RteEventToTaskMapping, all with RteImmediateRestart=false:
          BmwHwAgArbnAndEotPosn_InitEvent: RtePositionInTask=56, RteEventRef=BmwHwAgArbnAndEotPosn_InitEvent, RteMappedToTaskRef=Task_Init_Appl10
          TMT_BmwHwAgArbnAndEotPosnPer1: RtePositionInTask=26, RteEventRef=TMT_BmwHwAgArbnAndEotPosnPer1, RteMappedToTaskRef=Task_2msA_Appl10, RteUsedOsAlarmRef=Rte_Al_TE_Task_2msA_Appl10_0_2ms
          OIT_ClrBmwRackCentrToVehCentrOffs_Oper_ClrBmwRackCentrToVehCentrOffs_Oper: RteEventRef=OIT_ClrBmwRackCentrToVehCentrOffs_Oper_ClrBmwRackCentrToVehCentrOffs_Oper
          OIT_ClrVehCentrPosn_Oper_ClrVehCentrPosn_Oper: RteEventRef=OIT_ClrVehCentrPosn_Oper_ClrVehCentrPosn_Oper
          OIT_SetVehCentrPosn_Oper_SetVehCentrPosn_Oper: RteEventRef=OIT_SetVehCentrPosn_Oper_SetVehCentrPosn_Oper
    3 x RteSwComponentType:
      BmwHwAgArbnAndEotPosn: RteComponentTypeRef=BmwHwAgArbnAndEotPosn, RteImplementationRef=BmwHwAgArbnAndEotPosn_Implementation
        ComponentTypeCalibration (RteComponentTypeCalibration): RteCalibrationSupportEnabled=true
      LrndRackCentr: RteComponentTypeRef=LrndRackCentr, RteImplementationRef=LrndRackCentr_Implementation
        ComponentTypeCalibration (RteComponentTypeCalibration): RteCalibrationSupportEnabled=true
      LrnPinionCentr: RteComponentTypeRef=LrnPinionCentr, RteImplementationRef=LrnPinionCentr_Implementation
        ComponentTypeCalibration (RteComponentTypeCalibration): RteCalibrationSupportEnabled=true
    BmwMsgSlot51Bas0Repn2BusFrChA_EcuSwComposition (RteSwComponentInstance): RteSoftwareComponentInstanceRef=BmwMsgSlot51Bas0Repn2BusFrChA
      BmwMsgSlot51Bas0Repn2BusFrChA_InitEvent (RteEventToTaskMapping): RteImmediateRestart=false, RtePositionInTask=84, RteEventRef=BmwMsgSlot51Bas0Repn2BusFrChA_InitEvent, RteMappedToTaskRef=Task_Init_Appl10
      TMT_BmwMsgSlot51Bas0Repn2BusFrChAPer1 (RteEventToTaskMapping):
        RteImmediateRestart = false
        RtePositionInTask = 0
        RteEventRef = TMT_BmwMsgSlot51Bas0Repn2BusFrChAPer1
        RteMappedToTaskRef = Task_ComBsw_Appl10
        RteUsedOsEventRef = Rte_Ev_Cyclic_Task_ComBsw_Appl10_0_10ms
        RteUsedOsAlarmRef = Rte_Al_TE_Task_ComBsw_Appl10_0_10ms
    BmwMsgSlot274Bas2Repn4BusFrChA_EcuSwComposition (RteSwComponentInstance): RteSoftwareComponentInstanceRef=BmwMsgSlot274Bas2Repn4BusFrChA
      BmwMsgSlot274Bas2Repn4BusFrChA_InitEvent (RteEventToTaskMapping): RteImmediateRestart=false, RtePositionInTask=88, RteEventRef=BmwMsgSlot274Bas2Repn4BusFrChA_InitEvent, RteMappedToTaskRef=Task_Init_Appl10
      TMT_BmwMsgSlot274Bas2Repn4BusFrChAPer1 (RteEventToTaskMapping):
        RteImmediateRestart = false
        RtePositionInTask = 1
        RteEventRef = TMT_BmwMsgSlot274Bas2Repn4BusFrChAPer1
        RteMappedToTaskRef = Task_ComBsw_Appl10
        RteUsedOsEventRef = Rte_Ev_Cyclic_Task_ComBsw_Appl10_0_10ms
        RteUsedOsAlarmRef = Rte_Al_TE_Task_ComBsw_Appl10_0_10ms
    BmwMsgSlot274Bas2Repn4BusFrChA (RteSwComponentType): RteComponentTypeRef=BmwMsgSlot274Bas2Repn4BusFrChA, RteImplementationRef=BmwMsgSlot274Bas2Repn4BusFrChA_Implementation
      ComponentTypeCalibration (RteComponentTypeCalibration): RteCalibrationSupportEnabled=true
    BmwMsgSlot51Bas0Repn2BusFrChA (RteSwComponentType): RteComponentTypeRef=BmwMsgSlot51Bas0Repn2BusFrChA, RteImplementationRef=BmwMsgSlot51Bas0Repn2BusFrChA_Implementation
      ComponentTypeCalibration (RteComponentTypeCalibration): RteCalibrationSupportEnabled=true
    3 x RteSwComponentInstance:
      BmwStReqMgr_EcuSwComposition: RteSoftwareComponentInstanceRef=BmwStReqMgr
        BmwStReqMgr_InitEvent (RteEventToTaskMapping): RteImmediateRestart=false, RtePositionInTask=65, RteEventRef=BmwStReqMgr_InitEvent, RteMappedToTaskRef=Task_Init_Appl10
        TMT_BmwStReqMgrPer1 (RteEventToTaskMapping):
          RteImmediateRestart = false
          RtePositionInTask = 2
          RteEventRef = TMT_BmwStReqMgrPer1
          RteMappedToTaskRef = Task_2msB_Appl10
          RteUsedOsAlarmRef = Rte_Al_TE_Task_2msB_Appl10_0_2ms
      BmwFltHndlg_EcuSwComposition: RteSoftwareComponentInstanceRef=BmwFltHndlg
        BmwFltHndlg_InitEvent (RteEventToTaskMapping): RteImmediateRestart=false, RtePositionInTask=20, RteEventRef=BmwFltHndlg_InitEvent, RteMappedToTaskRef=Task_Init_Appl7
        TMT_BmwFltHndlgPer1 (RteEventToTaskMapping):
          RteImmediateRestart = false
          RtePositionInTask = 18
          RteEventRef = TMT_BmwFltHndlgPer1
          RteMappedToTaskRef = Task_2ms_Appl7
          RteUsedOsAlarmRef = Rte_Al_TE_Task_2ms_Appl7_0_2ms
      CtrldVelRtn_EcuSwComposition: RteSoftwareComponentInstanceRef=CtrldVelRtn
        CtrldVelRtn_InitEvent (RteEventToTaskMapping): RteImmediateRestart=false, RtePositionInTask=11, RteEventRef=CtrldVelRtn_InitEvent, RteMappedToTaskRef=Task_Init_Appl7
        TMT_CtrldVelRtnPer1 (RteEventToTaskMapping):
          RteImmediateRestart = false
          RtePositionInTask = 10
          RteEventRef = TMT_CtrldVelRtnPer1
          RteMappedToTaskRef = Task_2ms_Appl7
          RteUsedOsAlarmRef = Rte_Al_TE_Task_2ms_Appl7_0_2ms
    3 x RteSwComponentType:
      BmwFltHndlg: RteComponentTypeRef=BmwFltHndlg, RteImplementationRef=BmwFltHndlg_Implementation
        ComponentTypeCalibration (RteComponentTypeCalibration): RteCalibrationSupportEnabled=true
      BmwStReqMgr: RteComponentTypeRef=BmwStReqMgr, RteImplementationRef=BmwStReqMgr_Implementation
        ComponentTypeCalibration (RteComponentTypeCalibration): RteCalibrationSupportEnabled=true
      CtrldVelRtn: RteComponentTypeRef=CtrldVelRtn, RteImplementationRef=CtrldVelRtn_Implementation
        ComponentTypeCalibration (RteComponentTypeCalibration): RteCalibrationSupportEnabled=true
    3 x RteSwComponentInstance:
      DiagcMgrProxyAppl8_EcuSwComposition: RteSoftwareComponentInstanceRef=DiagcMgrProxyAppl8
        DiagcMgrProxyAppl8 (RteExclusiveAreaImplementation): RteExclusiveAreaImplMechanism=OS_INTERRUPT_BLOCKING, RteExclusiveAreaOptimization=false, RteExclusiveAreaRef=DiagcMgrProxyAppl8
        10 x RteEventToTaskMapping, all with RteImmediateRestart=false:
          DiagcMgrProxyAppl8_InitEvent: RtePositionInTask=3, RteEventRef=DiagcMgrProxyAppl8_InitEvent, RteMappedToTaskRef=Task_Init_Appl8
          TMT_DiagcMgrProxyAppl8Per1: RtePositionInTask=2, RteEventRef=TMT_DiagcMgrProxyAppl8Per1, RteMappedToTaskRef=Task_10ms_Appl8, RteUsedOsAlarmRef=Rte_Al_TE_Task_10ms_Appl8_0_10ms
          OIT_GetDiagcDataAppl8_Oper_GetDiagcDataAppl8_Oper: RteEventRef=OIT_GetDiagcDataAppl8_Oper_GetDiagcDataAppl8_Oper
          OIT_GetNtcActv8_Oper_GetNtcActv8_Oper: RteEventRef=OIT_GetNtcActv8_Oper_GetNtcActv8_Oper
          OIT_GetNtcDebCntrAppl8_Oper_GetNtcDebCntrAppl8_Oper: RteEventRef=OIT_GetNtcDebCntrAppl8_Oper_GetNtcDebCntrAppl8_Oper
          OIT_GetNtcInfoAppl8_Oper_GetNtcInfoAppl8_Oper: RteEventRef=OIT_GetNtcInfoAppl8_Oper_GetNtcInfoAppl8_Oper
          OIT_GetNtcQlfrSts8_Oper_GetNtcQlfrSts8_Oper: RteEventRef=OIT_GetNtcQlfrSts8_Oper_GetNtcQlfrSts8_Oper
          OIT_GetNtcSts8_Oper_GetNtcSts8_Oper: RteEventRef=OIT_GetNtcSts8_Oper_GetNtcSts8_Oper
          OIT_SetNtcSts8_Oper_SetNtcSts8_Oper: RteEventRef=OIT_SetNtcSts8_Oper_SetNtcSts8_Oper
          OIT_SetNtcStsAndSnpshtData8_Oper_SetNtcStsAndSnpshtData8_Oper: RteEventRef=OIT_SetNtcStsAndSnpshtData8_Oper_SetNtcStsAndSnpshtData8_Oper
      DiagcMgrProxyAppl9_EcuSwComposition: RteSoftwareComponentInstanceRef=DiagcMgrProxyAppl9
        DiagcMgrProxyAppl9 (RteExclusiveAreaImplementation): RteExclusiveAreaImplMechanism=OS_INTERRUPT_BLOCKING, RteExclusiveAreaOptimization=false, RteExclusiveAreaRef=DiagcMgrProxyAppl9
        10 x RteEventToTaskMapping, all with RteImmediateRestart=false:
          DiagcMgrProxyAppl9_InitEvent: RtePositionInTask=6, RteEventRef=DiagcMgrProxyAppl9_InitEvent, RteMappedToTaskRef=Task_Init_Appl9
          TMT_DiagcMgrProxyAppl9Per1: RtePositionInTask=1, RteEventRef=TMT_DiagcMgrProxyAppl9Per1, RteMappedToTaskRef=Task_10ms_Appl9, RteUsedOsAlarmRef=Rte_Al_TE_Task_10ms_Appl9_0_10ms
          OIT_GetDiagcDataAppl9_Oper_GetDiagcDataAppl9_Oper: RteEventRef=OIT_GetDiagcDataAppl9_Oper_GetDiagcDataAppl9_Oper
          OIT_GetNtcActv9_Oper_GetNtcActv9_Oper: RteEventRef=OIT_GetNtcActv9_Oper_GetNtcActv9_Oper
          OIT_GetNtcDebCntrAppl9_Oper_GetNtcDebCntrAppl9_Oper: RteEventRef=OIT_GetNtcDebCntrAppl9_Oper_GetNtcDebCntrAppl9_Oper
          OIT_GetNtcInfoAppl9_Oper_GetNtcInfoAppl9_Oper: RteEventRef=OIT_GetNtcInfoAppl9_Oper_GetNtcInfoAppl9_Oper
          OIT_GetNtcQlfrSts9_Oper_GetNtcQlfrSts9_Oper: RteEventRef=OIT_GetNtcQlfrSts9_Oper_GetNtcQlfrSts9_Oper
          OIT_GetNtcSts9_Oper_GetNtcSts9_Oper: RteEventRef=OIT_GetNtcSts9_Oper_GetNtcSts9_Oper
          OIT_SetNtcSts9_Oper_SetNtcSts9_Oper: RteEventRef=OIT_SetNtcSts9_Oper_SetNtcSts9_Oper
          OIT_SetNtcStsAndSnpshtData9_Oper_SetNtcStsAndSnpshtData9_Oper: RteEventRef=OIT_SetNtcStsAndSnpshtData9_Oper_SetNtcStsAndSnpshtData9_Oper
      BmwDiagcSrvHndlg_EcuSwComposition: RteSoftwareComponentInstanceRef=BmwDiagcSrvHndlg
        17 x RteEventToTaskMapping, all with RteImmediateRestart=false:
          BmwDiagcSrvHndlig_InitEvent: RtePositionInTask=102, RteEventRef=BmwDiagcSrvHndlig_InitEvent, RteMappedToTaskRef=Task_Init_Appl10
          TMT_BmwDiagcSrvHndlgPer1: RtePositionInTask=6, RteEventRef=TMT_BmwDiagcSrvHndlgPer1, RteMappedToTaskRef=Task_10ms_Appl10, RteUsedOsEventRef=Rte_Ev_Cyclic_Task_10ms_Appl10_0_10ms, RteUsedOsAlarmRef=Rte_Al_TE_Task_10ms_Appl10_0_10ms
          OIT_BmwDiagcSrvHndlgEpsRackCentrRstStrt_Oper_RoutineServices_EpsZahnstangenmitteReset_Routine_Start: RteEventRef=OIT_BmwDiagcSrvHndlgEpsRackCentrRstStrt_Oper_RoutineServices_EpsZahnstangenmitteReset_Routine_Start
          OIT_BmwDiagcSrvFHndlgEpsFactryIninStop_Oper_RoutineServices_EpsInitialisierungWerk_Routine_Stop: RteEventRef=OIT_BmwDiagcSrvFHndlgEpsFactryIninStop_Oper_RoutineServices_EpsInitialisierungWerk_Routine_Stop
          OIT_BmwDiagcSrvFHndlgEpsSteerAgSnsrCalWrite_Oper_DataServices_DID_DB5A_EpsLenkwinkelsensorKalibrierung_WriteData: RteEventRef=OIT_BmwDiagcSrvFHndlgEpsSteerAgSnsrCalWrite_Oper_DataServices_DID_DB5A_EpsLenkwinkelsensorKalibrierung_WriteData
          OIT_BmwDiagcSrvFHndlgEpsFactryIninRes_Oper_RoutineServices_EpsInitialisierungWerk_Routine_RequestResults: RteEventRef=OIT_BmwDiagcSrvFHndlgEpsFactryIninRes_Oper_RoutineServices_EpsInitialisierungWerk_Routine_RequestResults
          OIT_BmwDiagcSrvFHndlgEpsPinionAgSnsrReadCdnChk_Oper_DataServices_DID_DB57_EpsRitzelwinkelsensor_ConditionCheckRead: RteEventRef=OIT_BmwDiagcSrvFHndlgEpsPinionAgSnsrReadCdnChk_Oper_DataServices_DID_DB57_EpsRitzelwinkelsensor_ConditionCheckRead
          OIT_BmwDiagcSrvFHndlgEpsSteerAgSnsrCalRead_Oper_DataServices_DID_DB5A_EpsLenkwinkelsensorKalibrierung_ReadData: RteEventRef=OIT_BmwDiagcSrvFHndlgEpsSteerAgSnsrCalRead_Oper_DataServices_DID_DB5A_EpsLenkwinkelsensorKalibrierung_ReadData
          OIT_BmwDiagcSrvFHndlgEpsSteerAgSnsrCalReadCdnChk_Oper_DataServices_DID_DB5A_EpsLenkwinkelsensorKalibrierung_ConditionCheckRead: RteEventRef=OIT_BmwDiagcSrvFHndlgEpsSteerAgSnsrCalReadCdnChk_Oper_DataServices_DID_DB5A_EpsLenkwinkelsensorKalibrierung_ConditionCheckRead
          OIT_BmwDiagcSrvFHndlgEpsPinionAgSnsrRead_Oper_DataServices_DID_DB57_EpsRitzelwinkelsensor_ReadData: RteEventRef=OIT_BmwDiagcSrvFHndlgEpsPinionAgSnsrRead_Oper_DataServices_DID_DB57_EpsRitzelwinkelsensor_ReadData
          OIT_BmwDiagcSrvHndlgEpsPtlRackCentrRstStrt_Oper_RoutineServices_SteuernEpsMultiturnwertReset_Routine_Start: RteEventRef=OIT_BmwDiagcSrvHndlgEpsPtlRackCentrRstStrt_Oper_RoutineServices_SteuernEpsMultiturnwertReset_Routine_Start
          OIT_BmwDiagcSrvFHndlgEpsFactryIninStrt_Oper_RoutineServices_EpsInitialisierungWerk_Routine_Start: RteEventRef=OIT_BmwDiagcSrvFHndlgEpsFactryIninStrt_Oper_RoutineServices_EpsInitialisierungWerk_Routine_Start
          OIT_BmwDiagcSrvHndlgEpsSteerAgSnsrCalRstStrt_Oper_RoutineServices_EpsLenkwinkelsensorKalibrierungReset_Routine_Start: RteEventRef=OIT_BmwDiagcSrvHndlgEpsSteerAgSnsrCalRstStrt_Oper_RoutineServices_EpsLenkwinkelsensorKalibrierungReset_Routine_Start
          OIT_BmwDiagcSrvFHndlgStordRackTrvlAndCentrDataRead_Oper_DataServices_DID_DFDD_GelernterZahnstangenweg_ReadData: RteEventRef=OIT_BmwDiagcSrvFHndlgStordRackTrvlAndCentrDataRead_Oper_DataServices_DID_DFDD_GelernterZahnstangenweg_ReadData
          OIT_BmwDiagcSrvFHndlgStordRackTrvlAndCentrDataReadCdnChk_Oper_DataServices_DID_DFDD_GelernterZahnstangenweg_ConditionCheckRead: RteEventRef=OIT_BmwDiagcSrvFHndlgStordRackTrvlAndCentrDataReadCdnChk_Oper_DataServices_DID_DFDD_GelernterZahnstangenweg_ConditionCheckRead
          OIT_BmwDiagcSrvFHndlgSysSupplierIdentifierRead_Oper_DataServices_DID_F18A_SystemSupplierIdentifier_ReadData: RteEventRef=OIT_BmwDiagcSrvFHndlgSysSupplierIdentifierRead_Oper_DataServices_DID_F18A_SystemSupplierIdentifier_ReadData
          OIT_BmwDiagcSrvFHndlgSysSupplierIdentifieCdnChk_Oper_DataServices_DID_F18A_SystemSupplierIdentifier_ConditionCheckRead: RteEventRef=OIT_BmwDiagcSrvFHndlgSysSupplierIdentifieCdnChk_Oper_DataServices_DID_F18A_SystemSupplierIdentifier_ConditionCheckRead
        4 x RteNvRamAllocation:
          NvmBlock_BmwDiagcSrvHndlg_NvmProgCntr: RteNvmRamBlockLocationSymbol=Rte_BmwDiagcSrvHndlg_ProgCntr, RteNvmBlockRef=Rte_NvmBlock_BmwDiagcSrvHndlg_ProgCntr, RteSwNvRamMappingRef=NvmProgCntr
          NvmBlock_BmwDiagcSrvHndlg_NvmProgCntrMaxVal: RteNvmRamBlockLocationSymbol=Rte_BmwDiagcSrvHndlg_ProgCntrMaxVal, RteNvmRomBlockLocationSymbol=Rte_ProgCntrMaxValDft, RteNvmBlockRef=Rte_NvmBlock_BmwDiagcSrvHndlg_ProgCntrMaxVal, RteSwNvRamMappingRef=NvmProgCntrMaxVal
          NvmBlock_BmwDiagcSrvHndlg_NvmTestStamp: RteNvmRamBlockLocationSymbol=Rte_BmwDiagcSrvHndlg_TestStamp, RteNvmBlockRef=Rte_NvmBlock_BmwDiagcSrvHndlg_TestStamp, RteSwNvRamMappingRef=NvmTestStamp
          NvmBlock_BmwDiagcSrvHndlg_NvmMilesKmEeprom: RteNvmRamBlockLocationSymbol=Rte_BmwDiagcSrvHndlg_MilesKmEeprom, RteNvmBlockRef=Rte_NvmBlock_BmwDiagcSrvHndlg_MilesKmEeprom, RteSwNvRamMappingRef=NvmMilesKmEeprom
        33 x RteEventToTaskMapping, all with RteImmediateRestart=false:
          OIT_BmwDiagcSrvFHndlgProgmCntrRead_Oper_DataServices_DID_2502_ProgCounter_ReadData: RteEventRef=OIT_BmwDiagcSrvFHndlgProgmCntrRead_Oper_DataServices_DID_2502_ProgCounter_ReadData
          OIT_BmwDiagcSrvFHndlgProgmCntrMaxValRead_Oper_DataServices_DID_2503_ProgrammingCounterMaxValue_ReadData: RteEventRef=OIT_BmwDiagcSrvFHndlgProgmCntrMaxValRead_Oper_DataServices_DID_2503_ProgrammingCounterMaxValue_ReadData
          OIT_BmwDiagcSrvFHndlgProgmCntrMaxValReadCdnChk_Oper_DataServices_DID_2503_ProgrammingCounterMaxValue_ConditionCheckRead: RteEventRef=OIT_BmwDiagcSrvFHndlgProgmCntrMaxValReadCdnChk_Oper_DataServices_DID_2503_ProgrammingCounterMaxValue_ConditionCheckRead
          OIT_BmwDiagcSrvHndlgEpsProcStrt_Oper_RoutineServices_EpsVerfahren_Routine_Start: RteEventRef=OIT_BmwDiagcSrvHndlgEpsProcStrt_Oper_RoutineServices_EpsVerfahren_Routine_Start
          OIT_BmwDiagcSrvFHndlgEpsBattVltgRead_Oper_CSDataServices_DID_2866_Betriebsspannung_ReadData: RteEventRef=OIT_BmwDiagcSrvFHndlgEpsBattVltgRead_Oper_CSDataServices_DID_2866_Betriebsspannung_ReadData
          OIT_BmwDiagcSrvFHndlgVehSpdRead_Oper_CSDataServices_DID_2867_Fahrzeuggeschwindigkeit_ReadData: RteEventRef=OIT_BmwDiagcSrvFHndlgVehSpdRead_Oper_CSDataServices_DID_2867_Fahrzeuggeschwindigkeit_ReadData
          OIT_BmwDiagcSrvHndlgEpsTqSensrReadCdnChk_Oper_DataServices_DID_DB99_EpsMomentensensor_ConditionCheckRead: RteEventRef=OIT_BmwDiagcSrvHndlgEpsTqSensrReadCdnChk_Oper_DataServices_DID_DB99_EpsMomentensensor_ConditionCheckRead
          OIT_BmwDiagcSrvFHndlgEpsTestStampReadCdnChk_Oper_DataServices_DID_1000_Pruefstempel_ConditionCheckRead: RteEventRef=OIT_BmwDiagcSrvFHndlgEpsTestStampReadCdnChk_Oper_DataServices_DID_1000_Pruefstempel_ConditionCheckRead
          OIT_BmwDiagcSrvFHndlgMileKmEepromRead_Oper_DataServices_DID_2540_MileKmEeprom_ReadData: RteEventRef=OIT_BmwDiagcSrvFHndlgMileKmEepromRead_Oper_DataServices_DID_2540_MileKmEeprom_ReadData
          OIT_BmwDiagcSrvFHndlgReadSwRevision_Oper_DataServices_DID_250B_ReadSwRevision_ReadData: RteEventRef=OIT_BmwDiagcSrvFHndlgReadSwRevision_Oper_DataServices_DID_250B_ReadSwRevision_ReadData
          OIT_BmwDiagcSrvHndlgEpsTqSensrRead_Oper_DataServices_DID_DB99_EpsMomentensensor_ReadData: RteEventRef=OIT_BmwDiagcSrvHndlgEpsTqSensrRead_Oper_DataServices_DID_DB99_EpsMomentensensor_ReadData
          OIT_BmwDiagcSrvFHndlgPscmStsRead_Oper_CSDataServices_DID_500C_PscmSts_ReadData: RteEventRef=OIT_BmwDiagcSrvFHndlgPscmStsRead_Oper_CSDataServices_DID_500C_PscmSts_ReadData
          OIT_BmwDiagcSrvHndlgEpsIninSrvStrt_Oper_RoutineServices_EpsInitialisierungService_Routine_Start: RteEventRef=OIT_BmwDiagcSrvHndlgEpsIninSrvStrt_Oper_RoutineServices_EpsInitialisierungService_Routine_Start
          OIT_BmwDiagcSrvHndlgEpsCommuteStrt_Oper_RoutineServices_EpsPendeln_Routine_Start: RteEventRef=OIT_BmwDiagcSrvHndlgEpsCommuteStrt_Oper_RoutineServices_EpsPendeln_Routine_Start
          OIT_BmwDiagcSrvHndlgEpsRackCentrMotAgStsRead_Oper_DataServices_DID_DC77_EpsZahnstangenmitte_ReadData: RteEventRef=OIT_BmwDiagcSrvHndlgEpsRackCentrMotAgStsRead_Oper_DataServices_DID_DC77_EpsZahnstangenmitte_ReadData
          OIT_BmwDiagcSrvFHndlgEpsTestStampWrite_Oper_DataServices_DID_1000_Pruefstempel_WriteData: RteEventRef=OIT_BmwDiagcSrvFHndlgEpsTestStampWrite_Oper_DataServices_DID_1000_Pruefstempel_WriteData
          OIT_BmwDiagcSrvFHndlgReadSwRevisionCdnChk_Oper_DataServices_DID_250B_ReadSwRevision_ConditionCheckRead: RteEventRef=OIT_BmwDiagcSrvFHndlgReadSwRevisionCdnChk_Oper_DataServices_DID_250B_ReadSwRevision_ConditionCheckRead
          OIT_BmwDiagcSrvFHndlgMileKmEepromReadCdnChk_Oper_DataServices_DID_2540_MileKmEeprom_ConditionCheckRead: RteEventRef=OIT_BmwDiagcSrvFHndlgMileKmEepromReadCdnChk_Oper_DataServices_DID_2540_MileKmEeprom_ConditionCheckRead
          OIT_BmwDiagcSrvHndlgEpsCommuteRes_Oper_RoutineServices_EpsPendeln_Routine_RequestResults: RteEventRef=OIT_BmwDiagcSrvHndlgEpsCommuteRes_Oper_RoutineServices_EpsPendeln_Routine_RequestResults
          OIT_BmwDiagcSrvFHndlMileageRead_Oper_CSDataServices_DID_1700_KmStand_ReadData: RteEventRef=OIT_BmwDiagcSrvFHndlMileageRead_Oper_CSDataServices_DID_1700_KmStand_ReadData
          OIT_BmwDiagcSrvHndlgStatusFzgBordnetzRead_Oper_DataServices_DID_DB3C_StatusFzgBordnetz_ReadData: RteEventRef=OIT_BmwDiagcSrvHndlgStatusFzgBordnetzRead_Oper_DataServices_DID_DB3C_StatusFzgBordnetz_ReadData
          OIT_BmwDiagcSrvHndlgEpsProcRes_Oper_RoutineServices_EpsVerfahren_Routine_RequestResults: RteEventRef=OIT_BmwDiagcSrvHndlgEpsProcRes_Oper_RoutineServices_EpsVerfahren_Routine_RequestResults
          OIT_BmwDiagcSrvHndlgEpsIninSrvRes_Oper_RoutineServices_EpsInitialisierungService_Routine_RequestResults: RteEventRef=OIT_BmwDiagcSrvHndlgEpsIninSrvRes_Oper_RoutineServices_EpsInitialisierungService_Routine_RequestResults
          OIT_BmwDiagcSrvFHndlgEpsBaseNwRead_Oper_CSDataServices_DID_1750_FUwBn_ReadData: RteEventRef=OIT_BmwDiagcSrvFHndlgEpsBaseNwRead_Oper_CSDataServices_DID_1750_FUwBn_ReadData
          OIT_BmwDiagcSrvFHndlgAmbT_Oper_CSDataServices_DID_2805_Aussentemperatur_ReadData: RteEventRef=OIT_BmwDiagcSrvFHndlgAmbT_Oper_CSDataServices_DID_2805_Aussentemperatur_ReadData
          OIT_BmwDiagcSrvFHndlgMotTqRead_Oper_CSDataServices_DID_500F_MotTq_ReadData: RteEventRef=OIT_BmwDiagcSrvFHndlgMotTqRead_Oper_CSDataServices_DID_500F_MotTq_ReadData
          OIT_BmwDiagcSrvFHndlgHwAgRead_Oper_CSDataServices_DID_5003_HwAg_ReadData: RteEventRef=OIT_BmwDiagcSrvFHndlgHwAgRead_Oper_CSDataServices_DID_5003_HwAg_ReadData
          OIT_BmwDiagcSrvFHndlgHwTqRead_Oper_CSDataServices_DID_500E_HwTq_ReadData: RteEventRef=OIT_BmwDiagcSrvFHndlgHwTqRead_Oper_CSDataServices_DID_500E_HwTq_ReadData
          OIT_BmwDiagcSrvFHndlgEpsTestStampRead_Oper_DataServices_DID_1000_Pruefstempel_ReadData: RteEventRef=OIT_BmwDiagcSrvFHndlgEpsTestStampRead_Oper_DataServices_DID_1000_Pruefstempel_ReadData
          OIT_BmwDiagcSrvHndlgEpsIninSrvStop_Oper_RoutineServices_EpsInitialisierungService_Routine_Stop: RteEventRef=OIT_BmwDiagcSrvHndlgEpsIninSrvStop_Oper_RoutineServices_EpsInitialisierungService_Routine_Stop
          OIT_BmwDiagcSrvHndlgStatusFzgBordnetzReadCdnChk_Oper_DataServices_DID_DB3C_StatusFzgBordnetz_ConditionCheckRead: RteEventRef=OIT_BmwDiagcSrvHndlgStatusFzgBordnetzReadCdnChk_Oper_DataServices_DID_DB3C_StatusFzgBordnetz_ConditionCheckRead
          OIT_BmwDiagcSrvHndlgEpsRackCentrMotAgStsReadCdnChk_Oper_DataServices_DID_DC77_EpsZahnstangenmitte_ConditionCheckRead: RteEventRef=OIT_BmwDiagcSrvHndlgEpsRackCentrMotAgStsReadCdnChk_Oper_DataServices_DID_DC77_EpsZahnstangenmitte_ConditionCheckRead
          OIT_BmwDiagcSrvFHndlgEpsProgCntrMaxValWrite_Oper_DataServices_DID_2503_ProgrammingCounterMaxValue_WriteData: RteEventRef=OIT_BmwDiagcSrvFHndlgEpsProgCntrMaxValWrite_Oper_DataServices_DID_2503_ProgrammingCounterMaxValue_WriteData
    BmwDiagcSrvHndlg (RteSwComponentType): RteComponentTypeRef=BmwDiagcSrvHndlg, RteImplementationRef=BmwDiagcSrvHndlg_Implementation
      ComponentTypeCalibration (RteComponentTypeCalibration): RteCalibrationSupportEnabled=true
    CDD_XcpIf_EcuSwComposition (RteSwComponentInstance): RteSoftwareComponentInstanceRef=CDD_XcpIf
      3 x RteEventToTaskMapping, all with RteImmediateRestart=false:
        OIT_ActvTunStsReq_Oper_ActvTunStsReq_Oper: RteEventRef=OIT_ActvTunStsReq_Oper_ActvTunStsReq_Oper
        CDD_XcpIf_InitEvent: RtePositionInTask=105, RteEventRef=CDD_XcpIf_InitEvent, RteMappedToTaskRef=Task_Init_Appl10
        TMT_CDD_XcpIfPer1: RtePositionInTask=24, RteEventRef=TMT_CDD_XcpIfPer1, RteMappedToTaskRef=Task_100ms_Appl10, RteUsedOsEventRef=Rte_Ev_Cyclic_Task_100ms_Appl10_0_100ms, RteUsedOsAlarmRef=Rte_Al_TE_Task_100ms_Appl10_0_100ms
    TunSelnMngt_EcuSwComposition (RteSwComponentInstance): RteSoftwareComponentInstanceRef=TunSelnMngt
      TunSelnMngtIntDataProtnExclsvArea (RteExclusiveAreaImplementation): RteExclusiveAreaImplMechanism=ALL_INTERRUPT_BLOCKING, RteExclusiveAreaRef=TunSelnMngtIntDataProtnExclsvArea
      7 x RteEventToTaskMapping, all with RteImmediateRestart=false:
        OIT_CopyCalPageReq_Oper_CopyCalPageReq_Oper: RteEventRef=OIT_CopyCalPageReq_Oper_CopyCalPageReq_Oper
        OIT_GetCalPageReq_Oper_GetCalPageReq_Oper: RteEventRef=OIT_GetCalPageReq_Oper_GetCalPageReq_Oper
        OIT_GetSegInfoReq_Oper_GetSegInfoReq_Oper: RteEventRef=OIT_GetSegInfoReq_Oper_GetSegInfoReq_Oper
        OIT_OnlineTunRamAdrMpg_Oper_OnlineTunRamAdrMpg_Oper: RteEventRef=OIT_OnlineTunRamAdrMpg_Oper_OnlineTunRamAdrMpg_Oper
        OIT_SetCalPageReq_Oper_SetCalPageReq_Oper: RteEventRef=OIT_SetCalPageReq_Oper_SetCalPageReq_Oper
        TunSelnMngtInit1_InitEvent: RtePositionInTask=106, RteEventRef=TunSelnMngtInit1_InitEvent, RteMappedToTaskRef=Task_Init_Appl10
        TMT_TunSelnMngtPer1: RtePositionInTask=8, RteEventRef=TMT_TunSelnMngtPer1, RteMappedToTaskRef=Task_10ms_Appl10, RteUsedOsEventRef=Rte_Ev_Cyclic_Task_10ms_Appl10_0_10ms, RteUsedOsAlarmRef=Rte_Al_TE_Task_10ms_Appl10_0_10ms
    CDD_XcpIf (RteSwComponentType): RteComponentTypeRef=CDD_XcpIf, RteImplementationRef=CDD_XcpIf_Implementation
      ComponentTypeCalibration (RteComponentTypeCalibration): RteCalibrationSupportEnabled=true
    TunSelnMngt (RteSwComponentType): RteComponentTypeRef=TunSelnMngt, RteImplementationRef=TunSelnMngt_Implementation
      ComponentTypeCalibration (RteComponentTypeCalibration): RteCalibrationSupportEnabled=true
    CDD_XcpIfXcpEve2MilliSecDataAcqn_EcuSwComposition (RteSwComponentInstance): RteSoftwareComponentInstanceRef=CDD_XcpIfXcpEve2MilliSecDataAcqn
      TMT_CDD_XcpIfXcpEve2MilliSecDataAcqnPer1 (RteEventToTaskMapping):
        RteImmediateRestart = false
        RtePositionInTask = 36
        RteEventRef = TMT_CDD_XcpIfXcpEve2MilliSecDataAcqnPer1
        RteMappedToTaskRef = Task_2msB_Appl10
        RteUsedOsAlarmRef = Rte_Al_TE_Task_2msB_Appl10_0_2ms
    CDD_XcpIfXcpEve2MilliSecDataAcqn (RteSwComponentType): RteComponentTypeRef=CDD_XcpIfXcpEve2MilliSecDataAcqn, RteImplementationRef=CDD_XcpIfXcpEve2MilliSecDataAcqn_Implementation
      ComponentTypeCalibration (RteComponentTypeCalibration): RteCalibrationSupportEnabled=true
    RvsBattProtn_EcuSwComposition (RteSwComponentInstance): RteSoftwareComponentInstanceRef=RvsBattProtn
      RvsBattProtn_InitEvent (RteEventToTaskMapping): RteImmediateRestart=false, RtePositionInTask=19, RteEventRef=RvsBattProtn_InitEvent, RteMappedToTaskRef=Task_Init_Appl7
      TMT_RvsBattProtnPer1 (RteEventToTaskMapping):
        RteImmediateRestart = false
        RtePositionInTask = 2
        RteEventRef = TMT_RvsBattProtnPer1
        RteMappedToTaskRef = Task_10ms_Appl7
        RteUsedOsAlarmRef = Rte_Al_TE_Task_10ms_Appl7_0_10ms
    PhaDiscnct_EcuSwComposition (RteSwComponentInstance): RteSoftwareComponentInstanceRef=PhaDiscnct
      3 x RteEventToTaskMapping, all with RteImmediateRestart=false:
        PhaDiscnct_InitEvent: RtePositionInTask=108, RteEventRef=PhaDiscnct_InitEvent, RteMappedToTaskRef=Task_Init_Appl10
        TMT_PhaDiscnctPer1: RtePositionInTask=29, RteEventRef=TMT_PhaDiscnctPer1, RteMappedToTaskRef=Task_2msA_Appl10, RteUsedOsAlarmRef=Rte_Al_TE_Task_2msA_Appl10_0_2ms
        TMT_PhaDiscnctPer2: RtePositionInTask=30, RteEventRef=TMT_PhaDiscnctPer2, RteMappedToTaskRef=Task_2msA_Appl10, RteUsedOsAlarmRef=Rte_Al_TE_Task_2msA_Appl10_0_2ms
    RvsBattProtn (RteSwComponentType): RteComponentTypeRef=RvsBattProtn, RteImplementationRef=RvsBattProtn_Implementation
      ComponentTypeCalibration (RteComponentTypeCalibration): RteCalibrationSupportEnabled=true
    PhaDiscnct (RteSwComponentType): RteComponentTypeRef=PhaDiscnct, RteImplementationRef=PhaDiscnct_Implementation
      ComponentTypeCalibration (RteComponentTypeCalibration): RteCalibrationSupportEnabled=true
    LoaMgr_EcuSwComposition (RteSwComponentInstance): RteSoftwareComponentInstanceRef=LoaMgr
      LoaMgrExclusiveArea (RteExclusiveAreaImplementation): RteExclusiveAreaImplMechanism=ALL_INTERRUPT_BLOCKING, RteExclusiveAreaRef=LoaMgrExclusiveArea
      LoaMgr_InitEvent (RteEventToTaskMapping): RteImmediateRestart=false, RtePositionInTask=13, RteEventRef=LoaMgr_InitEvent, RteMappedToTaskRef=Task_Init_Appl10
      TMT_LoaMgrPer1 (RteEventToTaskMapping):
        RteImmediateRestart = false
        RtePositionInTask = 2
        RteEventRef = TMT_LoaMgrPer1
        RteMappedToTaskRef = Task_4ms_Appl10
        RteUsedOsAlarmRef = Rte_Al_TE_Task_4ms_Appl10_0_4ms
    LoaMgr (RteSwComponentType): RteComponentTypeRef=LoaMgr, RteImplementationRef=LoaMgr_Implementation
      ComponentTypeCalibration (RteComponentTypeCalibration): RteCalibrationSupportEnabled=true
    CDD_BattRtnCurr_EcuSwComposition (RteSwComponentInstance): RteSoftwareComponentInstanceRef=CDD_BattRtnCurr
      CDD_BattRtnCurr_InitEvent (RteEventToTaskMapping): RteImmediateRestart=false, RtePositionInTask=0, RteEventRef=CDD_BattRtnCurr_InitEvent, RteMappedToTaskRef=Task_Init_Appl8
      TMT_BattRtnCurrPer2 (RteEventToTaskMapping):
        RteImmediateRestart = false
        RtePositionInTask = 1
        RteEventRef = TMT_BattRtnCurrPer2
        RteMappedToTaskRef = Task_2ms_Appl8
        RteUsedOsAlarmRef = Rte_Al_TE_Task_2ms_Appl8_0_2ms
    CDD_BattRtnCurr (RteSwComponentType): RteComponentTypeRef=CDD_BattRtnCurr, RteImplementationRef=CDD_BattRtnCurr_Implementation
      ComponentTypeCalibration (RteComponentTypeCalibration): RteCalibrationSupportEnabled=true
    BmwVehSpd_EcuSwComposition (RteSwComponentInstance): RteSoftwareComponentInstanceRef=BmwVehSpd
      BmwVehSpd_InitEvent (RteEventToTaskMapping): RteImmediateRestart=false, RtePositionInTask=0, RteEventRef=BmwVehSpd_InitEvent, RteMappedToTaskRef=Task_Init_Appl9
      TMT_BmwVehSpdPer1 (RteEventToTaskMapping):
        RteImmediateRestart = false
        RtePositionInTask = 1
        RteEventRef = TMT_BmwVehSpdPer1
        RteMappedToTaskRef = Task_2ms_Appl9
        RteUsedOsAlarmRef = Rte_Al_TE_Task_2ms_Appl9_0_2ms
    BmwVehSpd (RteSwComponentType): RteComponentTypeRef=BmwVehSpd, RteImplementationRef=BmwVehSpd_Implementation
      ComponentTypeCalibration (RteComponentTypeCalibration): RteCalibrationSupportEnabled=true
    Dlog_EcuSwComposition (RteSwComponentInstance): RteSoftwareComponentInstanceRef=Dlog
      27 x RteEventToTaskMapping, all with RteImmediateRestart=false:
        OIEventCCSvkCurrent: RteEventRef=OIEventCCSvkCurrent
        OIEventCCSvkPlant: RteEventRef=OIEventCCSvkPlant
        OIEventCCSvkSystemSupplier: RteEventRef=OIEventCCSvkSystemSupplier
        oie_Vin_ConditionCheckRead: RteEventRef=oie_Vin_ConditionCheckRead
        OIEventDataLengthSvkCurrent: RteEventRef=OIEventDataLengthSvkCurrent
        oie_EcuInfo_GetEcuId: RteEventRef=oie_EcuInfo_GetEcuId
        oie_EcuInfo_GetVin: RteEventRef=oie_EcuInfo_GetVin
        LifeCycleModeSwitchedAck: RtePositionInTask=30, RteEventRef=LifeCycleModeSwitchedAck, RteMappedToTaskRef=Task_10ms_Appl10, RteUsedOsEventRef=Rte_Ev_Run_Dlog_Dlog_ModeSwitchAckLifeCycle
        LifeCycleRequest: RtePositionInTask=31, RteEventRef=LifeCycleRequest, RteMappedToTaskRef=Task_10ms_Appl10, RteUsedOsEventRef=Rte_Ev_Run_Dlog_Dlog_ModeSwitchRequestLifeCycle
        oie_NvMNotifyJobFinished_DlogProgData_JobFinished: RteEventRef=oie_NvMNotifyJobFinished_DlogProgData_JobFinished
        oie_NvMNotifyJobFinished_SvkEntry_JobFinished: RteEventRef=oie_NvMNotifyJobFinished_SvkEntry_JobFinished
        oie_EcuUid_ReadData: RteEventRef=oie_EcuUid_ReadData
        oie_HWModificationIndex_ReadData: RteEventRef=oie_HWModificationIndex_ReadData
        oie_InitBlockProgData_InitBlock: RteEventRef=oie_InitBlockProgData_InitBlock
        OIEventReadEcuSerialNumber: RteEventRef=OIEventReadEcuSerialNumber
        OIEventReadTimingParameters: RteEventRef=OIEventReadTimingParameters
        OIEventReadManufacturingData: RteEventRef=OIEventReadManufacturingData
        OIEventReadSvkCurrent: RteEventRef=OIEventReadSvkCurrent
        OIEventReadSvkPlant: RteEventRef=OIEventReadSvkPlant
        OIEventReadSvkSystemSupplier: RteEventRef=OIEventReadSvkSystemSupplier
        OIEventReadVin: RteEventRef=OIEventReadVin
        OIEventStartReadDevInfoField: RteEventRef=OIEventStartReadDevInfoField
        oie_SweSignatureAccess_GetNumSig: RteEventRef=oie_SweSignatureAccess_GetNumSig
        oie_SweSignatureAccess_GetNumSwe: RteEventRef=oie_SweSignatureAccess_GetNumSwe
        oie_SweSignatureAccess_SweGetSigLength: RteEventRef=oie_SweSignatureAccess_SweGetSigLength
        oie_SweSignatureAccess_SweGetSignature: RteEventRef=oie_SweSignatureAccess_SweGetSignature
        oie_SweSignatureAccess_GetSigStart: RteEventRef=oie_SweSignatureAccess_GetSigStart
    Dlog (RteSwComponentType): RteComponentTypeRef=Dlog, RteImplementationRef=DlogImpl
      ComponentTypeCalibration (RteComponentTypeCalibration): RteCalibrationSupportEnabled=true
    StdDiag_EcuSwComposition (RteSwComponentInstance): RteSoftwareComponentInstanceRef=StdDiag
      13 x RteEventToTaskMapping, all with RteImmediateRestart=false:
        Event_AllowOpModeChange: RteEventRef=Event_AllowOpModeChange
        Event_ConditionCheckActiveSessionState: RteEventRef=Event_ConditionCheckActiveSessionState
        LifeCycleRequest: RtePositionInTask=32, RteEventRef=LifeCycleRequest, RteMappedToTaskRef=Task_10ms_Appl10, RteUsedOsEventRef=Rte_Ev_Run_StdDiag_LifeCycleHandler
        Event_ManufacturerConfirmation: RteEventRef=Event_ManufacturerConfirmation
        Event_ManufacturerIndication: RteEventRef=Event_ManufacturerIndication
        Event_OpModeChangeCancelled: RteEventRef=Event_OpModeChangeCancelled
        Event_ReadDataActiveSessionState: RteEventRef=Event_ReadDataActiveSessionState
        Event_ReadDataSgbdIndex: RteEventRef=Event_ReadDataSgbdIndex
        Event_RoutineControlStartCheckProgrammingPreconditions: RteEventRef=Event_RoutineControlStartCheckProgrammingPreconditions
        Event_RoutineControlStartClearDTCSecondaryErrorMemory: RteEventRef=Event_RoutineControlStartClearDTCSecondaryErrorMemory
        Event_RoutineControlStartDiagCommLoopback: RteEventRef=Event_RoutineControlStartDiagCommLoopback
        Event_SessionChange_DefaultSession: RtePositionInTask=34, RteEventRef=Event_SessionChange_DefaultSession, RteMappedToTaskRef=Task_10ms_Appl10, RteUsedOsEventRef=Rte_Ev_Run_StdDiag_SessionChange_DefaultSession
        Event_SessionChange_OtherSession: RtePositionInTask=35, RteEventRef=Event_SessionChange_OtherSession, RteMappedToTaskRef=Task_10ms_Appl10, RteUsedOsEventRef=Rte_Ev_Run_StdDiag_SessionChange_OtherSession
    Omc_EcuSwComposition (RteSwComponentInstance): RteSoftwareComponentInstanceRef=Omc
      Mode (RteExclusiveAreaImplementation): RteExclusiveAreaImplMechanism=ALL_INTERRUPT_BLOCKING, RteExclusiveAreaRef=Mode
      11 x RteEventToTaskMapping, all with RteImmediateRestart=false:
        E_ChangeExtendedOperatingMode: RteEventRef=E_ChangeExtendedOperatingMode
        E_ChangeOperatingMode: RteEventRef=E_ChangeOperatingMode
        E_ClearEventAllowed: RteEventRef=E_ClearEventAllowed
        E_ConditionCheckReadExtendedOperatingMode: RteEventRef=E_ConditionCheckReadExtendedOperatingMode
        E_ConditionCheckReadDIDOperatingMode: RteEventRef=E_ConditionCheckReadDIDOperatingMode
        LifeCycleRequest: RtePositionInTask=33, RteEventRef=LifeCycleRequest, RteMappedToTaskRef=Task_10ms_Appl10, RteUsedOsEventRef=Rte_Ev_Run_Omc_LifeCycleHandler
        E_NvMNotifyJobFinished: RteEventRef=E_NvMNotifyJobFinished
        E_ReadDIDExtendedOperatingMode: RteEventRef=E_ReadDIDExtendedOperatingMode
        E_ReadOperatingMode: RteEventRef=E_ReadOperatingMode
        E_StdDiag_OpModeSwitchAllowedResult: RteEventRef=E_StdDiag_OpModeSwitchAllowedResult
        E_StdDiag_OpModeSwitchCancelledAck: RteEventRef=E_StdDiag_OpModeSwitchCancelledAck
    Omc (RteSwComponentType): RteComponentTypeRef=Omc, RteImplementationRef=Omc_Implementation
      ComponentTypeCalibration (RteComponentTypeCalibration): RteCalibrationSupportEnabled=true
    Stm_EcuSwComposition (RteSwComponentInstance): RteSoftwareComponentInstanceRef=Stm
      CentralErrorLockReadWrite_EA (RteExclusiveAreaImplementation): RteExclusiveAreaImplMechanism=ALL_INTERRUPT_BLOCKING, RteExclusiveAreaRef=CentralErrorLockReadWrite_EA
      6 x RteEventToTaskMapping, all with RteImmediateRestart=false, RteMappedToTaskRef=Task_10ms_Appl10:
        DRET_Runnable_ErrorCentralErrorLock_CentralErrorLockRx_centralErrorLock: RtePositionInTask=38, RteEventRef=DRET_Runnable_ErrorCentralErrorLock_CentralErrorLockRx_centralErrorLock, RteUsedOsEventRef=Rte_Ev_Run_Stm_Runnable_ErrorCentralErrorLock
        DRET_Runnable_ErrorEnergyMode_EnergyModeRx_energyState: RtePositionInTask=39, RteEventRef=DRET_Runnable_ErrorEnergyMode_EnergyModeRx_energyState, RteUsedOsEventRef=Rte_Ev_Run_Stm_Runnable_ErrorEnergyMode
        MST_Runnable_InitialCELSupervision_0: RtePositionInTask=40, RteEventRef=MST_Runnable_InitialCELSupervision_0, RteUsedOsEventRef=Rte_Ev_Run1_Stm_Runnable_InitialCELSupervision
        DRT_Runnable_ReceiveCentralErrorLock_CentralErrorLockRx_centralErrorLock: RtePositionInTask=41, RteEventRef=DRT_Runnable_ReceiveCentralErrorLock_CentralErrorLockRx_centralErrorLock, RteUsedOsEventRef=Rte_Ev_Run_Stm_Runnable_ReceiveCentralErrorLock
        DRT_Runnable_ReceiveEnergyMode_EnergyModeRx_energyState: RtePositionInTask=42, RteEventRef=DRT_Runnable_ReceiveEnergyMode_EnergyModeRx_energyState, RteUsedOsEventRef=Rte_Ev_Run_Stm_Runnable_ReceiveEnergyMode
        MST_Runnable_StopCentralErrorLockSupervision_0: RtePositionInTask=43, RteEventRef=MST_Runnable_StopCentralErrorLockSupervision_0, RteUsedOsEventRef=Rte_Ev_Run1_Stm_Runnable_StopCentralErrorLockSupervision
    Darh_EcuSwComposition (RteSwComponentInstance): RteSoftwareComponentInstanceRef=Darh
      ExclusiveArea_0 (RteExclusiveAreaImplementation): RteExclusiveAreaImplMechanism=ALL_INTERRUPT_BLOCKING, RteExclusiveAreaRef=ExclusiveArea_0
      12 x RteEventToTaskMapping, all with RteImmediateRestart=false:
        OperationInvokedEvent_ConditionCheckReadActivelyReportedDtc: RteEventRef=OperationInvokedEvent_ConditionCheckReadActivelyReportedDtc
        OperationInvokedEvent_EventDataChanged: RteEventRef=OperationInvokedEvent_EventDataChanged
        OperationInvokedEvent_GetRoeState: RteEventRef=OperationInvokedEvent_GetRoeState
        LifeCycleRequest: RtePositionInTask=36, RteEventRef=LifeCycleRequest, RteMappedToTaskRef=Task_10ms_Appl10, RteUsedOsEventRef=Rte_Ev_Run_Darh_LifeCycleHandler
        TimingEvent: RtePositionInTask=15, RteEventRef=TimingEvent, RteMappedToTaskRef=Task_100ms_Appl10, RteUsedOsEventRef=Rte_Ev_Run1_Darh_QueueHandler, RteUsedOsAlarmRef=Rte_Al_TE_Darh_QueueHandler
        OperationInvokedEvent_ReadActivelyReportedDtc: RteEventRef=OperationInvokedEvent_ReadActivelyReportedDtc
        OperationInvokedEvent_ReadActivelyReportedDtcLength: RteEventRef=OperationInvokedEvent_ReadActivelyReportedDtcLength
        OperationInvokedEvent_SetRoeSuspended: RteEventRef=OperationInvokedEvent_SetRoeSuspended
        OperationInvokedEvent_StartRoutineDiagnoseMaster: RteEventRef=OperationInvokedEvent_StartRoutineDiagnoseMaster
        OperationInvokedEvent_StartRoutineTriggerDtc: RteEventRef=OperationInvokedEvent_StartRoutineTriggerDtc
        OperationInvokedEvent_StopRoutineDiagnoseMaster: RteEventRef=OperationInvokedEvent_StopRoutineDiagnoseMaster
        E_WriteDataBlockNotification: RteEventRef=E_WriteDataBlockNotification
    Stm (RteSwComponentType): RteComponentTypeRef=Stm, RteImplementationRef=Stm_Implementation
      ComponentTypeCalibration (RteComponentTypeCalibration): RteCalibrationSupportEnabled=true
    Darh (RteSwComponentType): RteComponentTypeRef=Darh, RteImplementationRef=Darh_Implementation
      ComponentTypeCalibration (RteComponentTypeCalibration): RteCalibrationSupportEnabled=true
    4 x RteSwComponentInstance:
      Coding_EcuSwComposition: RteSoftwareComponentInstanceRef=Coding
        CodingData (RteExclusiveAreaImplementation): RteExclusiveAreaImplMechanism=ALL_INTERRUPT_BLOCKING, RteExclusiveAreaRef=CodingData
        CodingState (RteExclusiveAreaImplementation): RteExclusiveAreaImplMechanism=ALL_INTERRUPT_BLOCKING, RteExclusiveAreaRef=CodingState
        88 x RteEventToTaskMapping, all with RteImmediateRestart=false:
          E_DemClearEventAllowedNotCoded: RteEventRef=E_DemClearEventAllowedNotCoded
          E_Coding_TimingEvent: RtePositionInTask=16, RteEventRef=E_Coding_TimingEvent, RteMappedToTaskRef=Task_100ms_Appl10, RteUsedOsEventRef=Rte_Ev_Cyclic_Task_100ms_Appl10_0_100ms, RteUsedOsAlarmRef=Rte_Al_TE_Task_100ms_Appl10_0_100ms
          E_DCMConfirmation: RteEventRef=E_DCMConfirmation
          E_DCMIndication: RteEventRef=E_DCMIndication
          E_GetCafIds: RteEventRef=E_GetCafIds
          LifeCycleRequest: RtePositionInTask=14, RteEventRef=LifeCycleRequest, RteMappedToTaskRef=Task_10ms_Appl10, RteUsedOsEventRef=Rte_Ev_Run_Coding_LifeCycleHandler
          E_CheckNCD: RtePositionInTask=0, RteEventRef=E_CheckNCD, RteMappedToTaskRef=Task_Coding_Appl10, RteUsedOsEventRef=Rte_Ev_Run_Coding_R_CheckNCD
          E_ConditionCheckReadCPS: RtePositionInTask=1, RteEventRef=E_ConditionCheckReadCPS, RteMappedToTaskRef=Task_Coding_Appl10, RteUsedOsEventRef=Rte_Ev_Run_Coding_R_ConditionCheckReadCPS
          E_ConditionCheckReadProtocolData: RteEventRef=E_ConditionCheckReadProtocolData
          E_ReadCPS: RtePositionInTask=2, RteEventRef=E_ReadCPS, RteMappedToTaskRef=Task_Coding_Appl10, RteUsedOsEventRef=Rte_Ev_Run_Coding_R_ReadCPS
          E_ReadNCD: RtePositionInTask=3, RteEventRef=E_ReadNCD, RteMappedToTaskRef=Task_Coding_Appl10, RteUsedOsEventRef=Rte_Ev_Run_Coding_R_ReadNCD
          E_ReadProtocolData: RtePositionInTask=4, RteEventRef=E_ReadProtocolData, RteMappedToTaskRef=Task_Coding_Appl10, RteUsedOsEventRef=Rte_Ev_Run_Coding_R_ReadProtocolData
          E_WriteNCD: RtePositionInTask=5, RteEventRef=E_WriteNCD, RteMappedToTaskRef=Task_Coding_Appl10, RteUsedOsEventRef=Rte_Ev_Run_Coding_R_WriteNCD
          E_ExitCodingSession: RtePositionInTask=15, RteEventRef=E_ExitCodingSession, RteMappedToTaskRef=Task_10ms_Appl10, RteUsedOsEventRef=Rte_Ev_Run_Coding_SessionChange
          E_VinReceiveHandler: RtePositionInTask=16, RteEventRef=E_VinReceiveHandler, RteMappedToTaskRef=Task_10ms_Appl10, RteUsedOsEventRef=Rte_Ev_Run_Coding_VinReceiveHandler
          E_WriteDataBlockNotification: RteEventRef=E_WriteDataBlockNotification
          E_GetNAME09_reserved: RteEventRef=E_GetNAME09_reserved
          E_GetNAME05_04_reserved: RteEventRef=E_GetNAME05_04_reserved
          E_GetNAME05_03_reserved: RteEventRef=E_GetNAME05_03_reserved
          E_GetNAME01_02_reserved: RteEventRef=E_GetNAME01_02_reserved
          E_GetNAME01_07_reserved: RteEventRef=E_GetNAME01_07_reserved
          E_GetNAME03_00_reserved: RteEventRef=E_GetNAME03_00_reserved
          E_GetNAME00_06_reserved: RteEventRef=E_GetNAME00_06_reserved
          E_GetNAME00_02_reserved: RteEventRef=E_GetNAME00_02_reserved
          E_GetNAME00_01_CalculationOfActiveReturn: RteEventRef=E_GetNAME00_01_CalculationOfActiveReturn
          E_GetNAME05_00_ActiveFanActuation: RteEventRef=E_GetNAME05_00_ActiveFanActuation
          E_GetNAME11_reserved: RteEventRef=E_GetNAME11_reserved
          E_GetNAME02_06: RteEventRef=E_GetNAME02_06
          E_GetNAME04_00_DrivingDynamicsInterfaceMinusMotorTorque: RteEventRef=E_GetNAME04_00_DrivingDynamicsInterfaceMinusMotorTorque
          E_GetNAME05_01_reserved: RteEventRef=E_GetNAME05_01_reserved
          E_GetNAME04_06_reserved: RteEventRef=E_GetNAME04_06_reserved
          E_GetNAME05_07_reserved: RteEventRef=E_GetNAME05_07_reserved
          E_GetNAME13_reserved: RteEventRef=E_GetNAME13_reserved
          E_GetNAME03_06_reserved: RteEventRef=E_GetNAME03_06_reserved
          E_GetNAME05_06_reserved: RteEventRef=E_GetNAME05_06_reserved
          E_GetSpeedMinuslimitForMaxCurrent: RteEventRef=E_GetSpeedMinuslimitForMaxCurrent
          E_GetNAME04_05_DrivingExperienceSwitch: RteEventRef=E_GetNAME04_05_DrivingExperienceSwitch
          E_GetNAME01_04_reserved: RteEventRef=E_GetNAME01_04_reserved
          E_GetNAME04_04_EPSVibration: RteEventRef=E_GetNAME04_04_EPSVibration
          E_GetNAME10_reserved: RteEventRef=E_GetNAME10_reserved
          E_GetNAME00_00_CalculationOfLoadMinusstateMinusdependentSteeringAssistance: RteEventRef=E_GetNAME00_00_CalculationOfLoadMinusstateMinusdependentSteeringAssistance
          E_GetNAME24_reserved: RteEventRef=E_GetNAME24_reserved
          E_GetNAME25_reserved: RteEventRef=E_GetNAME25_reserved
          E_GetNAME01_05_reserved: RteEventRef=E_GetNAME01_05_reserved
          E_GetNAME04_02_DrivingDynamicsInterfaceMinusFactors: RteEventRef=E_GetNAME04_02_DrivingDynamicsInterfaceMinusFactors
          E_GetNAME18_reserved: RteEventRef=E_GetNAME18_reserved
          E_GetNAME03_03_reserved: RteEventRef=E_GetNAME03_03_reserved
          E_GetNAME23_reserved: RteEventRef=E_GetNAME23_reserved
          E_GetNAME03_02_SpeedDependantDegredation: RteEventRef=E_GetNAME03_02_SpeedDependantDegredation
          E_GetNAME05_05_reserved: RteEventRef=E_GetNAME05_05_reserved
          E_GetNAME02_07: RteEventRef=E_GetNAME02_07
          E_GetCurrentLimit: RteEventRef=E_GetCurrentLimit
          E_GetNAME02_01_CompensationOfConstantSteeringPullAndLateralInclinationPull: RteEventRef=E_GetNAME02_01_CompensationOfConstantSteeringPullAndLateralInclinationPull
          E_GetNAME20_reserved: RteEventRef=E_GetNAME20_reserved
          E_GetNAME27_reserved: RteEventRef=E_GetNAME27_reserved
          E_GetNAME02_00_CompensationOfFriction: RteEventRef=E_GetNAME02_00_CompensationOfFriction
          E_GetNAME03_01_VoltageDependantDegredation: RteEventRef=E_GetNAME03_01_VoltageDependantDegredation
          E_GetNAME17_reserved: RteEventRef=E_GetNAME17_reserved
          E_GetNAME03_07_reserved: RteEventRef=E_GetNAME03_07_reserved
          E_GetNAME00_03_ActiveInfluenceOnTheSteeringHysterisis: RteEventRef=E_GetNAME00_03_ActiveInfluenceOnTheSteeringHysterisis
          E_GetNAME00_07_reserved: RteEventRef=E_GetNAME00_07_reserved
          E_GetNAME01_03_ParkingPowerDamping: RteEventRef=E_GetNAME01_03_ParkingPowerDamping
          E_GetNAME02_02: RteEventRef=E_GetNAME02_02
          E_GetNAME03_05_reserved: RteEventRef=E_GetNAME03_05_reserved
          E_GetNAME02_05_CompensationOfInertiaOfTheSteeringWheel: RteEventRef=E_GetNAME02_05_CompensationOfInertiaOfTheSteeringWheel
          E_GetNAME04_03_DrivingDynamicsInterfaceMinusAdditionalDamping: RteEventRef=E_GetNAME04_03_DrivingDynamicsInterfaceMinusAdditionalDamping
          E_GetNAME02_03: RteEventRef=E_GetNAME02_03
          E_GetNAME22_reserved: RteEventRef=E_GetNAME22_reserved
          E_GetNAME12_reserved: RteEventRef=E_GetNAME12_reserved
          E_GetNAME01_06_reserved: RteEventRef=E_GetNAME01_06_reserved
          E_GetNAME03_04_reserved: RteEventRef=E_GetNAME03_04_reserved
          E_GetNAME05_02_reserved: RteEventRef=E_GetNAME05_02_reserved
          E_GetNAME01_00_reserved: RteEventRef=E_GetNAME01_00_reserved
          E_GetNAME28_reserved: RteEventRef=E_GetNAME28_reserved
          E_GetNAME01_01_reserved: RteEventRef=E_GetNAME01_01_reserved
          E_GetNAME00_05_reserved: RteEventRef=E_GetNAME00_05_reserved
          E_GetNAME15_reserved: RteEventRef=E_GetNAME15_reserved
          E_GetNAME19_reserved: RteEventRef=E_GetNAME19_reserved
          E_GetNAME26_reserved: RteEventRef=E_GetNAME26_reserved
          E_GetNAME04_00_DrivingDynamicsInterfaceMinusDriversTorque: RteEventRef=E_GetNAME04_00_DrivingDynamicsInterfaceMinusDriversTorque
          E_GetNAME29_reserved: RteEventRef=E_GetNAME29_reserved
          E_GetNAME02_04_CompensationOfInertiaOfTheSteeringGear: RteEventRef=E_GetNAME02_04_CompensationOfInertiaOfTheSteeringGear
          E_GetNAME21_reserved: RteEventRef=E_GetNAME21_reserved
          E_GetNAME08_reserved: RteEventRef=E_GetNAME08_reserved
          E_GetNAME14_reserved: RteEventRef=E_GetNAME14_reserved
          E_GetNAME00_04_reserved: RteEventRef=E_GetNAME00_04_reserved
          E_GetNAME04_07_automaticEngineStartStopFunction: RteEventRef=E_GetNAME04_07_automaticEngineStartStopFunction
          E_GetNAME16_reserved: RteEventRef=E_GetNAME16_reserved
      Rmh_EcuSwComposition: RteSoftwareComponentInstanceRef=Rmh
        DataReceivedEvent (RteEventToTaskMapping):
          RteImmediateRestart = false
          RtePositionInTask = 17
          RteEventRef = DataReceivedEvent
          RteMappedToTaskRef = Task_10ms_Appl10
          RteUsedOsEventRef = Rte_Ev_Run_Rmh_RxRequestMsg
      SysTime_EcuSwComposition: RteSoftwareComponentInstanceRef=SysTime
        SysTimeGetTimeArea (RteExclusiveAreaImplementation): RteExclusiveAreaImplMechanism=ALL_INTERRUPT_BLOCKING, RteExclusiveAreaRef=SysTimeGetTimeArea
        4 x RteEventToTaskMapping, all with RteImmediateRestart=false:
          LifeCycleRequest: RtePositionInTask=18, RteEventRef=LifeCycleRequest, RteMappedToTaskRef=Task_10ms_Appl10, RteUsedOsEventRef=Rte_Ev_Run_SysTime_LifeCycleHandler
          TimingEvent: RtePositionInTask=11, RteEventRef=TimingEvent, RteMappedToTaskRef=Task_10ms_Appl10, RteUsedOsEventRef=Rte_Ev_Cyclic_Task_10ms_Appl10_0_10ms, RteUsedOsAlarmRef=Rte_Al_TE_Task_10ms_Appl10_0_10ms
          OpInvokedEventReadDID: RteEventRef=OpInvokedEventReadDID
          SysTimeRx: RtePositionInTask=20, RteEventRef=SysTimeRx, RteMappedToTaskRef=Task_10ms_Appl10, RteUsedOsEventRef=Rte_Ev_Run1_SysTime_ReceiveSignal
      Rmh_Cdd_EcuSwComposition: RteSoftwareComponentInstanceRef=Rmh_Cdd
        OperationInvokedEvent (RteEventToTaskMapping): RteImmediateRestart=false, RtePositionInTask=21, RteEventRef=OperationInvokedEvent, RteMappedToTaskRef=Task_10ms_Appl10
    4 x RteSwComponentType:
      SysTime: RteComponentTypeRef=SysTime, RteImplementationRef=ImplementationSysTime
        ComponentTypeCalibration (RteComponentTypeCalibration): RteCalibrationSupportEnabled=true
      Coding: RteComponentTypeRef=Coding, RteImplementationRef=IMPL_Coding
        ComponentTypeCalibration (RteComponentTypeCalibration): RteCalibrationSupportEnabled=true
      Rmh_Cdd: RteComponentTypeRef=Rmh_Cdd, RteImplementationRef=Rmh_Cdd_Implementation
        ComponentTypeCalibration (RteComponentTypeCalibration): RteCalibrationSupportEnabled=true
      Rmh: RteComponentTypeRef=Rmh, RteImplementationRef=Rmh_Implementation
        ComponentTypeCalibration (RteComponentTypeCalibration): RteCalibrationSupportEnabled=true
